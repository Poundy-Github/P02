VERSION "created by dbc creator v1.0"

NS_ :

BS_:

BU_: T_Box GW DMS DVR HUT Tester

BO_ 793 BCM1: 16 GW
 SG_ IPBackgroundLmpCmd : 18|1@0+ (1,0) [0|1] ""  HUT
 SG_ TrunkSts : 23|1@0+ (1,0) [0|1] ""  HUT,T_Box,DVR
 SG_ DrvDoorSts : 22|1@0+ (1,0) [0|1] ""  HUT,T_Box,DMS,DVR
 SG_ LRDoorSts : 21|1@0+ (1,0) [0|1] ""  HUT,T_Box,DVR
 SG_ PassengerDoorSts : 20|1@0+ (1,0) [0|1] ""  HUT,T_Box,DVR
 SG_ RRDoorSts : 19|1@0+ (1,0) [0|1] ""  HUT,T_Box,DVR
 SG_ BrkPedalSts_BCM : 16|1@0+ (1,0) [0|1] ""  HUT
 SG_ BackgroundLightLvl : 39|8@0+ (1,0) [0|255] ""  HUT
 SG_ DrowsyDrvDetWarn : 44|2@0+ (1,0) [0|3] ""  HUT
 SG_ RLSFailSts : 63|1@0+ (1,0) [0|1] ""  HUT
 SG_ ReversGearSts : 42|2@0+ (1,0) [0|3] ""  T_Box
 SG_ PosnLightReq : 61|1@0+ (1,0) [0|1] ""  HUT
 SG_ FreshnessValue_BCM1 : 71|16@0+ (1,0) [0|65535] ""  HUT,T_Box
 SG_ MAC_Check_BCM1 : 87|48@0+ (1,0) [0|281474976710655] ""  HUT,T_Box
 SG_ BCM1_0x319 : 7|128@0+ (1,0) [0|0] ""  HUT

BO_ 837 BCM3: 16 GW
 SG_ LasHdLmpSts : 35|1@0+ (1,0) [0|1] ""  HUT
 SG_ AntitheftSts : 15|2@0+ (1,0) [0|3] ""  HUT,T_Box,DVR
 SG_ DrvDoorLockSts : 34|1@0+ (1,0) [0|1] ""  HUT,T_Box,DMS
 SG_ DoorLockSts : 13|2@0+ (1,0) [0|3] ""  HUT,T_Box
 SG_ RLDoorLockSts : 11|1@0+ (1,0) [0|1] ""  T_Box
 SG_ PassDoorLockSts : 10|1@0+ (1,0) [0|1] ""  T_Box
 SG_ RRDoorLockSts : 9|1@0+ (1,0) [0|1] ""  T_Box
 SG_ HazardLmpSwtSts : 8|1@0+ (1,0) [0|1] ""  HUT
 SG_ HiLowBeamSts : 33|2@0+ (1,0) [0|2] ""  HUT
 SG_ FreshnessValue_BCM3 : 71|16@0+ (1,0) [0|65535] ""  HUT,T_Box
 SG_ MAC_Check_BCM3 : 87|48@0+ (1,0) [0|281474976710655] ""  HUT,T_Box
 SG_ BCM3_0x345 : 7|128@0+ (1,0) [0|0] ""  HUT

BO_ 652 BCM6: 8 GW
 SG_ VolSwtReq : 16|1@0+ (1,0) [0|1] ""  HUT
 SG_ VolSwtErrSts : 46|1@0+ (1,0) [0|1] ""  HUT
 SG_ BCM6_0x28C : 7|64@0+ (1,0) [0|0] ""  HUT

BO_ 671 BCM8: 8 GW
 SG_ RemoteModSts : 9|1@0+ (1,0) [0|1] "1.0"  HUT,T_Box
 SG_ PASWorkCmd : 8|1@0+ (1,0) [0|1] ""  HUT
 SG_ WhistleSts : 45|1@0+ (1,0) [0|1] ""  T_Box
 SG_ WiprReq_F_Pbox : 51|3@0+ (1,0) [0|7] ""  HUT
 SG_ KL30BRelaySts : 61|1@0+ (1,0) [0|1] ""  HUT
 SG_ BCM8_0x29F : 7|64@0+ (1,0) [0|0] ""  HUT

BO_ 773 BCM11: 8 GW
 SG_ ClsWinRmd : 16|1@0+ (1,0) [0|1] ""  T_Box

BO_ 568 BCM12: 8 GW
 SG_ SrAntiPinch : 47|1@0+ (1,0) [0|1] ""  HUT,T_Box
 SG_ SsPosn_VR_APP : 46|7@0+ (1,0) [0|127] ""  HUT,T_Box
 SG_ SsAntiPinch : 55|1@0+ (1,0) [0|1] ""  HUT,T_Box
 SG_ SrPosn_VR_APP : 54|7@0+ (1,0) [0|127] ""  HUT,T_Box
 SG_ BCM12_0x238 : 7|64@0+ (1,0) [0|0] ""  HUT

BO_ 661 PEPS2: 8 GW
 SG_ SysPowerMod : 15|2@0+ (1,0) [0|3] ""  HUT,T_Box,DMS,DVR
 SG_ SysPowerModVld : 13|1@0+ (1,0) [0|1] ""  HUT,T_Box,DMS,DVR
 SG_ RemUpgrdModSysPower : 39|2@0+ (1,0) [0|3] ""  HUT,T_Box
 SG_ RemPowerFailureSts : 37|2@0+ (1,0) [0|3] ""  T_Box
 SG_ PEPS2_0x295 : 7|64@0+ (1,0) [0|0] ""  HUT

BO_ 770 PEPS4: 8 GW
 SG_ WarnPowerNotInOffPosn : 11|1@0+ (1,0) [0|1] ""  HUT
 SG_ WarnKeyInCarWhenExit : 10|1@0+ (1,0) [0|1] ""  HUT
 SG_ WarnVldKeyNotFound : 9|1@0+ (1,0) [0|1] ""  HUT
 SG_ WarnEngStrtNotMeet : 23|1@0+ (1,0) [0|1] ""  HUT
 SG_ PowerRlyFault : 22|1@0+ (1,0) [0|1] ""  HUT
 SG_ PEPS4_0x302 : 7|64@0+ (1,0) [0|0] ""  HUT

BO_ 53 PEPS5: 8 GW
 SG_ PEPS_T_BoxAuth1 : 7|64@0+ (1,0) [0|1.84467440737095E+019] ""  T_Box

BO_ 70 PEPS11: 8 GW
 SG_ PEPS_T_BoxAuth2 : 7|64@0+ (1,0) [0|1.84467440737096E+019] ""  T_Box

BO_ 669 AC1: 8 GW
 SG_ InCarTemp : 15|8@0+ (0.5,-40) [-40|86.5] "Â°C"  HUT,T_Box
 SG_ ACAQSEnaSts : 16|1@0+ (1,0) [0|1] ""  HUT
 SG_ ACOperMod : 39|3@0+ (1,0) [0|7] ""  HUT
 SG_ ACAIUEnaSts : 36|1@0+ (1,0) [0|1] ""  HUT,T_Box
 SG_ ACDrvAirDistriMod : 23|3@0+ (1,0) [0|7] ""  HUT
 SG_ ACSteplessSpdSetEnaSts : 19|1@0+ (1,0) [0|1] ""  HUT
 SG_ ACFrntPassTempSteplessSetEnaSts : 24|1@0+ (1,0) [0|1] ""  HUT
 SG_ ACDrvTempSteplessSetEnaSts : 25|1@0+ (1,0) [0|1] ""  HUT
 SG_ ACEEMSts : 63|4@0+ (1,0) [0|15] ""  HUT
 SG_ ACCbnClnEnasts : 47|1@0+ (1,0) [0|1] ""  T_Box
 SG_ ACCbnClnOffCode : 46|4@0+ (1,0) [0|15] ""  T_Box
 SG_ AC1_0x29D : 7|64@0+ (1,0) [0|0] ""  HUT

BO_ 901 AC2: 8 GW
 SG_ ACFrntDefrstSts : 40|1@0+ (1,0) [0|1] ""  HUT,T_Box
 SG_ ACHMIDispCmd : 13|2@0+ (1,0) [0|3] ""  HUT,T_Box
 SG_ ACFrntBlwrSpd : 11|4@0+ (1,0) [0|15] ""  HUT,T_Box
 SG_ ACOpenSts : 14|1@0+ (1,0) [0|1] ""  HUT,T_Box
 SG_ ACDualModEnaSts : 39|1@0+ (1,0) [0|1] ""  HUT
 SG_ ACDrvTemp_ATC : 38|6@0+ (0.5,16) [16|32] "Â°C"  HUT,T_Box
 SG_ ACAmbTemp : 23|8@0+ (0.5,-40) [-40|86.5] "Â°C"  HUT
 SG_ ACAirInletSts : 42|2@0+ (1,0) [0|3] ""  HUT
 SG_ ACFrntPasstTemp_ATC : 53|6@0+ (0.5,16) [16|32] "Â°C"  HUT,T_Box
 SG_ ACAutoModEnaSts : 32|1@0+ (1,0) [0|1] ""  HUT,T_Box
 SG_ ACCmprEnaSts : 43|1@0+ (1,0) [0|1] ""  HUT
 SG_ AC_FrntWinHeatEnaSts : 44|1@0+ (1,0) [0|1] ""  HUT
 SG_ AC_FrntWinHeatDislSts : 54|1@0+ (1,0) [0|1] ""  HUT
 SG_ ACAutoDefrstModEnaSts : 63|1@0+ (1,0) [0|1] ""  HUT
 SG_ AC2_0x385 : 7|64@0+ (1,0) [0|0] ""  HUT

BO_ 721 SCM1: 8 GW
 SG_ DrvSeatHeatSts : 15|2@0+ (1,0) [0|3] ""  HUT,T_Box
 SG_ PassSeatHeatSts : 13|2@0+ (1,0) [0|3] ""  HUT,T_Box
 SG_ DrvSeatVentnSts : 11|2@0+ (1,0) [0|3] ""  HUT,T_Box
 SG_ PassSeatVentnSts : 9|2@0+ (1,0) [0|3] ""  HUT,T_Box
 SG_ SCM1_0x2D1 : 7|64@0+ (1,0) [0|0] ""  HUT

BO_ 360 EPS1: 8 GW
 SG_ EPS_FailSts_0x168 : 13|2@0+ (1,0) [0|3] ""  HUT
 SG_ EPS_TrqSnsrSts_0x168 : 14|1@0+ (1,0) [0|1] ""  HUT
 SG_ CheckSum_EPS1_0x168 : 7|8@0+ (1,0) [0|255] ""  HUT
 SG_ EPS_SteerMod_0x168 : 55|3@0+ (1,0) [0|7] ""  HUT
 SG_ RollingCounter_EPS1_0x168 : 59|4@0+ (1,0) [0|15] ""  HUT
 SG_ dummy_EPS1_0 : 15|1@0+ (1,0) [0|1] ""  HUT
 SG_ dummy_EPS1_1 : 11|4@0+ (1,0) [0|15] ""  HUT
 SG_ dummy_EPS1_2 : 23|8@0+ (1,0) [0|255] ""  HUT
 SG_ dummy_EPS1_3 : 31|8@0+ (1,0) [0|255] ""  HUT
 SG_ dummy_EPS1_4 : 39|8@0+ (1,0) [0|255] ""  HUT
 SG_ dummy_EPS1_5 : 47|8@0+ (1,0) [0|255] ""  HUT
 SG_ dummy_EPS1_6 : 52|5@0+ (1,0) [0|31] ""  HUT
 SG_ dummy_EPS1_7 : 63|4@0+ (1,0) [0|15] ""  HUT
 SG_ EPS1_0x168 : 7|64@0+ (1,0) [0|0] ""  HUT

BO_ 354 EPS2: 8 GW
 SG_ EPS_LKATorqOvrlDlvd_0x162 : 47|16@0+ (0.01,-15) [-15|15] "Nm"  HUT
 SG_ EPS_LKATorqOvrlDlvdVld_0x162 : 63|1@0+ (1,0) [0|1] ""  HUT
 SG_ EPS_LKATrqOvlDlvdSts_0x162 : 61|2@0+ (1,0) [0|3] ""  HUT
 SG_ EPS2_0x162 : 7|64@0+ (1,0) [0|0] ""  HUT

BO_ 327 EPS_FD1: 64 GW
 SG_ CheckSum_EPS1_0x147 : 7|8@0+ (1,0) [0|255] ""  HUT
 SG_ EPS_FailSts_0x147 : 13|2@0+ (1,0) [0|3] ""  HUT
 SG_ EPS_TrqSnsrSts_0x147 : 14|1@0+ (1,0) [0|1] ""  HUT
 SG_ EPS_SteerMod_0x147 : 55|3@0+ (1,0) [0|7] ""  HUT
 SG_ RollingCounter_EPS1_0x147 : 59|4@0+ (1,0) [0|15] ""  HUT
 SG_ EPS_LKATorqOvrlDlvd_0x147 : 111|16@0+ (0.01,-15) [-15|15] "Nm"  HUT
 SG_ EPS_LKATorqOvrlDlvdVld_0x147 : 127|1@0+ (1,0) [0|1] ""  HUT
 SG_ EPS_LKATrqOvlDlvdSts_0x147 : 125|2@0+ (1,0) [0|3] ""  HUT
 SG_ dummy_EPS_FD1_0 : 15|1@0+ (1,0) [0|1] ""  HUT
 SG_ dummy_EPS_FD1_1 : 11|4@0+ (1,0) [0|15] ""  HUT
 SG_ dummy_EPS_FD1_2 : 23|8@0+ (1,0) [0|255] ""  HUT
 SG_ dummy_EPS_FD1_3 : 31|8@0+ (1,0) [0|255] ""  HUT
 SG_ dummy_EPS_FD1_4 : 39|8@0+ (1,0) [0|255] ""  HUT
 SG_ dummy_EPS_FD1_5 : 47|8@0+ (1,0) [0|255] ""  HUT
 SG_ dummy_EPS_FD1_6 : 52|5@0+ (1,0) [0|31] ""  HUT
 SG_ dummy_EPS_FD1_7 : 63|4@0+ (1,0) [0|15] ""  HUT
 SG_ EPS_FD1_0x147 : 7|512@0+ (1,0) [0|0] ""  HUT

BO_ 411 F_PBox1: 8 GW
 SG_ FFogLmpSts_F_Pbox : 8|1@0+ (1,0) [0|1] ""  HUT
 SG_ HiBeamSts_F_Pbox : 13|1@0+ (1,0) [0|1] ""  HUT
 SG_ HoodSts_F_Pbox : 21|1@0+ (1,0) [0|1] ""  HUT,T_Box
 SG_ LLasHdLmpDiagSig : 15|1@0+ (1,0) [0|1] ""  HUT
 SG_ RLasHdLmpDiagSig : 14|1@0+ (1,0) [0|1] ""  HUT
 SG_ LasHdLmpSts_F_Pbox : 9|1@0+ (1,0) [0|1] ""  HUT
 SG_ LHiBeamFailSts : 20|1@0+ (1,0) [0|1] ""  HUT
 SG_ RHiBeamFailSts : 19|1@0+ (1,0) [0|1] ""  HUT
 SG_ LLowBeamFailSts : 18|1@0+ (1,0) [0|1] ""  HUT
 SG_ RLowBeamFailSts : 17|1@0+ (1,0) [0|1] ""  HUT
 SG_ LHeadLmpFailSts : 35|1@0+ (1,0) [0|1] ""  HUT
 SG_ RHeadLmpFailSts : 34|1@0+ (1,0) [0|1] ""  HUT
 SG_ WhistleSts_F_Pbox : 32|1@0+ (1,0) [0|1] ""  T_Box
 SG_ F_PBox1_0x19B : 7|64@0+ (1,0) [0|0] ""  HUT

BO_ 357 CSA1: 8 GW
 SG_ LTurnLmpSwtSts : 19|1@0+ (1,0) [0|1] ""  HUT,DMS
 SG_ RTurnLmpSwtSts : 20|1@0+ (1,0) [0|1] ""  HUT,DMS
 SG_ AutoLmpSwtSts : 28|1@0+ (1,0) [0|1] ""  HUT
 SG_ HornSwtSts : 29|1@0+ (1,0) [0|1] ""  HUT,DVR
 SG_ CSA1_0x165 : 7|64@0+ (1,0) [0|0] ""  HUT

BO_ 161 CSA2: 8 GW
 SG_ SteerWheelAng : 15|15@0+ (0.1,0) [0|780] "deg"  HUT,DMS
 SG_ SteerWheelAngSign : 16|1@0+ (1,0) [0|1] ""  HUT,DMS
 SG_ SteerWheelSpd : 31|15@0+ (0.1,0) [0|1016] "degs"  HUT
 SG_ SteerWheelSpdSign : 32|1@0+ (1,0) [0|1] ""  HUT
 SG_ SAS_Sts : 55|2@0+ (1,0) [0|3] ""  HUT
 SG_ HWA_OK_OFFSwt : 60|1@0+ (1,0) [0|1] ""  HUT
 SG_ CSA2_0xA1 : 7|64@0+ (1,0) [0|0] ""  HUT

BO_ 580 CSA3: 8 GW
 SG_ MenuReturnSwtSts : 49|2@0+ (1,0) [0|3] ""  HUT
 SG_ HomeSwtSts : 51|2@0+ (1,0) [0|3] ""  HUT
 SG_ MuteSwtSts : 53|2@0+ (1,0) [0|3] ""  HUT
 SG_ CustomSwtSts : 55|2@0+ (1,0) [0|3] ""  HUT
 SG_ SteerWheelHeatdSts : 40|1@0+ (1,0) [0|1] ""  HUT
 SG_ PageUpSwtSts : 15|2@0+ (1,0) [0|3] ""  HUT
 SG_ PageDwnSwtSts : 13|2@0+ (1,0) [0|3] ""  HUT
 SG_ PageLSwtSts : 11|2@0+ (1,0) [0|3] ""  HUT
 SG_ PageRSwtSts : 9|2@0+ (1,0) [0|3] ""  HUT
 SG_ SeekUpSwtSts : 63|2@0+ (1,0) [0|3] ""  HUT
 SG_ SeekDwnSwtSts : 61|2@0+ (1,0) [0|3] ""  HUT
 SG_ AdjVolUpSwtSts : 23|2@0+ (1,0) [0|3] ""  HUT
 SG_ AdjVolDwnSwtSts : 21|2@0+ (1,0) [0|3] ""  HUT
 SG_ VRSwtSts : 19|2@0+ (1,0) [0|3] ""  HUT
 SG_ PhoneSwtSts : 29|2@0+ (1,0) [0|3] ""  HUT
 SG_ SoundSourceModSwtSts : 17|2@0+ (1,0) [0|3] ""  HUT
 SG_ EnterSwtSts : 31|2@0+ (1,0) [0|3] ""  HUT
 SG_ EnterSwtSts_Mmed : 27|2@0+ (1,0) [0|3] ""  HUT
 SG_ CustomSwtSts_Mmed : 39|2@0+ (1,0) [0|3] ""  HUT
 SG_ CSA3_0x244 : 7|64@0+ (1,0) [0|0] ""  HUT

BO_ 593 Haldex1: 8 GW
 SG_ DiagLmpReq : 14|1@0+ (1,0) [0|1] ""  HUT
 SG_ CouplingThermWarning : 10|1@0+ (1,0) [0|1] ""  HUT
 SG_ CouplingFaultSts : 9|2@0+ (1,0) [0|3] ""  HUT
 SG_ EstimatedTorque : 47|16@0+ (0.25,0) [0|3000] "Nm"  HUT
 SG_ Haldex1_0x251 : 7|64@0+ (1,0) [0|0] ""  HUT

BO_ 698 WPC1: 8 GW
 SG_ WPC_ChrgSts : 13|2@0+ (1,0) [0|3] ""  HUT
 SG_ WPC_SwtSts : 15|2@0+ (1,0) [0|3] ""  HUT
 SG_ WPC_FaultSts : 11|3@0+ (1,0) [0|7] ""  HUT
 SG_ WPC_PhoneReminder : 8|1@0+ (1,0) [0|1] ""  HUT
 SG_ WPC1_0x2BA : 7|64@0+ (1,0) [0|0] ""  HUT

BO_ 993 AMP1: 8 GW
 SG_ AMP_SWVersion : 7|16@0+ (1,0) [0|65535] ""  HUT
 SG_ AMP_HWVersion : 23|16@0+ (1,0) [0|65535] ""  HUT
 SG_ AMP_Chan1DTCInfo : 39|1@0+ (1,0) [0|1] ""  HUT
 SG_ AMP_Chan2DTCInfo : 38|1@0+ (1,0) [0|1] ""  HUT
 SG_ AMP_Chan3DTCInfo : 37|1@0+ (1,0) [0|1] ""  HUT
 SG_ AMP_Chan4DTCInfo : 36|1@0+ (1,0) [0|1] ""  HUT
 SG_ AMP_Chan5DTCInfo : 35|1@0+ (1,0) [0|1] ""  HUT
 SG_ AMP_Chan6DTCInfo : 34|1@0+ (1,0) [0|1] ""  HUT
 SG_ AMP_Chan7DTCInfo : 33|1@0+ (1,0) [0|1] ""  HUT
 SG_ AMP_Chan8DTCInfo : 32|1@0+ (1,0) [0|1] ""  HUT
 SG_ AMP_TempValue : 47|8@0+ (1,-50) [-50|204] ""  HUT
 SG_ AMP_TempSts : 55|2@0+ (1,0) [0|3] ""  HUT
 SG_ AMP_VolValue : 63|8@0+ (0.1,0) [0|25.5] ""  HUT
 SG_ BestListegPosnResp : 52|3@0+ (1,0) [0|7] ""  HUT
 SG_ Clari_FiResp : 53|1@0+ (1,0) [0|1] ""  HUT
 SG_ AMP1_0x3E1 : 7|64@0+ (1,0) [0|0] ""  HUT

BO_ 995 AMP2: 16 GW
 SG_ MediaCallSourceState : 7|4@0+ (1,0) [0|15] ""  HUT
 SG_ BeepSourceSts : 2|3@0+ (1,0) [0|7] ""  HUT
 SG_ BalanceSetState : 15|5@0+ (1,0) [0|20] ""  HUT
 SG_ VSCModeState : 9|2@0+ (1,0) [0|3] ""  HUT
 SG_ FadeSetState : 23|5@0+ (1,0) [0|20] ""  HUT
 SG_ DriveSideSts : 17|1@0+ (1,0) [0|1] ""  HUT
 SG_ BassSetState : 31|5@0+ (1,0) [0|20] ""  HUT
 SG_ MuteState : 25|1@0+ (1,0) [0|1] ""  HUT
 SG_ NaviSourceState : 39|3@0+ (1,0) [0|7] ""  HUT
 SG_ MidrangeSetState : 47|5@0+ (1,0) [0|20] ""  HUT
 SG_ T_box_ECallSts : 42|1@0+ (1,0) [0|1] ""  HUT
 SG_ GetHUTInfoSts : 41|1@0+ (1,0) [0|1] ""  HUT
 SG_ TrebleSetState : 55|5@0+ (1,0) [0|20] ""  HUT
 SG_ QLISurroundSetSt : 49|1@0+ (1,0) [0|1] ""  HUT
 SG_ AVMStResp : 3|1@0+ (1,0) [0|1] ""  HUT
 SG_ NaviMediaVolLvlResp : 63|4@0+ (1,0) [0|15] ""  HUT
 SG_ AVMMediaVolLvlResp : 59|4@0+ (1,0) [0|15] ""  HUT
 SG_ FPASChStResp : 10|1@0+ (1,0) [0|1] ""  HUT
 SG_ RPASChStResp : 18|1@0+ (1,0) [0|1] ""  HUT
 SG_ FreshnessValue_AMP2 : 71|16@0+ (1,0) [0|65535] ""  HUT
 SG_ MAC_Check_AMP2 : 87|48@0+ (1,0) [0|281474976710655] ""  HUT
 SG_ AMP2_0x3E3 : 7|128@0+ (1,0) [0|0] ""  HUT

BO_ 997 AMP3: 8 GW
 SG_ HFMVolSetSts : 7|6@0+ (1,0) [0|39] ""  HUT
 SG_ VR_TTSVolSetSts : 15|6@0+ (1,0) [0|39] ""  HUT
 SG_ NaviVolumeSetState : 23|6@0+ (1,0) [0|39] ""  HUT
 SG_ MainVolumeSetState : 31|6@0+ (1,0) [0|39] ""  HUT
 SG_ AMPPowerSts : 42|1@0+ (1,0) [0|1] ""  HUT
 SG_ IPVolSetSts : 39|6@0+ (1,0) [0|39] ""  HUT
 SG_ AMP3_0x3E5 : 7|64@0+ (1,0) [0|0] ""  HUT

BO_ 722 AMP4_ANC1: 8 GW
 SG_ Microphone_Cha1DTCInfo : 63|1@0+ (1,0) [0|1] ""  HUT
 SG_ Microphone_Cha2DTCInfo : 62|1@0+ (1,0) [0|1] ""  HUT
 SG_ Microphone_Cha3DTCInfo : 61|1@0+ (1,0) [0|1] ""  HUT
 SG_ Microphone_Cha4DTCInfo : 60|1@0+ (1,0) [0|1] ""  HUT
 SG_ ANCSwtStatus : 58|1@0+ (1,0) [0|1] ""  HUT
 SG_ AMP4_ANC1_0x2D2 : 7|64@0+ (1,0) [0|0] ""  HUT

BO_ 929 AMP5_IESS1: 8 GW
 SG_ IESS_SwitchModel : 53|2@0+ (1,0) [0|3] ""  HUT
 SG_ AMP5_IESS1_0x3A1 : 7|64@0+ (1,0) [0|0] ""  HUT

BO_ 805 HUD1: 8 GW
 SG_ HUD_SwtSts : 8|1@0+ (1,0) [0|1] ""  HUT
 SG_ HUD_BrightnessLvl : 15|4@0+ (1,0) [0|15] ""  HUT
 SG_ HUD_HeightLvl : 22|5@0+ (1,0) [0|31] ""  HUT
 SG_ HUD_UIMod : 60|1@0+ (1,0) [0|1] ""  HUT
 SG_ HUD_UIModVld : 61|1@0+ (1,0) [0|1] ""  HUT
 SG_ HUD_Manufactor : 47|3@0+ (1,0) [0|7] ""  HUT
 SG_ HUD_ReslType : 44|3@0+ (1,0) [0|7] ""  HUT
 SG_ HUD1_0x325 : 7|64@0+ (1,0) [0|0] ""  HUT

BO_ 412 R_PBox1: 16 GW
 SG_ HiPosnBrkLmpFailSts : 15|1@0+ (1,0) [0|1] ""  HUT
 SG_ LicPlateLmpFailSts : 14|1@0+ (1,0) [0|1] ""  HUT
 SG_ LBrkLmpFailSts : 13|1@0+ (1,0) [0|1] ""  HUT
 SG_ RFogLmpFailSts_R_Pbox : 29|1@0+ (1,0) [0|1] ""  HUT
 SG_ RFogLmpSts_R_Pbox : 28|1@0+ (1,0) [0|1] ""  HUT
 SG_ ParkLmpSts_R_Pbox : 26|1@0+ (1,0) [0|1] ""  HUT
 SG_ RBrkLmpFailSts : 12|1@0+ (1,0) [0|1] ""  HUT
 SG_ PosnLmpOutpSts_R_Pbox : 11|1@0+ (1,0) [0|1] ""  HUT
 SG_ RRPosnLmpFailSts : 10|1@0+ (1,0) [0|1] ""  HUT
 SG_ RvsLmpFailSts : 9|1@0+ (1,0) [0|1] ""  HUT
 SG_ LRPosnLmpFailSts : 8|1@0+ (1,0) [0|1] ""  HUT
 SG_ RTurnLmpFailSts : 19|2@0+ (1,0) [0|3] ""  HUT
 SG_ LTurnLmpFailSts : 17|2@0+ (1,0) [0|3] ""  HUT
 SG_ LTurnLmpSts_R_Pbox : 31|1@0+ (1,0) [0|1] ""  HUT,T_Box
 SG_ RTurnLmpSts_R_Pbox : 30|1@0+ (1,0) [0|1] ""  HUT,T_Box
 SG_ RWinHeatgIconRlyCmd : 21|1@0+ (1,0) [0|1] ""  HUT,T_Box
 SG_ RWinHeatgFailSts : 20|1@0+ (1,0) [0|1] ""  HUT
 SG_ FreshnessValue_R_PBox1 : 71|16@0+ (1,0) [0|65535] ""  HUT,T_Box
 SG_ MAC_Check_R_PBox1 : 87|48@0+ (1,0) [0|281474976710655] ""  HUT,T_Box
 SG_ R_PBox1_0x19C : 7|128@0+ (1,0) [0|0] ""  HUT

BO_ 849 ABM1: 16 GW
 SG_ CheckSum_ABM1 : 7|8@0+ (1,0) [0|255] ""  HUT
 SG_ SecRowLSBR : 14|1@0+ (1,0) [0|1] ""  HUT
 SG_ AirbFailLmpCmd : 13|1@0+ (1,0) [0|1] ""  HUT
 SG_ SecRowMidSBR : 12|1@0+ (1,0) [0|1] ""  HUT
 SG_ DrvSBR : 11|1@0+ (1,0) [0|1] ""  HUT
 SG_ SecRowRSBR : 10|1@0+ (1,0) [0|1] ""  HUT
 SG_ PassSBR : 9|1@0+ (1,0) [0|1] ""  HUT
 SG_ PassSBR_Visual : 27|2@0+ (1,0) [0|3] ""  HUT
 SG_ DrvSBR_Visual : 25|2@0+ (1,0) [0|3] ""  HUT
 SG_ SecRowLSBR_Visual : 29|2@0+ (1,0) [0|3] ""  HUT
 SG_ SecRowMidSBR_Visual : 31|2@0+ (1,0) [0|3] ""  HUT
 SG_ SecRowRSBR_Visual : 33|2@0+ (1,0) [0|3] ""  HUT
 SG_ CrashOutputSts : 23|8@0+ (1,0) [0|18] ""  HUT,T_Box,DVR
 SG_ RollingCounter_ABM1 : 59|4@0+ (1,0) [0|15] ""  HUT
 SG_ FreshnessValue_ABM1 : 71|16@0+ (1,0) [0|65535] ""  HUT,T_Box
 SG_ MAC_Check_ABM1 : 87|48@0+ (1,0) [0|281474976710655] ""  HUT,T_Box
 SG_ dummy_ABM1_0 : 15|1@0+ (1,0) [0|1] ""  HUT
 SG_ dummy_ABM1_1 : 8|1@0+ (1,0) [0|1] ""  HUT
 SG_ dummy_ABM1_2 : 39|6@0+ (1,0) [0|63] ""  HUT
 SG_ dummy_ABM1_3 : 47|8@0+ (1,0) [0|255] ""  HUT
 SG_ dummy_ABM1_4 : 55|8@0+ (1,0) [0|255] ""  HUT
 SG_ dummy_ABM1_5 : 63|4@0+ (1,0) [0|15] ""  HUT
 SG_ ABM1_0x351 : 7|128@0+ (1,0) [0|0] ""  HUT

BO_ 581 ABM2: 8 GW
 SG_ VehLgtAccel : 15|16@0+ (0.00098,-21.592) [-21.592|21.592] "ms^2"  HUT
 SG_ VehLatAccel : 31|16@0+ (0.00098,-21.592) [-21.592|21.592] "ms^2"  HUT
 SG_ VehYawRate : 47|16@0+ (0.00024,-2.093) [-2.093|2.093] "rads"  HUT
 SG_ VehLgtAccelVld : 63|1@0+ (1,0) [0|1] ""  HUT
 SG_ VehLatAccelVld : 62|1@0+ (1,0) [0|1] ""  HUT
 SG_ VehDynYawRateVld : 61|1@0+ (1,0) [0|1] ""  HUT
 SG_ ABM2_0x245 : 7|64@0+ (1,0) [0|0] ""  HUT

BO_ 833 TPMS1: 16 GW
 SG_ FLTirePressIndSts : 15|3@0+ (1,0) [0|7] ""  HUT,T_Box
 SG_ FRTirePressIndSts : 12|3@0+ (1,0) [0|7] ""  HUT,T_Box
 SG_ TirePressSysFailrIndcn : 9|2@0+ (1,0) [0|3] ""  HUT,T_Box
 SG_ RLTirePressIndSts : 23|3@0+ (1,0) [0|7] ""  HUT,T_Box
 SG_ RRTirePressIndSts : 20|3@0+ (1,0) [0|7] ""  HUT,T_Box
 SG_ FLTireTempSts : 31|2@0+ (1,0) [0|3] ""  HUT,T_Box
 SG_ FRTireTempSts : 29|2@0+ (1,0) [0|3] ""  HUT,T_Box
 SG_ RLTireTempSts : 27|2@0+ (1,0) [0|3] ""  HUT,T_Box
 SG_ RRTireTempSts : 25|2@0+ (1,0) [0|3] ""  HUT,T_Box
 SG_ TPMS_AutoLoctSts : 39|4@0+ (1,0) [0|5] ""  T_Box
 SG_ FreshnessValue_TPMS1 : 71|16@0+ (1,0) [0|65535] ""  HUT,T_Box
 SG_ MAC_Check_TPMS1 : 87|48@0+ (1,0) [0|281474976710655] ""  HUT,T_Box
 SG_ TPMS1_0x341 : 7|128@0+ (1,0) [0|0] ""  HUT

BO_ 917 TPMS2: 16 GW
 SG_ FLTirePress : 7|8@0+ (1.3725,0) [0|348.615] "kPa"  HUT,T_Box
 SG_ FLTireTemp : 15|8@0+ (1,-50) [-50|204] "Â°C"  HUT,T_Box
 SG_ FRTirePress : 23|8@0+ (1.3725,0) [0|348.615] "kPa"  HUT,T_Box
 SG_ FRTireTemp : 31|8@0+ (1,-50) [-50|204] "Â°C"  HUT,T_Box
 SG_ RLTirePress : 39|8@0+ (1.3725,0) [0|348.615] "kPa"  HUT,T_Box
 SG_ RLTireTemp : 47|8@0+ (1,-50) [-50|204] "Â°C"  HUT,T_Box
 SG_ RRTirePress : 55|8@0+ (1.3725,0) [0|348.615] "kPa"  HUT,T_Box
 SG_ RRTireTemp : 63|8@0+ (1,-50) [-50|204] "Â°C"  HUT,T_Box
 SG_ FreshnessValue_TPMS2 : 71|16@0+ (1,0) [0|65535] ""  HUT,T_Box
 SG_ MAC_Check_TPMS2 : 87|48@0+ (1,0) [0|281474976710655] ""  HUT,T_Box
 SG_ TPMS2_0x395 : 7|128@0+ (1,0) [0|0] ""  HUT

BO_ 627 Trailer1: 8 GW
 SG_ TrailerSts : 7|1@0+ (1,0) [0|1] ""  HUT
 SG_ Trailer1_0x273 : 7|64@0+ (1,0) [0|0] ""  HUT

BO_ 622 RPAS1: 8 GW
 SG_ RPAS_RLCornrSnsrFailSts_0x26e : 47|1@0+ (1,0) [0|1] ""  HUT
 SG_ RPAS_RLMiddlSnsrFailSts_0x26e : 46|1@0+ (1,0) [0|1] ""  HUT
 SG_ RPAS_RRMiddlSnsrFailSts_0x26e : 45|1@0+ (1,0) [0|1] ""  HUT
 SG_ RPAS_RRCornrSnsrFailSts_0x26e : 44|1@0+ (1,0) [0|1] ""  HUT
 SG_ RPAS_WorkSts_0x26e : 43|2@0+ (1,0) [0|3] ""  HUT
 SG_ RPAS_SoundIndcn_0x26e : 55|2@0+ (1,0) [0|3] ""  HUT
 SG_ MEBWorkSts_0x26e : 52|2@0+ (1,0) [0|3] ""  HUT
 SG_ MEB_EnableSts_0x26e : 50|1@0+ (1,0) [0|1] ""  HUT
 SG_ RPAS_ObjRRCornrAr1_0x26e : 15|4@0+ (1,0) [0|15] ""  HUT
 SG_ RPAS_ObjRRCornrAr2_0x26e : 11|4@0+ (1,0) [0|15] ""  HUT
 SG_ RPAS_ObjRRMidlAr1_0x26e : 23|4@0+ (1,0) [0|15] ""  HUT
 SG_ RPAS_ObjRRMidlAr2_0x26e : 19|4@0+ (1,0) [0|15] ""  HUT
 SG_ RPAS_ObjRLMidlAr1_0x26e : 31|4@0+ (1,0) [0|15] ""  HUT
 SG_ RPAS_ObjRLMidlAr2_0x26e : 27|4@0+ (1,0) [0|15] ""  HUT
 SG_ RPAS_ObjRLCornrAr1_0x26e : 39|4@0+ (1,0) [0|15] ""  HUT
 SG_ RPAS_ObjRLCornrAr2_0x26e : 35|4@0+ (1,0) [0|15] ""  HUT
 SG_ RPAS1_0x26E : 7|64@0+ (1,0) [0|0] ""  HUT

BO_ 347 HAP_FD1: 64 GW
 SG_ APS_PrkgMod : 117|2@0+ (1,0) [0|3] ""  HUT
 SG_ APS_ProcBar : 111|7@0+ (1,0) [0|127] "%"  HUT
 SG_ APS_SwtSts : 104|1@0+ (1,0) [0|1] ""  HUT
 SG_ APS_SlotDisp : 76|3@0+ (1,0) [0|7] ""  HUT
 SG_ APS_SysSoundIndcn : 79|3@0+ (1,0) [0|7] ""  HUT
 SG_ APS_PrkgTyp : 119|2@0+ (1,0) [0|3] ""  HUT
 SG_ APS_TextDisp : 103|8@0+ (1,0) [0|63] ""  HUT
 SG_ APS_WorkSts : 146|3@0+ (1,0) [0|7] ""  HUT,DVR
 SG_ MEB_AVHReq : 168|1@0+ (1,0) [0|1] ""  HUT,DVR
 SG_ LParaPrkgOutVald : 283|1@0+ (1,0) [0|1] ""  HUT
 SG_ RParaPrkgOutVald : 282|1@0+ (1,0) [0|1] ""  HUT
 SG_ HeadVertPrkgOutVald : 281|1@0+ (1,0) [0|1] ""  HUT
 SG_ TailVertPrkgOutVald : 280|1@0+ (1,0) [0|1] ""  HUT
 SG_ HAP_SwtDispCtrlCmd : 279|3@0+ (1,0) [0|7] ""  HUT
 SG_ P2P_PahDelSts : 265|2@0+ (1,0) [0|3] ""  HUT
 SG_ P2P_SelfDetErrCode : 276|4@0+ (1,0) [0|15] ""  HUT
 SG_ P2P_SelfDetSts : 287|2@0+ (1,0) [0|3] ""  HUT
 SG_ P2P_Pah1Avail : 272|1@0+ (1,0) [0|1] ""  HUT
 SG_ P2P_Pah2Avail : 285|1@0+ (1,0) [0|1] ""  HUT
 SG_ HAP_PrkgModCurrSts : 269|4@0+ (1,0) [0|15] ""  HUT
 SG_ APS_MovgDirc : 295|2@0+ (1,0) [0|3] ""  HUT
 SG_ HAP_FD1_0x15B : 7|512@0+ (1,0) [0|0] ""  HUT

BO_ 628 HAP_FD2: 64 GW
 SG_ AutoAVMSwtSet_Sts : 83|1@0+ (1,0) [0|1] ""  HUT
 SG_ AVM_CurrSts : 79|2@0+ (1,0) [0|3] ""  HUT
 SG_ GuidOvlSts : 95|2@0+ (1,0) [0|3] ""  HUT
 SG_ FrntCamInpFailSts : 108|1@0+ (1,0) [0|1] ""  HUT
 SG_ RearCamInpFailSts : 109|1@0+ (1,0) [0|1] ""  HUT
 SG_ LeCamInpFailSts : 110|1@0+ (1,0) [0|1] ""  HUT
 SG_ RiCamInpFailSts : 111|1@0+ (1,0) [0|1] ""  HUT
 SG_ EolNotCmpltd : 107|1@0+ (1,0) [0|1] ""  HUT
 SG_ OvlOpFailSts : 105|1@0+ (1,0) [0|1] ""  HUT
 SG_ LaneCalSts : 101|2@0+ (1,0) [0|3] ""  HUT
 SG_ RadarDispSts : 93|2@0+ (1,0) [0|3] ""  HUT
 SG_ LaneCalFltSts : 99|3@0+ (1,0) [0|7] ""  HUT
 SG_ AutoViewChgFuncSts : 84|1@0+ (1,0) [0|1] ""  HUT
 SG_ CarMdlTrsprcySts : 103|2@0+ (1,0) [0|3] ""  HUT
 SG_ CarMdlDispSts : 85|1@0+ (1,0) [0|1] ""  HUT
 SG_ CurrCalResultSts : 96|1@0+ (1,0) [0|1] ""  HUT
 SG_ MdlColrSts : 91|4@0+ (1,0) [0|15] ""  HUT
 SG_ SigViewIndcn : 77|6@0+ (1,0) [0|63] ""  HUT
 SG_ HAP_DispCmd : 127|1@0+ (1,0) [0|1] ""  HUT
 SG_ AVM_3DAngSts : 104|9@0+ (1,0) [0|360] "deg"  HUT
 SG_ MOD_WorkSts : 87|1@0+ (1,0) [0|1] ""  HUT
 SG_ HAP_Hmi_Index : 82|3@0+ (1,0) [0|7] ""  HUT
 SG_ DVRWorkSts : 126|2@0+ (1,0) [0|3] ""  HUT,DVR
 SG_ MOD_AlarmSts : 86|1@0+ (1,0) [0|1] ""  HUT
 SG_ HAP_FD2_0x274 : 7|512@0+ (1,0) [0|0] ""  HUT

BO_ 664 HAP_FD3: 64 GW
 SG_ RPAS_NearBrrdstn_0x298 : 15|8@0+ (1,0) [0|150] ""  HUT,DVR
 SG_ APS_ObjRiSideAr1 : 79|4@0+ (1,0) [0|15] ""  HUT
 SG_ APS_ObjRiSideAr2 : 75|4@0+ (1,0) [0|15] ""  HUT
 SG_ APS_ObjRiSideAr3 : 87|4@0+ (1,0) [0|15] ""  HUT
 SG_ APS_ObjRiSideAr4 : 83|4@0+ (1,0) [0|15] ""  HUT
 SG_ APS_ObjRiSideAr5 : 95|4@0+ (1,0) [0|15] ""  HUT
 SG_ APS_ObjLeSideAr1 : 91|4@0+ (1,0) [0|15] ""  HUT
 SG_ APS_ObjLeSideAr2 : 103|4@0+ (1,0) [0|15] ""  HUT
 SG_ APS_ObjLeSideAr3 : 99|4@0+ (1,0) [0|15] ""  HUT
 SG_ APS_ObjLeSideAr4 : 111|4@0+ (1,0) [0|15] ""  HUT
 SG_ APS_ObjLeSideAr5 : 107|4@0+ (1,0) [0|15] ""  HUT
 SG_ APS_FRSideSnsrFailSts : 119|1@0+ (1,0) [0|1] ""  HUT
 SG_ APS_FLSideSnsrFailSts : 118|1@0+ (1,0) [0|1] ""  HUT
 SG_ APS_RRSideSnsrFailSts : 117|1@0+ (1,0) [0|1] ""  HUT
 SG_ APS_RLSideSnsrFailSts : 116|1@0+ (1,0) [0|1] ""  HUT
 SG_ SDW_SoundIndcn : 115|2@0+ (1,0) [0|3] ""  HUT
 SG_ SDWActiveSts : 112|1@0+ (1,0) [0|1] ""  HUT
 SG_ RPAS_ObjRRCornrAr1_0x298 : 143|4@0+ (1,0) [0|15] ""  HUT
 SG_ RPAS_ObjRRCornrAr2_0x298 : 139|4@0+ (1,0) [0|15] ""  HUT
 SG_ RPAS_ObjRRMidlAr1_0x298 : 151|4@0+ (1,0) [0|15] ""  HUT
 SG_ RPAS_ObjRRMidlAr2_0x298 : 147|4@0+ (1,0) [0|15] ""  HUT
 SG_ RPAS_ObjRLMidlAr1_0x298 : 159|4@0+ (1,0) [0|15] ""  HUT
 SG_ RPAS_ObjRLMidlAr2_0x298 : 155|4@0+ (1,0) [0|15] ""  HUT
 SG_ RPAS_ObjRLCornrAr1_0x298 : 167|4@0+ (1,0) [0|15] ""  HUT
 SG_ RPAS_ObjRLCornrAr2_0x298 : 163|4@0+ (1,0) [0|15] ""  HUT
 SG_ RPAS_RLCornrSnsrFailSts_0x298 : 175|1@0+ (1,0) [0|1] ""  HUT
 SG_ RPAS_RLMiddlSnsrFailSts_0x298 : 174|1@0+ (1,0) [0|1] ""  HUT
 SG_ RPAS_RRMiddlSnsrFailSts_0x298 : 173|1@0+ (1,0) [0|1] ""  HUT
 SG_ RPAS_RRCornrSnsrFailSts_0x298 : 172|1@0+ (1,0) [0|1] ""  HUT
 SG_ RPAS_WorkSts_0x298 : 171|2@0+ (1,0) [0|3] ""  HUT
 SG_ RPAS_SoundIndcn_0x298 : 183|2@0+ (1,0) [0|3] ""  HUT
 SG_ MEBWorkSts_0x298 : 180|2@0+ (1,0) [0|3] ""  HUT
 SG_ MEB_EnableSts_0x298 : 178|1@0+ (1,0) [0|1] ""  HUT
 SG_ FPAS_ObjFLCornrAr1_0x298 : 207|4@0+ (1,0) [0|15] ""  HUT
 SG_ FPAS_ObjFLCornrAr2_0x298 : 203|4@0+ (1,0) [0|15] ""  HUT
 SG_ FPAS_ObjFLMidlAr1_0x298 : 215|4@0+ (1,0) [0|15] ""  HUT
 SG_ FPAS_ObjFLMidlAr2_0x298 : 211|4@0+ (1,0) [0|15] ""  HUT
 SG_ FPAS_ObjFRMidlAr1_0x298 : 223|4@0+ (1,0) [0|15] ""  HUT
 SG_ FPAS_ObjFRMidlAr2_0x298 : 219|4@0+ (1,0) [0|15] ""  HUT
 SG_ FPAS_ObjFRCornrAr1_0x298 : 231|4@0+ (1,0) [0|15] ""  HUT
 SG_ FPAS_ObjFRCornrAr2_0x298 : 227|4@0+ (1,0) [0|15] ""  HUT
 SG_ FPAS_FLCornrSnsrFailSts : 239|1@0+ (1,0) [0|1] ""  HUT
 SG_ FPAS_FLMiddlSnsrFailSts : 238|1@0+ (1,0) [0|1] ""  HUT
 SG_ FPAS_FRMiddlSnsrFailSts : 237|1@0+ (1,0) [0|1] ""  HUT
 SG_ FPAS_FRCornrSnsrFailSts : 236|1@0+ (1,0) [0|1] ""  HUT
 SG_ FPAS_WorkSts_0x298 : 235|2@0+ (1,0) [0|3] ""  HUT
 SG_ FPAS_AutoModSts_0x298 : 232|1@0+ (1,0) [0|1] ""  HUT
 SG_ FPAS_SoundIndcn_0x298 : 247|2@0+ (1,0) [0|3] ""  HUT
 SG_ FPAS_NearBrrdstn_0x298 : 242|7@0+ (1,0) [0|100] ""  HUT,DVR
 SG_ APA_MenuDispCtrlCmd : 279|4@0+ (1,0) [0|15] ""  HUT
 SG_ APA_FuncSts : 271|2@0+ (1,0) [0|3] ""  HUT
 SG_ P2P_FuncSts : 269|2@0+ (1,0) [0|3] ""  HUT
 SG_ RADS_FuncSts : 267|2@0+ (1,0) [0|3] ""  HUT
 SG_ FADS_FuncSts : 265|2@0+ (1,0) [0|3] ""  HUT
 SG_ HAP_TextIconDispCtrl : 275|2@0+ (1,0) [0|3] ""  HUT
 SG_ HAP_FD3_0x298 : 7|512@0+ (1,0) [0|0] ""  HUT

BO_ 649 HAP_FD6: 64 GW
 SG_ HAP_RtCam_WorkSts : 61|2@0+ (1,0) [0|3] ""  HUT
 SG_ HAP_RtSide_Obj1_ID : 15|4@0+ (1,0) [0|3] ""  HUT
 SG_ HAP_RtSide_Obj1_type : 11|3@0+ (1,0) [0|7] ""  HUT
 SG_ HAP_RtSide_Obj1_Confidence : 27|4@0+ (0.1,0) [0|1] ""  HUT
 SG_ HAP_RtSide_Obj1_Ground_Pos_X : 23|12@0+ (0.01,0) [0|40] "m"  HUT
 SG_ HAP_RtSide_Obj1_Ground_Pos_Y : 39|12@0+ (0.01,-20) [-20|20] "m"  HUT
 SG_ HAP_RtSide_Obj2_ID : 79|4@0+ (1,0) [0|3] ""  HUT
 SG_ HAP_RtSide_Obj2_type : 75|3@0+ (1,0) [0|7] ""  HUT
 SG_ HAP_RtSide_Obj2_Confidence : 91|4@0+ (0.1,0) [0|1] ""  HUT
 SG_ HAP_RtSide_Obj2_Ground_Pos_X : 87|12@0+ (0.01,0) [0|40] "m"  HUT
 SG_ HAP_RtSide_Obj2_Ground_Pos_Y : 103|12@0+ (0.01,-20) [-20|20] "m"  HUT
 SG_ HAP_RtSide_Obj3_ID : 143|4@0+ (1,0) [0|3] ""  HUT
 SG_ HAP_RtSide_Obj3_type : 139|3@0+ (1,0) [0|7] ""  HUT
 SG_ HAP_RtSide_Obj3_Confidence : 155|4@0+ (0.1,0) [0|1] ""  HUT
 SG_ HAP_RtSide_Obj3_Ground_Pos_X : 151|12@0+ (0.01,0) [0|40] "m"  HUT
 SG_ HAP_RtSide_Obj3_Ground_Pos_Y : 167|12@0+ (0.01,-20) [-20|20] "m"  HUT
 SG_ HAP_RtSide_Obj4_ID : 207|4@0+ (1,0) [0|3] ""  HUT
 SG_ HAP_RtSide_Obj4_type : 203|3@0+ (1,0) [0|7] ""  HUT
 SG_ HAP_RtSide_Obj4_Confidence : 219|4@0+ (0.1,0) [0|1] ""  HUT
 SG_ HAP_RtSide_Obj4_Ground_Pos_X : 215|12@0+ (0.01,0) [0|40] "m"  HUT
 SG_ HAP_RtSide_Obj4_Ground_Pos_Y : 231|12@0+ (0.01,-20) [-20|20] "m"  HUT
 SG_ USS_FLSide1_Status : 271|2@0+ (1,0) [0|3] ""  HUT
 SG_ USS_FLSide1_Dist : 279|7@0+ (0.1,0) [0|12.6] "m"  HUT
 SG_ USS_RLSide2_Status : 269|2@0+ (1,0) [0|3] ""  HUT
 SG_ USS_RLSide2_Dist : 287|7@0+ (0.1,0) [0|12.6] "m"  HUT
 SG_ USS_FRSide1_Status : 267|2@0+ (1,0) [0|3] ""  HUT
 SG_ USS_FRSide1_Dist : 295|7@0+ (0.1,0) [0|12.6] "m"  HUT
 SG_ USS_RRSide2_Status : 265|2@0+ (1,0) [0|3] ""  HUT
 SG_ USS_RRSide2_Dist : 303|7@0+ (0.1,0) [0|12.6] "m"  HUT
 SG_ HAP_FD6_0x289 : 7|512@0+ (1,0) [0|0] ""  HUT

BO_ 647 HC1: 8 GW
 SG_ Checksum_HC1 : 7|8@0+ (1,0) [0|255] ""  HUT
 SG_ HighBeamSts_HC : 15|1@0+ (1,0) [0|1] ""  HUT,T_Box
 SG_ ADBstatus : 14|2@0+ (1,0) [0|3] ""  HUT
 SG_ LeftLowBeamFailSts : 12|1@0+ (1,0) [0|1] ""  HUT
 SG_ RightLowBeamFailSts : 11|1@0+ (1,0) [0|1] ""  HUT
 SG_ LeftHighBeamFailSts : 10|1@0+ (1,0) [0|1] ""  HUT
 SG_ RightHighBeamFailSts : 9|1@0+ (1,0) [0|1] ""  HUT
 SG_ ALS_FailSts : 8|1@0+ (1,0) [0|1] ""  HUT
 SG_ RollingCounter_HC1 : 59|4@0+ (1,0) [0|15] ""  HUT
 SG_ dummy_HC1_0 : 23|8@0+ (1,0) [0|255] ""  HUT
 SG_ dummy_HC1_1 : 31|8@0+ (1,0) [0|255] ""  HUT
 SG_ dummy_HC1_2 : 39|8@0+ (1,0) [0|255] ""  HUT
 SG_ dummy_HC1_3 : 47|8@0+ (1,0) [0|255] ""  HUT
 SG_ dummy_HC1_4 : 55|8@0+ (1,0) [0|255] ""  HUT
 SG_ dummy_HC1_5 : 63|4@0+ (1,0) [0|15] ""  HUT
 SG_ HC1_0x287 : 7|64@0+ (1,0) [0|0] ""  HUT

BO_ 714 DDCM1: 8 GW
 SG_ DrvMirrFold_UnfoldSts : 23|1@0+ (1,0) [0|1] ""  HUT
 SG_ PowerCutSwt : 31|1@0+ (1,0) [0|1] ""  HUT
 SG_ DrvWinPosnSts : 30|3@0+ (1,0) [0|3] ""  HUT,T_Box
 SG_ DrvWinAntiPinchSts : 27|1@0+ (1,0) [0|1] ""  HUT,T_Box
 SG_ DrvWinLrnSts : 36|1@0+ (1,0) [0|1] ""  HUT,T_Box
 SG_ DrvWinHotProtSts : 35|1@0+ (1,0) [0|1] ""  HUT
 SG_ DrvSideRearAntiPinchSts : 34|1@0+ (1,0) [0|1] ""  HUT,T_Box
 SG_ DrvSideRearWinPosnSts : 47|3@0+ (1,0) [0|3] ""  HUT,T_Box
 SG_ DrvSideRearWinLrnSts : 33|1@0+ (1,0) [0|1] ""  HUT,T_Box
 SG_ DrvSideRearWinHotProtSts : 32|1@0+ (1,0) [0|1] ""  HUT
 SG_ DDCM1_0x2CA : 7|64@0+ (1,0) [0|0] ""  HUT

BO_ 717 PDCM1: 8 GW
 SG_ PassMirrFold_UnfoldSts : 12|1@0+ (1,0) [0|1] ""  HUT
 SG_ PassWinAntiPinchSts : 23|1@0+ (1,0) [0|1] ""  HUT,T_Box
 SG_ PassWinPosnSts : 22|3@0+ (1,0) [0|3] ""  HUT,T_Box
 SG_ PassWinLrnSts : 19|1@0+ (1,0) [0|1] ""  HUT,T_Box
 SG_ PassWinHotProtSts : 18|1@0+ (1,0) [0|1] ""  HUT
 SG_ PassSideRearWinAntiPinchSts : 17|1@0+ (1,0) [0|1] ""  HUT,T_Box
 SG_ PassSideRearWinPosnSts : 31|3@0+ (1,0) [0|3] ""  HUT,T_Box
 SG_ PassSideRearWinLrnSts : 16|1@0+ (1,0) [0|1] ""  HUT,T_Box
 SG_ PassSideRearWinHotProtSts : 28|1@0+ (1,0) [0|1] ""  HUT
 SG_ PDCM1_0x2CD : 7|64@0+ (1,0) [0|0] ""  HUT

BO_ 862 CP1: 8 GW
 SG_ RoofModFb : 8|1@0+ (1,0) [0|1] ""  HUT
 SG_ AllTerrainDislFb : 9|1@0+ (1,0) [0|1] ""  HUT
 SG_ ElecSideStepSysFb : 10|1@0+ (1,0) [0|1] ""  HUT
 SG_ CP1_0x35E : 7|64@0+ (1,0) [0|0] ""  HUT

BO_ 771 ESCL2: 8 GW
 SG_ RotSteerWheel : 21|1@0+ (1,0) [0|1] ""  HUT
 SG_ ESCL2_0x303 : 7|64@0+ (1,0) [0|0] ""  HUT

BO_ 543 STBS1: 8 GW
 SG_ STBS_SoundReq : 31|1@0+ (1,0) [0|1] ""  HUT
 SG_ VolUpReq_SC : 15|2@0+ (1,0) [0|3] ""  HUT
 SG_ VolDwnReq_SC : 13|2@0+ (1,0) [0|3] ""  HUT
 SG_ DispTODReq_SC : 11|2@0+ (1,0) [0|3] ""  HUT
 SG_ STBS1_0x21F : 7|64@0+ (1,0) [0|0] ""  HUT

BO_ 766 PLG_1: 8 GW
 SG_ PLG_Sts : 15|3@0+ (1,0) [0|7] ""  HUT
 SG_ PLG_1_0x2FE : 7|64@0+ (1,0) [0|0] ""  HUT

BO_ 86 GLO_NASS1: 8 GW
 SG_ E_CALLSts : 2|3@0+ (1,0) [0|5] ""  HUT
 SG_ QuietVoiceReq : 7|1@0+ (1,0) [0|1] ""  HUT
 SG_ GLO_NASS1_0x56 : 7|64@0+ (1,0) [0|0] ""  HUT

BO_ 621 FPAS1: 8 GW
 SG_ FPAS_ObjFLCornrAr1_0x26d : 15|4@0+ (1,0) [0|15] ""  HUT
 SG_ FPAS_ObjFLCornrAr2_0x26d : 11|4@0+ (1,0) [0|15] ""  HUT
 SG_ FPAS_ObjFLMidlAr1_0x26d : 23|4@0+ (1,0) [0|15] ""  HUT
 SG_ FPAS_ObjFLMidlAr2_0x26d : 19|4@0+ (1,0) [0|15] ""  HUT
 SG_ FPAS_ObjFRMidlAr1_0x26d : 31|4@0+ (1,0) [0|15] ""  HUT
 SG_ FPAS_ObjFRMidlAr2_0x26d : 27|4@0+ (1,0) [0|15] ""  HUT
 SG_ FPAS_ObjFRCornrAr1_0x26d : 39|4@0+ (1,0) [0|15] ""  HUT
 SG_ FPAS_ObjFRCornrAr2_0x26d : 35|4@0+ (1,0) [0|15] ""  HUT
 SG_ FPAS_FLCornrSnsrFltSts : 47|1@0+ (1,0) [0|1] ""  HUT
 SG_ FPAS_FLMiddlSnsrFltSts : 46|1@0+ (1,0) [0|1] ""  HUT
 SG_ FPAS_FRMiddlSnsrFltSts : 45|1@0+ (1,0) [0|1] ""  HUT
 SG_ FPAS_FRCornrSnsrFltSts : 44|1@0+ (1,0) [0|1] ""  HUT
 SG_ FPAS_WorkSts_0x26d : 43|2@0+ (1,0) [0|3] ""  HUT
 SG_ FPAS_AutoModSts_0x26d : 40|1@0+ (1,0) [0|1] ""  HUT
 SG_ FPAS_SoundIndcn_0x26d : 55|2@0+ (1,0) [0|3] ""  HUT
 SG_ FPAS_NearBrrdstn_0x26d : 50|7@0+ (1,0) [0|100] ""  HUT
 SG_ FPAS1_0x26D : 7|64@0+ (1,0) [0|0] ""  HUT

BO_ 749 RPAS2: 8 GW
 SG_ RPAS_NearBrrdstn_0x2ed : 15|8@0+ (1,0) [0|150] ""  HUT
 SG_ RPAS2_0x2ED : 7|64@0+ (1,0) [0|0] ""  HUT

BO_ 737 VSG1: 8 GW
 SG_ VSG_Sts : 15|2@0+ (1,0) [0|3] ""  HUT
 SG_ VSG_HUTSoundResp : 11|2@0+ (1,0) [0|3] ""  HUT
 SG_ VSG1_0x2E1 : 7|64@0+ (1,0) [0|0] ""  HUT

BO_ 656 ECM_PT6: 8 GW
 SG_ PressReliProgs : 23|7@0+ (1,0) [0|100] "%"  HUT
 SG_ FTIVFault : 16|1@0+ (1,0) [0|1] ""  HUT
 SG_ FuelTankCapWarning : 50|2@0+ (1,0) [0|3] ""  HUT
 SG_ ECM_PT6_0x290 : 7|64@0+ (1,0) [0|0] ""  HUT

BO_ 279 ECM_PT7: 8 GW
 SG_ EngState_PHEV : 31|3@0+ (1,0) [0|7] ""  HUT,DMS
 SG_ CruiseCtrlSts_PHEV : 55|4@0+ (1,0) [0|15] ""  HUT
 SG_ ECM_PT7_0x117 : 7|64@0+ (1,0) [0|0] ""  HUT

BO_ 616 HCU_HC3: 8 GW
 SG_ HCU_ChrgDchrgSts : 39|2@0+ (1,0) [0|3] ""  T_Box
 SG_ HCU_BattLowTemWarn : 55|2@0+ (1,0) [0|2] ""  HUT
 SG_ HCU_BattLowHeatSts : 53|2@0+ (1,0) [0|2] ""  HUT
 SG_ HCU_IntelEngIdlChrgnSts : 63|3@0+ (1,0) [0|7] ""  T_Box
 SG_ HCU_HC3_0x268 : 7|64@0+ (1,0) [0|0] ""  HUT

BO_ 788 HCU_HC6: 8 GW
 SG_ HCU_ACLineDisconnect : 33|2@0+ (1,0) [0|3] ""  HUT,T_Box
 SG_ HCU_ChargSts : 47|3@0+ (1,0) [0|7] ""  HUT,T_Box
 SG_ HCU_WorkshopMode : 35|1@0+ (1,0) [0|1] ""  HUT
 SG_ HCU_IntelBattTempMagSts : 37|1@0+ (1,0) [0|1] ""  HUT,T_Box
 SG_ HCU_HC6_0x314 : 7|64@0+ (1,0) [0|0] ""  HUT

BO_ 962 HCU_HC7: 8 GW
 SG_ HCU_EVContnsDistance : 23|8@0+ (1,0) [0|254] "Km"  HUT,T_Box
 SG_ HCU_EVContnsDistanceVld : 52|1@0+ (1,0) [0|1] ""  HUT
 SG_ HCU_RecupPwr : 25|10@0+ (10,0) [0|10230] "Wh"  HUT
 SG_ HCU_EgyUsed : 47|10@0+ (0.01,0) [0|10.23] "KWh"  HUT
 SG_ HCU_HiVoltInterlockSts_RM : 53|1@0+ (1,0) [0|1] ""  T_Box
 SG_ HCU_HC7_0x3C2 : 7|64@0+ (1,0) [0|0] ""  HUT

CM_ SG_ 793 IPBackgroundLmpCmd "IP background lamp command";
CM_ SG_ 793 TrunkSts "Trunk status";
CM_ SG_ 793 DrvDoorSts "Driver door status.";
CM_ SG_ 793 LRDoorSts "Left rear door status";
CM_ SG_ 793 PassengerDoorSts "Passenger door status.";
CM_ SG_ 793 RRDoorSts "Right   rear door status";
CM_ SG_ 793 BrkPedalSts_BCM "Brake pedal status";
CM_ SG_ 793 BackgroundLightLvl "Background light level";
CM_ SG_ 793 DrowsyDrvDetWarn "Drowsy driver detect warning";
CM_ SG_ 793 RLSFailSts "Rain or light sensor failure status";
CM_ SG_ 793 ReversGearSts "Reverse gear status.this signal is MT configuration,when AT keep send 0x3:Not available";
CM_ SG_ 793 PosnLightReq "Position Light request.";
CM_ SG_ 793 MAC_Check_BCM1 "MAC protection mechanism should comply with the GWM MAC Specificatio";
CM_ SG_ 837 LasHdLmpSts "Laser Head Lamp Status";
CM_ SG_ 837 AntitheftSts "Vehicle antitheft status";
CM_ SG_ 837 DrvDoorLockSts "The status of the driver door lock  status";
CM_ SG_ 837 DoorLockSts "Door lock status";
CM_ SG_ 837 RLDoorLockSts "The status of the RL door lock status";
CM_ SG_ 837 PassDoorLockSts "The status of the Passenger door lock status";
CM_ SG_ 837 RRDoorLockSts "The status of the RR door lock status";
CM_ SG_ 837 HazardLmpSwtSts "Hazard lamp switch status.";
CM_ SG_ 837 HiLowBeamSts "High Low Beam Status";
CM_ SG_ 837 MAC_Check_BCM3 "MAC protection mechanism should comply with the GWM MAC Specificatio";
CM_ SG_ 652 VolSwtReq "Volume switch Request";
CM_ SG_ 652 VolSwtErrSts "Volume switch Error Status.";
CM_ SG_ 671 RemoteModSts "Remote mode status.";
CM_ SG_ 671 PASWorkCmd "PAS Work command";
CM_ SG_ 671 WhistleSts "The state of the whistle signal.";
CM_ SG_ 671 WiprReq_F_Pbox "Front windshield wiper operation request.";
CM_ SG_ 671 KL30BRelaySts "KL30B Relay status.";
CM_ SG_ 773 ClsWinRmd "Remind  driver to close  the window.If the window is open,the driver's APP will alarm.";
CM_ SG_ 568 SrAntiPinch "SR Curtain anti-pinch";
CM_ SG_ 568 SsPosn_VR_APP "Report sunshade position for HUT and T_Box";
CM_ SG_ 568 SsAntiPinch "SS Curtain anti-pinch";
CM_ SG_ 568 SrPosn_VR_APP "Report sunroof position for HUT and T_Box";
CM_ SG_ 661 SysPowerMod "System power mode";
CM_ SG_ 661 SysPowerModVld "System power mode valid";
CM_ SG_ 661 RemUpgrdModSysPower "Remote upgrade system power mode";
CM_ SG_ 661 RemPowerFailureSts "Remote power failure status";
CM_ SG_ 770 WarnPowerNotInOffPosn "Power not in off warning,when the driver close the door and exit with carrying the key
ç”µæºæœªå…³æŠ¥è­¦ä¿¡å·";
CM_ SG_ 770 WarnKeyInCarWhenExit "Key in car warning,when the driver exit and close the door
é’¥åŒ™é—å¿˜è½¦å†…æŠ¥è­¦ä¿¡å·";
CM_ SG_ 770 WarnVldKeyNotFound "Valid Key not found  in the vehicle warning";
CM_ SG_ 770 WarnEngStrtNotMeet "Indicate the engine start condition is not meet";
CM_ SG_ 770 PowerRlyFault "ACC(reserved),IGN1 or IGN2 Relay rault,which is no same to the relay driver output status.
ç»§ç”µå™¨æ•…éšœ";
CM_ SG_ 53 PEPS_T_BoxAuth1 "PEPS anti-theft related signals,PEPS send to T_box";
CM_ SG_ 70 PEPS_T_BoxAuth2 "Anti-theft authentication related signals,PEPSKBCMTBK send to T_Box";
CM_ SG_ 669 InCarTemp "Air Conditioning Cabin Temperatureï¼ˆDriver sideï¼‰";
CM_ SG_ 669 ACAQSEnaSts "AQS(air quality sensorï¼‰enable Status";
CM_ SG_ 669 ACOperMod "AC operation mode";
CM_ SG_ 669 ACAIUEnaSts "Air Ionizer Unit enable Status";
CM_ SG_ 669 ACDrvAirDistriMod "Driver Air Distribution Mode";
CM_ SG_ 669 ACSteplessSpdSetEnaSts "Blower Stepless Speed Set enable status";
CM_ SG_ 669 ACFrntPassTempSteplessSetEnaSts "Front passenger side Temperature Stepless Set enable status";
CM_ SG_ 669 ACDrvTempSteplessSetEnaSts "Drive side Temperature Stepless Set enable status";
CM_ SG_ 669 ACEEMSts "AC EEM status";
CM_ SG_ 669 ACCbnClnEnasts "Cabin(incar) clean enable status";
CM_ SG_ 669 ACCbnClnOffCode "Cabin(incar) clean off code";
CM_ SG_ 901 ACFrntDefrstSts "Front Defrost status";
CM_ SG_ 901 ACHMIDispCmd "Display ACHMI on HUT command";
CM_ SG_ 901 ACFrntBlwrSpd "Front Blower Speed";
CM_ SG_ 901 ACOpenSts "AC open status";
CM_ SG_ 901 ACDualModEnaSts "AC dual mode enable status";
CM_ SG_ 901 ACDrvTemp_ATC "ATCï¼ˆAuto Touch Conditionï¼‰ Driver side Temperature";
CM_ SG_ 901 ACAmbTemp "Ambient display strategy:
1. In the Power mode = OFFï¼Œ ACC, or Crank: Ambient Temperature = ini.
2. In the Power mode = Run:
Initial ambient temperature is depending on the EEPROM data and vehicle soak time(Soak time is <= 1min or =>60 min, it will show the raw data from ambient temperature sensor; 1min < Soak time < 60min, it will show the data from EEPROM, stored in last ignition cycle.);
The ambient temperature will be updated according the raw data from sensor, vehicle speed, and time";
CM_ SG_ 901 ACAirInletSts "AC airinlet status";
CM_ SG_ 901 ACFrntPasstTemp_ATC "Front Passenger Temperature";
CM_ SG_ 901 ACAutoModEnaSts "AC Auto mode enable status";
CM_ SG_ 901 ACCmprEnaSts "Compressor enable status";
CM_ SG_ 901 AC_FrntWinHeatEnaSts "Front Window Heating Enable Status";
CM_ SG_ 901 AC_FrntWinHeatDislSts "Front Window Heating Disable Status";
CM_ SG_ 901 ACAutoDefrstModEnaSts "Auto defrost mode enable status";
CM_ SG_ 721 DrvSeatHeatSts "The driver side seat heating status";
CM_ SG_ 721 PassSeatHeatSts "The passenger side seat heating status";
CM_ SG_ 721 DrvSeatVentnSts "The driver side seat ventilation status";
CM_ SG_ 721 PassSeatVentnSts "The passenger side seat ventilation status";
CM_ SG_ 360 EPS_FailSts_0x168 "Electrical steering fail status";
CM_ SG_ 360 EPS_TrqSnsrSts_0x168 "EPS torque sensor status";
CM_ SG_ 360 CheckSum_EPS1_0x168 "Use the checksum strategy from document â€œEnd-to-End Communication Protection Specificationâ€";
CM_ SG_ 360 EPS_SteerMod_0x168 "EPS steering mode";
CM_ SG_ 360 RollingCounter_EPS1_0x168 "Rolling counter_EPS1";
CM_ SG_ 354 EPS_LKATorqOvrlDlvd_0x162 "Lane Keeping Assist Torque Overlay Delivered";
CM_ SG_ 354 EPS_LKATorqOvrlDlvdVld_0x162 "Lane Keeping Assist Torque Overlay Delivered Validity";
CM_ SG_ 354 EPS_LKATrqOvlDlvdSts_0x162 "Electrical power steering lane keeping assist torque overlay delivered status.";
CM_ SG_ 327 CheckSum_EPS1_0x147 "Use the checksum strategy from document â€œEnd-to-End Communication Protection Specificationâ€";
CM_ SG_ 327 EPS_FailSts_0x147 "Electrical steering fail status";
CM_ SG_ 327 EPS_TrqSnsrSts_0x147 "EPS torque sensor status";
CM_ SG_ 327 EPS_SteerMod_0x147 "EPS steering mode";
CM_ SG_ 327 RollingCounter_EPS1_0x147 "Rolling counter_EPS1";
CM_ SG_ 327 EPS_LKATorqOvrlDlvd_0x147 "Lane Keeping Assist Torque Overlay Delivered";
CM_ SG_ 327 EPS_LKATorqOvrlDlvdVld_0x147 "Lane Keeping Assist Torque Overlay Delivered Validity";
CM_ SG_ 327 EPS_LKATrqOvlDlvdSts_0x147 "Electrical power steering lane keeping assist torque overlay delivered status.";
CM_ SG_ 411 FFogLmpSts_F_Pbox "Front fog lamp status";
CM_ SG_ 411 HiBeamSts_F_Pbox "High beam status";
CM_ SG_ 411 HoodSts_F_Pbox "hood status";
CM_ SG_ 411 LLasHdLmpDiagSig "Left Laser head lamp Diagnose signal";
CM_ SG_ 411 RLasHdLmpDiagSig "Right Laser head lamp Diagnose signal";
CM_ SG_ 411 LasHdLmpSts_F_Pbox "Laser Head Lamp Status";
CM_ SG_ 411 LHiBeamFailSts "Left High beam failure status";
CM_ SG_ 411 RHiBeamFailSts "Right High beam failure status";
CM_ SG_ 411 LLowBeamFailSts "Left Low beam  failure status";
CM_ SG_ 411 RLowBeamFailSts "Right Low beam  failure status";
CM_ SG_ 411 LHeadLmpFailSts "Left head lamp failure status";
CM_ SG_ 411 RHeadLmpFailSts "Right head lamp failure status";
CM_ SG_ 411 WhistleSts_F_Pbox "The state of the whistle signal.";
CM_ SG_ 357 LTurnLmpSwtSts "Left Turn Lamp Switch Status";
CM_ SG_ 357 RTurnLmpSwtSts "Right Turn Lamp Switch Status";
CM_ SG_ 357 AutoLmpSwtSts "Auto lamp switch status
When CSA detected auto light switch logical is ON, then signal is Auto,
When CSA detected light switch is different from auto lamp, then this signal is Non-Auto.ç¯å…‰å¼€å…³æ˜¯å¦å¤„äºŽautoæ¡£å¼€å…³ä¿¡å·";
CM_ SG_ 357 HornSwtSts "Horn switch States";
CM_ SG_ 161 SteerWheelAng "angle of steering wheel (raw data)";
CM_ SG_ 161 SteerWheelAngSign "sign of steering wheel angle (+-)
definition according to DIN 70000  ISO 8855
wheel position to left = positive
wheel position to right = negative
wheel position straightforward = 0 (positive)";
CM_ SG_ 161 SteerWheelSpd "steering wheel rotation speed (raw data)";
CM_ SG_ 161 SteerWheelSpdSign "sign of steering wheel speed (+-)
definition according to DIN 70000  ISO 8855
wheel to left = positive
wheel to right = negative
wheel straightforward = 0 (positive)";
CM_ SG_ 161 SAS_Sts "Status of steering angle sensor";
CM_ SG_ 161 HWA_OK_OFFSwt "HWAï¼ˆè‡ªåŠ¨å˜é“ï¼‰OKOFF switch";
CM_ SG_ 580 MenuReturnSwtSts "Menu Return Switch Status";
CM_ SG_ 580 HomeSwtSts "Home Switch Status";
CM_ SG_ 580 MuteSwtSts "Mute Switch Status";
CM_ SG_ 580 CustomSwtSts "Custom Switch Status";
CM_ SG_ 580 SteerWheelHeatdSts "Steer wheel heated status";
CM_ SG_ 580 PageUpSwtSts "Page Up Switch Status";
CM_ SG_ 580 PageDwnSwtSts "Page Down Switch Status";
CM_ SG_ 580 PageLSwtSts "Page Left Switch Status";
CM_ SG_ 580 PageRSwtSts "Page Right Switch Status";
CM_ SG_ 580 SeekUpSwtSts "Seek Up Switch Status";
CM_ SG_ 580 SeekDwnSwtSts "Seek Down Switch Status";
CM_ SG_ 580 AdjVolUpSwtSts "Adjust Volume Up Switch  Status";
CM_ SG_ 580 AdjVolDwnSwtSts "Adjust Volume Down Switch Status";
CM_ SG_ 580 VRSwtSts "Voice Recognition Switch Status";
CM_ SG_ 580 PhoneSwtSts "Phone Answer or Reject Switch Status";
CM_ SG_ 580 SoundSourceModSwtSts "Sound Source Mode Switch Status";
CM_ SG_ 580 EnterSwtSts "Enter Switch Status";
CM_ SG_ 580 EnterSwtSts_Mmed "Enter Switch Status For Multimedia";
CM_ SG_ 580 CustomSwtSts_Mmed "Custom Switch Status For Multimedia";
CM_ SG_ 593 DiagLmpReq "Identifies there is a light diagnostic lamp request.";
CM_ SG_ 593 CouplingThermWarning "Indicates that the system is shutdown due to thermal protection Warning";
CM_ SG_ 593 CouplingFaultSts "indicates that which fault the coupling  has";
CM_ SG_ 593 EstimatedTorque "Estimated Coupling Torque";
CM_ SG_ 698 WPC_ChrgSts "Describe the status of charge of the WPC:standby,charging,charging completed,WPC failure.";
CM_ SG_ 698 WPC_SwtSts "WPC Switch Status";
CM_ SG_ 698 WPC_FaultSts "Describe the current failure status of WPC.";
CM_ SG_ 698 WPC_PhoneReminder "Describe whether there is a phone forgotten in the car.";
CM_ SG_ 993 AMP_SWVersion "Software version Information";
CM_ SG_ 993 AMP_HWVersion "Hardware version Information";
CM_ SG_ 993 AMP_Chan1DTCInfo "Amplifier output channel 1 DTC information";
CM_ SG_ 993 AMP_Chan2DTCInfo "Amplifier output channel 2 DTC information";
CM_ SG_ 993 AMP_Chan3DTCInfo "Amplifier output channel 3 DTC information";
CM_ SG_ 993 AMP_Chan4DTCInfo "Amplifier output channel 4 DTC information";
CM_ SG_ 993 AMP_Chan5DTCInfo "Amplifier output channel 5 DTC information";
CM_ SG_ 993 AMP_Chan6DTCInfo "Amplifier output channel 6 DTC information";
CM_ SG_ 993 AMP_Chan7DTCInfo "Amplifier output channel 7 DTC information";
CM_ SG_ 993 AMP_Chan8DTCInfo "Amplifier output channel 8 DTC information";
CM_ SG_ 993 AMP_TempValue "Amplifier internal temperature";
CM_ SG_ 993 AMP_TempSts "The value of AMP temperature status";
CM_ SG_ 993 AMP_VolValue "Amplifier internal voltage";
CM_ SG_ 993 BestListegPosnResp "Best listenting Position respond.";
CM_ SG_ 993 Clari_FiResp "Clari-Fi respond.";
CM_ SG_ 995 MediaCallSourceState "MediaCall Source State";
CM_ SG_ 995 BeepSourceSts "Beep source status.";
CM_ SG_ 995 BalanceSetState "Balance setting";
CM_ SG_ 995 VSCModeState "Vehicle Speed Compensation onoff";
CM_ SG_ 995 FadeSetState "Fade setting";
CM_ SG_ 995 DriveSideSts "Drive side state.";
CM_ SG_ 995 BassSetState "Low frequency audio setting";
CM_ SG_ 995 MuteState "MuteUnmute all speakers";
CM_ SG_ 995 NaviSourceState "Navi prompt onoff state imformation";
CM_ SG_ 995 MidrangeSetState "Mid frequency audio setting";
CM_ SG_ 995 T_box_ECallSts "T_box Ecall(emergency call) status (mute all speakers).";
CM_ SG_ 995 GetHUTInfoSts "Get HUT Information.";
CM_ SG_ 995 TrebleSetState "High frequency audio setting";
CM_ SG_ 995 QLISurroundSetSt "Stereo or surround state.";
CM_ SG_ 995 AVMStResp "AVM Status Response";
CM_ SG_ 995 NaviMediaVolLvlResp "Navigation Media Volume Level Response";
CM_ SG_ 995 AVMMediaVolLvlResp "AVM Media Volume Level Response";
CM_ SG_ 995 FPASChStResp "Front  Park Assistant System channel Status Response";
CM_ SG_ 995 RPASChStResp "Rear Park Assistant System channel Status Response";
CM_ SG_ 995 MAC_Check_AMP2 "MAC protection mechanism should comply with the GWM MAC Specificatio";
CM_ SG_ 997 HFMVolSetSts "HFM(hand free mode), RT(ring tone) and Tbox-IB call volume set status.";
CM_ SG_ 997 VR_TTSVolSetSts "VRTTS(text to sound) volume set state.";
CM_ SG_ 997 NaviVolumeSetState "Navi volume adjustment";
CM_ SG_ 997 MainVolumeSetState "Main volume step";
CM_ SG_ 997 AMPPowerSts "AMP feedback Power
Status to HUT";
CM_ SG_ 997 IPVolSetSts "IP Volume Set State";
CM_ SG_ 722 Microphone_Cha1DTCInfo "ANC Microphone  output channel 1 DTC information";
CM_ SG_ 722 Microphone_Cha2DTCInfo "ANC Microphone  output channel 2 DTC information";
CM_ SG_ 722 Microphone_Cha3DTCInfo "ANC Microphone  output channel 3 DTC information";
CM_ SG_ 722 Microphone_Cha4DTCInfo "ANC Microphone  output channel 4 DTC information";
CM_ SG_ 722 ANCSwtStatus "ANC switch onoff Status
ANCè®¾ç½®å¼€å…³(å·¥ç¨‹æ¨¡å¼ä¸‹)çŠ¶æ€è¿”å›ž";
CM_ SG_ 929 IESS_SwitchModel "IESS  feedback Switch
Model to HUT";
CM_ SG_ 805 HUD_SwtSts "Status of HUD Switch";
CM_ SG_ 805 HUD_BrightnessLvl "Brightness Level of HUD";
CM_ SG_ 805 HUD_HeightLvl "Height Level of HUD";
CM_ SG_ 805 HUD_UIMod "UI Mode of HUD";
CM_ SG_ 805 HUD_UIModVld "UI Mode Valid of HUD";
CM_ SG_ 805 HUD_Manufactor "HUD manufactor";
CM_ SG_ 805 HUD_ReslType "Resolution type of HUD";
CM_ SG_ 412 HiPosnBrkLmpFailSts "High position Brake lamp failure status";
CM_ SG_ 412 LicPlateLmpFailSts "License plate lamp fail status";
CM_ SG_ 412 LBrkLmpFailSts "Left  Brake lamp failure staus";
CM_ SG_ 412 RFogLmpFailSts_R_Pbox "Rear fog lamp failure status";
CM_ SG_ 412 RFogLmpSts_R_Pbox "Rear fog lamp status";
CM_ SG_ 412 ParkLmpSts_R_Pbox "Park lamp status";
CM_ SG_ 412 RBrkLmpFailSts "Right  Brake lamp failure staus";
CM_ SG_ 412 PosnLmpOutpSts_R_Pbox "Position lamp output status";
CM_ SG_ 412 RRPosnLmpFailSts "Right rear  position lamp failure staus";
CM_ SG_ 412 RvsLmpFailSts "Revers Lamp failure staus";
CM_ SG_ 412 LRPosnLmpFailSts "Left  rear position lamp failure status";
CM_ SG_ 412 RTurnLmpFailSts "Right turn lamp failure status";
CM_ SG_ 412 LTurnLmpFailSts "Left turn lamp failure status";
CM_ SG_ 412 LTurnLmpSts_R_Pbox "Left turn lamp status";
CM_ SG_ 412 RTurnLmpSts_R_Pbox "Right turn lamp status";
CM_ SG_ 412 RWinHeatgIconRlyCmd "Rear Window Heating Icon RelayCommandthis signal is transferred to CCSM by BCM";
CM_ SG_ 412 RWinHeatgFailSts "Rear Window Heating Status";
CM_ SG_ 412 MAC_Check_R_PBox1 "MAC protection mechanism should comply with the GWM MAC Specificatio";
CM_ SG_ 849 CheckSum_ABM1 "Use the checksum strategy from document â€œEnd-to-End Communication Protection Specificationâ€";
CM_ SG_ 849 SecRowLSBR "Second row Left Seat Belt Reminder.";
CM_ SG_ 849 AirbFailLmpCmd "Indicates the Airbag system lamp command";
CM_ SG_ 849 SecRowMidSBR "Second row Middle Seat Belt Reminder.";
CM_ SG_ 849 DrvSBR "Driver Seat Belt Reminder";
CM_ SG_ 849 SecRowRSBR "Second row Right Seat Belt Reminder.";
CM_ SG_ 849 PassSBR "Passenger Seat Belt Reminder";
CM_ SG_ 849 PassSBR_Visual "Passenger Seat Belt Reminder with Visual.";
CM_ SG_ 849 DrvSBR_Visual "Driver Seat Belt Reminder with Visual.";
CM_ SG_ 849 SecRowLSBR_Visual "Second row Left  Seat Belt Reminder with Visual.";
CM_ SG_ 849 SecRowMidSBR_Visual "Second row Middle Seat Belt Reminder with Visual.";
CM_ SG_ 849 SecRowRSBR_Visual "Second row Right  Seat Belt Reminder with Visual.";
CM_ SG_ 849 CrashOutputSts "Normal status message period is defined as 500ms.If any crash event is recognized and deploy decision sentï¼Œ the message is sent immediatelyï¼Œthe period is 10ms lasted for 20 times, this message is defined as crash status. After 20 times, recovery to normal status. If another deploy decision is sent during last crash status message output period, the new crash out message will not be sent, except the depoy decision out of the last crash out message course.
0x00   Startup  Default
0x03 0x11 0x12 acts asâ€œReservedâ€.
Receiver: If the signal's value is reserved, the Receiver will use no crash.";
CM_ SG_ 849 RollingCounter_ABM1 "Rolling counter_ABM1";
CM_ SG_ 849 MAC_Check_ABM1 "MAC protection mechanism should comply with the GWM MAC Specificatio";
CM_ SG_ 581 VehLgtAccel "Vehicle Longitudinal acceleration";
CM_ SG_ 581 VehLatAccel "Vehicle Lateral Acceleration";
CM_ SG_ 581 VehYawRate "Vehicle yaw rate";
CM_ SG_ 581 VehLgtAccelVld "Vehicle Longitudinal acceleration valid";
CM_ SG_ 581 VehLatAccelVld "Vehicle Lateral Acceleratio valid";
CM_ SG_ 581 VehDynYawRateVld "Vehicle yaw rate valid";
CM_ SG_ 833 FLTirePressIndSts "Front left tire pressure Indicator status";
CM_ SG_ 833 FRTirePressIndSts "Front right  tire pressure Indicator status";
CM_ SG_ 833 TirePressSysFailrIndcn "Tire pressure system failure indication";
CM_ SG_ 833 RLTirePressIndSts "Rear left  tire pressure Indicator status";
CM_ SG_ 833 RRTirePressIndSts "Rear right tire pressure Indicator status";
CM_ SG_ 833 FLTireTempSts "Front left tire tempperature status";
CM_ SG_ 833 FRTireTempSts "Front right tire tempperature status";
CM_ SG_ 833 RLTireTempSts "Rear left tire tempperature status";
CM_ SG_ 833 RRTireTempSts "Rear right tire tempperature status";
CM_ SG_ 833 TPMS_AutoLoctSts "TPMS system Auto-Locate status";
CM_ SG_ 833 MAC_Check_TPMS1 "MAC protection mechanism should comply with the GWM MAC Specificatio";
CM_ SG_ 917 FLTirePress "Left front tire pressure";
CM_ SG_ 917 FLTireTemp "Left front tire temperature";
CM_ SG_ 917 FRTirePress "Right front tire pressure";
CM_ SG_ 917 FRTireTemp "Right front tire temperature";
CM_ SG_ 917 RLTirePress "Left rear tire pressure";
CM_ SG_ 917 RLTireTemp "Left rear tire temperature";
CM_ SG_ 917 RRTirePress "Right rear tire pressure";
CM_ SG_ 917 RRTireTemp "Right rear tire temperature";
CM_ SG_ 917 MAC_Check_TPMS2 "MAC protection mechanism should comply with the GWM MAC Specificatio";
CM_ SG_ 627 TrailerSts "Trailer Status";
CM_ SG_ 622 RPAS_RLCornrSnsrFailSts_0x26e "Sensor fail status of the Rear Left Corner sensor";
CM_ SG_ 622 RPAS_RLMiddlSnsrFailSts_0x26e "Sensor fail status of the Rear Left Middle  sensor";
CM_ SG_ 622 RPAS_RRMiddlSnsrFailSts_0x26e "Sensor fail status of the Rear Right Middle sensor";
CM_ SG_ 622 RPAS_RRCornrSnsrFailSts_0x26e "Sensor fail status of the Rear Right Corner sensor";
CM_ SG_ 622 RPAS_WorkSts_0x26e "Rear Park Assistant System work Status";
CM_ SG_ 622 RPAS_SoundIndcn_0x26e "Rear Park Assistant System Sound Indication";
CM_ SG_ 622 MEBWorkSts_0x26e "MEB Work Status";
CM_ SG_ 622 MEB_EnableSts_0x26e "MEB Enable Status";
CM_ SG_ 622 RPAS_ObjRRCornrAr1_0x26e "Rear right Corner sensor detect area1";
CM_ SG_ 622 RPAS_ObjRRCornrAr2_0x26e "Rear right Corner sensor detect area2";
CM_ SG_ 622 RPAS_ObjRRMidlAr1_0x26e "Rear right middle sensor detect area1";
CM_ SG_ 622 RPAS_ObjRRMidlAr2_0x26e "Rear right middle sensor detect area2";
CM_ SG_ 622 RPAS_ObjRLMidlAr1_0x26e "Rear left middle sensor detect area1";
CM_ SG_ 622 RPAS_ObjRLMidlAr2_0x26e "Rear left middle sensor detect area2";
CM_ SG_ 622 RPAS_ObjRLCornrAr1_0x26e "Rear left Corner sensor detect area1";
CM_ SG_ 622 RPAS_ObjRLCornrAr2_0x26e "Rear left Corner sensor detect area2";
CM_ SG_ 347 APS_PrkgMod "APS Parking Mode";
CM_ SG_ 347 APS_ProcBar "APS Process bar";
CM_ SG_ 347 APS_SwtSts "APS Switch status";
CM_ SG_ 347 APS_SlotDisp "APS Slot Display";
CM_ SG_ 347 APS_SysSoundIndcn "APS_System Sound Indication";
CM_ SG_ 347 APS_PrkgTyp "APS Parking Type";
CM_ SG_ 347 APS_TextDisp "APS Text Display";
CM_ SG_ 347 APS_WorkSts "APS Work status";
CM_ SG_ 347 MEB_AVHReq "inform ESP the MEB request Auto Hold";
CM_ SG_ 347 LParaPrkgOutVald "Left parallel Parking Out Valid";
CM_ SG_ 347 RParaPrkgOutVald "Right parallel Parking Out Valid";
CM_ SG_ 347 HeadVertPrkgOutVald "Head Vertical Parking Out Valid";
CM_ SG_ 347 TailVertPrkgOutVald "Tail Vertical Parking Out Valid";
CM_ SG_ 347 HAP_SwtDispCtrlCmd "control switch area display mode";
CM_ SG_ 347 P2P_PahDelSts "P2P function path delete status";
CM_ SG_ 347 P2P_SelfDetErrCode "Point to point self detect error code";
CM_ SG_ 347 P2P_SelfDetSts "Point to Point parking function self detect status";
CM_ SG_ 347 P2P_Pah1Avail "path one is available for rountie play back";
CM_ SG_ 347 P2P_Pah2Avail "path two is available for rountie play back";
CM_ SG_ 347 HAP_PrkgModCurrSts "show park mode of current parking";
CM_ SG_ 347 APS_MovgDirc "Moving direction of parking";
CM_ SG_ 628 AutoAVMSwtSet_Sts "Auto Around view swtich set status,to HUT.";
CM_ SG_ 628 AVM_CurrSts "Used to indicate the current state of AVM.";
CM_ SG_ 628 GuidOvlSts "Show the current status of guidance overlay";
CM_ SG_ 628 FrntCamInpFailSts "Controller is failed to receive front camera video input.";
CM_ SG_ 628 RearCamInpFailSts "Controller is failed to receive rear camera video input.";
CM_ SG_ 628 LeCamInpFailSts "Controller is failed to receive left camera video input.";
CM_ SG_ 628 RiCamInpFailSts "Controller is failed to receive right camera video input.";
CM_ SG_ 628 EolNotCmpltd "Used to check whether EOL is completed.";
CM_ SG_ 628 OvlOpFailSts "Overlay could not operate normally. The corresponding buttons shall be shown as grey.";
CM_ SG_ 628 LaneCalSts "Used to indicate the current state of
Calibration.";
CM_ SG_ 628 RadarDispSts "Show the current Display status of Radar";
CM_ SG_ 628 LaneCalFltSts "Used to indicate the Fault-code of Lane
Calibration";
CM_ SG_ 628 AutoViewChgFuncSts "Used to indicate the function state of AutoChangeView";
CM_ SG_ 628 CarMdlTrsprcySts "Car Model Transparency Status";
CM_ SG_ 628 CarMdlDispSts "Indicate the 2D3D display mode status";
CM_ SG_ 628 CurrCalResultSts "Used to indicate  the current Calbrtion Result AVM Using";
CM_ SG_ 628 MdlColrSts "Used to indicate the model color";
CM_ SG_ 628 SigViewIndcn "Single View Indication, used to indicate the current single view.";
CM_ SG_ 628 HAP_DispCmd "HAP display command";
CM_ SG_ 628 AVM_3DAngSts "Horizontal angle state of 3D view";
CM_ SG_ 628 MOD_WorkSts "MOD function work status";
CM_ SG_ 628 HAP_Hmi_Index "Indicate the current HMI index of AVM.";
CM_ SG_ 628 DVRWorkSts "DVR work status";
CM_ SG_ 628 MOD_AlarmSts "MOD function alarm status";
CM_ SG_ 664 RPAS_NearBrrdstn_0x298 "RPAS nearest barrier distance";
CM_ SG_ 664 APS_ObjRiSideAr1 "Right side sensor detect area1";
CM_ SG_ 664 APS_ObjRiSideAr2 "Right side sensor detect area2";
CM_ SG_ 664 APS_ObjRiSideAr3 "Right side sensor detect area3";
CM_ SG_ 664 APS_ObjRiSideAr4 "Right side sensor detect area4";
CM_ SG_ 664 APS_ObjRiSideAr5 "Right side sensor detect area5";
CM_ SG_ 664 APS_ObjLeSideAr1 "Left side sensor detect area1";
CM_ SG_ 664 APS_ObjLeSideAr2 "Left side sensor detect area2";
CM_ SG_ 664 APS_ObjLeSideAr3 "Left side sensor detect area3";
CM_ SG_ 664 APS_ObjLeSideAr4 "Left side sensor detect area4";
CM_ SG_ 664 APS_ObjLeSideAr5 "Left side sensor detect area5";
CM_ SG_ 664 APS_FRSideSnsrFailSts "fail status of the Front Right Side sensor";
CM_ SG_ 664 APS_FLSideSnsrFailSts "fail status of the Front Left Sid sensor";
CM_ SG_ 664 APS_RRSideSnsrFailSts "fail status of the Rear Right Side sensor";
CM_ SG_ 664 APS_RLSideSnsrFailSts "Fault status of the Rear Left Side sensor";
CM_ SG_ 664 SDW_SoundIndcn "Side Distance Warning Sound Indication";
CM_ SG_ 664 SDWActiveSts "Side Distance Warning Function Active Status";
CM_ SG_ 664 RPAS_ObjRRCornrAr1_0x298 "Rear right Corner sensor detect area1";
CM_ SG_ 664 RPAS_ObjRRCornrAr2_0x298 "Rear right Corner sensor detect area2";
CM_ SG_ 664 RPAS_ObjRRMidlAr1_0x298 "Rear right middle sensor detect area1";
CM_ SG_ 664 RPAS_ObjRRMidlAr2_0x298 "Rear right middle sensor detect area2";
CM_ SG_ 664 RPAS_ObjRLMidlAr1_0x298 "Rear left middle sensor detect area1";
CM_ SG_ 664 RPAS_ObjRLMidlAr2_0x298 "Rear left middle sensor detect area2";
CM_ SG_ 664 RPAS_ObjRLCornrAr1_0x298 "Rear left Corner sensor detect area1";
CM_ SG_ 664 RPAS_ObjRLCornrAr2_0x298 "Rear left Corner sensor detect area2";
CM_ SG_ 664 RPAS_RLCornrSnsrFailSts_0x298 "Fail status of the Rear Left Corner sensor";
CM_ SG_ 664 RPAS_RLMiddlSnsrFailSts_0x298 "Fail status of the Rear Left Middle  sensor";
CM_ SG_ 664 RPAS_RRMiddlSnsrFailSts_0x298 "Fail status of the Rear Right Middle sensor";
CM_ SG_ 664 RPAS_RRCornrSnsrFailSts_0x298 "Fail status of the Rear Right Corner sensor";
CM_ SG_ 664 RPAS_WorkSts_0x298 "Rear Park Assistant System work Status";
CM_ SG_ 664 RPAS_SoundIndcn_0x298 "Rear Park Assistant System Sound Indication";
CM_ SG_ 664 MEBWorkSts_0x298 "MEB Work Status";
CM_ SG_ 664 MEB_EnableSts_0x298 "MEB Enable Status";
CM_ SG_ 664 FPAS_ObjFLCornrAr1_0x298 "Front left Corner sensor detect area1";
CM_ SG_ 664 FPAS_ObjFLCornrAr2_0x298 "Front left Corner sensor detect area2";
CM_ SG_ 664 FPAS_ObjFLMidlAr1_0x298 "Front left middle sensor detect area1";
CM_ SG_ 664 FPAS_ObjFLMidlAr2_0x298 "Front left middle sensor detect area2";
CM_ SG_ 664 FPAS_ObjFRMidlAr1_0x298 "Front right middle sensor detect area1";
CM_ SG_ 664 FPAS_ObjFRMidlAr2_0x298 "Front right middle area2";
CM_ SG_ 664 FPAS_ObjFRCornrAr1_0x298 "Front right Corner sensor detect area1";
CM_ SG_ 664 FPAS_ObjFRCornrAr2_0x298 "Front right Corner sensor detect area2";
CM_ SG_ 664 FPAS_FLCornrSnsrFailSts "Fail status of the Front Left Corner sensor";
CM_ SG_ 664 FPAS_FLMiddlSnsrFailSts "Fail status of the Front Left Middle  sensor";
CM_ SG_ 664 FPAS_FRMiddlSnsrFailSts "Fail status of the Front Right Middle sensor";
CM_ SG_ 664 FPAS_FRCornrSnsrFailSts "Fail status of the Front Right Corner sensor";
CM_ SG_ 664 FPAS_WorkSts_0x298 "Park Assistant Front System Status";
CM_ SG_ 664 FPAS_AutoModSts_0x298 "Park Assistant Front System AutoStategy Status";
CM_ SG_ 664 FPAS_SoundIndcn_0x298 "Front Park Assistant System Sound Indication";
CM_ SG_ 664 FPAS_NearBrrdstn_0x298 "FPAS nearest barrier distance";
CM_ SG_ 664 APA_MenuDispCtrlCmd "APA menu display mode control command (area A)";
CM_ SG_ 664 APA_FuncSts "APA Function status";
CM_ SG_ 664 P2P_FuncSts "P2P Function status";
CM_ SG_ 664 RADS_FuncSts "Reverse Asist Function status";
CM_ SG_ 664 FADS_FuncSts "Front Asist Function status";
CM_ SG_ 664 HAP_TextIconDispCtrl "Control display method of small icon beside text box";
CM_ SG_ 649 HAP_RtCam_WorkSts "Current work status of  HAP right camera";
CM_ SG_ 649 HAP_RtSide_Obj1_ID "ID of the Target obstacle on the right side of vehicle";
CM_ SG_ 649 HAP_RtSide_Obj1_type "OD_type";
CM_ SG_ 649 HAP_RtSide_Obj1_Confidence "Confidence of the Target obstacle";
CM_ SG_ 649 HAP_RtSide_Obj1_Ground_Pos_X "X-Axis Position of the Target obstacle";
CM_ SG_ 649 HAP_RtSide_Obj1_Ground_Pos_Y "Y-Axis Position of the Target obstacle";
CM_ SG_ 649 HAP_RtSide_Obj2_ID "ID of theTarget obstacle on the right side of vehicle";
CM_ SG_ 649 HAP_RtSide_Obj2_type "OD_type";
CM_ SG_ 649 HAP_RtSide_Obj2_Confidence "Confidence of the Target obstacle";
CM_ SG_ 649 HAP_RtSide_Obj2_Ground_Pos_X "X-Axis Position of the Target obstacle";
CM_ SG_ 649 HAP_RtSide_Obj2_Ground_Pos_Y "Y-Axis Position of the Target obstacle";
CM_ SG_ 649 HAP_RtSide_Obj3_ID "ID of theTarget obstacle on the right side of vehicle";
CM_ SG_ 649 HAP_RtSide_Obj3_type "OD_type";
CM_ SG_ 649 HAP_RtSide_Obj3_Confidence "Confidence of the Target obstacle";
CM_ SG_ 649 HAP_RtSide_Obj3_Ground_Pos_X "X-Axis Position of the Target obstacle";
CM_ SG_ 649 HAP_RtSide_Obj3_Ground_Pos_Y "Y-Axis Position of the Target obstacle";
CM_ SG_ 649 HAP_RtSide_Obj4_ID "ID of theTarget obstacle on the right side of vehicle";
CM_ SG_ 649 HAP_RtSide_Obj4_type "OD_type";
CM_ SG_ 649 HAP_RtSide_Obj4_Confidence "Confidence of the Target obstacle";
CM_ SG_ 649 HAP_RtSide_Obj4_Ground_Pos_X "X-Axis Position of the Target obstacle";
CM_ SG_ 649 HAP_RtSide_Obj4_Ground_Pos_Y "Y-Axis Position of the Target obstacle";
CM_ SG_ 649 USS_FLSide1_Status "USS(on the front left side) Working Status";
CM_ SG_ 649 USS_FLSide1_Dist "Distance of detecting the target on the front left side";
CM_ SG_ 649 USS_RLSide2_Status "USS(on the rear left side) Working Status";
CM_ SG_ 649 USS_RLSide2_Dist "Distance of detecting the target on the rear left side";
CM_ SG_ 649 USS_FRSide1_Status "USS(on the front right side) Working Status";
CM_ SG_ 649 USS_FRSide1_Dist "Distance of detecting the target on the front right side";
CM_ SG_ 649 USS_RRSide2_Status "USS(on the rear right side) Working Status";
CM_ SG_ 649 USS_RRSide2_Dist "Distance of detecting the target on the rear right side";
CM_ SG_ 647 Checksum_HC1 "Use the checksum strategy from document â€œEnd-to-End Communication Protection Specificationâ€";
CM_ SG_ 647 HighBeamSts_HC "High beam status";
CM_ SG_ 647 ADBstatus "ADB status";
CM_ SG_ 647 LeftLowBeamFailSts "Left Low beam  fail status";
CM_ SG_ 647 RightLowBeamFailSts "Right Low beam  fail status";
CM_ SG_ 647 LeftHighBeamFailSts "Left High Beam Fail Status";
CM_ SG_ 647 RightHighBeamFailSts "Right High Beam Fail Status";
CM_ SG_ 647 ALS_FailSts "ALS failure status";
CM_ SG_ 647 RollingCounter_HC1 "RollingCounter_HC1";
CM_ SG_ 714 DrvMirrFold_UnfoldSts "Driver RearView Mirror FoldUnfold status";
CM_ SG_ 714 PowerCutSwt "power cut switch";
CM_ SG_ 714 DrvWinPosnSts "driver window position status";
CM_ SG_ 714 DrvWinAntiPinchSts "Driver Window Anti-Pinch Status";
CM_ SG_ 714 DrvWinLrnSts "driver window learning status";
CM_ SG_ 714 DrvWinHotProtSts "driver window hot protection status";
CM_ SG_ 714 DrvSideRearAntiPinchSts "driver side rear Window Anti-Pinch  status";
CM_ SG_ 714 DrvSideRearWinPosnSts "driver side rear window position status";
CM_ SG_ 714 DrvSideRearWinLrnSts "driver side rear window learning status";
CM_ SG_ 714 DrvSideRearWinHotProtSts "driver side rear window hot protection status";
CM_ SG_ 717 PassMirrFold_UnfoldSts "Passenger Rear View Mirror FoldUnfold Status.";
CM_ SG_ 717 PassWinAntiPinchSts "Passenger Window Anti-Pinch Status";
CM_ SG_ 717 PassWinPosnSts "passenger window position status";
CM_ SG_ 717 PassWinLrnSts "passenger window learning status";
CM_ SG_ 717 PassWinHotProtSts "passenger window hot protection status";
CM_ SG_ 717 PassSideRearWinAntiPinchSts "passenger side rear window Anti-Pinch status";
CM_ SG_ 717 PassSideRearWinPosnSts "passenger side rear window position status";
CM_ SG_ 717 PassSideRearWinLrnSts "passenger side rear window learning status";
CM_ SG_ 717 PassSideRearWinHotProtSts "passenger side rear window hot protection status";
CM_ SG_ 862 RoofModFb "Feedback of RoofMod";
CM_ SG_ 862 AllTerrainDislFb "Feedback of AllTerrainDisl";
CM_ SG_ 862 ElecSideStepSysFb "Feedback of ElecSideStepSys";
CM_ SG_ 771 RotSteerWheel "Rotate Steering Wheel";
CM_ SG_ 543 STBS_SoundReq "STBS Touch Sound Request(è§¦æ‘¸å‘å£°è¯·æ±‚)";
CM_ SG_ 543 VolUpReq_SC "Volume Up Request_STBS Control(éŸ³é‡å¢žåŠ è¯·æ±‚)";
CM_ SG_ 543 VolDwnReq_SC "Volume Down Request_STBS Control(éŸ³é‡å‡å°è¯·æ±‚)";
CM_ SG_ 543 DispTODReq_SC "Display TOD(standby mode display Time Of Day) Request_STBS Control(å¾…æœºæ¨¡å¼è¯·æ±‚)";
CM_ SG_ 766 PLG_Sts "PLG statusï¼Œ";
CM_ SG_ 86 E_CALLSts "E-CALL Status";
CM_ SG_ 86 QuietVoiceReq "Indicates the quiet voice request states";
CM_ SG_ 621 FPAS_ObjFLCornrAr1_0x26d "Front left Corner sensor detect area1";
CM_ SG_ 621 FPAS_ObjFLCornrAr2_0x26d "Front left Corner sensor detect area2";
CM_ SG_ 621 FPAS_ObjFLMidlAr1_0x26d "Front left middle sensor detect area1";
CM_ SG_ 621 FPAS_ObjFLMidlAr2_0x26d "Front left middle sensor detect area2";
CM_ SG_ 621 FPAS_ObjFRMidlAr1_0x26d "Front right middle sensor detect area1";
CM_ SG_ 621 FPAS_ObjFRMidlAr2_0x26d "Front right middle area2";
CM_ SG_ 621 FPAS_ObjFRCornrAr1_0x26d "Front right Corner sensor detect area1";
CM_ SG_ 621 FPAS_ObjFRCornrAr2_0x26d "Front right Corner sensor detect area2";
CM_ SG_ 621 FPAS_FLCornrSnsrFltSts "Fault status of the Front Left Corner sensor";
CM_ SG_ 621 FPAS_FLMiddlSnsrFltSts "Fault status of the Front Left Middle  sensor";
CM_ SG_ 621 FPAS_FRMiddlSnsrFltSts "Fault status of the Front Right Middle sensor";
CM_ SG_ 621 FPAS_FRCornrSnsrFltSts "Faultstatus of the Front Right Corner sensor";
CM_ SG_ 621 FPAS_WorkSts_0x26d "Park Assistant Front System Status";
CM_ SG_ 621 FPAS_AutoModSts_0x26d "Park Assistant Front System AutoStategy Status";
CM_ SG_ 621 FPAS_SoundIndcn_0x26d "Front Park Assistant System Sound Indication";
CM_ SG_ 621 FPAS_NearBrrdstn_0x26d "FPAS nearest barrier distance";
CM_ SG_ 749 RPAS_NearBrrdstn_0x2ed "RPAS nearest barrier distance";
CM_ SG_ 737 VSG_Sts "VSG status.";
CM_ SG_ 737 VSG_HUTSoundResp "VSG audio options Respond";
CM_ SG_ 656 PressReliProgs "PressReliProgsIP";
CM_ SG_ 656 FTIVFault "Fuel Tank Isolation Valve Fault.IP";
CM_ SG_ 656 FuelTankCapWarning "Fuel tank cap do not colse warning.IP";
CM_ SG_ 279 EngState_PHEV "Engine status.HUT";
CM_ SG_ 279 CruiseCtrlSts_PHEV "Cruise control statusIP";
CM_ SG_ 616 HCU_ChrgDchrgSts "Chargingdischarging status";
CM_ SG_ 616 HCU_BattLowTemWarn "Battery low temperature low warnIP Received";
CM_ SG_ 616 HCU_BattLowHeatSts "Low temperature heating state of batteryIP Received";
CM_ SG_ 616 HCU_IntelEngIdlChrgnSts "Intelligent Engine Idle Charging status";
CM_ SG_ 788 HCU_ACLineDisconnect "AC Line Disconnect";
CM_ SG_ 788 HCU_ChargSts "Charging  statue  displayIPHUT Received";
CM_ SG_ 788 HCU_WorkshopMode "WorkshopModeIP Received";
CM_ SG_ 788 HCU_IntelBattTempMagSts "Intelligent Battery Temperature Management state";
CM_ SG_ 962 HCU_EVContnsDistance "Electric continuous distance.IP Received";
CM_ SG_ 962 HCU_EVContnsDistanceVld "Electric continuous distance valid.IP Received";
CM_ SG_ 962 HCU_RecupPwr "Accumulated electric energy the vehicle recuperated since ig on,
Energy quantity counter overflow is allowed.";
CM_ SG_ 962 HCU_EgyUsed "Accumulated electric energy the vehicle usd since ig on,Energyquantity counter overflow is allowed.";
CM_ SG_ 962 HCU_HiVoltInterlockSts_RM "HVIL error status";
BA_DEF_ BO_  "DiagRequest" ENUM  "No","Yes";
BA_DEF_ BO_  "DiagResponse" ENUM  "No","Yes";
BA_DEF_ BO_  "DiagState" ENUM  "No","Yes";
BA_DEF_ BO_  "GenMsgCycleTime" INT 0 65535;
BA_DEF_ BO_  "GenMsgCycleTimeFast" INT 0 65535;
BA_DEF_ BO_  "GenMsgILSupport" ENUM  "No","Yes";
BA_DEF_ BO_  "GenMsgNrOfRepetition" INT 0 65535;
BA_DEF_ BO_  "GenMsgSendType" ENUM  "Cyclic","CyclicAndSpontanX","Event";
BA_DEF_ BO_  "NmAsrMessage" ENUM  "No","Yes";
BA_DEF_ BO_  "SCP_AuthInfoTxLength" INT 0 512;
BA_DEF_ BO_  "SCP_DataId" INT 0 65535;
BA_DEF_ BO_  "SCP_FreshnessValueLength" INT 0 512;
BA_DEF_ BO_  "SCP_FreshnessValueTxLength" INT 0 512;
BA_DEF_ BO_  "SC_Message" ENUM  "NO","YES";
BA_DEF_ BO_  "VFrameFormat" ENUM  "StandardCAN","ExtendedCAN","reserved","reserved","reserved","reserved","reserved","reserved","reserved","reserved","reserved","reserved","reserved","reserved","StandardCAN_FD","ExtendedCAN_FD";
BA_DEF_ SG_  "GenSigCycleTime" INT 0 65535;
BA_DEF_ SG_  "GenSigSendType" ENUM  "Cyclic","OnWrite","OnWriteWithRepetition","OnChange","OnChangeWithRepetition","NotUsed","NotUsed","NoSigSendType";
BA_DEF_ SG_  "GenSigStartValue" FLOAT 0 100000000000;
BA_DEF_ SG_  "TransparentInitValue" STRING ;
BA_DEF_ SG_  "SystemSignalLongSymbol" STRING ;
BA_DEF_DEF_  "DiagRequest" "No";
BA_DEF_DEF_  "DiagResponse" "No";
BA_DEF_DEF_  "DiagState" "No";
BA_DEF_DEF_  "GenMsgCycleTime" 0;
BA_DEF_DEF_  "GenMsgCycleTimeFast" 0;
BA_DEF_DEF_  "GenMsgILSupport" "No";
BA_DEF_DEF_  "GenMsgNrOfRepetition" 0;
BA_DEF_DEF_  "GenMsgSendType" "Cyclic";
BA_DEF_DEF_  "NmAsrMessage" "No";
BA_DEF_DEF_  "SCP_AuthInfoTxLength" 0;
BA_DEF_DEF_  "SCP_DataId" 0;
BA_DEF_DEF_  "SCP_FreshnessValueLength" 0;
BA_DEF_DEF_  "SCP_FreshnessValueTxLength" 0;
BA_DEF_DEF_  "SC_Message" "NO";
BA_DEF_DEF_  "VFrameFormat" "";
BA_DEF_DEF_  "GenSigCycleTime" 0;
BA_DEF_DEF_  "GenSigSendType" "Cyclic";
BA_DEF_DEF_  "GenSigStartValue" 0;
BA_DEF_DEF_  "TransparentInitValue" "";
BA_DEF_DEF_  "SystemSignalLongSymbol" "";
BA_ "SC_Message" BO_ 793 1;
BA_ "SCP_FreshnessValueTxLength" BO_ 793 16;
BA_ "SCP_FreshnessValueLength" BO_ 793 64;
BA_ "SCP_DataId" BO_ 793 793;
BA_ "SCP_AuthInfoTxLength" BO_ 793 48;
BA_ "GenMsgILSupport" BO_ 793 1;
BA_ "GenMsgCycleTime" BO_ 793 50;
BA_ "VFrameFormat" BO_ 793 14;
BA_ "SC_Message" BO_ 837 1;
BA_ "SCP_FreshnessValueTxLength" BO_ 837 16;
BA_ "SCP_FreshnessValueLength" BO_ 837 64;
BA_ "SCP_DataId" BO_ 837 837;
BA_ "SCP_AuthInfoTxLength" BO_ 837 48;
BA_ "GenMsgILSupport" BO_ 837 1;
BA_ "GenMsgCycleTime" BO_ 837 50;
BA_ "VFrameFormat" BO_ 837 14;
BA_ "GenMsgILSupport" BO_ 652 1;
BA_ "GenMsgCycleTime" BO_ 652 100;
BA_ "VFrameFormat" BO_ 652 14;
BA_ "GenMsgILSupport" BO_ 671 1;
BA_ "GenMsgCycleTime" BO_ 671 100;
BA_ "VFrameFormat" BO_ 671 14;
BA_ "GenMsgILSupport" BO_ 773 1;
BA_ "GenMsgCycleTime" BO_ 773 100;
BA_ "VFrameFormat" BO_ 773 14;
BA_ "GenMsgILSupport" BO_ 568 1;
BA_ "GenMsgCycleTime" BO_ 568 50;
BA_ "VFrameFormat" BO_ 568 14;
BA_ "GenMsgILSupport" BO_ 661 1;
BA_ "GenMsgCycleTime" BO_ 661 50;
BA_ "VFrameFormat" BO_ 661 14;
BA_ "GenMsgNrOfRepetition" BO_ 770 5;
BA_ "GenMsgILSupport" BO_ 770 1;
BA_ "GenMsgCycleTimeFast" BO_ 770 20;
BA_ "GenMsgCycleTime" BO_ 770 200;
BA_ "VFrameFormat" BO_ 770 14;
BA_ "GenMsgSendType" BO_ 53 2;
BA_ "GenMsgNrOfRepetition" BO_ 53 5;
BA_ "GenMsgILSupport" BO_ 53 1;
BA_ "GenMsgCycleTimeFast" BO_ 53 20;
BA_ "VFrameFormat" BO_ 53 14;
BA_ "GenMsgSendType" BO_ 70 2;
BA_ "GenMsgNrOfRepetition" BO_ 70 5;
BA_ "GenMsgILSupport" BO_ 70 1;
BA_ "GenMsgCycleTimeFast" BO_ 70 20;
BA_ "VFrameFormat" BO_ 70 14;
BA_ "GenMsgILSupport" BO_ 669 1;
BA_ "GenMsgCycleTime" BO_ 669 100;
BA_ "VFrameFormat" BO_ 669 14;
BA_ "GenMsgILSupport" BO_ 901 1;
BA_ "GenMsgCycleTime" BO_ 901 100;
BA_ "VFrameFormat" BO_ 901 14;
BA_ "GenMsgILSupport" BO_ 721 1;
BA_ "GenMsgCycleTime" BO_ 721 100;
BA_ "VFrameFormat" BO_ 721 14;
BA_ "GenMsgILSupport" BO_ 360 1;
BA_ "GenMsgCycleTime" BO_ 360 20;
BA_ "VFrameFormat" BO_ 360 14;
BA_ "GenMsgILSupport" BO_ 354 1;
BA_ "GenMsgCycleTime" BO_ 354 20;
BA_ "VFrameFormat" BO_ 354 14;
BA_ "GenMsgILSupport" BO_ 327 1;
BA_ "GenMsgCycleTime" BO_ 327 20;
BA_ "VFrameFormat" BO_ 327 14;
BA_ "GenMsgILSupport" BO_ 411 1;
BA_ "GenMsgCycleTime" BO_ 411 50;
BA_ "VFrameFormat" BO_ 411 14;
BA_ "GenMsgILSupport" BO_ 357 1;
BA_ "GenMsgCycleTime" BO_ 357 20;
BA_ "VFrameFormat" BO_ 357 14;
BA_ "GenMsgILSupport" BO_ 161 1;
BA_ "GenMsgCycleTime" BO_ 161 10;
BA_ "VFrameFormat" BO_ 161 14;
BA_ "GenMsgILSupport" BO_ 580 1;
BA_ "GenMsgCycleTime" BO_ 580 50;
BA_ "VFrameFormat" BO_ 580 14;
BA_ "GenMsgILSupport" BO_ 593 1;
BA_ "GenMsgCycleTime" BO_ 593 20;
BA_ "VFrameFormat" BO_ 593 14;
BA_ "GenMsgILSupport" BO_ 698 1;
BA_ "GenMsgCycleTime" BO_ 698 100;
BA_ "VFrameFormat" BO_ 698 14;
BA_ "GenMsgSendType" BO_ 993 2;
BA_ "GenMsgNrOfRepetition" BO_ 993 5;
BA_ "GenMsgILSupport" BO_ 993 1;
BA_ "GenMsgCycleTimeFast" BO_ 993 20;
BA_ "VFrameFormat" BO_ 993 14;
BA_ "SC_Message" BO_ 995 1;
BA_ "SCP_FreshnessValueTxLength" BO_ 995 16;
BA_ "SCP_FreshnessValueLength" BO_ 995 64;
BA_ "SCP_DataId" BO_ 995 995;
BA_ "SCP_AuthInfoTxLength" BO_ 995 48;
BA_ "GenMsgSendType" BO_ 995 2;
BA_ "GenMsgNrOfRepetition" BO_ 995 5;
BA_ "GenMsgILSupport" BO_ 995 1;
BA_ "GenMsgCycleTimeFast" BO_ 995 20;
BA_ "VFrameFormat" BO_ 995 14;
BA_ "GenMsgSendType" BO_ 997 2;
BA_ "GenMsgNrOfRepetition" BO_ 997 5;
BA_ "GenMsgILSupport" BO_ 997 1;
BA_ "GenMsgCycleTimeFast" BO_ 997 20;
BA_ "VFrameFormat" BO_ 997 14;
BA_ "GenMsgSendType" BO_ 722 2;
BA_ "GenMsgNrOfRepetition" BO_ 722 5;
BA_ "GenMsgILSupport" BO_ 722 1;
BA_ "GenMsgCycleTimeFast" BO_ 722 20;
BA_ "VFrameFormat" BO_ 722 14;
BA_ "GenMsgSendType" BO_ 929 2;
BA_ "GenMsgNrOfRepetition" BO_ 929 5;
BA_ "GenMsgILSupport" BO_ 929 1;
BA_ "GenMsgCycleTimeFast" BO_ 929 20;
BA_ "VFrameFormat" BO_ 929 14;
BA_ "GenMsgILSupport" BO_ 805 1;
BA_ "GenMsgCycleTime" BO_ 805 200;
BA_ "VFrameFormat" BO_ 805 14;
BA_ "SC_Message" BO_ 412 1;
BA_ "SCP_FreshnessValueTxLength" BO_ 412 16;
BA_ "SCP_FreshnessValueLength" BO_ 412 64;
BA_ "SCP_DataId" BO_ 412 412;
BA_ "SCP_AuthInfoTxLength" BO_ 412 48;
BA_ "GenMsgILSupport" BO_ 412 1;
BA_ "GenMsgCycleTime" BO_ 412 50;
BA_ "VFrameFormat" BO_ 412 14;
BA_ "SC_Message" BO_ 849 1;
BA_ "SCP_FreshnessValueTxLength" BO_ 849 16;
BA_ "SCP_FreshnessValueLength" BO_ 849 64;
BA_ "SCP_DataId" BO_ 849 849;
BA_ "SCP_AuthInfoTxLength" BO_ 849 48;
BA_ "GenMsgNrOfRepetition" BO_ 849 5;
BA_ "GenMsgILSupport" BO_ 849 1;
BA_ "GenMsgCycleTimeFast" BO_ 849 20;
BA_ "GenMsgCycleTime" BO_ 849 500;
BA_ "VFrameFormat" BO_ 849 14;
BA_ "GenMsgILSupport" BO_ 581 1;
BA_ "GenMsgCycleTime" BO_ 581 20;
BA_ "VFrameFormat" BO_ 581 14;
BA_ "SC_Message" BO_ 833 1;
BA_ "SCP_FreshnessValueTxLength" BO_ 833 16;
BA_ "SCP_FreshnessValueLength" BO_ 833 64;
BA_ "SCP_DataId" BO_ 833 833;
BA_ "SCP_AuthInfoTxLength" BO_ 833 48;
BA_ "GenMsgILSupport" BO_ 833 1;
BA_ "GenMsgCycleTime" BO_ 833 500;
BA_ "VFrameFormat" BO_ 833 14;
BA_ "SC_Message" BO_ 917 1;
BA_ "SCP_FreshnessValueTxLength" BO_ 917 16;
BA_ "SCP_FreshnessValueLength" BO_ 917 64;
BA_ "SCP_DataId" BO_ 917 917;
BA_ "SCP_AuthInfoTxLength" BO_ 917 48;
BA_ "GenMsgILSupport" BO_ 917 1;
BA_ "GenMsgCycleTime" BO_ 917 500;
BA_ "VFrameFormat" BO_ 917 14;
BA_ "GenMsgILSupport" BO_ 627 1;
BA_ "GenMsgCycleTime" BO_ 627 50;
BA_ "VFrameFormat" BO_ 627 14;
BA_ "GenMsgILSupport" BO_ 622 1;
BA_ "GenMsgCycleTime" BO_ 622 100;
BA_ "VFrameFormat" BO_ 622 14;
BA_ "GenMsgILSupport" BO_ 347 1;
BA_ "GenMsgCycleTime" BO_ 347 20;
BA_ "VFrameFormat" BO_ 347 14;
BA_ "GenMsgILSupport" BO_ 628 1;
BA_ "GenMsgCycleTime" BO_ 628 50;
BA_ "VFrameFormat" BO_ 628 14;
BA_ "GenMsgILSupport" BO_ 664 1;
BA_ "GenMsgCycleTime" BO_ 664 100;
BA_ "VFrameFormat" BO_ 664 14;
BA_ "GenMsgILSupport" BO_ 649 1;
BA_ "GenMsgCycleTime" BO_ 649 100;
BA_ "VFrameFormat" BO_ 649 14;
BA_ "GenMsgILSupport" BO_ 647 1;
BA_ "GenMsgCycleTime" BO_ 647 100;
BA_ "VFrameFormat" BO_ 647 14;
BA_ "GenMsgILSupport" BO_ 714 1;
BA_ "GenMsgCycleTime" BO_ 714 100;
BA_ "VFrameFormat" BO_ 714 14;
BA_ "GenMsgILSupport" BO_ 717 1;
BA_ "GenMsgCycleTime" BO_ 717 100;
BA_ "VFrameFormat" BO_ 717 14;
BA_ "GenMsgILSupport" BO_ 862 1;
BA_ "GenMsgCycleTime" BO_ 862 500;
BA_ "VFrameFormat" BO_ 862 14;
BA_ "GenMsgNrOfRepetition" BO_ 771 5;
BA_ "GenMsgILSupport" BO_ 771 1;
BA_ "GenMsgCycleTimeFast" BO_ 771 20;
BA_ "GenMsgCycleTime" BO_ 771 200;
BA_ "VFrameFormat" BO_ 771 14;
BA_ "GenMsgILSupport" BO_ 543 1;
BA_ "GenMsgCycleTime" BO_ 543 50;
BA_ "VFrameFormat" BO_ 543 14;
BA_ "GenMsgILSupport" BO_ 766 1;
BA_ "GenMsgCycleTime" BO_ 766 100;
BA_ "VFrameFormat" BO_ 766 14;
BA_ "GenMsgSendType" BO_ 86 2;
BA_ "GenMsgNrOfRepetition" BO_ 86 5;
BA_ "GenMsgILSupport" BO_ 86 1;
BA_ "GenMsgCycleTimeFast" BO_ 86 20;
BA_ "VFrameFormat" BO_ 86 14;
BA_ "GenMsgILSupport" BO_ 621 1;
BA_ "GenMsgCycleTime" BO_ 621 100;
BA_ "VFrameFormat" BO_ 621 14;
BA_ "GenMsgILSupport" BO_ 749 1;
BA_ "GenMsgCycleTime" BO_ 749 100;
BA_ "VFrameFormat" BO_ 749 14;
BA_ "GenMsgILSupport" BO_ 737 1;
BA_ "GenMsgCycleTime" BO_ 737 100;
BA_ "VFrameFormat" BO_ 737 14;
BA_ "GenMsgILSupport" BO_ 656 1;
BA_ "GenMsgCycleTime" BO_ 656 100;
BA_ "VFrameFormat" BO_ 656 14;
BA_ "GenMsgILSupport" BO_ 279 1;
BA_ "GenMsgCycleTime" BO_ 279 20;
BA_ "VFrameFormat" BO_ 279 14;
BA_ "GenMsgILSupport" BO_ 616 1;
BA_ "GenMsgCycleTime" BO_ 616 50;
BA_ "VFrameFormat" BO_ 616 14;
BA_ "GenMsgILSupport" BO_ 788 1;
BA_ "GenMsgCycleTime" BO_ 788 200;
BA_ "VFrameFormat" BO_ 788 14;
BA_ "GenMsgILSupport" BO_ 962 1;
BA_ "GenMsgCycleTime" BO_ 962 1000;
BA_ "VFrameFormat" BO_ 962 14;
BA_ "GenSigCycleTime" SG_ 793 IPBackgroundLmpCmd 50;
BA_ "GenSigCycleTime" SG_ 793 TrunkSts 50;
BA_ "GenSigCycleTime" SG_ 793 DrvDoorSts 50;
BA_ "GenSigCycleTime" SG_ 793 LRDoorSts 50;
BA_ "GenSigCycleTime" SG_ 793 PassengerDoorSts 50;
BA_ "GenSigCycleTime" SG_ 793 RRDoorSts 50;
BA_ "GenSigCycleTime" SG_ 793 BrkPedalSts_BCM 50;
BA_ "GenSigStartValue" SG_ 793 BackgroundLightLvl 128;
BA_ "GenSigCycleTime" SG_ 793 BackgroundLightLvl 50;
BA_ "GenSigCycleTime" SG_ 793 DrowsyDrvDetWarn 50;
BA_ "GenSigCycleTime" SG_ 793 RLSFailSts 50;
BA_ "GenSigCycleTime" SG_ 793 ReversGearSts 50;
BA_ "GenSigCycleTime" SG_ 793 PosnLightReq 50;
BA_ "GenSigCycleTime" SG_ 793 FreshnessValue_BCM1 50;
BA_ "GenSigCycleTime" SG_ 793 MAC_Check_BCM1 50;
BA_ "TransparentInitValue" SG_ 793 BCM1_0x319 "0 0 0 0 128 0 0 0 0 0 0 0 0 0 0 0 ";
BA_ "GenSigCycleTime" SG_ 793 BCM1_0x319 50;
BA_ "GenSigCycleTime" SG_ 837 LasHdLmpSts 50;
BA_ "GenSigCycleTime" SG_ 837 AntitheftSts 50;
BA_ "GenSigCycleTime" SG_ 837 DrvDoorLockSts 50;
BA_ "GenSigCycleTime" SG_ 837 DoorLockSts 50;
BA_ "GenSigCycleTime" SG_ 837 RLDoorLockSts 50;
BA_ "GenSigCycleTime" SG_ 837 PassDoorLockSts 50;
BA_ "GenSigCycleTime" SG_ 837 RRDoorLockSts 50;
BA_ "GenSigCycleTime" SG_ 837 HazardLmpSwtSts 50;
BA_ "GenSigCycleTime" SG_ 837 HiLowBeamSts 50;
BA_ "GenSigCycleTime" SG_ 837 FreshnessValue_BCM3 50;
BA_ "GenSigCycleTime" SG_ 837 MAC_Check_BCM3 50;
BA_ "TransparentInitValue" SG_ 837 BCM3_0x345 "0 0 0 0 0 0 0 0 0 0 0 0 0 0 0 0 ";
BA_ "GenSigCycleTime" SG_ 837 BCM3_0x345 50;
BA_ "GenSigCycleTime" SG_ 652 VolSwtReq 100;
BA_ "GenSigCycleTime" SG_ 652 VolSwtErrSts 100;
BA_ "TransparentInitValue" SG_ 652 BCM6_0x28C "0 0 0 0 0 0 0 0 ";
BA_ "GenSigCycleTime" SG_ 652 BCM6_0x28C 100;
BA_ "GenSigCycleTime" SG_ 671 RemoteModSts 100;
BA_ "GenSigCycleTime" SG_ 671 PASWorkCmd 100;
BA_ "GenSigCycleTime" SG_ 671 WhistleSts 100;
BA_ "GenSigCycleTime" SG_ 671 WiprReq_F_Pbox 100;
BA_ "GenSigCycleTime" SG_ 671 KL30BRelaySts 100;
BA_ "TransparentInitValue" SG_ 671 BCM8_0x29F "0 0 0 0 0 0 0 0 ";
BA_ "GenSigCycleTime" SG_ 671 BCM8_0x29F 100;
BA_ "GenSigCycleTime" SG_ 773 ClsWinRmd 100;
BA_ "GenSigCycleTime" SG_ 568 SrAntiPinch 50;
BA_ "GenSigStartValue" SG_ 568 SsPosn_VR_APP 127;
BA_ "GenSigCycleTime" SG_ 568 SsPosn_VR_APP 50;
BA_ "GenSigCycleTime" SG_ 568 SsAntiPinch 50;
BA_ "GenSigStartValue" SG_ 568 SrPosn_VR_APP 127;
BA_ "GenSigCycleTime" SG_ 568 SrPosn_VR_APP 50;
BA_ "TransparentInitValue" SG_ 568 BCM12_0x238 "0 0 0 0 0 127 127 0 ";
BA_ "GenSigCycleTime" SG_ 568 BCM12_0x238 50;
BA_ "GenSigCycleTime" SG_ 661 SysPowerMod 50;
BA_ "GenSigCycleTime" SG_ 661 SysPowerModVld 50;
BA_ "GenSigCycleTime" SG_ 661 RemUpgrdModSysPower 50;
BA_ "GenSigCycleTime" SG_ 661 RemPowerFailureSts 50;
BA_ "TransparentInitValue" SG_ 661 PEPS2_0x295 "0 0 0 0 0 0 0 0 ";
BA_ "GenSigCycleTime" SG_ 661 PEPS2_0x295 50;
BA_ "GenSigSendType" SG_ 770 WarnPowerNotInOffPosn 2;
BA_ "GenSigCycleTime" SG_ 770 WarnPowerNotInOffPosn 200;
BA_ "GenSigSendType" SG_ 770 WarnKeyInCarWhenExit 2;
BA_ "GenSigCycleTime" SG_ 770 WarnKeyInCarWhenExit 200;
BA_ "GenSigSendType" SG_ 770 WarnVldKeyNotFound 2;
BA_ "GenSigCycleTime" SG_ 770 WarnVldKeyNotFound 200;
BA_ "GenSigSendType" SG_ 770 WarnEngStrtNotMeet 2;
BA_ "GenSigCycleTime" SG_ 770 WarnEngStrtNotMeet 200;
BA_ "GenSigSendType" SG_ 770 PowerRlyFault 2;
BA_ "GenSigCycleTime" SG_ 770 PowerRlyFault 200;
BA_ "TransparentInitValue" SG_ 770 PEPS4_0x302 "0 0 0 0 0 0 0 0 ";
BA_ "GenSigCycleTime" SG_ 770 PEPS4_0x302 200;
BA_ "GenSigSendType" SG_ 53 PEPS_T_BoxAuth1 2;
BA_ "GenSigSendType" SG_ 70 PEPS_T_BoxAuth2 2;
BA_ "GenSigStartValue" SG_ 669 InCarTemp 254;
BA_ "GenSigCycleTime" SG_ 669 InCarTemp 100;
BA_ "GenSigCycleTime" SG_ 669 ACAQSEnaSts 100;
BA_ "GenSigCycleTime" SG_ 669 ACOperMod 100;
BA_ "GenSigCycleTime" SG_ 669 ACAIUEnaSts 100;
BA_ "GenSigStartValue" SG_ 669 ACDrvAirDistriMod 7;
BA_ "GenSigCycleTime" SG_ 669 ACDrvAirDistriMod 100;
BA_ "GenSigCycleTime" SG_ 669 ACSteplessSpdSetEnaSts 100;
BA_ "GenSigCycleTime" SG_ 669 ACFrntPassTempSteplessSetEnaSts 100;
BA_ "GenSigCycleTime" SG_ 669 ACDrvTempSteplessSetEnaSts 100;
BA_ "GenSigCycleTime" SG_ 669 ACEEMSts 100;
BA_ "GenSigCycleTime" SG_ 669 ACCbnClnEnasts 100;
BA_ "GenSigCycleTime" SG_ 669 ACCbnClnOffCode 100;
BA_ "TransparentInitValue" SG_ 669 AC1_0x29D "0 254 224 0 0 0 0 0 ";
BA_ "GenSigCycleTime" SG_ 669 AC1_0x29D 100;
BA_ "GenSigCycleTime" SG_ 901 ACFrntDefrstSts 100;
BA_ "GenSigCycleTime" SG_ 901 ACHMIDispCmd 100;
BA_ "GenSigStartValue" SG_ 901 ACFrntBlwrSpd 15;
BA_ "GenSigCycleTime" SG_ 901 ACFrntBlwrSpd 100;
BA_ "GenSigCycleTime" SG_ 901 ACOpenSts 100;
BA_ "GenSigCycleTime" SG_ 901 ACDualModEnaSts 100;
BA_ "GenSigStartValue" SG_ 901 ACDrvTemp_ATC 33;
BA_ "GenSigCycleTime" SG_ 901 ACDrvTemp_ATC 100;
BA_ "GenSigStartValue" SG_ 901 ACAmbTemp 254;
BA_ "GenSigCycleTime" SG_ 901 ACAmbTemp 100;
BA_ "GenSigStartValue" SG_ 901 ACAirInletSts 3;
BA_ "GenSigCycleTime" SG_ 901 ACAirInletSts 100;
BA_ "GenSigStartValue" SG_ 901 ACFrntPasstTemp_ATC 33;
BA_ "GenSigCycleTime" SG_ 901 ACFrntPasstTemp_ATC 100;
BA_ "GenSigCycleTime" SG_ 901 ACAutoModEnaSts 100;
BA_ "GenSigCycleTime" SG_ 901 ACCmprEnaSts 100;
BA_ "GenSigCycleTime" SG_ 901 AC_FrntWinHeatEnaSts 100;
BA_ "GenSigCycleTime" SG_ 901 AC_FrntWinHeatDislSts 100;
BA_ "GenSigCycleTime" SG_ 901 ACAutoDefrstModEnaSts 100;
BA_ "TransparentInitValue" SG_ 901 AC2_0x385 "0 15 254 0 66 6 33 0 ";
BA_ "GenSigCycleTime" SG_ 901 AC2_0x385 100;
BA_ "GenSigCycleTime" SG_ 721 DrvSeatHeatSts 100;
BA_ "GenSigCycleTime" SG_ 721 PassSeatHeatSts 100;
BA_ "GenSigCycleTime" SG_ 721 DrvSeatVentnSts 100;
BA_ "GenSigCycleTime" SG_ 721 PassSeatVentnSts 100;
BA_ "TransparentInitValue" SG_ 721 SCM1_0x2D1 "0 0 0 0 0 0 0 0 ";
BA_ "GenSigCycleTime" SG_ 721 SCM1_0x2D1 100;
BA_ "GenSigCycleTime" SG_ 360 EPS_FailSts_0x168 20;
BA_ "GenSigStartValue" SG_ 360 EPS_TrqSnsrSts_0x168 1;
BA_ "GenSigCycleTime" SG_ 360 EPS_TrqSnsrSts_0x168 20;
BA_ "GenSigCycleTime" SG_ 360 CheckSum_EPS1_0x168 20;
BA_ "GenSigCycleTime" SG_ 360 EPS_SteerMod_0x168 20;
BA_ "GenSigCycleTime" SG_ 360 RollingCounter_EPS1_0x168 20;
BA_ "TransparentInitValue" SG_ 360 EPS1_0x168 "0 64 0 0 0 0 0 0 ";
BA_ "GenSigCycleTime" SG_ 360 EPS1_0x168 20;
BA_ "GenSigCycleTime" SG_ 354 EPS_LKATorqOvrlDlvd_0x162 20;
BA_ "GenSigCycleTime" SG_ 354 EPS_LKATorqOvrlDlvdVld_0x162 20;
BA_ "GenSigCycleTime" SG_ 354 EPS_LKATrqOvlDlvdSts_0x162 20;
BA_ "TransparentInitValue" SG_ 354 EPS2_0x162 "0 0 0 0 0 0 0 0 ";
BA_ "GenSigCycleTime" SG_ 354 EPS2_0x162 20;
BA_ "GenSigCycleTime" SG_ 327 CheckSum_EPS1_0x147 20;
BA_ "GenSigCycleTime" SG_ 327 EPS_FailSts_0x147 20;
BA_ "GenSigStartValue" SG_ 327 EPS_TrqSnsrSts_0x147 1;
BA_ "GenSigCycleTime" SG_ 327 EPS_TrqSnsrSts_0x147 20;
BA_ "GenSigCycleTime" SG_ 327 EPS_SteerMod_0x147 20;
BA_ "GenSigCycleTime" SG_ 327 RollingCounter_EPS1_0x147 20;
BA_ "GenSigCycleTime" SG_ 327 EPS_LKATorqOvrlDlvd_0x147 20;
BA_ "GenSigCycleTime" SG_ 327 EPS_LKATorqOvrlDlvdVld_0x147 20;
BA_ "GenSigCycleTime" SG_ 327 EPS_LKATrqOvlDlvdSts_0x147 20;
BA_ "TransparentInitValue" SG_ 327 EPS_FD1_0x147 "0 64 0 0 0 0 0 0 0 0 0 0 0 0 0 0 0 0 0 0 0 0 0 0 0 0 0 0 0 0 0 0 0 0 0 0 0 0 0 0 0 0 0 0 0 0 0 0 0 0 0 0 0 0 0 0 0 0 0 0 0 0 0 0 ";
BA_ "GenSigCycleTime" SG_ 327 EPS_FD1_0x147 20;
BA_ "GenSigCycleTime" SG_ 411 FFogLmpSts_F_Pbox 50;
BA_ "GenSigCycleTime" SG_ 411 HiBeamSts_F_Pbox 50;
BA_ "GenSigCycleTime" SG_ 411 HoodSts_F_Pbox 50;
BA_ "GenSigCycleTime" SG_ 411 LLasHdLmpDiagSig 50;
BA_ "GenSigCycleTime" SG_ 411 RLasHdLmpDiagSig 50;
BA_ "GenSigCycleTime" SG_ 411 LasHdLmpSts_F_Pbox 50;
BA_ "GenSigCycleTime" SG_ 411 LHiBeamFailSts 50;
BA_ "GenSigCycleTime" SG_ 411 RHiBeamFailSts 50;
BA_ "GenSigCycleTime" SG_ 411 LLowBeamFailSts 50;
BA_ "GenSigCycleTime" SG_ 411 RLowBeamFailSts 50;
BA_ "GenSigCycleTime" SG_ 411 LHeadLmpFailSts 50;
BA_ "GenSigCycleTime" SG_ 411 RHeadLmpFailSts 50;
BA_ "GenSigCycleTime" SG_ 411 WhistleSts_F_Pbox 50;
BA_ "TransparentInitValue" SG_ 411 F_PBox1_0x19B "0 0 0 0 0 0 0 0 ";
BA_ "GenSigCycleTime" SG_ 411 F_PBox1_0x19B 50;
BA_ "GenSigCycleTime" SG_ 357 LTurnLmpSwtSts 20;
BA_ "GenSigCycleTime" SG_ 357 RTurnLmpSwtSts 20;
BA_ "GenSigCycleTime" SG_ 357 AutoLmpSwtSts 20;
BA_ "GenSigCycleTime" SG_ 357 HornSwtSts 20;
BA_ "TransparentInitValue" SG_ 357 CSA1_0x165 "0 0 0 0 0 0 0 0 ";
BA_ "GenSigCycleTime" SG_ 357 CSA1_0x165 20;
BA_ "GenSigCycleTime" SG_ 161 SteerWheelAng 10;
BA_ "GenSigCycleTime" SG_ 161 SteerWheelAngSign 10;
BA_ "GenSigCycleTime" SG_ 161 SteerWheelSpd 10;
BA_ "GenSigCycleTime" SG_ 161 SteerWheelSpdSign 10;
BA_ "GenSigCycleTime" SG_ 161 SAS_Sts 10;
BA_ "GenSigCycleTime" SG_ 161 HWA_OK_OFFSwt 10;
BA_ "TransparentInitValue" SG_ 161 CSA2_0xA1 "0 0 0 0 0 0 0 0 ";
BA_ "GenSigCycleTime" SG_ 161 CSA2_0xA1 10;
BA_ "GenSigCycleTime" SG_ 580 MenuReturnSwtSts 50;
BA_ "GenSigCycleTime" SG_ 580 HomeSwtSts 50;
BA_ "GenSigCycleTime" SG_ 580 MuteSwtSts 50;
BA_ "GenSigCycleTime" SG_ 580 CustomSwtSts 50;
BA_ "GenSigCycleTime" SG_ 580 SteerWheelHeatdSts 50;
BA_ "GenSigCycleTime" SG_ 580 PageUpSwtSts 50;
BA_ "GenSigCycleTime" SG_ 580 PageDwnSwtSts 50;
BA_ "GenSigCycleTime" SG_ 580 PageLSwtSts 50;
BA_ "GenSigCycleTime" SG_ 580 PageRSwtSts 50;
BA_ "GenSigCycleTime" SG_ 580 SeekUpSwtSts 50;
BA_ "GenSigCycleTime" SG_ 580 SeekDwnSwtSts 50;
BA_ "GenSigCycleTime" SG_ 580 AdjVolUpSwtSts 50;
BA_ "GenSigCycleTime" SG_ 580 AdjVolDwnSwtSts 50;
BA_ "GenSigCycleTime" SG_ 580 VRSwtSts 50;
BA_ "GenSigCycleTime" SG_ 580 PhoneSwtSts 50;
BA_ "GenSigCycleTime" SG_ 580 SoundSourceModSwtSts 50;
BA_ "GenSigCycleTime" SG_ 580 EnterSwtSts 50;
BA_ "GenSigCycleTime" SG_ 580 EnterSwtSts_Mmed 50;
BA_ "GenSigCycleTime" SG_ 580 CustomSwtSts_Mmed 50;
BA_ "TransparentInitValue" SG_ 580 CSA3_0x244 "0 0 0 0 0 0 0 0 ";
BA_ "GenSigCycleTime" SG_ 580 CSA3_0x244 50;
BA_ "GenSigCycleTime" SG_ 593 DiagLmpReq 20;
BA_ "GenSigCycleTime" SG_ 593 CouplingThermWarning 20;
BA_ "GenSigCycleTime" SG_ 593 CouplingFaultSts 20;
BA_ "GenSigCycleTime" SG_ 593 EstimatedTorque 20;
BA_ "TransparentInitValue" SG_ 593 Haldex1_0x251 "0 0 0 0 0 0 0 0 ";
BA_ "GenSigCycleTime" SG_ 593 Haldex1_0x251 20;
BA_ "GenSigCycleTime" SG_ 698 WPC_ChrgSts 100;
BA_ "GenSigCycleTime" SG_ 698 WPC_SwtSts 100;
BA_ "GenSigCycleTime" SG_ 698 WPC_FaultSts 100;
BA_ "GenSigCycleTime" SG_ 698 WPC_PhoneReminder 100;
BA_ "TransparentInitValue" SG_ 698 WPC1_0x2BA "0 0 0 0 0 0 0 0 ";
BA_ "GenSigCycleTime" SG_ 698 WPC1_0x2BA 100;
BA_ "GenSigSendType" SG_ 993 AMP_SWVersion 2;
BA_ "GenSigSendType" SG_ 993 AMP_HWVersion 2;
BA_ "GenSigSendType" SG_ 993 AMP_Chan1DTCInfo 2;
BA_ "GenSigSendType" SG_ 993 AMP_Chan2DTCInfo 2;
BA_ "GenSigSendType" SG_ 993 AMP_Chan3DTCInfo 2;
BA_ "GenSigSendType" SG_ 993 AMP_Chan4DTCInfo 2;
BA_ "GenSigSendType" SG_ 993 AMP_Chan5DTCInfo 2;
BA_ "GenSigSendType" SG_ 993 AMP_Chan6DTCInfo 2;
BA_ "GenSigSendType" SG_ 993 AMP_Chan7DTCInfo 2;
BA_ "GenSigSendType" SG_ 993 AMP_Chan8DTCInfo 2;
BA_ "GenSigSendType" SG_ 993 AMP_TempValue 2;
BA_ "GenSigSendType" SG_ 993 AMP_TempSts 2;
BA_ "GenSigSendType" SG_ 993 AMP_VolValue 2;
BA_ "GenSigSendType" SG_ 993 BestListegPosnResp 2;
BA_ "GenSigStartValue" SG_ 993 Clari_FiResp 1;
BA_ "GenSigSendType" SG_ 993 Clari_FiResp 2;
BA_ "TransparentInitValue" SG_ 993 AMP1_0x3E1 "0 0 0 0 0 0 32 0 ";
BA_ "GenSigSendType" SG_ 993 AMP1_0x3E1 2;
BA_ "GenSigSendType" SG_ 995 MediaCallSourceState 2;
BA_ "GenSigSendType" SG_ 995 BeepSourceSts 2;
BA_ "GenSigStartValue" SG_ 995 BalanceSetState 10;
BA_ "GenSigSendType" SG_ 995 BalanceSetState 2;
BA_ "GenSigStartValue" SG_ 995 VSCModeState 2;
BA_ "GenSigSendType" SG_ 995 VSCModeState 2;
BA_ "GenSigStartValue" SG_ 995 FadeSetState 10;
BA_ "GenSigSendType" SG_ 995 FadeSetState 2;
BA_ "GenSigSendType" SG_ 995 DriveSideSts 2;
BA_ "GenSigStartValue" SG_ 995 BassSetState 10;
BA_ "GenSigSendType" SG_ 995 BassSetState 2;
BA_ "GenSigStartValue" SG_ 995 MuteState 1;
BA_ "GenSigSendType" SG_ 995 MuteState 2;
BA_ "GenSigSendType" SG_ 995 NaviSourceState 2;
BA_ "GenSigStartValue" SG_ 995 MidrangeSetState 10;
BA_ "GenSigSendType" SG_ 995 MidrangeSetState 2;
BA_ "GenSigSendType" SG_ 995 T_box_ECallSts 2;
BA_ "GenSigStartValue" SG_ 995 GetHUTInfoSts 1;
BA_ "GenSigSendType" SG_ 995 GetHUTInfoSts 2;
BA_ "GenSigStartValue" SG_ 995 TrebleSetState 10;
BA_ "GenSigSendType" SG_ 995 TrebleSetState 2;
BA_ "GenSigStartValue" SG_ 995 QLISurroundSetSt 1;
BA_ "GenSigSendType" SG_ 995 QLISurroundSetSt 2;
BA_ "GenSigSendType" SG_ 995 AVMStResp 2;
BA_ "GenSigStartValue" SG_ 995 NaviMediaVolLvlResp 3;
BA_ "GenSigSendType" SG_ 995 NaviMediaVolLvlResp 2;
BA_ "GenSigStartValue" SG_ 995 AVMMediaVolLvlResp 3;
BA_ "GenSigSendType" SG_ 995 AVMMediaVolLvlResp 2;
BA_ "GenSigSendType" SG_ 995 FPASChStResp 2;
BA_ "GenSigSendType" SG_ 995 RPASChStResp 2;
BA_ "GenSigSendType" SG_ 995 FreshnessValue_AMP2 2;
BA_ "GenSigSendType" SG_ 995 MAC_Check_AMP2 2;
BA_ "TransparentInitValue" SG_ 995 AMP2_0x3E3 "0 82 80 82 0 82 82 51 0 0 0 0 0 0 0 0 ";
BA_ "GenSigSendType" SG_ 995 AMP2_0x3E3 2;
BA_ "GenSigStartValue" SG_ 997 HFMVolSetSts 10;
BA_ "GenSigSendType" SG_ 997 HFMVolSetSts 2;
BA_ "GenSigStartValue" SG_ 997 VR_TTSVolSetSts 10;
BA_ "GenSigSendType" SG_ 997 VR_TTSVolSetSts 2;
BA_ "GenSigStartValue" SG_ 997 NaviVolumeSetState 10;
BA_ "GenSigSendType" SG_ 997 NaviVolumeSetState 2;
BA_ "GenSigStartValue" SG_ 997 MainVolumeSetState 10;
BA_ "GenSigSendType" SG_ 997 MainVolumeSetState 2;
BA_ "GenSigStartValue" SG_ 997 AMPPowerSts 1;
BA_ "GenSigSendType" SG_ 997 AMPPowerSts 2;
BA_ "GenSigStartValue" SG_ 997 IPVolSetSts 15;
BA_ "GenSigSendType" SG_ 997 IPVolSetSts 2;
BA_ "TransparentInitValue" SG_ 997 AMP3_0x3E5 "40 40 40 40 60 4 0 0 ";
BA_ "GenSigSendType" SG_ 997 AMP3_0x3E5 2;
BA_ "GenSigSendType" SG_ 722 Microphone_Cha1DTCInfo 2;
BA_ "GenSigSendType" SG_ 722 Microphone_Cha2DTCInfo 2;
BA_ "GenSigSendType" SG_ 722 Microphone_Cha3DTCInfo 2;
BA_ "GenSigSendType" SG_ 722 Microphone_Cha4DTCInfo 2;
BA_ "GenSigStartValue" SG_ 722 ANCSwtStatus 1;
BA_ "GenSigSendType" SG_ 722 ANCSwtStatus 2;
BA_ "TransparentInitValue" SG_ 722 AMP4_ANC1_0x2D2 "0 0 0 0 0 0 0 4 ";
BA_ "GenSigSendType" SG_ 722 AMP4_ANC1_0x2D2 2;
BA_ "GenSigSendType" SG_ 929 IESS_SwitchModel 2;
BA_ "TransparentInitValue" SG_ 929 AMP5_IESS1_0x3A1 "0 0 0 0 0 0 0 0 ";
BA_ "GenSigSendType" SG_ 929 AMP5_IESS1_0x3A1 2;
BA_ "GenSigStartValue" SG_ 805 HUD_SwtSts 1;
BA_ "GenSigCycleTime" SG_ 805 HUD_SwtSts 200;
BA_ "GenSigStartValue" SG_ 805 HUD_BrightnessLvl 4;
BA_ "GenSigCycleTime" SG_ 805 HUD_BrightnessLvl 200;
BA_ "GenSigStartValue" SG_ 805 HUD_HeightLvl 10;
BA_ "GenSigCycleTime" SG_ 805 HUD_HeightLvl 200;
BA_ "GenSigCycleTime" SG_ 805 HUD_UIMod 200;
BA_ "GenSigCycleTime" SG_ 805 HUD_UIModVld 200;
BA_ "GenSigStartValue" SG_ 805 HUD_Manufactor 7;
BA_ "GenSigCycleTime" SG_ 805 HUD_Manufactor 200;
BA_ "GenSigStartValue" SG_ 805 HUD_ReslType 7;
BA_ "GenSigCycleTime" SG_ 805 HUD_ReslType 200;
BA_ "TransparentInitValue" SG_ 805 HUD1_0x325 "0 65 40 0 0 252 0 0 ";
BA_ "GenSigCycleTime" SG_ 805 HUD1_0x325 200;
BA_ "GenSigCycleTime" SG_ 412 HiPosnBrkLmpFailSts 50;
BA_ "GenSigCycleTime" SG_ 412 LicPlateLmpFailSts 50;
BA_ "GenSigCycleTime" SG_ 412 LBrkLmpFailSts 50;
BA_ "GenSigCycleTime" SG_ 412 RFogLmpFailSts_R_Pbox 50;
BA_ "GenSigCycleTime" SG_ 412 RFogLmpSts_R_Pbox 50;
BA_ "GenSigCycleTime" SG_ 412 ParkLmpSts_R_Pbox 50;
BA_ "GenSigCycleTime" SG_ 412 RBrkLmpFailSts 50;
BA_ "GenSigCycleTime" SG_ 412 PosnLmpOutpSts_R_Pbox 50;
BA_ "GenSigCycleTime" SG_ 412 RRPosnLmpFailSts 50;
BA_ "GenSigCycleTime" SG_ 412 RvsLmpFailSts 50;
BA_ "GenSigCycleTime" SG_ 412 LRPosnLmpFailSts 50;
BA_ "GenSigCycleTime" SG_ 412 RTurnLmpFailSts 50;
BA_ "GenSigCycleTime" SG_ 412 LTurnLmpFailSts 50;
BA_ "GenSigCycleTime" SG_ 412 LTurnLmpSts_R_Pbox 50;
BA_ "GenSigCycleTime" SG_ 412 RTurnLmpSts_R_Pbox 50;
BA_ "GenSigCycleTime" SG_ 412 RWinHeatgIconRlyCmd 50;
BA_ "GenSigCycleTime" SG_ 412 RWinHeatgFailSts 50;
BA_ "GenSigCycleTime" SG_ 412 FreshnessValue_R_PBox1 50;
BA_ "GenSigCycleTime" SG_ 412 MAC_Check_R_PBox1 50;
BA_ "TransparentInitValue" SG_ 412 R_PBox1_0x19C "0 0 0 0 0 0 0 0 0 0 0 0 0 0 0 0 ";
BA_ "GenSigCycleTime" SG_ 412 R_PBox1_0x19C 50;
BA_ "GenSigSendType" SG_ 849 CheckSum_ABM1 2;
BA_ "GenSigCycleTime" SG_ 849 CheckSum_ABM1 500;
BA_ "GenSigStartValue" SG_ 849 SecRowLSBR 1;
BA_ "GenSigSendType" SG_ 849 SecRowLSBR 2;
BA_ "GenSigCycleTime" SG_ 849 SecRowLSBR 500;
BA_ "GenSigStartValue" SG_ 849 AirbFailLmpCmd 1;
BA_ "GenSigSendType" SG_ 849 AirbFailLmpCmd 2;
BA_ "GenSigCycleTime" SG_ 849 AirbFailLmpCmd 500;
BA_ "GenSigStartValue" SG_ 849 SecRowMidSBR 1;
BA_ "GenSigSendType" SG_ 849 SecRowMidSBR 2;
BA_ "GenSigCycleTime" SG_ 849 SecRowMidSBR 500;
BA_ "GenSigStartValue" SG_ 849 DrvSBR 1;
BA_ "GenSigSendType" SG_ 849 DrvSBR 2;
BA_ "GenSigCycleTime" SG_ 849 DrvSBR 500;
BA_ "GenSigStartValue" SG_ 849 SecRowRSBR 1;
BA_ "GenSigSendType" SG_ 849 SecRowRSBR 2;
BA_ "GenSigCycleTime" SG_ 849 SecRowRSBR 500;
BA_ "GenSigStartValue" SG_ 849 PassSBR 1;
BA_ "GenSigSendType" SG_ 849 PassSBR 2;
BA_ "GenSigCycleTime" SG_ 849 PassSBR 500;
BA_ "GenSigStartValue" SG_ 849 PassSBR_Visual 1;
BA_ "GenSigSendType" SG_ 849 PassSBR_Visual 2;
BA_ "GenSigCycleTime" SG_ 849 PassSBR_Visual 500;
BA_ "GenSigStartValue" SG_ 849 DrvSBR_Visual 1;
BA_ "GenSigSendType" SG_ 849 DrvSBR_Visual 2;
BA_ "GenSigCycleTime" SG_ 849 DrvSBR_Visual 500;
BA_ "GenSigStartValue" SG_ 849 SecRowLSBR_Visual 1;
BA_ "GenSigSendType" SG_ 849 SecRowLSBR_Visual 2;
BA_ "GenSigCycleTime" SG_ 849 SecRowLSBR_Visual 500;
BA_ "GenSigStartValue" SG_ 849 SecRowMidSBR_Visual 1;
BA_ "GenSigSendType" SG_ 849 SecRowMidSBR_Visual 2;
BA_ "GenSigCycleTime" SG_ 849 SecRowMidSBR_Visual 500;
BA_ "GenSigStartValue" SG_ 849 SecRowRSBR_Visual 1;
BA_ "GenSigSendType" SG_ 849 SecRowRSBR_Visual 2;
BA_ "GenSigCycleTime" SG_ 849 SecRowRSBR_Visual 500;
BA_ "GenSigSendType" SG_ 849 CrashOutputSts 2;
BA_ "GenSigCycleTime" SG_ 849 CrashOutputSts 500;
BA_ "GenSigSendType" SG_ 849 RollingCounter_ABM1 2;
BA_ "GenSigCycleTime" SG_ 849 RollingCounter_ABM1 500;
BA_ "GenSigSendType" SG_ 849 FreshnessValue_ABM1 2;
BA_ "GenSigCycleTime" SG_ 849 FreshnessValue_ABM1 500;
BA_ "GenSigSendType" SG_ 849 MAC_Check_ABM1 2;
BA_ "GenSigCycleTime" SG_ 849 MAC_Check_ABM1 500;
BA_ "TransparentInitValue" SG_ 849 ABM1_0x351 "0 126 0 85 1 0 0 0 0 0 0 0 0 0 0 0 ";
BA_ "GenSigCycleTime" SG_ 849 ABM1_0x351 500;
BA_ "GenSigStartValue" SG_ 581 VehLgtAccel 22033;
BA_ "GenSigCycleTime" SG_ 581 VehLgtAccel 20;
BA_ "GenSigStartValue" SG_ 581 VehLatAccel 22033;
BA_ "GenSigCycleTime" SG_ 581 VehLatAccel 20;
BA_ "GenSigStartValue" SG_ 581 VehYawRate 8721;
BA_ "GenSigCycleTime" SG_ 581 VehYawRate 20;
BA_ "GenSigCycleTime" SG_ 581 VehLgtAccelVld 20;
BA_ "GenSigCycleTime" SG_ 581 VehLatAccelVld 20;
BA_ "GenSigCycleTime" SG_ 581 VehDynYawRateVld 20;
BA_ "TransparentInitValue" SG_ 581 ABM2_0x245 "0 86 17 86 17 34 17 0 ";
BA_ "GenSigCycleTime" SG_ 581 ABM2_0x245 20;
BA_ "GenSigCycleTime" SG_ 833 FLTirePressIndSts 500;
BA_ "GenSigCycleTime" SG_ 833 FRTirePressIndSts 500;
BA_ "GenSigCycleTime" SG_ 833 TirePressSysFailrIndcn 500;
BA_ "GenSigCycleTime" SG_ 833 RLTirePressIndSts 500;
BA_ "GenSigCycleTime" SG_ 833 RRTirePressIndSts 500;
BA_ "GenSigCycleTime" SG_ 833 FLTireTempSts 500;
BA_ "GenSigCycleTime" SG_ 833 FRTireTempSts 500;
BA_ "GenSigCycleTime" SG_ 833 RLTireTempSts 500;
BA_ "GenSigCycleTime" SG_ 833 RRTireTempSts 500;
BA_ "GenSigCycleTime" SG_ 833 TPMS_AutoLoctSts 500;
BA_ "GenSigCycleTime" SG_ 833 FreshnessValue_TPMS1 500;
BA_ "GenSigCycleTime" SG_ 833 MAC_Check_TPMS1 500;
BA_ "TransparentInitValue" SG_ 833 TPMS1_0x341 "0 0 0 0 0 0 0 0 0 0 0 0 0 0 0 0 ";
BA_ "GenSigCycleTime" SG_ 833 TPMS1_0x341 500;
BA_ "GenSigCycleTime" SG_ 917 FLTirePress 500;
BA_ "GenSigCycleTime" SG_ 917 FLTireTemp 500;
BA_ "GenSigCycleTime" SG_ 917 FRTirePress 500;
BA_ "GenSigCycleTime" SG_ 917 FRTireTemp 500;
BA_ "GenSigCycleTime" SG_ 917 RLTirePress 500;
BA_ "GenSigCycleTime" SG_ 917 RLTireTemp 500;
BA_ "GenSigCycleTime" SG_ 917 RRTirePress 500;
BA_ "GenSigCycleTime" SG_ 917 RRTireTemp 500;
BA_ "GenSigCycleTime" SG_ 917 FreshnessValue_TPMS2 500;
BA_ "GenSigCycleTime" SG_ 917 MAC_Check_TPMS2 500;
BA_ "TransparentInitValue" SG_ 917 TPMS2_0x395 "0 0 0 0 0 0 0 0 0 0 0 0 0 0 0 0 ";
BA_ "GenSigCycleTime" SG_ 917 TPMS2_0x395 500;
BA_ "GenSigCycleTime" SG_ 627 TrailerSts 50;
BA_ "TransparentInitValue" SG_ 627 Trailer1_0x273 "0 0 0 0 0 0 0 0 ";
BA_ "GenSigCycleTime" SG_ 627 Trailer1_0x273 50;
BA_ "GenSigCycleTime" SG_ 622 RPAS_RLCornrSnsrFailSts_0x26e 100;
BA_ "GenSigCycleTime" SG_ 622 RPAS_RLMiddlSnsrFailSts_0x26e 100;
BA_ "GenSigCycleTime" SG_ 622 RPAS_RRMiddlSnsrFailSts_0x26e 100;
BA_ "GenSigCycleTime" SG_ 622 RPAS_RRCornrSnsrFailSts_0x26e 100;
BA_ "GenSigCycleTime" SG_ 622 RPAS_WorkSts_0x26e 100;
BA_ "GenSigCycleTime" SG_ 622 RPAS_SoundIndcn_0x26e 100;
BA_ "GenSigCycleTime" SG_ 622 MEBWorkSts_0x26e 100;
BA_ "GenSigCycleTime" SG_ 622 MEB_EnableSts_0x26e 100;
BA_ "GenSigCycleTime" SG_ 622 RPAS_ObjRRCornrAr1_0x26e 100;
BA_ "GenSigCycleTime" SG_ 622 RPAS_ObjRRCornrAr2_0x26e 100;
BA_ "GenSigCycleTime" SG_ 622 RPAS_ObjRRMidlAr1_0x26e 100;
BA_ "GenSigCycleTime" SG_ 622 RPAS_ObjRRMidlAr2_0x26e 100;
BA_ "GenSigCycleTime" SG_ 622 RPAS_ObjRLMidlAr1_0x26e 100;
BA_ "GenSigCycleTime" SG_ 622 RPAS_ObjRLMidlAr2_0x26e 100;
BA_ "GenSigCycleTime" SG_ 622 RPAS_ObjRLCornrAr1_0x26e 100;
BA_ "GenSigCycleTime" SG_ 622 RPAS_ObjRLCornrAr2_0x26e 100;
BA_ "TransparentInitValue" SG_ 622 RPAS1_0x26E "0 0 0 0 0 0 0 0 ";
BA_ "GenSigCycleTime" SG_ 622 RPAS1_0x26E 100;
BA_ "GenSigCycleTime" SG_ 347 APS_PrkgMod 20;
BA_ "GenSigStartValue" SG_ 347 APS_ProcBar 127;
BA_ "GenSigCycleTime" SG_ 347 APS_ProcBar 20;
BA_ "GenSigCycleTime" SG_ 347 APS_SwtSts 20;
BA_ "GenSigCycleTime" SG_ 347 APS_SlotDisp 20;
BA_ "GenSigCycleTime" SG_ 347 APS_SysSoundIndcn 20;
BA_ "GenSigCycleTime" SG_ 347 APS_PrkgTyp 20;
BA_ "GenSigCycleTime" SG_ 347 APS_TextDisp 20;
BA_ "GenSigCycleTime" SG_ 347 APS_WorkSts 20;
BA_ "GenSigCycleTime" SG_ 347 MEB_AVHReq 20;
BA_ "GenSigCycleTime" SG_ 347 LParaPrkgOutVald 20;
BA_ "GenSigCycleTime" SG_ 347 RParaPrkgOutVald 20;
BA_ "GenSigCycleTime" SG_ 347 HeadVertPrkgOutVald 20;
BA_ "GenSigCycleTime" SG_ 347 TailVertPrkgOutVald 20;
BA_ "GenSigCycleTime" SG_ 347 HAP_SwtDispCtrlCmd 20;
BA_ "GenSigCycleTime" SG_ 347 P2P_PahDelSts 20;
BA_ "GenSigCycleTime" SG_ 347 P2P_SelfDetErrCode 20;
BA_ "GenSigCycleTime" SG_ 347 P2P_SelfDetSts 20;
BA_ "GenSigCycleTime" SG_ 347 P2P_Pah1Avail 20;
BA_ "GenSigCycleTime" SG_ 347 P2P_Pah2Avail 20;
BA_ "GenSigCycleTime" SG_ 347 HAP_PrkgModCurrSts 20;
BA_ "GenSigCycleTime" SG_ 347 APS_MovgDirc 20;
BA_ "TransparentInitValue" SG_ 347 HAP_FD1_0x15B "0 0 0 0 0 0 0 0 0 0 0 0 0 254 0 0 0 0 0 0 0 0 0 0 0 0 0 0 0 0 0 0 0 0 0 0 0 0 0 0 0 0 0 0 0 0 0 0 0 0 0 0 0 0 0 0 0 0 0 0 0 0 0 0 ";
BA_ "GenSigCycleTime" SG_ 347 HAP_FD1_0x15B 20;
BA_ "GenSigCycleTime" SG_ 628 AutoAVMSwtSet_Sts 50;
BA_ "GenSigCycleTime" SG_ 628 AVM_CurrSts 50;
BA_ "GenSigCycleTime" SG_ 628 GuidOvlSts 50;
BA_ "GenSigCycleTime" SG_ 628 FrntCamInpFailSts 50;
BA_ "GenSigCycleTime" SG_ 628 RearCamInpFailSts 50;
BA_ "GenSigCycleTime" SG_ 628 LeCamInpFailSts 50;
BA_ "GenSigCycleTime" SG_ 628 RiCamInpFailSts 50;
BA_ "GenSigCycleTime" SG_ 628 EolNotCmpltd 50;
BA_ "GenSigCycleTime" SG_ 628 OvlOpFailSts 50;
BA_ "GenSigCycleTime" SG_ 628 LaneCalSts 50;
BA_ "GenSigCycleTime" SG_ 628 RadarDispSts 50;
BA_ "GenSigCycleTime" SG_ 628 LaneCalFltSts 50;
BA_ "GenSigCycleTime" SG_ 628 AutoViewChgFuncSts 50;
BA_ "GenSigCycleTime" SG_ 628 CarMdlTrsprcySts 50;
BA_ "GenSigCycleTime" SG_ 628 CarMdlDispSts 50;
BA_ "GenSigCycleTime" SG_ 628 CurrCalResultSts 50;
BA_ "GenSigCycleTime" SG_ 628 MdlColrSts 50;
BA_ "GenSigCycleTime" SG_ 628 SigViewIndcn 50;
BA_ "GenSigCycleTime" SG_ 628 HAP_DispCmd 50;
BA_ "GenSigCycleTime" SG_ 628 AVM_3DAngSts 50;
BA_ "GenSigCycleTime" SG_ 628 MOD_WorkSts 50;
BA_ "GenSigCycleTime" SG_ 628 HAP_Hmi_Index 50;
BA_ "GenSigCycleTime" SG_ 628 DVRWorkSts 50;
BA_ "GenSigCycleTime" SG_ 628 MOD_AlarmSts 50;
BA_ "TransparentInitValue" SG_ 628 HAP_FD2_0x274 "0 0 0 0 0 0 0 0 0 0 0 0 0 0 0 0 0 0 0 0 0 0 0 0 0 0 0 0 0 0 0 0 0 0 0 0 0 0 0 0 0 0 0 0 0 0 0 0 0 0 0 0 0 0 0 0 0 0 0 0 0 0 0 0 ";
BA_ "GenSigCycleTime" SG_ 628 HAP_FD2_0x274 50;
BA_ "GenSigStartValue" SG_ 664 RPAS_NearBrrdstn_0x298 255;
BA_ "GenSigCycleTime" SG_ 664 RPAS_NearBrrdstn_0x298 100;
BA_ "GenSigCycleTime" SG_ 664 APS_ObjRiSideAr1 100;
BA_ "GenSigCycleTime" SG_ 664 APS_ObjRiSideAr2 100;
BA_ "GenSigCycleTime" SG_ 664 APS_ObjRiSideAr3 100;
BA_ "GenSigCycleTime" SG_ 664 APS_ObjRiSideAr4 100;
BA_ "GenSigCycleTime" SG_ 664 APS_ObjRiSideAr5 100;
BA_ "GenSigCycleTime" SG_ 664 APS_ObjLeSideAr1 100;
BA_ "GenSigCycleTime" SG_ 664 APS_ObjLeSideAr2 100;
BA_ "GenSigCycleTime" SG_ 664 APS_ObjLeSideAr3 100;
BA_ "GenSigCycleTime" SG_ 664 APS_ObjLeSideAr4 100;
BA_ "GenSigCycleTime" SG_ 664 APS_ObjLeSideAr5 100;
BA_ "GenSigCycleTime" SG_ 664 APS_FRSideSnsrFailSts 100;
BA_ "GenSigCycleTime" SG_ 664 APS_FLSideSnsrFailSts 100;
BA_ "GenSigCycleTime" SG_ 664 APS_RRSideSnsrFailSts 100;
BA_ "GenSigCycleTime" SG_ 664 APS_RLSideSnsrFailSts 100;
BA_ "GenSigCycleTime" SG_ 664 SDW_SoundIndcn 100;
BA_ "GenSigCycleTime" SG_ 664 SDWActiveSts 100;
BA_ "GenSigCycleTime" SG_ 664 RPAS_ObjRRCornrAr1_0x298 100;
BA_ "GenSigCycleTime" SG_ 664 RPAS_ObjRRCornrAr2_0x298 100;
BA_ "GenSigCycleTime" SG_ 664 RPAS_ObjRRMidlAr1_0x298 100;
BA_ "GenSigCycleTime" SG_ 664 RPAS_ObjRRMidlAr2_0x298 100;
BA_ "GenSigCycleTime" SG_ 664 RPAS_ObjRLMidlAr1_0x298 100;
BA_ "GenSigCycleTime" SG_ 664 RPAS_ObjRLMidlAr2_0x298 100;
BA_ "GenSigCycleTime" SG_ 664 RPAS_ObjRLCornrAr1_0x298 100;
BA_ "GenSigCycleTime" SG_ 664 RPAS_ObjRLCornrAr2_0x298 100;
BA_ "GenSigCycleTime" SG_ 664 RPAS_RLCornrSnsrFailSts_0x298 100;
BA_ "GenSigCycleTime" SG_ 664 RPAS_RLMiddlSnsrFailSts_0x298 100;
BA_ "GenSigCycleTime" SG_ 664 RPAS_RRMiddlSnsrFailSts_0x298 100;
BA_ "GenSigCycleTime" SG_ 664 RPAS_RRCornrSnsrFailSts_0x298 100;
BA_ "GenSigCycleTime" SG_ 664 RPAS_WorkSts_0x298 100;
BA_ "GenSigCycleTime" SG_ 664 RPAS_SoundIndcn_0x298 100;
BA_ "GenSigCycleTime" SG_ 664 MEBWorkSts_0x298 100;
BA_ "GenSigCycleTime" SG_ 664 MEB_EnableSts_0x298 100;
BA_ "GenSigCycleTime" SG_ 664 FPAS_ObjFLCornrAr1_0x298 100;
BA_ "GenSigCycleTime" SG_ 664 FPAS_ObjFLCornrAr2_0x298 100;
BA_ "GenSigCycleTime" SG_ 664 FPAS_ObjFLMidlAr1_0x298 100;
BA_ "GenSigCycleTime" SG_ 664 FPAS_ObjFLMidlAr2_0x298 100;
BA_ "GenSigCycleTime" SG_ 664 FPAS_ObjFRMidlAr1_0x298 100;
BA_ "GenSigCycleTime" SG_ 664 FPAS_ObjFRMidlAr2_0x298 100;
BA_ "GenSigCycleTime" SG_ 664 FPAS_ObjFRCornrAr1_0x298 100;
BA_ "GenSigCycleTime" SG_ 664 FPAS_ObjFRCornrAr2_0x298 100;
BA_ "GenSigCycleTime" SG_ 664 FPAS_FLCornrSnsrFailSts 100;
BA_ "GenSigCycleTime" SG_ 664 FPAS_FLMiddlSnsrFailSts 100;
BA_ "GenSigCycleTime" SG_ 664 FPAS_FRMiddlSnsrFailSts 100;
BA_ "GenSigCycleTime" SG_ 664 FPAS_FRCornrSnsrFailSts 100;
BA_ "GenSigCycleTime" SG_ 664 FPAS_WorkSts_0x298 100;
BA_ "GenSigCycleTime" SG_ 664 FPAS_AutoModSts_0x298 100;
BA_ "GenSigCycleTime" SG_ 664 FPAS_SoundIndcn_0x298 100;
BA_ "GenSigStartValue" SG_ 664 FPAS_NearBrrdstn_0x298 127;
BA_ "GenSigCycleTime" SG_ 664 FPAS_NearBrrdstn_0x298 100;
BA_ "GenSigCycleTime" SG_ 664 APA_MenuDispCtrlCmd 100;
BA_ "GenSigCycleTime" SG_ 664 APA_FuncSts 100;
BA_ "GenSigCycleTime" SG_ 664 P2P_FuncSts 100;
BA_ "GenSigCycleTime" SG_ 664 RADS_FuncSts 100;
BA_ "GenSigCycleTime" SG_ 664 FADS_FuncSts 100;
BA_ "GenSigCycleTime" SG_ 664 HAP_TextIconDispCtrl 100;
BA_ "TransparentInitValue" SG_ 664 HAP_FD3_0x298 "0 255 0 0 0 0 0 0 0 0 0 0 0 0 0 0 0 0 0 0 0 0 0 0 0 0 0 0 0 0 7 240 0 0 0 0 0 0 0 0 0 0 0 0 0 0 0 0 0 0 0 0 0 0 0 0 0 0 0 0 0 0 0 0 ";
BA_ "GenSigCycleTime" SG_ 664 HAP_FD3_0x298 100;
BA_ "GenSigStartValue" SG_ 649 HAP_RtCam_WorkSts 1;
BA_ "GenSigCycleTime" SG_ 649 HAP_RtCam_WorkSts 100;
BA_ "GenSigCycleTime" SG_ 649 HAP_RtSide_Obj1_ID 100;
BA_ "GenSigCycleTime" SG_ 649 HAP_RtSide_Obj1_type 100;
BA_ "GenSigCycleTime" SG_ 649 HAP_RtSide_Obj1_Confidence 100;
BA_ "GenSigCycleTime" SG_ 649 HAP_RtSide_Obj1_Ground_Pos_X 100;
BA_ "GenSigCycleTime" SG_ 649 HAP_RtSide_Obj1_Ground_Pos_Y 100;
BA_ "GenSigCycleTime" SG_ 649 HAP_RtSide_Obj2_ID 100;
BA_ "GenSigCycleTime" SG_ 649 HAP_RtSide_Obj2_type 100;
BA_ "GenSigCycleTime" SG_ 649 HAP_RtSide_Obj2_Confidence 100;
BA_ "GenSigCycleTime" SG_ 649 HAP_RtSide_Obj2_Ground_Pos_X 100;
BA_ "GenSigCycleTime" SG_ 649 HAP_RtSide_Obj2_Ground_Pos_Y 100;
BA_ "GenSigCycleTime" SG_ 649 HAP_RtSide_Obj3_ID 100;
BA_ "GenSigCycleTime" SG_ 649 HAP_RtSide_Obj3_type 100;
BA_ "GenSigCycleTime" SG_ 649 HAP_RtSide_Obj3_Confidence 100;
BA_ "GenSigCycleTime" SG_ 649 HAP_RtSide_Obj3_Ground_Pos_X 100;
BA_ "GenSigCycleTime" SG_ 649 HAP_RtSide_Obj3_Ground_Pos_Y 100;
BA_ "GenSigCycleTime" SG_ 649 HAP_RtSide_Obj4_ID 100;
BA_ "GenSigCycleTime" SG_ 649 HAP_RtSide_Obj4_type 100;
BA_ "GenSigCycleTime" SG_ 649 HAP_RtSide_Obj4_Confidence 100;
BA_ "GenSigCycleTime" SG_ 649 HAP_RtSide_Obj4_Ground_Pos_X 100;
BA_ "GenSigCycleTime" SG_ 649 HAP_RtSide_Obj4_Ground_Pos_Y 100;
BA_ "GenSigStartValue" SG_ 649 USS_FLSide1_Status 1;
BA_ "GenSigCycleTime" SG_ 649 USS_FLSide1_Status 100;
BA_ "GenSigCycleTime" SG_ 649 USS_FLSide1_Dist 100;
BA_ "GenSigStartValue" SG_ 649 USS_RLSide2_Status 1;
BA_ "GenSigCycleTime" SG_ 649 USS_RLSide2_Status 100;
BA_ "GenSigCycleTime" SG_ 649 USS_RLSide2_Dist 100;
BA_ "GenSigStartValue" SG_ 649 USS_FRSide1_Status 1;
BA_ "GenSigCycleTime" SG_ 649 USS_FRSide1_Status 100;
BA_ "GenSigCycleTime" SG_ 649 USS_FRSide1_Dist 100;
BA_ "GenSigStartValue" SG_ 649 USS_RRSide2_Status 1;
BA_ "GenSigCycleTime" SG_ 649 USS_RRSide2_Status 100;
BA_ "GenSigCycleTime" SG_ 649 USS_RRSide2_Dist 100;
BA_ "TransparentInitValue" SG_ 649 HAP_FD6_0x289 "0 0 0 0 0 0 0 16 0 0 0 0 0 0 0 0 0 0 0 0 0 0 0 0 0 0 0 0 0 0 0 0 0 85 0 0 0 0 0 0 0 0 0 0 0 0 0 0 0 0 0 0 0 0 0 0 0 0 0 0 0 0 0 0 ";
BA_ "GenSigCycleTime" SG_ 649 HAP_FD6_0x289 100;
BA_ "GenSigCycleTime" SG_ 647 Checksum_HC1 100;
BA_ "GenSigCycleTime" SG_ 647 HighBeamSts_HC 100;
BA_ "GenSigCycleTime" SG_ 647 ADBstatus 100;
BA_ "GenSigCycleTime" SG_ 647 LeftLowBeamFailSts 100;
BA_ "GenSigCycleTime" SG_ 647 RightLowBeamFailSts 100;
BA_ "GenSigCycleTime" SG_ 647 LeftHighBeamFailSts 100;
BA_ "GenSigCycleTime" SG_ 647 RightHighBeamFailSts 100;
BA_ "GenSigCycleTime" SG_ 647 ALS_FailSts 100;
BA_ "GenSigCycleTime" SG_ 647 RollingCounter_HC1 100;
BA_ "TransparentInitValue" SG_ 647 HC1_0x287 "0 0 0 0 0 0 0 0 ";
BA_ "GenSigCycleTime" SG_ 647 HC1_0x287 100;
BA_ "GenSigCycleTime" SG_ 714 DrvMirrFold_UnfoldSts 100;
BA_ "GenSigCycleTime" SG_ 714 PowerCutSwt 100;
BA_ "GenSigCycleTime" SG_ 714 DrvWinPosnSts 100;
BA_ "GenSigCycleTime" SG_ 714 DrvWinAntiPinchSts 100;
BA_ "GenSigCycleTime" SG_ 714 DrvWinLrnSts 100;
BA_ "GenSigCycleTime" SG_ 714 DrvWinHotProtSts 100;
BA_ "GenSigCycleTime" SG_ 714 DrvSideRearAntiPinchSts 100;
BA_ "GenSigCycleTime" SG_ 714 DrvSideRearWinPosnSts 100;
BA_ "GenSigCycleTime" SG_ 714 DrvSideRearWinLrnSts 100;
BA_ "GenSigCycleTime" SG_ 714 DrvSideRearWinHotProtSts 100;
BA_ "TransparentInitValue" SG_ 714 DDCM1_0x2CA "0 0 0 0 0 0 0 0 ";
BA_ "GenSigCycleTime" SG_ 714 DDCM1_0x2CA 100;
BA_ "GenSigCycleTime" SG_ 717 PassMirrFold_UnfoldSts 100;
BA_ "GenSigCycleTime" SG_ 717 PassWinAntiPinchSts 100;
BA_ "GenSigCycleTime" SG_ 717 PassWinPosnSts 100;
BA_ "GenSigCycleTime" SG_ 717 PassWinLrnSts 100;
BA_ "GenSigCycleTime" SG_ 717 PassWinHotProtSts 100;
BA_ "GenSigCycleTime" SG_ 717 PassSideRearWinAntiPinchSts 100;
BA_ "GenSigCycleTime" SG_ 717 PassSideRearWinPosnSts 100;
BA_ "GenSigCycleTime" SG_ 717 PassSideRearWinLrnSts 100;
BA_ "GenSigCycleTime" SG_ 717 PassSideRearWinHotProtSts 100;
BA_ "TransparentInitValue" SG_ 717 PDCM1_0x2CD "0 0 0 0 0 0 0 0 ";
BA_ "GenSigCycleTime" SG_ 717 PDCM1_0x2CD 100;
BA_ "GenSigCycleTime" SG_ 862 RoofModFb 500;
BA_ "GenSigCycleTime" SG_ 862 AllTerrainDislFb 500;
BA_ "GenSigCycleTime" SG_ 862 ElecSideStepSysFb 500;
BA_ "TransparentInitValue" SG_ 862 CP1_0x35E "0 0 0 0 0 0 0 0 ";
BA_ "GenSigCycleTime" SG_ 862 CP1_0x35E 500;
BA_ "GenSigSendType" SG_ 771 RotSteerWheel 2;
BA_ "GenSigCycleTime" SG_ 771 RotSteerWheel 200;
BA_ "TransparentInitValue" SG_ 771 ESCL2_0x303 "0 0 0 0 0 0 0 0 ";
BA_ "GenSigCycleTime" SG_ 771 ESCL2_0x303 200;
BA_ "GenSigCycleTime" SG_ 543 STBS_SoundReq 50;
BA_ "GenSigCycleTime" SG_ 543 VolUpReq_SC 50;
BA_ "GenSigCycleTime" SG_ 543 VolDwnReq_SC 50;
BA_ "GenSigCycleTime" SG_ 543 DispTODReq_SC 50;
BA_ "TransparentInitValue" SG_ 543 STBS1_0x21F "0 0 0 0 0 0 0 0 ";
BA_ "GenSigCycleTime" SG_ 543 STBS1_0x21F 50;
BA_ "GenSigCycleTime" SG_ 766 PLG_Sts 100;
BA_ "TransparentInitValue" SG_ 766 PLG_1_0x2FE "0 0 0 0 0 0 0 0 ";
BA_ "GenSigCycleTime" SG_ 766 PLG_1_0x2FE 100;
BA_ "GenSigSendType" SG_ 86 E_CALLSts 2;
BA_ "GenSigSendType" SG_ 86 QuietVoiceReq 2;
BA_ "TransparentInitValue" SG_ 86 GLO_NASS1_0x56 "0 0 0 0 0 0 0 0 ";
BA_ "GenSigSendType" SG_ 86 GLO_NASS1_0x56 2;
BA_ "GenSigCycleTime" SG_ 621 FPAS_ObjFLCornrAr1_0x26d 100;
BA_ "GenSigCycleTime" SG_ 621 FPAS_ObjFLCornrAr2_0x26d 100;
BA_ "GenSigCycleTime" SG_ 621 FPAS_ObjFLMidlAr1_0x26d 100;
BA_ "GenSigCycleTime" SG_ 621 FPAS_ObjFLMidlAr2_0x26d 100;
BA_ "GenSigCycleTime" SG_ 621 FPAS_ObjFRMidlAr1_0x26d 100;
BA_ "GenSigCycleTime" SG_ 621 FPAS_ObjFRMidlAr2_0x26d 100;
BA_ "GenSigCycleTime" SG_ 621 FPAS_ObjFRCornrAr1_0x26d 100;
BA_ "GenSigCycleTime" SG_ 621 FPAS_ObjFRCornrAr2_0x26d 100;
BA_ "GenSigCycleTime" SG_ 621 FPAS_FLCornrSnsrFltSts 100;
BA_ "GenSigCycleTime" SG_ 621 FPAS_FLMiddlSnsrFltSts 100;
BA_ "GenSigCycleTime" SG_ 621 FPAS_FRMiddlSnsrFltSts 100;
BA_ "GenSigCycleTime" SG_ 621 FPAS_FRCornrSnsrFltSts 100;
BA_ "GenSigCycleTime" SG_ 621 FPAS_WorkSts_0x26d 100;
BA_ "GenSigCycleTime" SG_ 621 FPAS_AutoModSts_0x26d 100;
BA_ "GenSigCycleTime" SG_ 621 FPAS_SoundIndcn_0x26d 100;
BA_ "GenSigStartValue" SG_ 621 FPAS_NearBrrdstn_0x26d 127;
BA_ "GenSigCycleTime" SG_ 621 FPAS_NearBrrdstn_0x26d 100;
BA_ "TransparentInitValue" SG_ 621 FPAS1_0x26D "0 0 0 0 0 0 7 240 ";
BA_ "GenSigCycleTime" SG_ 621 FPAS1_0x26D 100;
BA_ "GenSigStartValue" SG_ 749 RPAS_NearBrrdstn_0x2ed 255;
BA_ "GenSigCycleTime" SG_ 749 RPAS_NearBrrdstn_0x2ed 100;
BA_ "TransparentInitValue" SG_ 749 RPAS2_0x2ED "0 255 0 0 0 0 0 0 ";
BA_ "GenSigCycleTime" SG_ 749 RPAS2_0x2ED 100;
BA_ "GenSigCycleTime" SG_ 737 VSG_Sts 100;
BA_ "GenSigCycleTime" SG_ 737 VSG_HUTSoundResp 100;
BA_ "TransparentInitValue" SG_ 737 VSG1_0x2E1 "0 0 0 0 0 0 0 0 ";
BA_ "GenSigCycleTime" SG_ 737 VSG1_0x2E1 100;
BA_ "GenSigCycleTime" SG_ 656 PressReliProgs 100;
BA_ "GenSigCycleTime" SG_ 656 FTIVFault 100;
BA_ "GenSigCycleTime" SG_ 656 FuelTankCapWarning 100;
BA_ "TransparentInitValue" SG_ 656 ECM_PT6_0x290 "0 0 0 0 0 0 0 0 ";
BA_ "GenSigCycleTime" SG_ 656 ECM_PT6_0x290 100;
BA_ "GenSigCycleTime" SG_ 279 EngState_PHEV 20;
BA_ "GenSigCycleTime" SG_ 279 CruiseCtrlSts_PHEV 20;
BA_ "TransparentInitValue" SG_ 279 ECM_PT7_0x117 "0 0 0 0 0 0 0 0 ";
BA_ "GenSigCycleTime" SG_ 279 ECM_PT7_0x117 20;
BA_ "GenSigStartValue" SG_ 616 HCU_ChrgDchrgSts 2;
BA_ "GenSigCycleTime" SG_ 616 HCU_ChrgDchrgSts 50;
BA_ "GenSigCycleTime" SG_ 616 HCU_BattLowTemWarn 50;
BA_ "GenSigCycleTime" SG_ 616 HCU_BattLowHeatSts 50;
BA_ "GenSigCycleTime" SG_ 616 HCU_IntelEngIdlChrgnSts 50;
BA_ "TransparentInitValue" SG_ 616 HCU_HC3_0x268 "0 0 0 0 128 0 0 0 ";
BA_ "GenSigCycleTime" SG_ 616 HCU_HC3_0x268 50;
BA_ "GenSigCycleTime" SG_ 788 HCU_ACLineDisconnect 200;
BA_ "GenSigCycleTime" SG_ 788 HCU_ChargSts 200;
BA_ "GenSigCycleTime" SG_ 788 HCU_WorkshopMode 200;
BA_ "GenSigCycleTime" SG_ 788 HCU_IntelBattTempMagSts 200;
BA_ "TransparentInitValue" SG_ 788 HCU_HC6_0x314 "0 0 0 0 0 0 0 0 ";
BA_ "GenSigCycleTime" SG_ 788 HCU_HC6_0x314 200;
BA_ "GenSigCycleTime" SG_ 962 HCU_EVContnsDistance 1000;
BA_ "GenSigCycleTime" SG_ 962 HCU_EVContnsDistanceVld 1000;
BA_ "GenSigCycleTime" SG_ 962 HCU_RecupPwr 1000;
BA_ "GenSigCycleTime" SG_ 962 HCU_EgyUsed 1000;
BA_ "GenSigCycleTime" SG_ 962 HCU_HiVoltInterlockSts_RM 1000;
BA_ "TransparentInitValue" SG_ 962 HCU_HC7_0x3C2 "0 0 0 0 0 0 0 0 ";
BA_ "GenSigCycleTime" SG_ 962 HCU_HC7_0x3C2 1000;
VAL_ 793 IPBackgroundLmpCmd 0 "Backlight OFF" 1 "Backlight ON" ;
VAL_ 793 TrunkSts 0 "Closed" 1 "Open" ;
VAL_ 793 DrvDoorSts 0 "Closed" 1 "Open" ;
VAL_ 793 LRDoorSts 0 "Closed" 1 "Open" ;
VAL_ 793 PassengerDoorSts 0 "Closed" 1 "Open" ;
VAL_ 793 RRDoorSts 0 "Closed" 1 "Open" ;
VAL_ 793 BrkPedalSts_BCM 0 "Off" 1 "On" ;
VAL_ 793 BackgroundLightLvl 0 "Valid Values" 255 "Valid Values" ;
VAL_ 793 DrowsyDrvDetWarn 0 "No warning" 1 "Warning 1" 2 "Warning 2" 3 "Not available" ;
VAL_ 793 RLSFailSts 0 "No failure" 1 "Failure" ;
VAL_ 793 ReversGearSts 0 "Off" 1 "On" 2 "Reserved" 3 "Not available" ;
VAL_ 793 PosnLightReq 0 "Off" 1 "On" ;
VAL_ 837 LasHdLmpSts 0 "Off" 1 "On" ;
VAL_ 837 AntitheftSts 0 "Disarmed" 1 "Armed" 2 "Prearmed" 3 "Alarmed" ;
VAL_ 837 DrvDoorLockSts 0 "Lock" 1 "Unlock" ;
VAL_ 837 DoorLockSts 0 "NA" 1 "All doors locked" 2 "Driver door unlocked" 3 "All doors unlocked" ;
VAL_ 837 RLDoorLockSts 0 "Lock" 1 "Unlock" ;
VAL_ 837 PassDoorLockSts 0 "Lock" 1 "Unlock" ;
VAL_ 837 RRDoorLockSts 0 "Lock" 1 "Unlock" ;
VAL_ 837 HazardLmpSwtSts 0 "Off" 1 "On" ;
VAL_ 837 HiLowBeamSts 0 "Off" 1 "ON" 2 "error" 3 "Reserved" ;
VAL_ 652 VolSwtReq 0 "No request" 1 "Request" ;
VAL_ 652 VolSwtErrSts 0 "No Error" 1 "Error" ;
VAL_ 671 RemoteModSts 0 "Normal mode" 1 "Remote mode" ;
VAL_ 671 PASWorkCmd 0 "OFF" 1 "ON" ;
VAL_ 671 WhistleSts 0 "Off" 1 "On" ;
VAL_ 671 WiprReq_F_Pbox 0 "Wiper Off" 1 "Wiper action once" 2 "Speed1 (Lo)" 3 "Speed2 (Hi)" 4 "Reserved" 6 "Reserved" 7 "Invalid" ;
VAL_ 671 KL30BRelaySts 0 "Off" 1 "On" ;
VAL_ 773 ClsWinRmd 0 "No Alarm" 1 "Alarm" ;
VAL_ 568 SrAntiPinch 0 "Not active" 1 "Active" ;
VAL_ 568 SsPosn_VR_APP 0 "Fully close" 1 "reserved" 9 "reserved" 10 "10%" 11 "reserved" 19 "reserved" 20 "20%" 21 "reserved" 29 "reserved" 30 "30%" 31 "reserved" 39 "reserved" 40 "40%" 41 "reserved" 49 "reserved" 50 "50%" 51 "reserved" 59 "reserved" 60 "60%" 61 "reserved" 69 "reserved" 70 "70%" 71 "reserved" 79 "reserved" 80 "80%" 81 "reserved" 89 "reserved" 90 "90%" 91 "reserved" 99 "reserved" 100 "Fully open" 101 "Reserved" 127 "Reserved" ;
VAL_ 568 SsAntiPinch 0 "Not active" 1 "Active" ;
VAL_ 568 SrPosn_VR_APP 0 "Tilt up" 1 "reserved" 9 "reserved" 10 "10%" 11 "reserved" 19 "reserved" 20 "20%" 21 "reserved" 29 "reserved" 30 "30%" 31 "reserved" 39 "reserved" 40 "40%" 41 "reserved" 49 "reserved" 50 "50%" 51 "reserved" 59 "reserved" 60 "60%" 61 "reserved" 69 "reserved" 70 "70%" 71 "reserved" 79 "reserved" 80 "80%" 81 "reserved" 89 "reserved" 90 "90%" 91 "reserved" 99 "reserved" 100 "Fully open" 101 "Fully close" 102 "Vent area" 103 "reserved" 127 "reserved" ;
VAL_ 661 SysPowerMod 0 "OFF" 1 "ACC (reserved)" 2 "ON" 3 "Crank" ;
VAL_ 661 SysPowerModVld 0 "Invalid" 1 "Valid" ;
VAL_ 661 RemUpgrdModSysPower 0 "OFF" 1 "Remote upgrade mode ON (Engine OFF )" 2 "Reserved" 3 "Reserved" ;
VAL_ 661 RemPowerFailureSts 0 "No failure" 1 "power on condition not satisfied" 2 "power off condition not satisfied" 3 "Reserved" ;
VAL_ 770 WarnPowerNotInOffPosn 0 "No Warning" 1 "Warning" ;
VAL_ 770 WarnKeyInCarWhenExit 0 "No Warning" 1 "Warning" ;
VAL_ 770 WarnVldKeyNotFound 0 "No Warning" 1 "Warning" ;
VAL_ 770 WarnEngStrtNotMeet 0 "No Warning" 1 "Warning" ;
VAL_ 770 PowerRlyFault 0 "No failure" 1 "ACCIGN1IGN2 Relay failure(ACC Reserved)" ;
VAL_ 53 PEPS_T_BoxAuth1 -2147483648 "Valid Value" 0 "Valid Value" ;
VAL_ 669 InCarTemp 0 "Valid value" 253 "Valid value" 254 "Initial value" 255 "Invalid value" ;
VAL_ 669 ACAQSEnaSts 0 "Disable" 1 "Enable" ;
VAL_ 669 ACOperMod 0 "Economy Mode" 1 "Standard Mode" 2 "Strong Mode" 3 "Reserved" 7 "Reserved" ;
VAL_ 669 ACAIUEnaSts 0 "Disable" 1 "Enable" ;
VAL_ 669 ACDrvAirDistriMod 0 "Face" 1 "Face & Foot" 2 "Foot" 3 "Foot & Defrost" 4 "Defrost" 5 "Reserved" 6 "Reserved" 7 "Auto air distribution mode" ;
VAL_ 669 ACSteplessSpdSetEnaSts 0 "Disable" 1 "Enable" ;
VAL_ 669 ACFrntPassTempSteplessSetEnaSts 0 "Disable" 1 "Enable" ;
VAL_ 669 ACDrvTempSteplessSetEnaSts 0 "Disable" 1 "Enable" ;
VAL_ 669 ACEEMSts 0 "Normal mode" 1 "Transport_static mode" 2 "Transport_Dynamic mode" 3 "Static_power saving level 1" 4 "Static_power saving level 2" 5 "Dynamic_power saving level 4" 6 "Dynamic_power saving level 5" 7 "Power system error" 8 "Reserved" 15 "Reserved" ;
VAL_ 669 ACCbnClnEnasts 0 "Disable" 1 "Enable" ;
VAL_ 669 ACCbnClnOffCode 0 "No offcode" 1 "Any door is open" 2 "SystemPowerMode is not off" 3 "Status of Battery is not ok" 4 "Any door is open and SystemPowerMode is not off" 5 "Status of Battery is not ok and Any door is open" 6 "Status of Battery is not ok and SystemPowerMode is not off" 7 "Status of Battery is not ok and SystemPowerMode is not off and  Any door is open" 8 "SystemPowerMode is not on" 9 "SystemPowerMode is not on and  Any door is open" 10 "Remote mode status is off" 11 "Reserved" 15 "Reserved" ;
VAL_ 901 ACFrntDefrstSts 0 "Off" 1 "On" ;
VAL_ 901 ACHMIDispCmd 0 "No Display" 1 "No Displayï¼ˆAC status changed in Auto modeï¼‰" 2 "Display" 3 "Reserved" ;
VAL_ 901 ACFrntBlwrSpd 0 "Off" 1 "Level 1ï¼ˆLowï¼‰-7ï¼ˆHiï¼‰" 7 "Level 1ï¼ˆLowï¼‰-7ï¼ˆHiï¼‰" 8 "Reserved" 13 "Reserved" 14 "Auto blower level" 15 "Initial value" ;
VAL_ 901 ACOpenSts 0 "Off" 1 "On" ;
VAL_ 901 ACDualModEnaSts 0 "Disable" 1 "Enable" ;
VAL_ 901 ACDrvTemp_ATC 0 "Low" 1 "Valid value" 31 "Valid value" 32 "High" 33 "Initial value" 34 "Reserved" 63 "Reserved" ;
VAL_ 901 ACAmbTemp 0 "Valid value" 253 "Valid value" 254 "Initial value" 255 "Invalid Value" ;
VAL_ 901 ACAirInletSts 0 "Recirculation" 1 "Fresh" 2 "Auto" 3 "Initial value" ;
VAL_ 901 ACFrntPasstTemp_ATC 0 "Low" 1 "Valid value" 31 "Valid value" 32 "High" 33 "Initial value" 34 "Reserved" 63 "Reserved" ;
VAL_ 901 ACAutoModEnaSts 0 "Disable" 1 "Enable" ;
VAL_ 901 ACCmprEnaSts 0 "Disable" 1 "Enable" ;
VAL_ 901 AC_FrntWinHeatEnaSts 0 "Disable" 1 "Enable" ;
VAL_ 901 AC_FrntWinHeatDislSts 0 "Active" 1 "Forbidden" ;
VAL_ 901 ACAutoDefrstModEnaSts 0 "Disable" 1 "Enable" ;
VAL_ 721 DrvSeatHeatSts 0 "OFF" 1 "Level 1_low" 2 "Level 2_middle" 3 "Level 3_high" ;
VAL_ 721 PassSeatHeatSts 0 "OFF" 1 "Level 1_low" 2 "Level 2_middle" 3 "Level 3_high" ;
VAL_ 721 DrvSeatVentnSts 0 "OFF" 1 "Level 1_low" 2 "Level 2_middle" 3 "Level 3_high" ;
VAL_ 721 PassSeatVentnSts 0 "OFF" 1 "Level 1_low" 2 "Level 2_middle" 3 "Level 3_high" ;
VAL_ 360 EPS_FailSts_0x168 0 "No fault" 1 "Permanent Error Detected" 2 "Intermittent Error Detected" 3 "Reserved" ;
VAL_ 360 EPS_TrqSnsrSts_0x168 0 "Normal" 1 "Abnormal" ;
VAL_ 360 CheckSum_EPS1_0x168 0 "Valid values" 255 "Valid values" ;
VAL_ 360 EPS_SteerMod_0x168 0 "Comfort Mode" 1 "sport mode" 2 "Handiness Mode" 3 "Reserved" 7 "Reserved" ;
VAL_ 360 RollingCounter_EPS1_0x168 0 "Valid value" 14 "Valid value" 15 "Invalid value" ;
VAL_ 354 EPS_LKATorqOvrlDlvd_0x162 0 "Valid value" 3000 "Valid value" 3001 "Reserved" 65535 "Reserved" ;
VAL_ 354 EPS_LKATorqOvrlDlvdVld_0x162 0 "Invalid" 1 "Valid" ;
VAL_ 354 EPS_LKATrqOvlDlvdSts_0x162 0 "Not active" 1 "Active" 2 "Temporary inhibit" 3 "Permanently failed" ;
VAL_ 327 CheckSum_EPS1_0x147 0 "Valid values" 255 "Valid values" ;
VAL_ 327 EPS_FailSts_0x147 0 "No fault" 1 "Permanent Error Detected" 2 "Intermittent Error Detected" 3 "Reserved" ;
VAL_ 327 EPS_TrqSnsrSts_0x147 0 "Normal" 1 "Abnormal" ;
VAL_ 327 EPS_SteerMod_0x147 0 "Comfort Mode" 1 "sport mode" 2 "Handiness Mode" 3 "Reserved" 7 "Reserved" ;
VAL_ 327 RollingCounter_EPS1_0x147 0 "Valid value" 14 "Valid value" 15 "Invalid value" ;
VAL_ 327 EPS_LKATorqOvrlDlvd_0x147 0 "Valid value" 3000 "Valid value" 3001 "Reserved" 65535 "Reserved" ;
VAL_ 327 EPS_LKATorqOvrlDlvdVld_0x147 0 "Invalid" 1 "Valid" ;
VAL_ 327 EPS_LKATrqOvlDlvdSts_0x147 0 "Not active" 1 "Active" 2 "Temporary inhibit" 3 "Permanently failed" ;
VAL_ 411 FFogLmpSts_F_Pbox 0 "Off" 1 "On" ;
VAL_ 411 HiBeamSts_F_Pbox 0 "Off" 1 "On" ;
VAL_ 411 HoodSts_F_Pbox 0 "Closed" 1 "Open" ;
VAL_ 411 LLasHdLmpDiagSig 0 "No failure" 1 "failure" ;
VAL_ 411 RLasHdLmpDiagSig 0 "No failure" 1 "failure" ;
VAL_ 411 LasHdLmpSts_F_Pbox 0 "Off" 1 "On" ;
VAL_ 411 LHiBeamFailSts 0 "No failure" 1 "failure" ;
VAL_ 411 RHiBeamFailSts 0 "No failure" 1 "failure" ;
VAL_ 411 LLowBeamFailSts 0 "No failure" 1 "failure" ;
VAL_ 411 RLowBeamFailSts 0 "No failure" 1 "failure" ;
VAL_ 411 LHeadLmpFailSts 0 "No failure" 1 "failure" ;
VAL_ 411 RHeadLmpFailSts 0 "No failure" 1 "failure" ;
VAL_ 411 WhistleSts_F_Pbox 0 "Off" 1 "On" ;
VAL_ 357 LTurnLmpSwtSts 0 "OFF" 1 "ON" ;
VAL_ 357 RTurnLmpSwtSts 0 "OFF" 1 "ON" ;
VAL_ 357 AutoLmpSwtSts 0 "Non-Auto" 1 "Auto" ;
VAL_ 357 HornSwtSts 0 "OFF" 1 "ON" ;
VAL_ 161 SteerWheelAng 0 "Valid value" 7800 "Valid value" 7801 "Reserved" 32766 "Reserved" 32767 "Invalid" ;
VAL_ 161 SteerWheelAngSign 0 "Left (Positive)" 1 "Right (Negative)" ;
VAL_ 161 SteerWheelSpd 0 "Valid value" 10160 "Valid value" 10161 "Reserved" 32766 "Reserved" 32767 "Invalid" ;
VAL_ 161 SteerWheelSpdSign 0 "Left (Positive)" 1 "Right (Negative)" ;
VAL_ 161 SAS_Sts 0 "SAS Angle And Speed Correct" 1 "SAS Not Calibrated" 2 "Intermittent Error Detected" 3 "Permanent Error Detected" ;
VAL_ 161 HWA_OK_OFFSwt 0 "No press" 1 "Pressed" ;
VAL_ 580 MenuReturnSwtSts 0 "Released" 1 "Pressed" 2 "error" 3 "invalidation" ;
VAL_ 580 HomeSwtSts 0 "Released" 1 "Pressed" 2 "error" 3 "invalidation" ;
VAL_ 580 MuteSwtSts 0 "Released" 1 "Pressed" 2 "Error" 3 "invalidation" ;
VAL_ 580 CustomSwtSts 0 "Released" 1 "Pressed" 2 "error" 3 "invalidation" ;
VAL_ 580 SteerWheelHeatdSts 0 "Not active" 1 "Active" ;
VAL_ 580 PageUpSwtSts 0 "Released" 1 "Pressed" 2 "error" 3 "invalid" ;
VAL_ 580 PageDwnSwtSts 0 "Released" 1 "Pressed" 2 "error" 3 "invalidation" ;
VAL_ 580 PageLSwtSts 0 "Released" 1 "Pressed" 2 "error" 3 "invalidation" ;
VAL_ 580 PageRSwtSts 0 "Released" 1 "Pressed" 2 "error" 3 "invalidation" ;
VAL_ 580 SeekUpSwtSts 0 "Released" 1 "Pressed" 2 "error" 3 "invalidation" ;
VAL_ 580 SeekDwnSwtSts 0 "Released" 1 "Pressed" 2 "error" 3 "invalidation" ;
VAL_ 580 AdjVolUpSwtSts 0 "Released" 1 "Pressed" 2 "error" 3 "invalidation" ;
VAL_ 580 AdjVolDwnSwtSts 0 "Released" 1 "Pressed" 2 "error" 3 "invalidation" ;
VAL_ 580 VRSwtSts 0 "Released" 1 "Pressed" 2 "error" 3 "invalidation" ;
VAL_ 580 PhoneSwtSts 0 "Released" 1 "Pressed" 2 "error" 3 "invalidation" ;
VAL_ 580 SoundSourceModSwtSts 0 "Released" 1 "Pressed" 2 "error" 3 "invalidation" ;
VAL_ 580 EnterSwtSts 0 "Released" 1 "Pressed" 2 "error" 3 "invalidation" ;
VAL_ 580 EnterSwtSts_Mmed 0 "Released" 1 "Pressed" 2 "error" 3 "invalidation" ;
VAL_ 580 CustomSwtSts_Mmed 0 "Released" 1 "Pressed" 2 "error" 3 "invalidation" ;
VAL_ 593 DiagLmpReq 0 "Lamp is not being requested" 1 "Lamp is being requested" ;
VAL_ 593 CouplingThermWarning 0 "No coupling thermal failsafe" 1 "coupling thermal failsafe" ;
VAL_ 593 CouplingFaultSts 0 "Normal Operating Mode" 1 "Reduced coupling functionality" 2 "Temporary coupling failure" 3 "Permanent coupling failure" ;
VAL_ 593 EstimatedTorque 0 "Valid value" 12000 "Valid value" 12001 "Reserved" 65534 "Reserved" 65535 "Invalid" ;
VAL_ 698 WPC_ChrgSts 0 "Standby" 1 "Charging" 2 "Charging Completed" 3 "WPC Fault" ;
VAL_ 698 WPC_SwtSts 0 "Initial Value" 1 "ON" 2 "OFF" 3 "Reserved" ;
VAL_ 698 WPC_FaultSts 0 "No Fault" 1 "Foreign Object Detection_FOD" 2 "Over Voltage Protection_OVP" 3 "Low Voltage Protection_LVP" 4 "Over Temperature Protection_OTP" 5 "System Fault" 6 "Reserved" 7 "Reserved" ;
VAL_ 698 WPC_PhoneReminder 0 "No need to remind" 1 "Remind forgotten phone" ;
VAL_ 993 AMP_Chan1DTCInfo 0 "No error in this channel" 1 "Short to groundshort to ACC open load error" ;
VAL_ 993 AMP_Chan2DTCInfo 0 "No error in this channel" 1 "Short to groundshort to ACC open load error" ;
VAL_ 993 AMP_Chan3DTCInfo 0 "No error in this channel" 1 "Short to groundshort to ACC open load error" ;
VAL_ 993 AMP_Chan4DTCInfo 0 "No error in this channel" 1 "Short to groundshort to ACC open load error" ;
VAL_ 993 AMP_Chan5DTCInfo 0 "No error in this channel" 1 "Short to groundshort to ACC open load error" ;
VAL_ 993 AMP_Chan6DTCInfo 0 "No error in this channel" 1 "Short to groundshort to ACC open load error" ;
VAL_ 993 AMP_Chan7DTCInfo 0 "No error in this channel" 1 "Short to groundshort to ACC open load error" ;
VAL_ 993 AMP_Chan8DTCInfo 0 "No error in this channel" 1 "Short to groundshort to ACC open load error" ;
VAL_ 993 AMP_TempValue 0 "Amplifier internal temperature value" 254 "Amplifier internal temperature value" 255 "Invalid value" ;
VAL_ 993 AMP_TempSts 0 "Temperature normal" 1 "Temperature value lower than working temperature" 2 "Temperature value higher than working temperature" 3 "Invalid temperature value" ;
VAL_ 993 AMP_VolValue 0 "Amplifier internal voltage value" 254 "Amplifier internal voltage value" 255 "Invalid value" ;
VAL_ 993 BestListegPosnResp 0 "All Seat" 1 "Front Seat" 2 "Rear Seat" 3 "Driver Seat" 4 "Boss Seat" 5 "Children sleep Seat" 6 "reserved" 7 "reserved" ;
VAL_ 993 Clari_FiResp 0 "OFF" 1 "ON" ;
VAL_ 995 MediaCallSourceState 0 "Media Source on" 1 "Call Source on" 2 "Reserved-CH I CH IIé€šé“" 15 "Reserved-CH I CH IIé€šé“" ;
VAL_ 995 BeepSourceSts 0 "None" 1 "Beep on" 2 "IP on" 3 "IP turn light on" 4 "Radar alarm on" 5 "Reserved CH III" 7 "Reserved CH III" ;
VAL_ 995 BalanceSetState 0 "Lch+10 - Lch+1" 9 "Lch+10 - Lch+1" 10 "Center" 11 "Rch+1 - Rch+10" 20 "Rch+1 - Rch+10" 21 "Reserved" 31 "Reserved" ;
VAL_ 995 VSCModeState 0 "OFF" 1 "LOW" 2 "MID" 3 "HI" ;
VAL_ 995 FadeSetState 0 "Rear+10 - Rear+1" 9 "Rear+10 - Rear+1" 10 "Center" 11 "Front+1 - Front+10" 20 "Front+1 - Front+10" 21 "Reserved" 31 "Reserved" ;
VAL_ 995 DriveSideSts 0 "LHD" 1 "RHD" ;
VAL_ 995 BassSetState 0 "-10 - -1" 9 "-10 - -1" 10 "0" 11 "+1 - +10" 20 "+1 - +10" 21 "Reserved" 31 "Reserved" ;
VAL_ 995 MuteState 0 "Unmute" 1 "Mute" ;
VAL_ 995 NaviSourceState 0 "None" 1 "Navi on" 2 "VRTTS on" 3 "Reserved-CH IV" 7 "Reserved-CH IV" ;
VAL_ 995 MidrangeSetState 0 "-10" 1 "-9" 2 "-8" 3 "-7" 4 "-6" 5 "-5" 6 "-4" 7 "-3" 8 "-2" 9 "-1" 10 "0" 11 "1" 12 "2" 13 "3" 14 "4" 15 "5" 16 "6" 17 "7" 18 "8" 19 "9" 20 "10" 21 "Reserved" 31 "Reserved" ;
VAL_ 995 T_box_ECallSts 0 "OFF" 1 "ON" ;
VAL_ 995 GetHUTInfoSts 0 "No action" 1 "Action" ;
VAL_ 995 TrebleSetState 0 "-10" 1 "-9" 2 "-8" 3 "-7" 4 "-6" 5 "-5" 6 "-4" 7 "-3" 8 "-2" 9 "-1" 10 "0" 11 "1" 12 "2" 13 "3" 14 "4" 15 "5" 16 "6" 17 "7" 18 "8" 19 "9" 20 "10" 21 "Reserved" 31 "Reserved" ;
VAL_ 995 QLISurroundSetSt 0 "Stereo" 1 "Surround" ;
VAL_ 995 AVMStResp 0 "OFF" 1 "ON" ;
VAL_ 995 NaviMediaVolLvlResp 0 "Main audio attenuation Level 0" 1 "Main audio attenuation Level 1" 2 "Main audio attenuation Level 2" 3 "Main audio attenuation Level 3" 4 "Main audio attenuation Level 4" 5 "Main audio attenuation Level 5" 6 "Main audio attenuation Level 6" 7 "Main audio attenuation Level 7" 8 "Main audio attenuation Level 8" 9 "Main audio attenuation Level 9" 10 "Main audio attenuation Level 10" 11 "Invalid" 15 "Invalid" ;
VAL_ 995 AVMMediaVolLvlResp 0 "Main audio attenuation Level 0" 1 "Main audio attenuation Level 1" 2 "Main audio attenuation Level 2" 3 "Main audio attenuation Level 3" 4 "Main audio attenuation Level 4" 5 "Main audio attenuation Level 5" 6 "Main audio attenuation Level 6" 7 "Main audio attenuation Level 7" 8 "Main audio attenuation Level 8" 9 "Main audio attenuation Level 9" 10 "Main audio attenuation Level 10" 11 "Invalid" 15 "Invalid" ;
VAL_ 995 FPASChStResp 0 "OFF" 1 "ON" ;
VAL_ 995 RPASChStResp 0 "OFF" 1 "ON" ;
VAL_ 997 HFMVolSetSts 0 "HFMRTTbox-I&B Call volume step 0-39" 39 "HFMRTTbox-I&B Call volume step 0-39" 40 "Reserved" 62 "Reserved" 63 "Invalid Value" ;
VAL_ 997 VR_TTSVolSetSts 0 "VRTTS volume step 0-39" 39 "VRTTS volume step 0-39" 40 "Reserved" 62 "Reserved" 63 "Invalid Value" ;
VAL_ 997 NaviVolumeSetState 0 "Navi volume step 0-39" 39 "Navi volume step 0-39" 40 "Reserved" 62 "Reserved" 63 "Invalid Value" ;
VAL_ 997 MainVolumeSetState 0 "Main volume step 0-39" 39 "Main volume step 0-39" 40 "Reserved" 62 "Reserved" 63 "Invalid Value" ;
VAL_ 997 AMPPowerSts 0 "OFF" 1 "ON" ;
VAL_ 997 IPVolSetSts 0 "Reserved" 9 "Reserved" 10 "IP volume step 10-20" 20 "IP volume step 10-20" 21 "Reserved" 62 "Reserved" 63 "Invalid Value" ;
VAL_ 722 Microphone_Cha1DTCInfo 0 "No error in this channel" 1 "Short to groundshort to ACC open load error" ;
VAL_ 722 Microphone_Cha2DTCInfo 0 "No error in this channel" 1 "Short to groundshort to ACC open load error" ;
VAL_ 722 Microphone_Cha3DTCInfo 0 "No error in this channel" 1 "Short to groundshort to ACC open load error" ;
VAL_ 722 Microphone_Cha4DTCInfo 0 "No error in this channel" 1 "Short to groundshort to ACC open load error" ;
VAL_ 722 ANCSwtStatus 0 "OFF" 1 "ON" ;
VAL_ 929 IESS_SwitchModel 0 "OFF" 1 "Model 1" 2 "Model 2" 3 "Model 3" ;
VAL_ 805 HUD_SwtSts 0 "OFF" 1 "ON" ;
VAL_ 805 HUD_BrightnessLvl 0 "Level 1" 1 "Level 2" 2 "Level 3" 3 "Level 4" 4 "Level 5" 5 "Level 6" 6 "Level 7" 7 "Level 8" 8 "Level 9" 9 "Reserved" 15 "Reserved" ;
VAL_ 805 HUD_HeightLvl 0 "Level 1" 1 "Level 2" 2 "Level 3" 3 "Level 4" 4 "Level 5" 5 "Level 6" 6 "Level 7" 7 "Level 8" 8 "Level 9" 9 "Level 10" 10 "Level 11" 11 "Level 12" 12 "Level 13" 13 "Level 14" 14 "Level 15" 15 "Level 16" 16 "Level 17" 17 "Level 18" 18 "Level 19" 19 "Level 20" 20 "Level 21" 21 "Reserved" 31 "Reserved" ;
VAL_ 805 HUD_UIMod 0 "Normal Mode" 1 "Dot Matrix Mode" ;
VAL_ 805 HUD_UIModVld 0 "Invalid" 1 "Valid" ;
VAL_ 805 HUD_Manufactor 0 "ADAYO" 1 "Reserved" 6 "Reserved" 7 "Not configured" ;
VAL_ 805 HUD_ReslType 0 "LVDS1" 1 "LVDS2" 2 "LVDS3" 3 "LVDS4" 4 "Reserved" 6 "Reserved" 7 "Not configured" ;
VAL_ 412 HiPosnBrkLmpFailSts 0 "No failure" 1 "failure" ;
VAL_ 412 LicPlateLmpFailSts 0 "No failure" 1 "failure" ;
VAL_ 412 LBrkLmpFailSts 0 "No failure" 1 "failure" ;
VAL_ 412 RFogLmpFailSts_R_Pbox 0 "No failure" 1 "failure" ;
VAL_ 412 RFogLmpSts_R_Pbox 0 "Off" 1 "On" ;
VAL_ 412 ParkLmpSts_R_Pbox 0 "Off" 1 "On" ;
VAL_ 412 RBrkLmpFailSts 0 "No failure" 1 "failure" ;
VAL_ 412 PosnLmpOutpSts_R_Pbox 0 "OFF" 1 "ON" ;
VAL_ 412 RRPosnLmpFailSts 0 "No failure" 1 "failure" ;
VAL_ 412 RvsLmpFailSts 0 "No failure" 1 "failure" ;
VAL_ 412 LRPosnLmpFailSts 0 "No failure" 1 "failure" ;
VAL_ 412 RTurnLmpFailSts 0 "No failure" 1 "Short circuit" 2 "Open circuit" 3 "Reserved" ;
VAL_ 412 LTurnLmpFailSts 0 "No failure" 1 "Short circuit" 2 "Open circuit" 3 "Reserved" ;
VAL_ 412 LTurnLmpSts_R_Pbox 0 "Off" 1 "On" ;
VAL_ 412 RTurnLmpSts_R_Pbox 0 "Off" 1 "On" ;
VAL_ 412 RWinHeatgIconRlyCmd 0 "Not active" 1 "Active" ;
VAL_ 412 RWinHeatgFailSts 0 "No Failure" 1 "Failure" ;
VAL_ 849 CheckSum_ABM1 0 "Valid values" 255 "Valid values" ;
VAL_ 849 SecRowLSBR 0 "No reminder" 1 "Reminder" ;
VAL_ 849 AirbFailLmpCmd 0 "Lamp off" 1 "Lamp on" ;
VAL_ 849 SecRowMidSBR 0 "No reminder" 1 "Reminder" ;
VAL_ 849 DrvSBR 0 "No reminder" 1 "Reminder" ;
VAL_ 849 SecRowRSBR 0 "No reminder" 1 "Reminder" ;
VAL_ 849 PassSBR 0 "No reminder" 1 "Reminder" ;
VAL_ 849 PassSBR_Visual 0 "Lamp off" 1 "Lamp on" 2 "Reserved" 3 "Lamp  blink & sound remind" ;
VAL_ 849 DrvSBR_Visual 0 "Lamp off" 1 "Lamp on" 2 "Reserved" 3 "Lamp  blink & sound remind" ;
VAL_ 849 SecRowLSBR_Visual 0 "Lamp off" 1 "Lamp on" 2 "Reserved" 3 "Lamp  blink & sound remind" ;
VAL_ 849 SecRowMidSBR_Visual 0 "Lamp off" 1 "Lamp on" 2 "Reserved" 3 "Lamp  blink & sound remind" ;
VAL_ 849 SecRowRSBR_Visual 0 "Lamp off" 1 "Lamp on" 2 "Reserved" 3 "Lamp  blink & sound remind" ;
VAL_ 849 CrashOutputSts 0 "No crash" 1 "Reserved" 2 "Front First level" 3 "rear crash(Reserved)" 4 "Reserved" 7 "Reserved" 8 "Right hand side" 9 "Reserved" 15 "Reserved" 16 "Left hand side" 17 "Rollover(Reserved)" 18 "Static Roll(Reserved)" 19 "Reserved" 255 "Reserved" ;
VAL_ 849 RollingCounter_ABM1 0 "Valid value" 14 "Valid value" 15 "Invalid value" ;
VAL_ 581 VehLgtAccel 0 "Valid Value" 44066 "Valid Value" 44067 "Reserved" 65535 "Reserved" ;
VAL_ 581 VehLatAccel 0 "Valid Value" 44066 "Valid Value" 44067 "Reserved" 65535 "Reserved" ;
VAL_ 581 VehYawRate 0 "Valid Value" 17441 "Valid Value" 17442 "Reserved" 65535 "Reserved" ;
VAL_ 581 VehLgtAccelVld 0 "Invalid" 1 "Valid" ;
VAL_ 581 VehLatAccelVld 0 "Invalid" 1 "Valid" ;
VAL_ 581 VehDynYawRateVld 0 "Invalid" 1 "Valid" ;
VAL_ 833 FLTirePressIndSts 0 "Normal" 1 "Low" 2 "Reserved" 3 "High" 4 "Not available" 5 "Reserved" 7 "Reserved" ;
VAL_ 833 FRTirePressIndSts 0 "Normal" 1 "Low" 2 "Reserved" 3 "High" 4 "Not available" 5 "Reserved" 7 "Reserved" ;
VAL_ 833 TirePressSysFailrIndcn 0 "No failure" 1 "Failure" 2 "Reserved" 3 "Reserved" ;
VAL_ 833 RLTirePressIndSts 0 "Normal" 1 "Low" 2 "Reserved" 3 "High" 4 "Not available" 5 "Reserved" 7 "Reserved" ;
VAL_ 833 RRTirePressIndSts 0 "Normal" 1 "Low" 2 "Reserved" 3 "High" 4 "Not available" 5 "Reserved" 7 "Reserved" ;
VAL_ 833 FLTireTempSts 0 "Normal" 1 "High" 2 "Not available" 3 "Reserved" ;
VAL_ 833 FRTireTempSts 0 "Normal" 1 "High" 2 "Not available" 3 "Reserved" ;
VAL_ 833 RLTireTempSts 0 "Normal" 1 "High" 2 "Not available" 3 "Reserved" ;
VAL_ 833 RRTireTempSts 0 "Normal" 1 "High" 2 "Not available" 3 "Reserved" ;
VAL_ 833 TPMS_AutoLoctSts 0 "Auto-Learn or Auto-Locate not in progress  TPMS is base system" 1 "Auto-Learn in progress" 2 "Auto-Locate in progress (Auto-Learn complete)" 3 "Auto-Locate complete" 4 "Auto-Learn timeout" 5 "Auto-Locate timeout" 6 "Reserved" 15 "Reserved" ;
VAL_ 917 FLTirePress 0 "Valid Value" 254 "Valid Value" 255 "Invalid Value" ;
VAL_ 917 FLTireTemp 0 "Valid Value" 254 "Valid Value" 255 "Invalid Value" ;
VAL_ 917 FRTirePress 0 "Valid Value" 254 "Valid Value" 255 "Invalid Value" ;
VAL_ 917 FRTireTemp 0 "Valid Value" 254 "Valid Value" 255 "Invalid Value" ;
VAL_ 917 RLTirePress 0 "Valid Value" 254 "Valid Value" 255 "Invalid Value" ;
VAL_ 917 RLTireTemp 0 "Valid Value" 254 "Valid Value" 255 "Invalid Value" ;
VAL_ 917 RRTirePress 0 "Valid Value" 254 "Valid Value" 255 "Invalid Value" ;
VAL_ 917 RRTireTemp 0 "Valid Value" 254 "Valid Value" 255 "Invalid Value" ;
VAL_ 627 TrailerSts 0 "Trailer off" 1 "Trailer on" ;
VAL_ 622 RPAS_RLCornrSnsrFailSts_0x26e 0 "Sensor normal" 1 "Sensor fault" ;
VAL_ 622 RPAS_RLMiddlSnsrFailSts_0x26e 0 "Sensor normal" 1 "Sensor fault" ;
VAL_ 622 RPAS_RRMiddlSnsrFailSts_0x26e 0 "Sensor normal" 1 "Sensor fault" ;
VAL_ 622 RPAS_RRCornrSnsrFailSts_0x26e 0 "Sensor normal" 1 "Sensor fault" ;
VAL_ 622 RPAS_WorkSts_0x26e 0 "Disable" 1 "Enable" 2 "Active" 3 "Failed" ;
VAL_ 622 RPAS_SoundIndcn_0x26e 0 "Tone 0-No warning" 1 "Tone 1-Long beep" 2 "Tone 2-1.5 Hz" 3 "Tone 3-3Hz" ;
VAL_ 622 MEBWorkSts_0x26e 0 "Off" 1 "Enable" 2 "Active" 3 "Failed" ;
VAL_ 622 MEB_EnableSts_0x26e 0 "Disable" 1 "Enable" ;
VAL_ 622 RPAS_ObjRRCornrAr1_0x26e 0 "No object" 1 "Object in zone 1, 0~10cm" 2 "Object in zone 2, 11~20cm" 3 "Object in zone 3, 21~30cm" 4 "Object in zone 4, 31~40cm" 5 "Object in zone 5, 41~50cm" 6 "Object in zone 6, 51~60cm" 7 "Reserved" 15 "Reserved" ;
VAL_ 622 RPAS_ObjRRCornrAr2_0x26e 0 "No object" 1 "Object in zone 1, 0~10cm" 2 "Object in zone 2, 11~20cm" 3 "Object in zone 3, 21~30cm" 4 "Object in zone 4, 31~40cm" 5 "Object in zone 5, 41~50cm" 6 "Object in zone 6, 51~60cm" 7 "Reserved" 15 "Reserved" ;
VAL_ 622 RPAS_ObjRRMidlAr1_0x26e 0 "No object" 1 "Object in zone 1, 0~10cm" 2 "Object in zone 2, 11~20cm" 3 "Object in zone 3, 21~30cm" 4 "Object in zone 4, 31~40cm" 5 "Object in zone 5, 41~50cm" 6 "Object in zone 6, 51~60cm" 7 "Object in zone 7, 61~70cm" 8 "Object in zone 8, 71~80cm" 9 "Object in zone 9, 81~90cm" 10 "Object in zone 10, 91~100cm" 11 "Object in zone 11, 101~110cm" 12 "Object in zone 12, 111~120cm" 13 "Object in zone 13, 121~130cm" 14 "Object in zone 14, 131~140cm" 15 "Object in zone 15, 141~150cm" ;
VAL_ 622 RPAS_ObjRRMidlAr2_0x26e 0 "No object" 1 "Object in zone 1, 0~10cm" 2 "Object in zone 2, 11~20cm" 3 "Object in zone 3, 21~30cm" 4 "Object in zone 4, 31~40cm" 5 "Object in zone 5, 41~50cm" 6 "Object in zone 6, 51~60cm" 7 "Object in zone 7, 61~70cm" 8 "Object in zone 8, 71~80cm" 9 "Object in zone 9, 81~90cm" 10 "Object in zone 10, 91~100cm" 11 "Object in zone 11, 101~110cm" 12 "Object in zone 12, 111~120cm" 13 "Object in zone 13, 121~130cm" 14 "Object in zone 14, 131~140cm" 15 "Object in zone 15, 141~150cm" ;
VAL_ 622 RPAS_ObjRLMidlAr1_0x26e 0 "No object" 1 "Object in zone 1, 0~10cm" 2 "Object in zone 2, 11~20cm" 3 "Object in zone 3, 21~30cm" 4 "Object in zone 4, 31~40cm" 5 "Object in zone 5, 41~50cm" 6 "Object in zone 6, 51~60cm" 7 "Object in zone 7, 61~70cm" 8 "Object in zone 8, 71~80cm" 9 "Object in zone 9, 81~90cm" 10 "Object in zone 10, 91~100cm" 11 "Object in zone 11, 101~110cm" 12 "Object in zone 12, 111~120cm" 13 "Object in zone 13, 121~130cm" 14 "Object in zone 14, 131~140cm" 15 "Object in zone 15, 141~150cm" ;
VAL_ 622 RPAS_ObjRLMidlAr2_0x26e 0 "No object" 1 "Object in zone 1, 0~10cm" 2 "Object in zone 2, 11~20cm" 3 "Object in zone 3, 21~30cm" 4 "Object in zone 4, 31~40cm" 5 "Object in zone 5, 41~50cm" 6 "Object in zone 6, 51~60cm" 7 "Object in zone 7, 61~70cm" 8 "Object in zone 8, 71~80cm" 9 "Object in zone 9, 81~90cm" 10 "Object in zone 10, 91~100cm" 11 "Object in zone 11, 101~110cm" 12 "Object in zone 12, 111~120cm" 13 "Object in zone 13, 121~130cm" 14 "Object in zone 14, 131~140cm" 15 "Object in zone 15, 141~150cm" ;
VAL_ 622 RPAS_ObjRLCornrAr1_0x26e 0 "No object" 1 "Object in zone 1, 0~10cm" 2 "Object in zone 2, 11~20cm" 3 "Object in zone 3, 21~30cm" 4 "Object in zone 4, 31~40cm" 5 "Object in zone 5, 41~50cm" 6 "Object in zone 6, 51~60cm" 7 "Reserved" 15 "Reserved" ;
VAL_ 622 RPAS_ObjRLCornrAr2_0x26e 0 "No object" 1 "Object in zone 1, 0~10cm" 2 "Object in zone 2, 11~20cm" 3 "Object in zone 3, 21~30cm" 4 "Object in zone 4, 31~40cm" 5 "Object in zone 5, 41~50cm" 6 "Object in zone 6, 51~60cm" 7 "Reserved" 15 "Reserved" ;
VAL_ 347 APS_PrkgMod 0 "None" 1 "Parking in" 2 "Parking out" 3 "Reserved" ;
VAL_ 347 APS_ProcBar 0 "0-100" 100 "0-100" 101 "Reserved" 126 "Reserved" 127 "No Display" ;
VAL_ 347 APS_SwtSts 0 "no press" 1 "press" ;
VAL_ 347 APS_SlotDisp 0 "No parking slot" 1 "Left parallel parking slot" 2 "Left vertical parking slot" 3 "Left T-shape parking slot" 4 "Right parallel parking slot" 5 "Right vertical parking slot" 6 "Right T-shape parking slot" 7 "Reserved" ;
VAL_ 347 APS_SysSoundIndcn 0 "Tone 0 - No Warning" 1 "Tone 1 - APS failed tone" 2 "Tone 2 - APS successful tone" 3 "Tone 3 - APS warning tone" 4 "Tone 4 - APS request tone" 5 "Reserved" 7 "Reserved" ;
VAL_ 347 APS_PrkgTyp 0 "None" 1 "Parallel parking" 2 "Vertical parking" 3 "Reserved" ;
VAL_ 347 APS_TextDisp 0 "No Request" 1 "Wrong gear position to start parking" 2 "Turn D to search for slot" 3 "Please close the trunk" 4 "Please close the door" 5 "Please fasten the seat belt" 6 "Please unfold the Mirror" 7 "Speed is too high, need <23kmh" 8 "System error Parking sys exits" 9 "control unit error parking sys exits" 10 "Please brake" 11 "please select parking mode" 12 "please select internal parking" 13 "please select Slot and parking mode" 14 "please select Slot and internal parking" 15 "Please keep braking" 16 "Hands off the steering wheel" 17 "Release the brake, parking start" 18 "Auto parking, be ready to brake" 19 "parking suspended,close trunk" 20 "parking suspended, close door" 21 "parking suspended, fasten seat belt" 22 "Obstacles Detected" 23 "brake recovered, confirm to continue" 24 "Parking quited" 25 "parking   finished" 26 "interfered by driver parking quited" 27 "too many parking times parking sys exits" 28 "Parking time too long Parking sys exits" 29 "Too Small Slot Parking sys exits" 30 "Please Clean the Camera" 31 "Select the parking mode(APA3)" 32 "Searching the right slot" 33 "Searching the left slot" 34 "Please turn D to search for parking slot" 35 "Speed is too high, need <30kmh" 36 "Speed is too high,sys exits" 37 "Select parking type" 38 "Long press switch 2s to enter auto parking" 39 "Parking suspended, Please release the gas pedal" 40 "Please brake, And long press switch 2s to continue auto parking" 41 "Parking is not available" 42 "Please select the parking direction by turning the turn switch" 43 "Please brakeï¼Œ And long press switch 2s to enter_POC_left" 44 "Parking sys exits" 45 "Parking suspended, fold the Mirror" 46 "Too Small Slot Please select another direction" 47 "Driving Mode not supported" 48 "Path is smooth" 49 "Please select park out" 50 "Please select park out direction" 51 "Please get off the car with keys to start remote parking" 52 "Please confirm to start parking" 53 "Remote Parking in exit" 54 "Parking suspended,Remote connection error" 55 "System error, Parking sys can not start" 56 "Control unit error, Parking sys can not start" 57 "Please Turn P and Apply EPB Remote parking sys not Running" 58 "Select Remote parking out type" 59 "Please brake,And long press switch 2s to enter_POC_Right" 60 "Please release switch to en-ter guidance" 61 "Slope over ,system exits" 62 "Reserved" 63 "Reserved" 64 "Path study begin please drive the car" 65 "Path studying" 66 "Confirm study finished" 67 "Path studying failed caused by Path too long" 68 "Path studying failed caused by Speed too high" 69 "Path studying failed caused by communication error" 70 "Path studying failed caused by Path error" 71 "Path studying failed caused by learn time too long" 72 "Path studying failed caused by internal error" 73 "Reserved" 79 "Reserved" 80 "Path saving" 81 "Path saving Succeed" 82 "Path saving failed caused by Path too short" 83 "Path saving failed caused by communication error" 84 "Path saving failed caused by Path error" 85 "Path saving failed caused by Path error limit storage room" 86 "Path saving failed caused by internal error" 87 "Reserved" 95 "Reserved" 96 "Please drive to path start point" 97 "Path matche please stop" 98 "Please select play back mode" 99 "Path match failed caused by communication error" 100 "Path match failed caused by path error" 101 "Path match failed caused by long time no action" 102 "Path match failed caused by internal error" 103 "Reserved" 111 "Reserved" 112 "No save distanceï¼ŒRADS sys esits" 113 "RADS running, be ready to brake" 114 "Near the bourn" 115 "Arrive at the bourn" 116 "Release the brake" 117 "Trunk open, RADS sys exits" 118 "Door open, RADS sys exits" 119 "Seat belt drop, RADS sys exits" 120 "Mirror fold, RADS sys exits" 121 "Obstacles Detected, RADS sys exits" 122 "No continue driving Parking quited" 123 "Please turn to R" 124 "Release the brake, Driving assistance start" 125 "Please turn to D" 126 "Reserved for RADS" 127 "Reserved for RADS" 128 "Reserved" 255 "Reserved" ;
VAL_ 347 APS_WorkSts 0 "Disable" 1 "Standby" 2 "Searching" 3 "Guidance" 4 "Failed" 5 "Wait for Engine restart" 6 "Reserved" 7 "Reserved" ;
VAL_ 347 MEB_AVHReq 0 "No Request" 1 "Request" ;
VAL_ 347 LParaPrkgOutVald 0 "valid" 1 "Invalid" ;
VAL_ 347 RParaPrkgOutVald 0 "valid" 1 "Invalid" ;
VAL_ 347 HeadVertPrkgOutVald 0 "valid" 1 "Invalid" ;
VAL_ 347 TailVertPrkgOutVald 0 "valid" 1 "Invalid" ;
VAL_ 347 HAP_SwtDispCtrlCmd 0 "no display" 1 "park out direction Select menu" 2 "continue park menu" 3 "Study finish button" 4 "RDAS distance arrow" 5 "RDAS active distance arrow steering" 6 "Reserved" 7 "Reserved" ;
VAL_ 347 P2P_PahDelSts 0 "No Action" 1 "deleting" 2 "successed" 3 "failed" ;
VAL_ 347 P2P_SelfDetErrCode 0 "No Error" 1 "HAP Error" 2 "tyre pressure error" 3 "door open" 4 "trunk open" 5 "vehicle moving" 6 "environment error" 7 "Camera is smudgy" 8 "Seat belt not fastened" 9 "Mirror is folded" 10 "reserved" 15 "reserved" ;
VAL_ 347 P2P_SelfDetSts 0 "No Action" 1 "Detecting" 2 "Successed" 3 "Failed" ;
VAL_ 347 P2P_Pah1Avail 0 "Not avalible" 1 "Avalible" ;
VAL_ 347 P2P_Pah2Avail 0 "Not avalible" 1 "Avalible" ;
VAL_ 347 HAP_PrkgModCurrSts 0 "No display" 1 "Left parallel park in" 2 "Right parallel park in" 3 "Left vert park in" 4 "Right vert park in" 5 "Left Tshape park in" 6 "Right Tshape park in" 7 "Left parallel park out" 8 "Right parallel park out" 9 "Front vert park out" 10 "Rear vert park out" 11 "reserved" 15 "reserved" ;
VAL_ 347 APS_MovgDirc 0 "No Display" 1 "Moving forward" 2 "Moving backward" 3 "Reserved" ;
VAL_ 628 AutoAVMSwtSet_Sts 0 "Off" 1 "ON" ;
VAL_ 628 AVM_CurrSts 0 "Off" 1 "ON" 2 "AVM no videoï¼ˆé›·è¾¾æ¨¡å¼ï¼‰" 3 "Reserved" ;
VAL_ 628 GuidOvlSts 0 "Around View and Single View" 1 "Only Around View" 2 "Only Single View" 3 "No Guidance" ;
VAL_ 628 FrntCamInpFailSts 0 "no failure" 1 "failure" ;
VAL_ 628 RearCamInpFailSts 0 "no failure" 1 "failure" ;
VAL_ 628 LeCamInpFailSts 0 "no failure" 1 "failure" ;
VAL_ 628 RiCamInpFailSts 0 "no failure" 1 "failure" ;
VAL_ 628 EolNotCmpltd 0 "Ccompleted" 1 "No completed" ;
VAL_ 628 OvlOpFailSts 0 "no failure" 1 "failure" ;
VAL_ 628 LaneCalSts 0 "No Commands" 1 "In Calibration process" 2 "Calibration success" 3 "Calibration failure" ;
VAL_ 628 RadarDispSts 0 "Both Around View and Single View Radar Display" 1 "Only Around View Radar Display" 2 "Only Single View Radar Display" 3 "No Radar Display" ;
VAL_ 628 LaneCalFltSts 0 "No fault" 1 "Front view Calibration abnormal" 2 "Rear view Calibration abnormal" 3 "left view Calibration abnormal" 4 "Right view Calibration abnormal" 5 "Calibration data storage failed" 6 "Reserved" 7 "Reserved" ;
VAL_ 628 AutoViewChgFuncSts 0 "Off" 1 "ON" ;
VAL_ 628 CarMdlTrsprcySts 0 "Opaque" 1 "Translucent" 2 "Completely transparent" 3 "Reserved" ;
VAL_ 628 CarMdlDispSts 0 "2D mode" 1 "3D mode" ;
VAL_ 628 CurrCalResultSts 0 "Use Factory Calibration Result" 1 "Use Lane Calibration Result" ;
VAL_ 628 MdlColrSts 0 "Silvery" 1 "Red" 2 "Gray" 3 "White" 4 "Black" 5 "Brown" 6 "Blue" 7 "Orange" 8 "Green" 9 "Gold" 10 "Purple" 11 "Reserved" 15 "Reserved" ;
VAL_ 628 SigViewIndcn 0 "No Commands" 1 "Front to Center View" 2 "Rear to Center View" 3 "Left to Center View" 4 "Right to Center View" 5 "Left Front to Center View" 6 "Right Front to Center View" 7 "Left Rear to Center View" 8 "Right Rear to Center View" 9 "Front View" 10 "Rear View" 11 "Left View" 12 "Right View" 13 "Left Turn 3D View" 14 "Right Turn 3D View" 15 "Front Overlook View" 16 "Rear Overlook View" 17 "Front 180 Deg View" 18 "Rear 180 Deg View" 19 "Front Wheel View" 20 "Rear Wheel View" 21 "Front Wash View" 22 "Rear Wash View" 23 "Free_3D View" 24 "LeftRight View" 25 "Engine Room View" 26 "CCO View" 27 "Reserved" 62 "Reserved" 63 "3D Car Model Round View" ;
VAL_ 628 HAP_DispCmd 0 "OFF" 1 "ON" ;
VAL_ 628 AVM_3DAngSts 0 "Not active" 1 "0~360Â°" 361 "0~360Â°" 362 "reserved" 510 "reserved" 511 "invalid" ;
VAL_ 628 MOD_WorkSts 0 "OFF" 1 "ON" ;
VAL_ 628 HAP_Hmi_Index 0 "Reserved" 1 "Main Screen" 2 "EOLTest" 3 "P2P Screen" 4 "Assist Screen" 5 "Reserved" 7 "Reserved" ;
VAL_ 628 DVRWorkSts 0 "DVR_Standby" 1 "DVR_Active" 2 "DVR_InterFailed" 3 "DVR_NetFailed" ;
VAL_ 628 MOD_AlarmSts 0 "OFF" 1 "ON" ;
VAL_ 664 RPAS_NearBrrdstn_0x298 0 "Valid value" 150 "Valid value" 151 "Reserved" 254 "Reserved" 255 "No Display" ;
VAL_ 664 APS_ObjRiSideAr1 0 "No object" 1 "Object in zone 1, 0~10cm" 2 "Object in zone 2, 11~20cm" 3 "Object in zone 3, 21~30cm" 4 "Object in zone 4, 31~40cm" 5 "Object in zone 5, 41~50cm" 6 "Object in zone 6, 51~60cm" 7 "Reserved" 15 "Reserved" ;
VAL_ 664 APS_ObjRiSideAr2 0 "No object" 1 "Object in zone 1, 0~10cm" 2 "Object in zone 2, 11~20cm" 3 "Object in zone 3, 21~30cm" 4 "Object in zone 4, 31~40cm" 5 "Object in zone 5, 41~50cm" 6 "Object in zone 6, 51~60cm" 7 "Reserved" 15 "Reserved" ;
VAL_ 664 APS_ObjRiSideAr3 0 "No object" 1 "Object in zone 1, 0~10cm" 2 "Object in zone 2, 11~20cm" 3 "Object in zone 3, 21~30cm" 4 "Object in zone 4, 31~40cm" 5 "Object in zone 5, 41~50cm" 6 "Object in zone 6, 51~60cm" 7 "Reserved" 15 "Reserved" ;
VAL_ 664 APS_ObjRiSideAr4 0 "No object" 1 "Object in zone 1, 0~10cm" 2 "Object in zone 2, 11~20cm" 3 "Object in zone 3, 21~30cm" 4 "Object in zone 4, 31~40cm" 5 "Object in zone 5, 41~50cm" 6 "Object in zone 6, 51~60cm" 7 "Reserved" 15 "Reserved" ;
VAL_ 664 APS_ObjRiSideAr5 0 "No object" 1 "Object in zone 1, 0~10cm" 2 "Object in zone 2, 11~20cm" 3 "Object in zone 3, 21~30cm" 4 "Object in zone 4, 31~40cm" 5 "Object in zone 5, 41~50cm" 6 "Object in zone 6, 51~60cm" 7 "Reserved" 15 "Reserved" ;
VAL_ 664 APS_ObjLeSideAr1 0 "No object" 1 "Object in zone 1, 0~10cm" 2 "Object in zone 2, 11~20cm" 3 "Object in zone 3, 21~30cm" 4 "Object in zone 4, 31~40cm" 5 "Object in zone 5, 41~50cm" 6 "Object in zone 6, 51~60cm" 7 "Reserved" 15 "Reserved" ;
VAL_ 664 APS_ObjLeSideAr2 0 "No object" 1 "Object in zone 1, 0~10cm" 2 "Object in zone 2, 11~20cm" 3 "Object in zone 3, 21~30cm" 4 "Object in zone 4, 31~40cm" 5 "Object in zone 5, 41~50cm" 6 "Object in zone 6, 51~60cm" 7 "Reserved" 15 "Reserved" ;
VAL_ 664 APS_ObjLeSideAr3 0 "No object" 1 "Object in zone 1, 0~10cm" 2 "Object in zone 2, 11~20cm" 3 "Object in zone 3, 21~30cm" 4 "Object in zone 4, 31~40cm" 5 "Object in zone 5, 41~50cm" 6 "Object in zone 6, 51~60cm" 7 "Reserved" 15 "Reserved" ;
VAL_ 664 APS_ObjLeSideAr4 0 "No object" 1 "Object in zone 1, 0~10cm" 2 "Object in zone 2, 11~20cm" 3 "Object in zone 3, 21~30cm" 4 "Object in zone 4, 31~40cm" 5 "Object in zone 5, 41~50cm" 6 "Object in zone 6, 51~60cm" 7 "Reserved" 15 "Reserved" ;
VAL_ 664 APS_ObjLeSideAr5 0 "No object" 1 "Object in zone 1, 0~10cm" 2 "Object in zone 2, 11~20cm" 3 "Object in zone 3, 21~30cm" 4 "Object in zone 4, 31~40cm" 5 "Object in zone 5, 41~50cm" 6 "Object in zone 6, 51~60cm" 7 "Reserved" 15 "Reserved" ;
VAL_ 664 APS_FRSideSnsrFailSts 0 "no failure" 1 "failure" ;
VAL_ 664 APS_FLSideSnsrFailSts 0 "no failure" 1 "failure" ;
VAL_ 664 APS_RRSideSnsrFailSts 0 "no failure" 1 "failure" ;
VAL_ 664 APS_RLSideSnsrFailSts 0 "no failure" 1 "failure" ;
VAL_ 664 SDW_SoundIndcn 0 "Tone 0 - No warning" 1 "Tone 1 - Long beep" 2 "Tone 2 - 1.5 Hz" 3 "Tone 3 - 3Hz" ;
VAL_ 664 SDWActiveSts 0 "Not active" 1 "Active" ;
VAL_ 664 RPAS_ObjRRCornrAr1_0x298 0 "No object" 1 "Object in zone 1, 0~10cm" 2 "Object in zone 2, 11~20cm" 3 "Object in zone 3, 21~30cm" 4 "Object in zone 4, 31~40cm" 5 "Object in zone 5, 41~50cm" 6 "Object in zone 6, 51~60cm" 7 "Reserved" 15 "Reserved" ;
VAL_ 664 RPAS_ObjRRCornrAr2_0x298 0 "No object" 1 "Object in zone 1, 0~10cm" 2 "Object in zone 2, 11~20cm" 3 "Object in zone 3, 21~30cm" 4 "Object in zone 4, 31~40cm" 5 "Object in zone 5, 41~50cm" 6 "Object in zone 6, 51~60cm" 7 "Reserved" 15 "Reserved" ;
VAL_ 664 RPAS_ObjRRMidlAr1_0x298 0 "No object" 1 "Object in zone 1, 0~10cm" 2 "Object in zone 2, 11~20cm" 3 "Object in zone 3, 21~30cm" 4 "Object in zone 4, 31~40cm" 5 "Object in zone 5, 41~50cm" 6 "Object in zone 6, 51~60cm" 7 "Object in zone 7, 61~70cm" 8 "Object in zone 8, 71~80cm" 9 "Object in zone 9, 81~90cm" 10 "Object in zone 10, 91~100cm" 11 "Object in zone 11, 101~110cm" 12 "Object in zone 12, 111~120cm" 13 "Object in zone 13, 121~130cm" 14 "Object in zone 14, 131~140cm" 15 "Object in zone 15, 141~150cm" ;
VAL_ 664 RPAS_ObjRRMidlAr2_0x298 0 "No object" 1 "Object in zone 1, 0~10cm" 2 "Object in zone 2, 11~20cm" 3 "Object in zone 3, 21~30cm" 4 "Object in zone 4, 31~40cm" 5 "Object in zone 5, 41~50cm" 6 "Object in zone 6, 51~60cm" 7 "Object in zone 7, 61~70cm" 8 "Object in zone 8, 71~80cm" 9 "Object in zone 9, 81~90cm" 10 "Object in zone 10, 91~100cm" 11 "Object in zone 11, 101~110cm" 12 "Object in zone 12, 111~120cm" 13 "Object in zone 13, 121~130cm" 14 "Object in zone 14, 131~140cm" 15 "Object in zone 15, 141~150cm" ;
VAL_ 664 RPAS_ObjRLMidlAr1_0x298 0 "No object" 1 "Object in zone 1, 0~10cm" 2 "Object in zone 2, 11~20cm" 3 "Object in zone 3, 21~30cm" 4 "Object in zone 4, 31~40cm" 5 "Object in zone 5, 41~50cm" 6 "Object in zone 6, 51~60cm" 7 "Object in zone 7, 61~70cm" 8 "Object in zone 8, 71~80cm" 9 "Object in zone 9, 81~90cm" 10 "Object in zone 10, 91~100cm" 11 "Object in zone 11, 101~110cm" 12 "Object in zone 12, 111~120cm" 13 "Object in zone 13, 121~130cm" 14 "Object in zone 14, 131~140cm" 15 "Object in zone 15, 141~150cm" ;
VAL_ 664 RPAS_ObjRLMidlAr2_0x298 0 "No object" 1 "Object in zone 1, 0~10cm" 2 "Object in zone 2, 11~20cm" 3 "Object in zone 3, 21~30cm" 4 "Object in zone 4, 31~40cm" 5 "Object in zone 5, 41~50cm" 6 "Object in zone 6, 51~60cm" 7 "Object in zone 7, 61~70cm" 8 "Object in zone 8, 71~80cm" 9 "Object in zone 9, 81~90cm" 10 "Object in zone 10, 91~100cm" 11 "Object in zone 11, 101~110cm" 12 "Object in zone 12, 111~120cm" 13 "Object in zone 13, 121~130cm" 14 "Object in zone 14, 131~140cm" 15 "Object in zone 15, 141~150cm" ;
VAL_ 664 RPAS_ObjRLCornrAr1_0x298 0 "No object" 1 "Object in zone 1, 0~10cm" 2 "Object in zone 2, 11~20cm" 3 "Object in zone 3, 21~30cm" 4 "Object in zone 4, 31~40cm" 5 "Object in zone 5, 41~50cm" 6 "Object in zone 6, 51~60cm" 7 "Reserved" 15 "Reserved" ;
VAL_ 664 RPAS_ObjRLCornrAr2_0x298 0 "No object" 1 "Object in zone 1, 0~10cm" 2 "Object in zone 2, 11~20cm" 3 "Object in zone 3, 21~30cm" 4 "Object in zone 4, 31~40cm" 5 "Object in zone 5, 41~50cm" 6 "Object in zone 6, 51~60cm" 7 "Reserved" 15 "Reserved" ;
VAL_ 664 RPAS_RLCornrSnsrFailSts_0x298 0 "no failure" 1 "failure" ;
VAL_ 664 RPAS_RLMiddlSnsrFailSts_0x298 0 "no failure" 1 "failure" ;
VAL_ 664 RPAS_RRMiddlSnsrFailSts_0x298 0 "no failure" 1 "failure" ;
VAL_ 664 RPAS_RRCornrSnsrFailSts_0x298 0 "no failure" 1 "failure" ;
VAL_ 664 RPAS_WorkSts_0x298 0 "Disable" 1 "Enable" 2 "Active" 3 "Failed" ;
VAL_ 664 RPAS_SoundIndcn_0x298 0 "Tone zero No warning" 1 "Tone one  Long beep" 2 "Tone two 1.5 Hz" 3 "Tone three  3Hz" ;
VAL_ 664 MEBWorkSts_0x298 0 "Off" 1 "Enable" 2 "Active" 3 "Failed" ;
VAL_ 664 MEB_EnableSts_0x298 0 "Disable" 1 "Enable" ;
VAL_ 664 FPAS_ObjFLCornrAr1_0x298 0 "No object" 1 "Object in zone 1, 0~10cm" 2 "Object in zone 2, 11~20cm" 3 "Object in zone 3, 21~30cm" 4 "Object in zone 4, 31~40cm" 5 "Object in zone 5, 41~50cm" 6 "Object in zone 6, 51~60cm" 7 "Reserved" 15 "Reserved" ;
VAL_ 664 FPAS_ObjFLCornrAr2_0x298 0 "No object" 1 "Object in zone 1, 0~10cm" 2 "Object in zone 2, 11~20cm" 3 "Object in zone 3, 21~30cm" 4 "Object in zone 4, 31~40cm" 5 "Object in zone 5, 41~50cm" 6 "Object in zone 6, 51~60cm" 7 "Reserved" 15 "Reserved" ;
VAL_ 664 FPAS_ObjFLMidlAr1_0x298 0 "No object" 1 "Object in zone 1, 0~10cm" 2 "Object in zone 2, 11~20cm" 3 "Object in zone 3, 21~30cm" 4 "Object in zone 4, 31~40cm" 5 "Object in zone 5, 41~50cm" 6 "Object in zone 6, 51~60cm" 7 "Object in zone 7, 61~70cm" 8 "Object in zone 8, 71~80cm" 9 "Object in zone 9, 81~90cm" 10 "Object in zone 10, 91~100cm" 11 "Reserved" 15 "Reserved" ;
VAL_ 664 FPAS_ObjFLMidlAr2_0x298 0 "No object" 1 "Object in zone 1, 0~10cm" 2 "Object in zone 2, 11~20cm" 3 "Object in zone 3, 21~30cm" 4 "Object in zone 4, 31~40cm" 5 "Object in zone 5, 41~50cm" 6 "Object in zone 6, 51~60cm" 7 "Object in zone 7, 61~70cm" 8 "Object in zone 8, 71~80cm" 9 "Object in zone 9, 81~90cm" 10 "Object in zone 10, 91~100cm" 11 "Reserved" 15 "Reserved" ;
VAL_ 664 FPAS_ObjFRMidlAr1_0x298 0 "No object" 1 "Object in zone 1, 0~10cm" 2 "Object in zone 2, 11~20cm" 3 "Object in zone 3, 21~30cm" 4 "Object in zone 4, 31~40cm" 5 "Object in zone 5, 41~50cm" 6 "Object in zone 6, 51~60cm" 7 "Object in zone 7, 61~70cm" 8 "Object in zone 8, 71~80cm" 9 "Object in zone 9, 81~90cm" 10 "Object in zone 10, 91~100cm" 11 "Reserved" 15 "Reserved" ;
VAL_ 664 FPAS_ObjFRMidlAr2_0x298 0 "No object" 1 "Object in zone 1, 0~10cm" 2 "Object in zone 2, 11~20cm" 3 "Object in zone 3, 21~30cm" 4 "Object in zone 4, 31~40cm" 5 "Object in zone 5, 41~50cm" 6 "Object in zone 6, 51~60cm" 7 "Object in zone 7, 61~70cm" 8 "Object in zone 8, 71~80cm" 9 "Object in zone 9, 81~90cm" 10 "Object in zone 10, 91~100cm" 11 "Reserved" 15 "Reserved" ;
VAL_ 664 FPAS_ObjFRCornrAr1_0x298 0 "No object" 1 "Object in zone 1, 0~10cm" 2 "Object in zone 2, 11~20cm" 3 "Object in zone 3, 21~30cm" 4 "Object in zone 4, 31~40cm" 5 "Object in zone 5, 41~50cm" 6 "Object in zone 6, 51~60cm" 7 "Reserved" 15 "Reserved" ;
VAL_ 664 FPAS_ObjFRCornrAr2_0x298 0 "No object" 1 "Object in zone 1, 0~10cm" 2 "Object in zone 2, 11~20cm" 3 "Object in zone 3, 21~30cm" 4 "Object in zone 4, 31~40cm" 5 "Object in zone 5, 41~50cm" 6 "Object in zone 6, 51~60cm" 7 "Reserved" 15 "Reserved" ;
VAL_ 664 FPAS_FLCornrSnsrFailSts 0 "no failure" 1 "failure" ;
VAL_ 664 FPAS_FLMiddlSnsrFailSts 0 "no failure" 1 "failure" ;
VAL_ 664 FPAS_FRMiddlSnsrFailSts 0 "no failure" 1 "failure" ;
VAL_ 664 FPAS_FRCornrSnsrFailSts 0 "no failure" 1 "failure" ;
VAL_ 664 FPAS_WorkSts_0x298 0 "Disable" 1 "Enable" 2 "Active" 3 "Failed" ;
VAL_ 664 FPAS_AutoModSts_0x298 0 "Not available" 1 "available" ;
VAL_ 664 FPAS_SoundIndcn_0x298 0 "Tone zero  No warning" 1 "Tone one  Long beep" 2 "Tone two 1.5 Hz" 3 "Tone three 3Hz" ;
VAL_ 664 FPAS_NearBrrdstn_0x298 0 "Valid value" 100 "Valid value" 101 "Reserved" 126 "Reserved" 127 "No Display" ;
VAL_ 664 APA_MenuDispCtrlCmd 0 "No_Disp_avm_menu" 1 "park_in_indicate_menu" 2 "park_in_select_slot_menu" 3 "park_in_mode_select_menu" 4 "park_in_process" 5 "remote_park_in_process" 6 "park_out_confirm_menu" 7 "park_out_process" 8 "park_in_indicate_menu_NoRPA" 9 "park_in_select_slot_menu_NoRPA" 10 "park_in_mode_select_menu_NoRPA" 11 "park_out _indicate_menu" 12 "Reversed" 15 "Reversed" ;
VAL_ 664 APA_FuncSts 0 "APA Function standby" 1 "APA Function active" 2 "APA Function disable" 3 "Reserved" ;
VAL_ 664 P2P_FuncSts 0 "P2P Functionstandby" 1 "P2P Function active" 2 "P2P Function disable" 3 "Reserved" ;
VAL_ 664 RADS_FuncSts 0 "Reverse Asist Function standby" 1 "Reverse Asist Function active" 2 "Reverse Asist Function disable" 3 "Reserved" ;
VAL_ 664 FADS_FuncSts 0 "FADS Function standby" 1 "FADS Function active" 2 "FADS Function disable" 3 "Reserved" ;
VAL_ 664 HAP_TextIconDispCtrl 0 "No display" 1 "Display according to text info" 2 "Display parking mode" 3 "Reserved" ;
VAL_ 649 HAP_RtCam_WorkSts 0 "Disable" 1 "Enable" 2 "Active" 3 "Failed" ;
VAL_ 649 HAP_RtSide_Obj1_ID 0 "Valid values" 3 "Valid values" 4 "Invalid values" 15 "Invalid values" ;
VAL_ 649 HAP_RtSide_Obj1_type 0 "No target" 1 "Pedestrian" 2 "Biker" 3 "Vehicle" 4 "Ground Locker" 5 "Barrier" 6 "Reserved" 7 "Unknown type" ;
VAL_ 649 HAP_RtSide_Obj1_Confidence 0 "Valid value" 10 "Invalid" 15 "Invalid" ;
VAL_ 649 HAP_RtSide_Obj1_Ground_Pos_X 0 "Valid values" 4000 "Valid values" 4001 "Reserved" 4094 "Reserved" 4095 "Invalid values" ;
VAL_ 649 HAP_RtSide_Obj1_Ground_Pos_Y 0 "Valid values" 4000 "Valid values" 4001 "Reserved" 4094 "Reserved" 4095 "Invalid values" ;
VAL_ 649 HAP_RtSide_Obj2_ID 0 "Valid values" 3 "Valid values" 4 "Invalid values" 15 "Invalid values" ;
VAL_ 649 HAP_RtSide_Obj2_type 0 "No target" 1 "Pedestrian" 2 "Biker" 3 "Vehicle" 4 "Ground Locker" 5 "Barrier" 6 "Reserved" 7 "Unknown type" ;
VAL_ 649 HAP_RtSide_Obj2_Confidence 0 "Valid value" 10 "Invalid" 15 "Invalid" ;
VAL_ 649 HAP_RtSide_Obj2_Ground_Pos_X 0 "Valid values" 4000 "Valid values" 4001 "Reserved" 4094 "Reserved" 4095 "Invalid values" ;
VAL_ 649 HAP_RtSide_Obj2_Ground_Pos_Y 0 "Valid values" 4000 "Valid values" 4001 "Reserved" 4094 "Reserved" 4095 "Invalid values" ;
VAL_ 649 HAP_RtSide_Obj3_ID 0 "Valid values" 3 "Valid values" 4 "Invalid values" 15 "Invalid values" ;
VAL_ 649 HAP_RtSide_Obj3_type 0 "No target" 1 "Pedestrian" 2 "Biker" 3 "Vehicle" 4 "Ground Locker" 5 "Barrier" 6 "Reserved" 7 "Unknown type" ;
VAL_ 649 HAP_RtSide_Obj3_Confidence 0 "Valid value" 10 "Invalid" 15 "Invalid" ;
VAL_ 649 HAP_RtSide_Obj3_Ground_Pos_X 0 "Valid values" 4000 "Valid values" 4001 "Reserved" 4094 "Reserved" 4095 "Invalid values" ;
VAL_ 649 HAP_RtSide_Obj3_Ground_Pos_Y 0 "Valid values" 4000 "Valid values" 4001 "Reserved" 4094 "Reserved" 4095 "Invalid values" ;
VAL_ 649 HAP_RtSide_Obj4_ID 0 "Valid values" 3 "Valid values" 4 "Invalid values" 15 "Invalid values" ;
VAL_ 649 HAP_RtSide_Obj4_type 0 "No target" 1 "Pedestrian" 2 "Biker" 3 "Vehicle" 4 "Ground Locker" 5 "Barrier" 6 "Reserved" 7 "Unknown type" ;
VAL_ 649 HAP_RtSide_Obj4_Confidence 0 "Valid value" 10 "Invalid" 15 "Invalid" ;
VAL_ 649 HAP_RtSide_Obj4_Ground_Pos_X 0 "Valid values" 4000 "Valid values" 4001 "Reserved" 4094 "Reserved" 4095 "Invalid values" ;
VAL_ 649 HAP_RtSide_Obj4_Ground_Pos_Y 0 "Valid values" 4000 "Valid values" 4001 "Reserved" 4094 "Reserved" 4095 "Invalid values" ;
VAL_ 649 USS_FLSide1_Status 0 "Disable" 1 "Enable" 2 "Active" 3 "Failed" ;
VAL_ 649 USS_FLSide1_Dist 0 "Valid values" 126 "Valid values" 127 "Invalid" ;
VAL_ 649 USS_RLSide2_Status 0 "Disable" 1 "Enable" 2 "Active" 3 "Failed" ;
VAL_ 649 USS_RLSide2_Dist 0 "Valid values" 126 "Valid values" 127 "Invalid" ;
VAL_ 649 USS_FRSide1_Status 0 "Disable" 1 "Enable" 2 "Active" 3 "Failed" ;
VAL_ 649 USS_FRSide1_Dist 0 "Valid values" 126 "Valid values" 127 "Invalid" ;
VAL_ 649 USS_RRSide2_Status 0 "Disable" 1 "Enable" 2 "Active" 3 "Failed" ;
VAL_ 649 USS_RRSide2_Dist 0 "Valid values" 126 "Valid values" 127 "Invalid" ;
VAL_ 647 Checksum_HC1 0 "Valid Value" 255 "Valid Value" ;
VAL_ 647 HighBeamSts_HC 0 "Off" 1 "On" ;
VAL_ 647 ADBstatus 0 "Off" 1 "ON" 2 "error" 3 "Reserved" ;
VAL_ 647 LeftLowBeamFailSts 0 "No failure" 1 "Failure" ;
VAL_ 647 RightLowBeamFailSts 0 "No failure" 1 "Failure" ;
VAL_ 647 LeftHighBeamFailSts 0 "No failure" 1 "Failure" ;
VAL_ 647 RightHighBeamFailSts 0 "No failure" 1 "Failure" ;
VAL_ 647 ALS_FailSts 0 "No failure" 1 "Failure" ;
VAL_ 647 RollingCounter_HC1 0 "Valid value" 14 "Valid value" 15 "Invalid value" ;
VAL_ 714 DrvMirrFold_UnfoldSts 0 "Unfold" 1 "Fold" ;
VAL_ 714 PowerCutSwt 0 "Unlock" 1 "Lock" ;
VAL_ 714 DrvWinPosnSts 0 "Middle" 1 "Up" 2 "Down" 3 "Other" 4 "reserved" 7 "reserved" ;
VAL_ 714 DrvWinAntiPinchSts 0 "Not active" 1 "Active" ;
VAL_ 714 DrvWinLrnSts 0 "Unlearn" 1 "Learn" ;
VAL_ 714 DrvWinHotProtSts 0 "NO" 1 "Hot prtect" ;
VAL_ 714 DrvSideRearAntiPinchSts 0 "Not active" 1 "Active" ;
VAL_ 714 DrvSideRearWinPosnSts 0 "Middle" 1 "Up" 2 "Down" 3 "Other" 4 "reserved" 7 "reserved" ;
VAL_ 714 DrvSideRearWinLrnSts 0 "Unlearn" 1 "Learn" ;
VAL_ 714 DrvSideRearWinHotProtSts 0 "NO" 1 "Hot prtect" ;
VAL_ 717 PassMirrFold_UnfoldSts 0 "Unfold" 1 "Fold" ;
VAL_ 717 PassWinAntiPinchSts 0 "Not active" 1 "Active" ;
VAL_ 717 PassWinPosnSts 0 "Middle" 1 "Up" 2 "Down" 3 "Other" 4 "reserved" 7 "reserved" ;
VAL_ 717 PassWinLrnSts 0 "Unlearn" 1 "Learn" ;
VAL_ 717 PassWinHotProtSts 0 "NO" 1 "Hot prtect" ;
VAL_ 717 PassSideRearWinAntiPinchSts 0 "Not active" 1 "Active" ;
VAL_ 717 PassSideRearWinPosnSts 0 "Middle" 1 "Up" 2 "Down" 3 "Other" 4 "reserved" 7 "reserved" ;
VAL_ 717 PassSideRearWinLrnSts 0 "Unlearn" 1 "Learn" ;
VAL_ 717 PassSideRearWinHotProtSts 0 "NO" 1 "Hot prtect" ;
VAL_ 862 RoofModFb 0 "OFF" 1 "ON" ;
VAL_ 862 AllTerrainDislFb 0 "OFF" 1 "ON" ;
VAL_ 862 ElecSideStepSysFb 0 "OFF" 1 "ON" ;
VAL_ 771 RotSteerWheel 0 "Off" 1 "Warning" ;
VAL_ 543 STBS_SoundReq 0 "No Request" 1 "Request" ;
VAL_ 543 VolUpReq_SC 0 "Released" 1 "Pressed" 2 "Error" 3 "Invalid" ;
VAL_ 543 VolDwnReq_SC 0 "Released" 1 "Pressed" 2 "Error" 3 "Invalid" ;
VAL_ 543 DispTODReq_SC 0 "Released" 1 "Pressed" 2 "Error" 3 "Invalid" ;
VAL_ 766 PLG_Sts 0 "PLG unknown" 1 "Fully opened" 2 "Fully closed" 3 "Opening" 4 "Closing" 5 "PLG stopped" 6 "Latch releasing" 7 "Latch cinching" ;
VAL_ 86 E_CALLSts 0 "No Action" 1 "Dialing in" 2 "Dialing out" 3 "On call" 4 "Hang up" 5 "Build failed" ;
VAL_ 86 QuietVoiceReq 0 "OFF" 1 "ON" ;
VAL_ 621 FPAS_ObjFLCornrAr1_0x26d 0 "No object" 1 "Object in zone 1, 0~10cm" 2 "Object in zone 2, 11~20cm" 3 "Object in zone 3, 21~30cm" 4 "Object in zone 4, 31~40cm" 5 "Object in zone 5, 41~50cm" 6 "Object in zone 6, 51~60cm" 7 "Reserved" 15 "Reserved" ;
VAL_ 621 FPAS_ObjFLCornrAr2_0x26d 0 "No object" 1 "Object in zone 1, 0~10cm" 2 "Object in zone 2, 11~20cm" 3 "Object in zone 3, 21~30cm" 4 "Object in zone 4, 31~40cm" 5 "Object in zone 5, 41~50cm" 6 "Object in zone 6, 51~60cm" 7 "Reserved" 15 "Reserved" ;
VAL_ 621 FPAS_ObjFLMidlAr1_0x26d 0 "No object" 1 "Object in zone 1, 0~10cm" 2 "Object in zone 2, 11~20cm" 3 "Object in zone 3, 21~30cm" 4 "Object in zone 4, 31~40cm" 5 "Object in zone 5, 41~50cm" 6 "Object in zone 6, 51~60cm" 7 "Object in zone 7, 61~70cm" 8 "Object in zone 8, 71~80cm" 9 "Object in zone 9, 81~90cm" 10 "Object in zone 10, 91~100cm" 11 "Reserved" 15 "Reserved" ;
VAL_ 621 FPAS_ObjFLMidlAr2_0x26d 0 "No object" 1 "Object in zone 1, 0~10cm" 2 "Object in zone 2, 11~20cm" 3 "Object in zone 3, 21~30cm" 4 "Object in zone 4, 31~40cm" 5 "Object in zone 5, 41~50cm" 6 "Object in zone 6, 51~60cm" 7 "Object in zone 7, 61~70cm" 8 "Object in zone 8, 71~80cm" 9 "Object in zone 9, 81~90cm" 10 "Object in zone 10, 91~100cm" 11 "Reserved" 15 "Reserved" ;
VAL_ 621 FPAS_ObjFRMidlAr1_0x26d 0 "No object" 1 "Object in zone 1, 0~10cm" 2 "Object in zone 2, 11~20cm" 3 "Object in zone 3, 21~30cm" 4 "Object in zone 4, 31~40cm" 5 "Object in zone 5, 41~50cm" 6 "Object in zone 6, 51~60cm" 7 "Object in zone 7, 61~70cm" 8 "Object in zone 8, 71~80cm" 9 "Object in zone 9, 81~90cm" 10 "Object in zone 10, 91~100cm" 11 "Reserved" 15 "Reserved" ;
VAL_ 621 FPAS_ObjFRMidlAr2_0x26d 0 "No object" 1 "Object in zone 1, 0~10cm" 2 "Object in zone 2, 11~20cm" 3 "Object in zone 3, 21~30cm" 4 "Object in zone 4, 31~40cm" 5 "Object in zone 5, 41~50cm" 6 "Object in zone 6, 51~60cm" 7 "Object in zone 7, 61~70cm" 8 "Object in zone 8, 71~80cm" 9 "Object in zone 9, 81~90cm" 10 "Object in zone 10, 91~100cm" 11 "Reserved" 15 "Reserved" ;
VAL_ 621 FPAS_ObjFRCornrAr1_0x26d 0 "No object" 1 "Object in zone 1, 0~10cm" 2 "Object in zone 2, 11~20cm" 3 "Object in zone 3, 21~30cm" 4 "Object in zone 4, 31~40cm" 5 "Object in zone 5, 41~50cm" 6 "Object in zone 6, 51~60cm" 7 "Reserved" 15 "Reserved" ;
VAL_ 621 FPAS_ObjFRCornrAr2_0x26d 0 "No object" 1 "Object in zone 1, 0~10cm" 2 "Object in zone 2, 11~20cm" 3 "Object in zone 3, 21~30cm" 4 "Object in zone 4, 31~40cm" 5 "Object in zone 5, 41~50cm" 6 "Object in zone 6, 51~60cm" 7 "Reserved" 15 "Reserved" ;
VAL_ 621 FPAS_FLCornrSnsrFltSts 0 "no failure" 1 "failure" ;
VAL_ 621 FPAS_FLMiddlSnsrFltSts 0 "no failure" 1 "failure" ;
VAL_ 621 FPAS_FRMiddlSnsrFltSts 0 "no failure" 1 "failure" ;
VAL_ 621 FPAS_FRCornrSnsrFltSts 0 "no failure" 1 "failure" ;
VAL_ 621 FPAS_WorkSts_0x26d 0 "Disable" 1 "Enable" 2 "Active" 3 "Failed" ;
VAL_ 621 FPAS_AutoModSts_0x26d 0 "Not available" 1 "available" ;
VAL_ 621 FPAS_SoundIndcn_0x26d 0 "Tone zero  No warning" 1 "Tone one  Long beep" 2 "Tone two 1.5 Hz" 3 "Tone three 3Hz" ;
VAL_ 621 FPAS_NearBrrdstn_0x26d 0 "Valid value" 100 "Valid value" 101 "Reserved" 126 "Reserved" 127 "No Display" ;
VAL_ 749 RPAS_NearBrrdstn_0x2ed 0 "Valid value" 150 "Valid value" 151 "Reserved" 254 "Reserved" 255 "No Display" ;
VAL_ 737 VSG_Sts 0 "Standby" 1 "Sound on" 2 "Fault" 3 "OFF" ;
VAL_ 737 VSG_HUTSoundResp 0 "sound 1" 1 "sound 2" 2 "sound 3" 3 "Reserved" ;
VAL_ 656 PressReliProgs 0 "value" 99 "value" 100 "Finish" 101 "reserved" 127 "reserved" ;
VAL_ 656 FTIVFault 0 "No warning" 1 "Warning" ;
VAL_ 656 FuelTankCapWarning 0 "No warning" 1 "Warning(Fuel tank cap did not close)" 2 "Reserved" 3 "Fault(Fuel tank cap did not open)" ;
VAL_ 279 EngState_PHEV 0 "Stand by" 1 "Ready" 2 "Cranking" 3 "Running" 4 "Stopping" 5 "Finish" 6 "Autostopping" 7 "Reserved" ;
VAL_ 279 CruiseCtrlSts_PHEV 0 "OFF" 1 "Stand by" 2 "Cruise" 3 "Acceleration" 4 "Deceleration" 5 "Tip up" 6 "Tip dwon" 7 "Resume from above vehicle speed" 8 "Resume from below vehicle speed" 9 "Error" 10 "Reserved" 15 "Reserved" ;
VAL_ 616 HCU_ChrgDchrgSts 0 "Charging" 1 "Discharging" 2 "Invalid" 3 "Reserved" ;
VAL_ 616 HCU_BattLowTemWarn 0 "Normal" 1 "Battery temperature is too low, plug in heating" 2 "Battery temperature is low, vehicle cannot start normal; Please wait, battery is being heating" 3 "Reserved" ;
VAL_ 616 HCU_BattLowHeatSts 0 "No Display" 1 "PTC heating is complete" 2 "Plug in heating is complete" 3 "Reserved" ;
VAL_ 616 HCU_IntelEngIdlChrgnSts 0 "Default" 1 "Idle charging" 2 "Fail to Idle charging" 3 "Idle charging shut off" 4 "Idle charging is complete" 5 "Reserved" 7 "Reserved" ;
VAL_ 788 HCU_ACLineDisconnect 0 "Init" 1 "Not connect" 2 "connect" 3 "Reserved" ;
VAL_ 788 HCU_ChargSts 0 "Default" 1 "Chargingï¼ˆå……ç”µä¸­ï¼‰" 2 "Delaying" 3 "Charge complete" 4 "Charge stopped" 5 "Charge Initialize" 6 "Charging Heatingï¼ˆæ’æžªä»…åŠ çƒ­ï¼‰" 7 "Fault" ;
VAL_ 788 HCU_WorkshopMode 0 "Not active" 1 "Active" ;
VAL_ 788 HCU_IntelBattTempMagSts 0 "Off" 1 "On" ;
VAL_ 962 HCU_EVContnsDistance 0 "Vaild value" 254 "Vaild value" 255 "Invalid" ;
VAL_ 962 HCU_EVContnsDistanceVld 0 "Invalid" 1 "Valid" ;
VAL_ 962 HCU_RecupPwr 0 "Valid value" 1023 "Valid value" ;
VAL_ 962 HCU_EgyUsed 0 "Valid value" 1023 "Valid value" ;
VAL_ 962 HCU_HiVoltInterlockSts_RM 0 "Normal" 1 "Warning" ;
SIG_GROUP_ 360 EPS1 1 : CheckSum_EPS1_0x168 dummy_EPS1_0 EPS_TrqSnsrSts_0x168 EPS_FailSts_0x168 dummy_EPS1_1 dummy_EPS1_2 dummy_EPS1_3 dummy_EPS1_4 dummy_EPS1_5 EPS_SteerMod_0x168 dummy_EPS1_6 dummy_EPS1_7 RollingCounter_EPS1_0x168;
SIG_GROUP_ 327 EPS_FD1 1 : CheckSum_EPS1_0x147 dummy_EPS_FD1_0 EPS_TrqSnsrSts_0x147 EPS_FailSts_0x147 dummy_EPS_FD1_1 dummy_EPS_FD1_2 dummy_EPS_FD1_3 dummy_EPS_FD1_4 dummy_EPS_FD1_5 EPS_SteerMod_0x147 dummy_EPS_FD1_6 dummy_EPS_FD1_7 RollingCounter_EPS1_0x147;
SIG_GROUP_ 849 ABM1 1 : CheckSum_ABM1 dummy_ABM1_0 SecRowLSBR AirbFailLmpCmd SecRowMidSBR DrvSBR SecRowRSBR PassSBR dummy_ABM1_1 CrashOutputSts SecRowMidSBR_Visual SecRowLSBR_Visual PassSBR_Visual DrvSBR_Visual dummy_ABM1_2 SecRowRSBR_Visual dummy_ABM1_3 dummy_ABM1_4 dummy_ABM1_5 RollingCounter_ABM1;
SIG_GROUP_ 647 HC1 1 : Checksum_HC1 HighBeamSts_HC ADBstatus LeftLowBeamFailSts RightLowBeamFailSts LeftHighBeamFailSts RightHighBeamFailSts ALS_FailSts dummy_HC1_0 dummy_HC1_1 dummy_HC1_2 dummy_HC1_3 dummy_HC1_4 dummy_HC1_5 RollingCounter_HC1;
