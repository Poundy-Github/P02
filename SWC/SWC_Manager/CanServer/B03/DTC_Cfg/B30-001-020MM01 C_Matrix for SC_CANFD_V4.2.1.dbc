VERSION "created by dbc creator v1.0"

NS_ :

BS_:

BU_: T_Box GW DMS DVR HUT Tester

BO_ 51 T_Box_FD1: 16 T_Box
 SG_ T_Box_RemtWinCtrl : 2|3@0+ (1,0) [0|7] ""  GW
 SG_ T_Box_RemtTrunkCtrl : 4|2@0+ (1,0) [0|3] ""  GW
 SG_ T_Box_RemtDoorLockCtrl : 7|3@0+ (1,0) [0|7] ""  GW,HUT
 SG_ T_Box_AudioMuteReq : 9|2@0+ (1,0) [0|3] ""  HUT
 SG_ T_Box_RemtDrvTempSet : 15|6@0+ (0.5,16) [16.5|31.5] "Â°C"  GW
 SG_ T_Box_RemtAutoCtrl : 17|2@0+ (1,0) [0|3] ""  GW
 SG_ T_Box_RemtPassTempSet : 23|6@0+ (0.5,16) [16.5|31.5] "Â°C"  GW
 SG_ T_Box_RemtSsCtrl : 27|4@0+ (1,0) [0|15] ""  GW
 SG_ T_Box_RemtSrCtrl : 31|4@0+ (1,0) [0|15] ""  GW
 SG_ T_Box_RemtDrvSeatVentnLvlSet : 34|3@0+ (1,0) [0|7] ""  GW
 SG_ T_Box_RemtPassSeatVentnLvlSet : 37|3@0+ (1,0) [0|7] ""  GW
 SG_ T_Box_RemtAIUReq : 39|2@0+ (1,0) [0|3] ""  GW
 SG_ T_Box_PM25AirQLvl : 43|4@0+ (1,0) [0|15] ""  HUT
 SG_ T_Box_RemtCarSearch : 45|2@0+ (1,0) [0|3] ""  GW
 SG_ T_Box_RemtEngCtrl : 47|2@0+ (1,0) [0|3] ""  GW
 SG_ T_Box_RemtDrvSeatHeatgLvlSet : 52|3@0+ (1,0) [0|7] ""  GW
 SG_ T_Box_RemtPassSeatHeatgLvlSet : 55|3@0+ (1,0) [0|7] ""  GW
 SG_ T_Box_PM25_Dens : 49|10@0+ (1,0) [0|1023] "ugm^3"  HUT
 SG_ FreshnessValue_T_Box_FD1 : 71|16@0+ (1,0) [0|65535] ""  GW,HUT
 SG_ MAC_Check_T_Box_FD1 : 87|48@0+ (1,0) [0|281474976710655] ""  GW,HUT
 SG_ T_Box_FD1_0x33 : 7|128@0+ (1,0) [0|0] ""  HUT

BO_ 54 T_Box_FD2: 16 T_Box
 SG_ T_Box_PEPSAuth1 : 7|64@0+ (1,0) [0|1.84467440737096E+019] ""  GW

BO_ 1001 T_Box_FD3: 16 T_Box
 SG_ T_Box_SWUpdSts : 18|3@0+ (1,0) [0|7] ""  HUT
 SG_ T_Box_SysErrSts : 7|5@0+ (1,0) [0|31] ""  GW,HUT
 SG_ FreshnessValue_T_Box_FD3 : 71|16@0+ (1,0) [0|65535] ""  GW,HUT
 SG_ MAC_Check_T_Box_FD3 : 87|48@0+ (1,0) [0|281474976710655] ""  GW,HUT
 SG_ T_Box_FD3_0x3E9 : 7|128@0+ (1,0) [0|0] ""  HUT

BO_ 481 T_Box_FD4: 16 T_Box
 SG_ T_Box_BMSReMtPreHeatT : 7|11@0+ (1,0) [0|1440] ""  GW
 SG_ Phone_ChrgnMode : 10|2@0+ (1,0) [0|3] ""  GW
 SG_ T_Box_IntelEngIdlChrgnSwt : 21|2@0+ (1,0) [0|3] ""  GW
 SG_ T_Box_BattKeepTemp : 17|2@0+ (1,0) [0|3] ""  GW
 SG_ T_Box_RemtFrntDefrostCtrl : 19|2@0+ (1,0) [0|3] ""  GW
 SG_ Phone_BattSOCLim : 29|3@0+ (1,0) [0|7] ""  GW
 SG_ T_Box_RemtRearDefrostCtrl : 39|2@0+ (1,0) [0|3] ""  GW
 SG_ RemUpgrdModeCmd : 34|2@0+ (1,0) [0|3] ""  GW
 SG_ T_Box_RemtVideoMonrEnaReq_APP : 41|2@0+ (1,0) [0|3] ""  HUT,DVR
 SG_ T_Box_BMSReMtPreHeatReq : 49|2@0+ (1,0) [0|3] ""  GW
 SG_ T_Box_RemtCockpitClnReq : 53|2@0+ (1,0) [0|3] ""  GW
 SG_ T_Box_RemtSdlMod : 55|2@0+ (1,0) [0|3] ""  GW
 SG_ T_Box_FD4_0x1E1 : 7|128@0+ (1,0) [0|0] ""  HUT

BO_ 72 T_Box7: 16 T_Box
 SG_ T_Box_PEPSAuth2 : 7|64@0+ (1,0) [0|1.84467440737096E+019] ""  GW

BO_ 829 T_Box_FD6: 8 T_Box
 SG_ T_BOX_RemtLimitStart : 1|2@0+ (1,0) [0|3] ""  GW
 SG_ T_Box_FD6_0x33D : 7|64@0+ (1,0) [0|0] "" Vector__XXX

BO_ 748 DVR_FD1: 64 DVR
 SG_ DVRRemtCnSts : 11|2@0+ (1,0) [0|3] ""  T_Box
 SG_ DVR_360VideoCaptureReq : 9|1@0+ (1,0) [0|1] ""  GW
 SG_ DVRSN : 71|48@0+ (1,0) [0|1] ""  T_Box
 SG_ DVR_FD1_0x2EC : 7|512@0+ (1,0) [0|0] "" Vector__XXX

BO_ 680 EEM1: 8 GW
 SG_ TranPMode_Sts : 7|1@0+ (1,0) [0|1] ""  HUT,T_Box,DMS,DVR
 SG_ Stat_PwrSv_Lvl : 6|3@0+ (1,0) [0|7] ""  HUT
 SG_ DeepSlpCmd : 3|2@0+ (1,0) [0|3] ""  T_Box
 SG_ Dyn_PwrSv_Lvl : 23|3@0+ (1,0) [0|7] ""  HUT
 SG_ LvPwrSysErr : 25|2@0+ (1,0) [0|3] ""  HUT
 SG_ LimitStartSts : 61|2@0+ (1,0) [0|3] ""  HUT,T_Box
 SG_ EEM1_0x2A8 : 7|64@0+ (1,0) [0|0] ""  HUT

BO_ 699 GW_FD1: 64 GW
 SG_ U_BATT : 71|14@0+ (0.0009765625,3) [3|18] "V"  HUT,T_Box
 SG_ I_RANGE : 73|2@0+ (1,0) [0|3] ""  HUT
 SG_ I_BATT : 87|16@0+ (1,-32768) [-32768|32767] "A"  HUT
 SG_ SOC : 135|8@0+ (1,0) [0|100] "%"  HUT,T_Box,DVR
 SG_ SOH_SUL : 143|8@0+ (1,0) [0|100] "%"  HUT
 SG_ SOC_STATE : 183|2@0+ (1,0) [0|3] ""  HUT
 SG_ SOH_SUL_STATE : 181|2@0+ (1,0) [0|3] ""  HUT
 SG_ GW_FD1_0x2BB : 7|512@0+ (1,0) [0|0] ""  HUT

BO_ 367 RSDS_FD1: 64 GW
 SG_ RSDS_IPSoundReq : 81|2@0+ (1,0) [0|3] ""  HUT
 SG_ BSD_LCA_warningReqRight : 95|2@0+ (1,0) [0|3] ""  HUT
 SG_ BSD_LCA_warningReqleft : 93|2@0+ (1,0) [0|3] ""  HUT
 SG_ DOW_warningReqRight : 91|2@0+ (1,0) [0|3] ""  HUT
 SG_ DOW_warningReqleft : 89|2@0+ (1,0) [0|3] ""  HUT
 SG_ RSDS_ErrSts : 119|1@0+ (1,0) [0|1] ""  HUT
 SG_ RSDS_BrkgTrig : 118|1@0+ (1,0) [0|1] ""  HUT
 SG_ RSDS_BliSts : 117|1@0+ (1,0) [0|1] ""  HUT
 SG_ RSDS_TrailerSts : 116|1@0+ (1,0) [0|1] ""  HUT
 SG_ RSDS_LCAResp : 115|1@0+ (1,0) [0|1] ""  HUT
 SG_ RSDS_DOWResp : 114|1@0+ (1,0) [0|1] ""  HUT
 SG_ RSDS_RCWResp : 113|1@0+ (1,0) [0|1] ""  HUT
 SG_ RSDS_RCTAResp : 112|1@0+ (1,0) [0|1] ""  HUT
 SG_ RSDS_RCTABrkResp : 127|1@0+ (1,0) [0|1] ""  HUT
 SG_ RSDS_RCW_Trigger : 105|2@0+ (1,0) [0|3] ""  HUT
 SG_ RSDS_CTA_Actv : 126|1@0+ (1,0) [0|1] ""  HUT
 SG_ RCTA_warningReqRight : 125|1@0+ (1,0) [0|1] ""  HUT
 SG_ RCTA_warningReqLeft : 124|1@0+ (1,0) [0|1] ""  HUT
 SG_ RSDS_FD1_0x16F : 7|512@0+ (1,0) [0|0] ""  HUT

BO_ 573 IFC_FD2: 64 GW
 SG_ Checksum_IFC3 : 71|8@0+ (1,0) [0|255] ""  HUT
 SG_ LDWResp : 79|1@0+ (1,0) [0|1] ""  HUT
 SG_ LKAResp : 78|1@0+ (1,0) [0|1] ""  HUT
 SG_ LCKResp : 77|1@0+ (1,0) [0|1] ""  HUT
 SG_ AESResp : 75|1@0+ (1,0) [0|1] ""  HUT
 SG_ ELKResp : 76|1@0+ (1,0) [0|1] ""  HUT
 SG_ LDW_LKA_Snvty : 74|2@0+ (1,0) [0|3] ""  HUT
 SG_ IFCHUTInterface : 72|1@0+ (1,0) [0|1] ""  HUT
 SG_ LSSWarnFormResp : 85|2@0+ (1,0) [0|3] ""  HUT
 SG_ LSSResp : 83|1@0+ (1,0) [0|1] ""  HUT
 SG_ IntelligentEvaResp : 82|1@0+ (1,0) [0|1] ""  HUT
 SG_ ESS_Pedresp : 87|1@0+ (1,0) [0|1] ""  HUT
 SG_ ESS_Vehresp : 86|1@0+ (1,0) [0|1] ""  HUT
 SG_ AESSts : 81|2@0+ (1,0) [0|3] ""  HUT
 SG_ ESSSts : 95|2@0+ (1,0) [0|3] ""  HUT
 SG_ AESErrSts : 93|1@0+ (1,0) [0|1] ""  HUT
 SG_ ESSErrSts : 92|1@0+ (1,0) [0|1] ""  HUT
 SG_ RollingCounter_IFC3 : 123|4@0+ (1,0) [0|15] ""  HUT
 SG_ Checksum_IFC4 : 135|8@0+ (1,0) [0|255] ""  HUT
 SG_ IFCCalibrationSts : 154|2@0+ (1,0) [0|3] ""  HUT
 SG_ CameraBlockageSts : 152|1@0+ (1,0) [0|1] ""  HUT
 SG_ LDW_LKAWarn : 143|2@0+ (1,0) [0|3] ""  HUT
 SG_ LSSIntervention : 141|3@0+ (1,0) [0|7] ""  HUT
 SG_ LSSFuncSts : 138|3@0+ (1,0) [0|7] ""  HUT
 SG_ ELKMainState : 151|3@0+ (1,0) [0|7] ""  HUT
 SG_ LaneAvailability : 148|2@0+ (1,0) [0|3] ""  HUT
 SG_ TJA_FollowSts : 146|2@0+ (1,0) [0|3] ""  HUT
 SG_ LSSErrSts : 144|3@0+ (1,0) [0|7] ""  HUT
 SG_ IFC_Handsoffwarn : 157|3@0+ (1,0) [0|7] ""  HUT
 SG_ ELKActSts : 167|2@0+ (1,0) [0|3] ""  HUT
 SG_ IntelligentEvaActSts : 165|2@0+ (1,0) [0|3] ""  HUT
 SG_ LCKStsIndcr : 163|2@0+ (1,0) [0|3] ""  HUT
 SG_ AESintervention : 191|2@0+ (1,0) [0|3] ""  HUT
 SG_ ESSintervention : 189|2@0+ (1,0) [0|3] ""  HUT
 SG_ RollingCounter_IFC4 : 187|4@0+ (1,0) [0|15] ""  HUT
 SG_ Checksum_IFC5 : 199|8@0+ (1,0) [0|255] ""  HUT
 SG_ IFC_LaneCurve : 207|12@0+ (1.5E-005,-0.030705) [-0.030705|0.030705] ""  HUT
 SG_ IFC_LeLaneTyp : 211|3@0+ (1,0) [0|7] ""  HUT
 SG_ IFC_RiLaneTyp : 208|3@0+ (1,0) [0|7] ""  HUT
 SG_ IFC_NextLeLaneTyp : 221|3@0+ (1,0) [0|7] ""  HUT
 SG_ IFC_NextRiLaneTyp : 218|3@0+ (1,0) [0|7] ""  HUT
 SG_ IFC_LeLane_dy : 231|12@0+ (0.00390625,-8) [-8|7.9921875] ""  HUT
 SG_ IFC_RiLane_dy : 235|12@0+ (0.00390625,-8) [-8|7.9921875] ""  HUT
 SG_ RollingCounter_IFC5 : 251|4@0+ (1,0) [0|15] ""  HUT
 SG_ Checksum_IFC6 : 263|8@0+ (1,0) [0|255] ""  HUT
 SG_ IFC_NextLeLane_dy : 271|12@0+ (0.00390625,-8) [-8|7.9921875] ""  HUT
 SG_ IFC_NextRiLane_dy : 275|12@0+ (0.00390625,-8) [-8|7.9921875] ""  HUT
 SG_ RollingCounter_IFC6 : 315|4@0+ (1,0) [0|15] ""  HUT
 SG_ FreshnessValue_IFC_FD2 : 455|16@0+ (1,0) [0|65535] ""  HUT
 SG_ MAC_Check_IFC_FD2 : 471|48@0+ (1,0) [0|281474976710655] ""  HUT
 SG_ dummy_IFC_FD2_8 : 91|4@0+ (1,0) [0|15] ""  HUT
 SG_ dummy_IFC_FD2_9 : 103|8@0+ (1,0) [0|255] ""  HUT
 SG_ dummy_IFC_FD2_10 : 111|8@0+ (1,0) [0|255] ""  HUT
 SG_ dummy_IFC_FD2_11 : 119|8@0+ (1,0) [0|255] ""  HUT
 SG_ dummy_IFC_FD2_12 : 127|4@0+ (1,0) [0|15] ""  HUT
 SG_ dummy_IFC_FD2_13 : 161|2@0+ (1,0) [0|3] ""  HUT
 SG_ dummy_IFC_FD2_14 : 175|8@0+ (1,0) [0|255] ""  HUT
 SG_ dummy_IFC_FD2_15 : 183|8@0+ (1,0) [0|255] ""  HUT
 SG_ dummy_IFC_FD2_16 : 255|4@0+ (1,0) [0|15] ""  HUT
 SG_ dummy_IFC_FD2_17 : 295|8@0+ (1,0) [0|255] ""  HUT
 SG_ dummy_IFC_FD2_18 : 303|8@0+ (1,0) [0|255] ""  HUT
 SG_ dummy_IFC_FD2_19 : 311|8@0+ (1,0) [0|255] ""  HUT
 SG_ dummy_IFC_FD2_20 : 319|4@0+ (1,0) [0|15] ""  HUT
 SG_ IFC_FD2_0x23D : 7|512@0+ (1,0) [0|0] ""  HUT

BO_ 719 IFC_FD3: 64 GW
 SG_ TSRResp : 79|1@0+ (1,0) [0|1] ""  HUT
 SG_ TSRSpdLimUnit : 78|2@0+ (1,0) [0|3] ""  HUT
 SG_ TSRSpdLim : 87|6@0+ (1,0) [0|63] ""  HUT
 SG_ TSRSpdLimCfdc : 76|2@0+ (1,0) [0|3] ""  HUT
 SG_ TSRSts : 74|3@0+ (1,0) [0|7] ""  HUT
 SG_ TSRSpdLimSts : 81|2@0+ (1,0) [0|3] ""  HUT
 SG_ TSRTrfcSignValCfdc : 95|2@0+ (1,0) [0|3] ""  HUT
 SG_ TSRTrfcSignVal : 93|8@0+ (1,0) [0|255] ""  HUT
 SG_ TSRSpdLimWarn : 101|1@0+ (1,0) [0|1] ""  HUT
 SG_ TSRWarnResp : 108|1@0+ (1,0) [0|1] ""  HUT
 SG_ TSR_Snvty : 100|5@0+ (1,-15) [-15|15] "kmh"  HUT
 SG_ IFC_FD3_0x2CF : 7|512@0+ (1,0) [0|0] ""  HUT

BO_ 683 ACC_FD2: 64 GW
 SG_ ACC_LeTgt_02_Dy : 15|7@0+ (0.1,-8) [-8|0] "m"  HUT
 SG_ ACC_LeTgt_02_Dx : 8|9@0+ (0.5,0) [0|150] "m"  HUT
 SG_ ACC_LeTgt_02_Typ : 31|3@0+ (1,0) [0|7] ""  HUT
 SG_ ACC_LeTargrt_02_Detn : 28|2@0+ (1,0) [0|3] ""  HUT
 SG_ ACC_RiTargrt_02_Detn : 26|2@0+ (1,0) [0|3] ""  HUT
 SG_ ACC_RiTgt_02_Dy : 55|7@0+ (0.1,0) [0|8] "m"  HUT
 SG_ ACC_RiTgt_02_Dx : 24|9@0+ (0.5,0) [0|150] "m"  HUT
 SG_ ACC_RiTgt_02_Typ : 63|3@0+ (1,0) [0|7] ""  HUT
 SG_ ACC_LeTgtObjBarDisp : 47|3@0+ (1,0) [0|7] ""  HUT
 SG_ ACC_RiTgtObjBarDisp : 44|3@0+ (1,0) [0|7] ""  HUT
 SG_ Checksum_ACC3 : 71|8@0+ (1,0) [0|255] ""  HUT
 SG_ ISL_Resp : 79|1@0+ (1,0) [0|1] ""  HUT
 SG_ ICA_HandsOffResp : 78|1@0+ (1,0) [0|1] ""  HUT
 SG_ Longctrl_VehHldReq_DVR : 87|1@0+ (1,0) [0|1] ""  HUT
 SG_ Longctrl_DrvOFF_Req_DVR : 86|1@0+ (1,0) [0|1] ""  HUT
 SG_ Longctrl_ModSts_DVR : 85|4@0+ (1,0) [0|15] ""  HUT
 SG_ Longctrl_Decel_Req_DVR : 81|1@0+ (1,0) [0|1] ""  HUT
 SG_ Longctrl_EngTrqReq_DVR : 95|16@0+ (0.0030518,-100) [-100|99.999713] "%"  HUT
 SG_ Longctrl_EngTrqReqActive_DVR : 80|1@0+ (1,0) [0|1] ""  HUT
 SG_ Longctrl_DecelToStopReq_DVR : 119|1@0+ (1,0) [0|1] ""  HUT
 SG_ Longctrl_ParkShiftReq_DVR : 118|2@0+ (1,0) [0|3] ""  HUT
 SG_ Longctrl_Decel_ReqValue_DVR : 111|8@0+ (0.05,-7) [-7|5.75] "ms^2"  HUT
 SG_ Longctrl_HCUTrqReqActive_DVR : 116|1@0+ (1,0) [0|1] ""  HUT
 SG_ HWA_SnvtySet_Resp : 76|2@0+ (1,0) [0|3] ""  HUT
 SG_ HWA_Resp : 77|1@0+ (1,0) [0|1] ""  HUT
 SG_ ALC_Resp : 73|1@0+ (1,0) [0|1] ""  HUT
 SG_ ALC_InterSysInfoDisp : 127|2@0+ (1,0) [0|3] ""  HUT
 SG_ RollingCounter_ACC3 : 123|4@0+ (1,0) [0|15] ""  HUT
 SG_ Checksum_ACC4 : 135|8@0+ (1,0) [0|255] ""  HUT
 SG_ ACC_ObjDetecte : 143|1@0+ (1,0) [0|1] ""  HUT
 SG_ ACC_TakeOverReq : 142|1@0+ (1,0) [0|1] ""  HUT
 SG_ ACC_InterSysInfoDisp : 141|5@0+ (1,0) [0|31] ""  HUT
 SG_ ACC_ModDisp : 151|5@0+ (1,0) [0|31] ""  HUT
 SG_ ACC_FctSts : 146|2@0+ (1,0) [0|3] ""  HUT
 SG_ ACC_TgtObjBarDisp : 159|3@0+ (1,0) [0|7] ""  HUT
 SG_ ACC_TimeGapSet : 170|3@0+ (1,0) [0|7] ""  HUT
 SG_ ACC_SpdSetValue : 183|8@0+ (1,0) [0|255] "kphmph"  HUT
 SG_ Longctrl_HazActv : 156|2@0+ (1,0) [0|3] ""  HUT
 SG_ TJA_ACC_SelSts : 154|3@0+ (1,0) [0|7] ""  HUT
 SG_ ISL_InterSysInfoDisp : 172|2@0+ (1,0) [0|3] ""  HUT
 SG_ TJA_ICA_ModDisp : 175|3@0+ (1,0) [0|7] ""  HUT
 SG_ TJA_ICA_InterSysInfoDisp : 163|3@0+ (1,0) [0|7] ""  HUT
 SG_ CruCha_ModDisp : 167|4@0+ (1,0) [0|15] ""  HUT
 SG_ CruChar_InterSysInfoDisp : 191|4@0+ (1,0) [0|15] ""  HUT
 SG_ RollingCounter_ACC4 : 187|4@0+ (1,0) [0|15] ""  HUT
 SG_ Checksum_ACC8 : 199|8@0+ (1,0) [0|255] ""  HUT
 SG_ Longctrl_HCUTrqReq_DVR : 231|16@0+ (0.5,-16384) [-16384|16383.5] "NM"  HUT
 SG_ HWA_warning : 217|2@0+ (1,0) [0|3] ""  HUT
 SG_ HWA_ModDisp : 207|4@0+ (1,0) [0|15] ""  HUT
 SG_ HWA_InterSysInfoDisp : 203|4@0+ (1,0) [0|15] ""  HUT
 SG_ HWA_LaneChangeReq : 223|3@0+ (1,0) [0|7] ""  HUT
 SG_ HWA_LaneChange : 213|2@0+ (1,0) [0|3] ""  HUT
 SG_ ADAS_DriverInloop_Monitor : 211|3@0+ (1,7) [7|7] ""  HUT
 SG_ RollingCounter_ACC8 : 251|4@0+ (1,0) [0|15] ""  HUT
 SG_ Checksum_ACC6 : 263|8@0+ (1,0) [0|255] ""  HUT
 SG_ ACC_PotentialTgtDy : 271|8@0+ (0.1,-8) [-8|8] "m"  HUT
 SG_ ACC_PotentialTgtDx : 279|9@0+ (0.5,0) [0|150] "m"  HUT
 SG_ ACC_RlvTgtDetn : 286|2@0+ (1,0) [0|3] ""  HUT
 SG_ ACC_EgoStatus : 284|2@0+ (1,0) [0|3] ""  HUT
 SG_ ACC_RlvTgtDy : 295|8@0+ (0.1,-8) [-8|8] "m"  HUT
 SG_ ACC_RlvTgtDx : 303|9@0+ (0.5,0) [0|150] "m"  HUT
 SG_ ACC_PotentialTgtDetn : 309|2@0+ (1,0) [0|3] ""  HUT
 SG_ ACC_PotentialTgtTyp : 307|3@0+ (1,0) [0|7] ""  HUT
 SG_ ACC_RlvTgtTyp : 282|3@0+ (1,0) [0|7] ""  HUT
 SG_ RollingCounter_ACC6 : 315|4@0+ (1,0) [0|15] ""  HUT
 SG_ Checksum_ACC7 : 327|8@0+ (1,0) [0|255] ""  HUT
 SG_ ACC_LeTgtDy : 335|8@0+ (0.1,-8) [-8|8] "m"  HUT
 SG_ ACC_LeTgtDx : 343|9@0+ (0.5,0) [0|150] "m"  HUT
 SG_ ACC_LeTgtTyp : 350|3@0+ (1,0) [0|7] ""  HUT
 SG_ ACC_LeTargrtDection : 347|2@0+ (1,0) [0|3] ""  HUT
 SG_ ACC_RiTargrtDetn : 345|2@0+ (1,0) [0|3] ""  HUT
 SG_ ACC_RiTgtDy : 359|8@0+ (0.1,-8) [-8|8] "m"  HUT
 SG_ ACC_RiTgtDx : 367|9@0+ (0.5,0) [0|150] "m"  HUT
 SG_ ACC_RiTgtTyp : 374|3@0+ (1,0) [0|7] ""  HUT
 SG_ Request_driveoff : 383|3@0+ (1,0) [0|7] ""  HUT
 SG_ RollingCounter_ACC7 : 379|4@0+ (1,0) [0|15] ""  HUT
 SG_ ACC_RlvTgtfusion : 399|1@0+ (1,0) [0|1] ""  HUT
 SG_ ACC_RlvTgtHeading : 398|6@0+ (0.05,-1.5) [-1.5|1.5] "rad"  HUT
 SG_ ACC_LeTgtfusion : 392|1@0+ (1,0) [0|1] ""  HUT
 SG_ ACC_LeTgtHeading : 407|6@0+ (0.05,-1.5) [-1.5|1.5] "rad"  HUT
 SG_ ACC_RiTgtfusion : 401|1@0+ (1,0) [0|1] ""  HUT
 SG_ ACC_RiTgtHeading : 415|6@0+ (0.05,-1.5) [-1.5|1.5] "rad"  HUT
 SG_ ACC_PotentialTgtfusion : 400|1@0+ (1,0) [0|1] ""  HUT
 SG_ ACC_PotentialTgtHeading : 409|6@0+ (0.05,-1.5) [-1.5|1.5] "rad"  HUT
 SG_ TargetCutinPro : 419|6@0+ (0.02,0) [0|1] ""  HUT
 SG_ TargetCutoutPro : 429|6@0+ (0.02,0) [0|1] ""  HUT
 SG_ FreshnessValue_ACC_FD2 : 455|16@0+ (1,0) [0|65535] ""  HUT
 SG_ MAC_Check_ACC_FD2 : 471|48@0+ (1,0) [0|281474976710655] ""  HUT
 SG_ dummy_ACC_FD2_4 : 74|1@0+ (1,0) [0|1] ""  HUT
 SG_ dummy_ACC_FD2_5 : 72|1@0+ (1,0) [0|1] ""  HUT
 SG_ dummy_ACC_FD2_6 : 115|4@0+ (1,0) [0|15] ""  HUT
 SG_ dummy_ACC_FD2_7 : 125|2@0+ (1,0) [0|3] ""  HUT
 SG_ dummy_ACC_FD2_8 : 136|1@0+ (1,0) [0|1] ""  HUT
 SG_ dummy_ACC_FD2_9 : 144|1@0+ (1,0) [0|1] ""  HUT
 SG_ dummy_ACC_FD2_10 : 160|1@0+ (1,0) [0|1] ""  HUT
 SG_ dummy_ACC_FD2_11 : 215|2@0+ (1,0) [0|3] ""  HUT
 SG_ dummy_ACC_FD2_12 : 208|1@0+ (1,0) [0|1] ""  HUT
 SG_ dummy_ACC_FD2_13 : 220|3@0+ (1,0) [0|7] ""  HUT
 SG_ dummy_ACC_FD2_14 : 247|8@0+ (1,0) [0|255] ""  HUT
 SG_ dummy_ACC_FD2_15 : 255|4@0+ (1,0) [0|15] ""  HUT
 SG_ dummy_ACC_FD2_16 : 310|1@0+ (1,0) [0|1] ""  HUT
 SG_ dummy_ACC_FD2_17 : 304|1@0+ (1,0) [0|1] ""  HUT
 SG_ dummy_ACC_FD2_18 : 319|4@0+ (1,0) [0|15] ""  HUT
 SG_ dummy_ACC_FD2_19 : 371|4@0+ (1,0) [0|15] ""  HUT
 SG_ dummy_ACC_FD2_20 : 380|1@0+ (1,0) [0|1] ""  HUT
 SG_ ACC_FD2_0x2AB : 7|512@0+ (1,0) [0|0] ""  HUT

BO_ 696 ACC_FD4: 64 GW
 SG_ AEBObjID : 7|8@0+ (1,0) [0|255] ""  HUT
 SG_ AEBObjExist : 15|6@0+ (0.015625,0) [0|0.984375] "%"  HUT
 SG_ AEBObjVideoCfmd : 9|1@0+ (1,0) [0|1] ""  HUT
 SG_ AEBObjVx : 23|12@0+ (0.0625,-128) [-128|127] "ms"  HUT
 SG_ AEBObjDx : 27|12@0+ (0.0625,0) [0|255.9375] "m"  HUT
 SG_ AEBObjCntAlive : 47|12@0+ (1,0) [0|3855] ""  HUT
 SG_ AEBObjDy : 50|11@0+ (0.125,-128) [-128|127.875] "m"  HUT
 SG_ AEBObjState : 71|3@0+ (1,0) [0|7] ""  HUT
 SG_ AEBObjObstcl : 68|5@0+ (0.03125,0) [0|0.96875] "%"  HUT
 SG_ AEBObjVy : 79|10@0+ (0.125,-64) [-64|63.875] "ms"  HUT
 SG_ CyclistObjExist : 85|6@0+ (0.015625,0) [0|0.984375] "%"  HUT
 SG_ AEBObjAx : 95|10@0+ (0.03125,-16) [-16|15.96875] "ms2"  HUT
 SG_ AEBObjAy : 101|10@0+ (0.03125,-16) [-16|15.96875] "ms2"  HUT
 SG_ CyclistObjDx : 107|12@0+ (0.0625,0) [0|255.9375] "m"  HUT
 SG_ CyclistObjID : 127|8@0+ (1,0) [0|255] ""  HUT
 SG_ CyclistObjObstcl : 135|5@0+ (0.03125,0) [0|0.96875] "%"  HUT
 SG_ CyclistObjDy : 130|11@0+ (0.125,-128) [-128|127.875] "m"  HUT
 SG_ CyclistObjVx : 151|12@0+ (0.0625,-128) [-128|127] "ms"  HUT
 SG_ CyclistObjCntAlive : 155|12@0+ (1,0) [0|3855] ""  HUT
 SG_ CyclistObjVy : 175|10@0+ (0.125,-64) [-64|63.875] "ms"  HUT
 SG_ CyclistObjState : 181|3@0+ (1,0) [0|7] ""  HUT
 SG_ CyclistObjVideoCfmd : 178|1@0+ (1,0) [0|1] ""  HUT
 SG_ CyclistObjAx : 177|10@0+ (0.03125,-16) [-16|15.96875] "ms2"  HUT
 SG_ CyclistObjAy : 199|10@0+ (0.03125,-16) [-16|15.96875] "ms2"  HUT
 SG_ PedObjExist : 205|6@0+ (0.015625,0) [0|0.984375] "%"  HUT
 SG_ PedObjID : 215|8@0+ (1,0) [0|255] ""  HUT
 SG_ PedObjObstcl : 223|5@0+ (0.03125,0) [0|0.96875] "%"  HUT
 SG_ PedObjDy : 218|11@0+ (0.125,-128) [-128|127.875] "m"  HUT
 SG_ PedObjDx : 239|12@0+ (0.0625,0) [0|255.9375] "m"  HUT
 SG_ PedObjVx : 243|12@0+ (0.0625,-128) [-128|127] "ms"  HUT
 SG_ PedObjVy : 263|10@0+ (0.125,-64) [-64|63.875] "ms"  HUT
 SG_ PedObjVideoCfmd : 269|1@0+ (1,0) [0|1] ""  HUT
 SG_ ACCTgtObjDx : 267|12@0+ (0.0625,0) [0|255.9375] "m"  HUT
 SG_ PedObjAy : 287|10@0+ (0.03125,-16) [-16|15.96875] "ms2"  HUT
 SG_ PedObjCntAlive : 293|12@0+ (1,0) [0|3855] ""  HUT
 SG_ PedObjAx : 297|10@0+ (0.03125,-16) [-16|15.96875] "ms2"  HUT
 SG_ ACCTgtObjID : 319|8@0+ (1,0) [0|255] ""  HUT
 SG_ ACCTgtObjObstcl : 327|5@0+ (0.03125,0) [0|0.96875] "%"  HUT
 SG_ ACCTgtObjDy : 322|11@0+ (0.125,-128) [-128|127.875] "m"  HUT
 SG_ ACCTgtObjExist : 343|6@0+ (0.015625,0) [0|0.984375] "%"  HUT
 SG_ ACCTgtObjVy : 337|10@0+ (0.125,-64) [-64|63.875] "ms"  HUT
 SG_ ACCTgtObjVx : 359|12@0+ (0.0625,-128) [-128|127] "ms"  HUT
 SG_ ACCTgtObjAx : 363|10@0+ (0.03125,-16) [-16|15.96875] "ms2"  HUT
 SG_ ACCTgtObjAy : 369|10@0+ (0.03125,-16) [-16|15.96875] "ms2"  HUT
 SG_ ACCTgtObjState : 391|3@0+ (1,0) [0|7] ""  HUT
 SG_ ACCTgtObjVideoCfmd : 388|1@0+ (1,0) [0|1] ""  HUT
 SG_ ACCTgtObjCntAlive : 387|12@0+ (1,0) [0|3855] ""  HUT
 SG_ RadarHorMisalign : 407|12@0+ (0.0001,-0.2048) [-0.2048|0.2047] "rad"  HUT
 SG_ HandsoffDetd : 411|2@0+ (1,0) [0|3] ""  HUT
 SG_ DrvgOnHiWay : 409|2@0+ (1,0) [0|3] ""  HUT
 SG_ RoadCrvt : 423|10@0+ (0.00032,-0.16352) [-0.16352|0.16352] ""  HUT
 SG_ SpdLimitDst : 429|6@0+ (10,0) [0|600] "m"  HUT
 SG_ RoadCrvtFar : 439|10@0+ (0.00032,-0.16352) [-0.16352|0.16352] ""  HUT
 SG_ RampDst : 445|6@0+ (10,0) [0|600] "m"  HUT
 SG_ SpdLimit : 455|8@0+ (1,0) [0|255] ""  HUT
 SG_ CurveDst : 463|6@0+ (10,0) [0|600] "m"  HUT
 SG_ NavSpdLimUnit : 457|2@0+ (1,0) [0|3] ""  HUT
 SG_ TunnelDst : 471|6@0+ (10,0) [0|600] "m"  HUT
 SG_ DrvgOnRiLane : 465|2@0+ (1,0) [0|3] ""  HUT
 SG_ BrdgDst : 479|6@0+ (10,0) [0|600] "m"  HUT
 SG_ RadarDrvrAttentive : 473|1@0+ (1,0) [0|1] ""  HUT
 SG_ ACC_DataRecReq : 487|3@0+ (1,0) [0|7] ""  HUT,DVR
 SG_ ACC_SOSReq : 484|2@0+ (1,0) [0|3] ""  HUT,T_Box
 SG_ PedObjState : 482|3@0+ (1,0) [0|7] ""  HUT
 SG_ MapDataValid : 495|1@0+ (1,0) [0|1] ""  HUT
 SG_ DrvrSts : 494|3@0+ (1,0) [0|7] ""  HUT
 SG_ AEBObjOverlap : 491|5@0+ (1,0) [0|31] ""  HUT
 SG_ AEBObjDrvby : 502|5@0+ (1,0) [0|31] ""  HUT
 SG_ ACC_FD4_0x2B8 : 7|512@0+ (1,0) [0|0] ""  HUT

BO_ 395 AEB_FD1: 64 GW
 SG_ AEB_ABA_Level : 79|2@0+ (1,0) [0|3] ""  HUT
 SG_ AEB_ABA_Req : 77|1@0+ (1,0) [0|1] ""  HUT
 SG_ EBA_TgtDecel_Req : 76|1@0+ (1,0) [0|1] ""  HUT
 SG_ AEB_VehHldReq : 75|1@0+ (1,0) [0|1] ""  HUT
 SG_ AEB_TgtDecel_Req : 74|1@0+ (1,0) [0|1] ""  HUT
 SG_ AEB_TgtDecel_ReqValue : 87|16@0+ (0.000488,-16) [-16|16] "ms2"  HUT
 SG_ AEB_AWB_Req : 73|1@0+ (1,0) [0|1] ""  HUT
 SG_ AEB_AWB_Level : 103|4@0+ (1,0) [0|15] ""  HUT
 SG_ AEB_ABP_Req : 72|1@0+ (1,0) [0|1] ""  HUT
 SG_ AEB_BrkReqFunc : 99|3@0+ (1,0) [0|7] ""  HUT
 SG_ AEB_ObjSty : 111|3@0+ (1,0) [0|7] ""  HUT
 SG_ AEB_FD1_0x18B : 7|512@0+ (1,0) [0|0] ""  HUT

BO_ 551 AEB_FD2: 64 GW
 SG_ Checksum_AEB2 : 71|8@0+ (1,0) [0|255] ""  HUT
 SG_ AEB_PedResp : 79|1@0+ (1,0) [0|1] ""  HUT
 SG_ AEB_VehResp : 78|1@0+ (1,0) [0|1] ""  HUT
 SG_ FCW_Snvty : 77|2@0+ (1,0) [0|3] ""  HUT
 SG_ AEB_JA_Resp : 75|1@0+ (1,0) [0|1] ""  HUT
 SG_ RollingCounter_AEB2 : 123|4@0+ (1,0) [0|15] ""  HUT
 SG_ Checksum_AEB3 : 135|8@0+ (1,0) [0|255] ""  HUT
 SG_ AEB_VehTrig : 143|1@0+ (1,0) [0|1] ""  HUT
 SG_ AEB_PedTrig : 142|1@0+ (1,0) [0|1] ""  HUT
 SG_ FCW_AEB_VehFctSts : 138|2@0+ (1,0) [0|3] ""  HUT
 SG_ FCW_AEB_PedFctSts : 151|2@0+ (1,0) [0|3] ""  HUT
 SG_ FCW_Warn : 149|2@0+ (1,0) [0|3] ""  HUT
 SG_ AEB_JAFuncSts : 147|2@0+ (1,0) [0|3] ""  HUT
 SG_ AEB_JA_Warn : 145|2@0+ (1,0) [0|3] ""  HUT
 SG_ AEB_JABrkTrig : 159|2@0+ (1,0) [0|3] ""  HUT
 SG_ RollingCounter_AEB3 : 187|4@0+ (1,0) [0|15] ""  HUT
 SG_ FreshnessValue_AEB_FD2 : 455|16@0+ (1,0) [0|65535] ""  HUT
 SG_ MAC_Check_AEB_FD2 : 471|48@0+ (1,0) [0|281474976710655] ""  HUT
 SG_ dummy_AEB_FD2_8 : 74|3@0+ (1,0) [0|7] ""  HUT
 SG_ dummy_AEB_FD2_9 : 87|8@0+ (1,0) [0|255] ""  HUT
 SG_ dummy_AEB_FD2_10 : 95|8@0+ (1,0) [0|255] ""  HUT
 SG_ dummy_AEB_FD2_11 : 103|8@0+ (1,0) [0|255] ""  HUT
 SG_ dummy_AEB_FD2_12 : 111|8@0+ (1,0) [0|255] ""  HUT
 SG_ dummy_AEB_FD2_13 : 119|8@0+ (1,0) [0|255] ""  HUT
 SG_ dummy_AEB_FD2_14 : 127|4@0+ (1,0) [0|15] ""  HUT
 SG_ dummy_AEB_FD2_15 : 141|3@0+ (1,0) [0|7] ""  HUT
 SG_ dummy_AEB_FD2_16 : 136|1@0+ (1,0) [0|1] ""  HUT
 SG_ dummy_AEB_FD2_17 : 157|6@0+ (1,0) [0|63] ""  HUT
 SG_ dummy_AEB_FD2_18 : 167|8@0+ (1,0) [0|255] ""  HUT
 SG_ dummy_AEB_FD2_19 : 175|8@0+ (1,0) [0|255] ""  HUT
 SG_ dummy_AEB_FD2_20 : 183|8@0+ (1,0) [0|255] ""  HUT
 SG_ dummy_AEB_FD2_21 : 191|4@0+ (1,0) [0|15] ""  HUT
 SG_ AEB_FD2_0x227 : 7|512@0+ (1,0) [0|0] ""  HUT

BO_ 273 ECM1: 8 GW
 SG_ EMS_AuthenResult : 25|2@0+ (1,0) [0|3] ""  HUT
 SG_ EngSpd : 47|16@0+ (0.125,0) [0|8191.875] "rpm"  HUT,T_Box,DMS,DVR
 SG_ EngSpdVldty : 63|2@0+ (1,0) [0|2] ""  HUT,T_Box,DMS,DVR
 SG_ BrkPedalSts : 19|2@0+ (1,0) [0|3] ""  HUT
 SG_ ECM1_0x111 : 7|64@0+ (1,0) [0|0] ""  HUT

BO_ 258 ECM9: 8 GW
 SG_ AccelPedlPosnDiagc : 39|8@0+ (0.3937,0) [0|100.3935] "%"  HUT
 SG_ AccPedalOverride : 15|1@0+ (1,0) [0|1] ""  HUT
 SG_ ECMRespACC : 55|1@0+ (1,0) [0|1] ""  HUT
 SG_ ECMACCInterface : 54|1@0+ (1,0) [0|1] ""  HUT
 SG_ ECM9_0x102 : 7|64@0+ (1,0) [0|0] ""  HUT

BO_ 313 ECM10: 8 GW
 SG_ Tgtgear_Up : 11|1@0+ (1,0) [0|1] ""  HUT
 SG_ Tgtgear_Down : 10|1@0+ (1,0) [0|1] ""  HUT
 SG_ NeutralSts : 13|2@0+ (1,0) [0|3] ""  T_Box
 SG_ ECM10_0x139 : 7|64@0+ (1,0) [0|0] ""  HUT

BO_ 723 ECM11: 8 GW
 SG_ EngSpd_ForIP : 47|16@0+ (0.125,0) [0|8191.875] "rpm"  HUT
 SG_ EWP_Err : 32|1@0+ (1,0) [0|1] ""  HUT
 SG_ ECM11_0x2D3 : 7|64@0+ (1,0) [0|0] ""  HUT

BO_ 625 ECM2: 8 GW
 SG_ FuelConsumption : 15|16@0+ (2,0) [0|131070] "Î¼l"  HUT
 SG_ TgtCrsVehSpd : 47|8@0+ (1,0) [0|255] "kphmph"  HUT
 SG_ CruiseCtrlSts : 55|2@0+ (1,0) [0|2] ""  HUT
 SG_ AccelPedalPosnVldty : 50|2@0+ (1,0) [0|2] ""  HUT
 SG_ EngSVSSig : 48|1@0+ (1,0) [0|1] ""  HUT
 SG_ MILSts : 63|1@0+ (1,0) [0|1] ""  HUT
 SG_ EngState : 62|2@0+ (1,0) [0|3] ""  HUT,T_Box
 SG_ AccelPedalPosn : 31|8@0+ (0.3937,0) [0|100.3935] "%"  HUT
 SG_ ECM2_0x271 : 7|64@0+ (1,0) [0|0] ""  HUT

BO_ 881 ECM3: 8 GW
 SG_ EngCoolantTemp : 31|8@0+ (0.75,-48) [-48|143.25] "Deg C"  HUT,T_Box
 SG_ GPF_Warning : 47|2@0+ (1,0) [0|3] ""  HUT
 SG_ GentrWarnLmpSts : 45|1@0+ (1,0) [0|1] ""  HUT
 SG_ EngClntTempWarn : 40|1@0+ (1,0) [0|1] ""  HUT,T_Box
 SG_ EngClntTempVldty : 55|2@0+ (1,0) [0|2] ""  HUT,T_Box
 SG_ SS_Screen_tip : 61|1@0+ (1,0) [0|1] ""  HUT
 SG_ SSSSetSts : 44|1@0+ (1,0) [0|1] ""  HUT
 SG_ SS_Enable_Lamp : 43|1@0+ (1,0) [0|1] ""  HUT
 SG_ SS_Fault_Lamp : 42|1@0+ (1,0) [0|1] ""  HUT
 SG_ BaroPressure : 15|8@0+ (0.59,0) [0|149.86] "kPa"  HUT
 SG_ ECM3_0x371 : 7|64@0+ (1,0) [0|0] ""  HUT

BO_ 130 ECM4: 8 GW
 SG_ NetEngTrq : 15|16@0+ (0.0030518,-100) [-100|99.9966612] "%"  HUT
 SG_ DrvEngTrqReq : 31|16@0+ (0.0030518,-100) [-100|99.999713] "%"  HUT
 SG_ DrvEngTrqReqVld : 63|1@0+ (1,0) [0|1] ""  HUT
 SG_ ECM4_0x82 : 7|64@0+ (1,0) [0|0] ""  HUT

BO_ 132 ECM7: 8 GW
 SG_ EngTrqEstimdActGear : 31|16@0+ (0.0030518,-100) [-100|99.999713] "%"  HUT
 SG_ EngTrqEstimdActGear_Qf : 62|1@0+ (1,0) [0|1] ""  HUT
 SG_ ECM7_0x84 : 7|64@0+ (1,0) [0|0] ""  HUT

BO_ 134 ECM8: 8 GW
 SG_ TrqLoss : 47|16@0+ (0.0030518,-100) [-100|99.999713] "%"  HUT
 SG_ ECM8_0x86 : 7|64@0+ (1,0) [0|0] ""  HUT

BO_ 949 ECM19: 8 GW
 SG_ ECM_VIN : 7|64@0+ (1,0) [0|1.84467440737096E+019] ""  HUT
 SG_ ECM19_0x3B5 : 7|64@0+ (1,0) [0|0] ""  HUT

BO_ 951 ECM20: 8 GW
 SG_ ECM_VehDstBackup : 7|24@0+ (0.1,0) [0|999999.9] "Km"  HUT
 SG_ EngRoStrt_Failure : 47|11@0+ (1,0) [0|2047] ""  T_Box
 SG_ ECM20_0x3B7 : 7|64@0+ (1,0) [0|0] ""  HUT

BO_ 166 DCT3: 8 GW
 SG_ TgtEngSpdIP : 47|12@0+ (2,0) [0|8190] "RPM"  HUT
 SG_ TgtEngSpdIPValid : 50|1@0+ (1,0) [0|1] ""  HUT
 SG_ TrsmTqIdle : 31|16@0+ (0.0030518,-100) [-100|99.9966612] "%"  HUT
 SG_ DCT3_0xA6 : 7|64@0+ (1,0) [0|0] ""  HUT

BO_ 545 DCT5: 8 GW
 SG_ CurrentGearValid : 18|1@0+ (1,0) [0|1] ""  HUT,DMS
 SG_ CURRENT_GEAR : 55|4@0+ (1,0) [0|15] ""  HUT,T_Box,DMS
 SG_ TGS_LEVER : 51|4@0+ (1,0) [0|15] ""  HUT,T_Box
 SG_ SHIFT_IN_PROGRESS : 17|1@0+ (1,0) [0|1] ""  HUT
 SG_ ShiftInPrgValid : 31|1@0+ (1,0) [0|1] ""  HUT
 SG_ TargetGearValid : 16|1@0+ (1,0) [0|1] ""  HUT
 SG_ TARGET_GEAR : 27|4@0+ (1,0) [0|15] ""  HUT
 SG_ DCT5_0x221 : 7|64@0+ (1,0) [0|0] ""  HUT

BO_ 565 DCT7: 16 GW
 SG_ CheckSum_DCT7 : 7|8@0+ (1,0) [0|255] ""  HUT
 SG_ DCT_RaceModeSts : 10|3@0+ (1,0) [0|7] ""  HUT
 SG_ DCT_PrsBrk_Warn : 31|2@0+ (1,0) [0|3] ""  HUT
 SG_ DCT_ShftNotAlwd_Warn : 29|2@0+ (1,0) [0|3] ""  HUT
 SG_ DCT_ShftRecom_M : 27|2@0+ (1,0) [0|3] ""  HUT
 SG_ DrvWarnMsg : 39|3@0+ (1,0) [0|7] ""  HUT
 SG_ DrvFaiMsg_0x235 : 36|4@0+ (1,0) [0|15] ""  HUT
 SG_ DrvModDisp_0x235 : 47|3@0+ (1,0) [0|7] ""  HUT
 SG_ DrvModDispSts_0x235 : 44|2@0+ (1,0) [0|3] ""  HUT
 SG_ DrvAutoGearDisp : 63|4@0+ (1,0) [0|15] ""  HUT
 SG_ DrvGearDispSts_0x235 : 55|2@0+ (1,0) [0|3] ""  HUT
 SG_ RollingCounter_DCT7 : 59|4@0+ (1,0) [0|15] ""  HUT
 SG_ FreshnessValue_DCT7 : 71|16@0+ (1,0) [0|65535] ""  HUT
 SG_ MAC_Check_DCT7 : 87|48@0+ (1,0) [0|281474976710655] ""  HUT
 SG_ dummy_DCT7_0 : 15|5@0+ (1,0) [0|31] ""  HUT
 SG_ dummy_DCT7_1 : 23|8@0+ (1,0) [0|255] ""  HUT
 SG_ dummy_DCT7_2 : 25|2@0+ (1,0) [0|3] ""  HUT
 SG_ dummy_DCT7_3 : 32|1@0+ (1,0) [0|1] ""  HUT
 SG_ dummy_DCT7_4 : 42|3@0+ (1,0) [0|7] ""  HUT
 SG_ dummy_DCT7_5 : 53|6@0+ (1,0) [0|63] ""  HUT
 SG_ DCT7_0x235 : 7|128@0+ (1,0) [0|0] ""  HUT

BO_ 561 ABS1: 8 GW
 SG_ FLWheelDriveDirection : 15|2@0+ (1,0) [0|3] ""  HUT
 SG_ FLWheelSpdVld : 13|1@0+ (1,0) [0|1] ""  HUT
 SG_ FLWheelSpd : 12|13@0+ (0.05625,0) [0|299.98125] "kmh"  HUT
 SG_ FRWheelDriveDirection : 31|2@0+ (1,0) [0|3] ""  HUT
 SG_ FRWheelSpdVld : 29|1@0+ (1,0) [0|1] ""  HUT
 SG_ FRWheelSpd : 28|13@0+ (0.05625,0) [0|299.98125] "kmh"  HUT
 SG_ ABS1_0x231 : 7|64@0+ (1,0) [0|0] ""  HUT

BO_ 582 ABS2: 8 GW
 SG_ RLWheelDriveDirection : 15|2@0+ (1,0) [0|3] ""  HUT
 SG_ RLWheelSpdVld : 13|1@0+ (1,0) [0|1] ""  HUT
 SG_ RLWheelSpd : 12|13@0+ (0.05625,0) [0|299.98125] "kmh"  HUT
 SG_ RRWheelDriveDirection : 31|2@0+ (1,0) [0|3] ""  HUT
 SG_ RRWheelSpdVld : 29|1@0+ (1,0) [0|1] ""  HUT
 SG_ RRWheelSpd : 28|13@0+ (0.05625,0) [0|299.98125] "kmh"  HUT
 SG_ ABS2_0x246 : 7|64@0+ (1,0) [0|0] ""  HUT

BO_ 613 ABS3: 16 GW
 SG_ CheckSum_ABS3_0x265 : 7|8@0+ (1,0) [0|255] ""  HUT
 SG_ ABSFailSts_0x265 : 15|1@0+ (1,0) [0|1] ""  HUT
 SG_ EBDFailSts_0x265 : 14|1@0+ (1,0) [0|1] ""  HUT
 SG_ VehSpdVld_0x265 : 13|1@0+ (1,0) [0|1] ""  HUT,T_Box,DMS,DVR
 SG_ VehSpd_0x265 : 12|13@0+ (0.05625,0) [0|299.98125] "kph"  HUT,T_Box,DMS,DVR
 SG_ VehOdoInfoSts_0x265 : 26|1@0+ (1,0) [0|1] ""  HUT,T_Box
 SG_ VehOdoInfo_0x265 : 25|10@0+ (1,0) [0|999] "m"  HUT
 SG_ ABSActv_0x265 : 27|1@0+ (1,0) [0|1] ""  HUT,DVR
 SG_ EBDActv_0x265 : 31|1@0+ (1,0) [0|1] ""  HUT
 SG_ RollingCounter_ABS3_0x265 : 59|4@0+ (1,0) [0|15] ""  HUT
 SG_ dummy_ABS3_0 : 30|3@0+ (1,0) [0|7] ""  HUT
 SG_ dummy_ABS3_1 : 47|8@0+ (1,0) [0|255] ""  HUT
 SG_ dummy_ABS3_2 : 55|8@0+ (1,0) [0|255] ""  HUT
 SG_ dummy_ABS3_3 : 63|4@0+ (1,0) [0|15] ""  HUT
 SG_ ABS3_0x265 : 7|128@0+ (1,0) [0|0] ""  HUT

BO_ 363 EPB1: 8 GW
 SG_ CheckSum_EPB1 : 7|8@0+ (1,0) [0|255] ""  HUT
 SG_ PressBrakePedalPointOut : 17|1@0+ (1,0) [0|1] ""  HUT
 SG_ EPBErrSts : 27|2@0+ (1,0) [0|3] ""  HUT
 SG_ EPBSts : 29|2@0+ (1,0) [0|3] ""  HUT
 SG_ EPBTextDisp : 39|4@0+ (1,0) [0|15] ""  HUT
 SG_ EPBRedLmpSts : 25|2@0+ (1,0) [0|3] ""  HUT
 SG_ RollingCounter_EPB1 : 59|4@0+ (1,0) [0|15] ""  HUT
 SG_ dummy_EPB1_0 : 15|8@0+ (1,0) [0|255] ""  HUT
 SG_ dummy_EPB1_1 : 23|6@0+ (1,0) [0|63] ""  HUT
 SG_ dummy_EPB1_2 : 16|1@0+ (1,0) [0|1] ""  HUT
 SG_ dummy_EPB1_3 : 31|2@0+ (1,0) [0|3] ""  HUT
 SG_ dummy_EPB1_4 : 35|4@0+ (1,0) [0|15] ""  HUT
 SG_ dummy_EPB1_5 : 47|8@0+ (1,0) [0|255] ""  HUT
 SG_ dummy_EPB1_6 : 55|8@0+ (1,0) [0|255] ""  HUT
 SG_ dummy_EPB1_7 : 63|4@0+ (1,0) [0|15] ""  HUT
 SG_ EPB1_0x16B : 7|64@0+ (1,0) [0|0] ""  HUT

BO_ 329 ESP1: 16 GW
 SG_ CheckSum_ESP1_0x149 : 7|8@0+ (1,0) [0|255] ""  HUT
 SG_ ESPFuncOffSts_0x149 : 12|1@0+ (1,0) [0|1] ""  HUT
 SG_ ESPActvInfoLmp_0x149 : 13|1@0+ (1,0) [0|1] ""  HUT
 SG_ ESPBrkLmpCtrl_0x149 : 14|1@0+ (1,0) [0|1] ""  HUT
 SG_ ESPFailSts_0x149 : 15|1@0+ (1,0) [0|1] ""  HUT
 SG_ ESP_MasterCylBrkPressVld_0x149 : 16|1@0+ (1,0) [0|1] ""  HUT
 SG_ MSRActv_0x149 : 21|1@0+ (1,0) [0|1] ""  HUT
 SG_ VDCActv_0x149 : 20|1@0+ (1,0) [0|1] ""  HUT
 SG_ PTCActv_0x149 : 22|1@0+ (1,0) [0|1] ""  HUT
 SG_ BTCActv_0x149 : 23|1@0+ (1,0) [0|1] ""  HUT
 SG_ ESP_MasterCylBrkPress_0x149 : 31|16@0+ (0.03125,-42.5) [-42.5|425] "bar"  HUT
 SG_ RollingCounter_ESP1_0x149 : 59|4@0+ (1,0) [0|15] ""  HUT
 SG_ FreshnessValue_ESP1 : 71|16@0+ (1,0) [0|65535] ""  HUT
 SG_ MAC_Check_ESP1 : 87|48@0+ (1,0) [0|281474976710655] ""  HUT
 SG_ dummy_ESP1_0 : 11|4@0+ (1,0) [0|15] ""  HUT
 SG_ dummy_ESP1_1 : 19|3@0+ (1,0) [0|7] ""  HUT
 SG_ dummy_ESP1_2 : 47|8@0+ (1,0) [0|255] ""  HUT
 SG_ dummy_ESP1_3 : 55|8@0+ (1,0) [0|255] ""  HUT
 SG_ dummy_ESP1_4 : 63|4@0+ (1,0) [0|15] ""  HUT
 SG_ ESP1_0x149 : 7|128@0+ (1,0) [0|0] ""  HUT

BO_ 325 ESP2: 16 GW
 SG_ CheckSum_ESP2_0x145 : 7|8@0+ (1,0) [0|255] ""  HUT
 SG_ BrkDskOvrheatd_0x145 : 11|1@0+ (1,0) [0|1] ""  HUT
 SG_ NoBrkForce_0x145 : 12|1@0+ (1,0) [0|1] ""  HUT
 SG_ VehStandstill_0x145 : 14|2@0+ (1,0) [0|3] ""  HUT
 SG_ AEBIBActv_0x145 : 17|1@0+ (1,0) [0|1] ""  HUT
 SG_ AEBBAActv_0x145 : 18|1@0+ (1,0) [0|1] ""  HUT
 SG_ AEBAvailable_0x145 : 19|1@0+ (1,0) [0|1] ""  HUT
 SG_ ABPAvailable_0x145 : 20|1@0+ (1,0) [0|1] ""  HUT
 SG_ ABPActv_0x145 : 21|1@0+ (1,0) [0|1] ""  HUT
 SG_ ABAavailable_0x145 : 22|1@0+ (1,0) [0|1] ""  HUT
 SG_ ABAActv_0x145 : 23|1@0+ (1,0) [0|1] ""  HUT
 SG_ CDDActv_0x145 : 28|1@0+ (1,0) [0|1] ""  HUT
 SG_ CDDAvailable_0x145 : 29|1@0+ (1,0) [0|1] ""  HUT
 SG_ AWBAvailable_0x145 : 30|1@0+ (1,0) [0|1] ""  HUT
 SG_ AWBActv_0x145 : 31|1@0+ (1,0) [0|1] ""  HUT
 SG_ HDCFault_0x145 : 25|2@0+ (1,0) [0|3] ""  HUT
 SG_ HDCCtrl_0x145 : 27|2@0+ (1,0) [0|2] ""  HUT
 SG_ AVHErrSts_0x145 : 35|2@0+ (1,0) [0|3] ""  HUT
 SG_ AVHSts_0x145 : 37|2@0+ (1,0) [0|2] ""  HUT
 SG_ CDPActv_0x145 : 39|1@0+ (1,0) [0|1] ""  HUT
 SG_ DrivingModDis : 55|5@0+ (1,0) [0|31] ""  HUT
 SG_ DrivingModReq_ESP : 32|5@0+ (1,0) [0|31] ""  HUT
 SG_ TAB_Available : 40|1@0+ (1,0) [0|1] ""  HUT
 SG_ TAB_Sts : 49|2@0+ (1,0) [0|3] ""  HUT
 SG_ RollingCounter_ESP2_0x145 : 59|4@0+ (1,0) [0|15] ""  HUT
 SG_ FreshnessValue_ESP2 : 71|16@0+ (1,0) [0|65535] ""  HUT
 SG_ MAC_Check_ESP2 : 87|48@0+ (1,0) [0|281474976710655] ""  HUT
 SG_ dummy_ESP2_0 : 15|1@0+ (1,0) [0|1] ""  HUT
 SG_ dummy_ESP2_1 : 10|3@0+ (1,0) [0|7] ""  HUT
 SG_ dummy_ESP2_2 : 16|1@0+ (1,0) [0|1] ""  HUT
 SG_ dummy_ESP2_3 : 38|1@0+ (1,0) [0|1] ""  HUT
 SG_ dummy_ESP2_4 : 33|1@0+ (1,0) [0|1] ""  HUT
 SG_ dummy_ESP2_5 : 43|3@0+ (1,0) [0|7] ""  HUT
 SG_ dummy_ESP2_6 : 50|1@0+ (1,0) [0|1] ""  HUT
 SG_ dummy_ESP2_7 : 63|4@0+ (1,0) [0|15] ""  HUT
 SG_ ESP2_0x145 : 7|128@0+ (1,0) [0|0] ""  HUT

BO_ 311 ESP_FD2: 64 GW
 SG_ CheckSum_ESP2_0x137 : 71|8@0+ (1,0) [0|255] ""  HUT
 SG_ BrkDskOvrheatd_0x137 : 75|1@0+ (1,0) [0|1] ""  HUT
 SG_ NoBrkForce_0x137 : 76|1@0+ (1,0) [0|1] ""  HUT
 SG_ VehStandstill_0x137 : 78|2@0+ (1,0) [0|3] ""  HUT
 SG_ AEBIBActv_0x137 : 81|1@0+ (1,0) [0|1] ""  HUT
 SG_ AEBBAActv_0x137 : 82|1@0+ (1,0) [0|1] ""  HUT
 SG_ AEBAvailable_0x137 : 83|1@0+ (1,0) [0|1] ""  HUT
 SG_ ABPAvailable_0x137 : 84|1@0+ (1,0) [0|1] ""  HUT
 SG_ ABPActv_0x137 : 85|1@0+ (1,0) [0|1] ""  HUT
 SG_ ABAavailable_0x137 : 86|1@0+ (1,0) [0|1] ""  HUT
 SG_ ABAActv_0x137 : 87|1@0+ (1,0) [0|1] ""  HUT
 SG_ HDCFault_0x137 : 89|2@0+ (1,0) [0|3] ""  HUT
 SG_ HDCCtrl_0x137 : 91|2@0+ (1,0) [0|2] ""  HUT
 SG_ CDDActv_0x137 : 92|1@0+ (1,0) [0|1] ""  HUT
 SG_ CDDAvailable_0x137 : 93|1@0+ (1,0) [0|1] ""  HUT
 SG_ AWBAvailable_0x137 : 94|1@0+ (1,0) [0|1] ""  HUT
 SG_ AWBActv_0x137 : 95|1@0+ (1,0) [0|1] ""  HUT
 SG_ AVHErrSts_0x137 : 99|2@0+ (1,0) [0|3] ""  HUT
 SG_ AVHSts_0x137 : 101|2@0+ (1,0) [0|2] ""  HUT
 SG_ CDPActv_0x137 : 103|1@0+ (1,0) [0|1] ""  HUT
 SG_ RollingCounter_ESP2_0x137 : 123|4@0+ (1,0) [0|15] ""  HUT
 SG_ CheckSum_ESP1_0x137 : 135|8@0+ (1,0) [0|255] ""  HUT
 SG_ ESPFuncOffSts_0x137 : 140|1@0+ (1,0) [0|1] ""  HUT
 SG_ ESPActvInfoLmp_0x137 : 141|1@0+ (1,0) [0|1] ""  HUT
 SG_ ESPBrkLmpCtrl_0x137 : 142|1@0+ (1,0) [0|1] ""  HUT
 SG_ ESPFailSts_0x137 : 143|1@0+ (1,0) [0|1] ""  HUT
 SG_ ESP_MasterCylBrkPressVld_0x137 : 144|1@0+ (1,0) [0|1] ""  HUT
 SG_ MSRActv_0x137 : 149|1@0+ (1,0) [0|1] ""  HUT
 SG_ VDCActv_0x137 : 148|1@0+ (1,0) [0|1] ""  HUT
 SG_ PTCActv_0x137 : 150|1@0+ (1,0) [0|1] ""  HUT
 SG_ BTCActv_0x137 : 151|1@0+ (1,0) [0|1] ""  HUT
 SG_ ESP_MasterCylBrkPress_0x137 : 159|16@0+ (0.03125,-42.5) [-42.5|425] "bar"  HUT
 SG_ RollingCounter_ESP1_0x137 : 187|4@0+ (1,0) [0|15] ""  HUT
 SG_ CheckSum_ABS3_0x137 : 327|8@0+ (1,0) [0|255] ""  HUT
 SG_ ABSFailSts_0x137 : 335|1@0+ (1,0) [0|1] ""  HUT
 SG_ EBDFailSts_0x137 : 334|1@0+ (1,0) [0|1] ""  HUT,T_Box
 SG_ VehSpdVld_0x137 : 333|1@0+ (1,0) [0|1] ""  HUT,T_Box,DMS,DVR
 SG_ VehSpd_0x137 : 332|13@0+ (0.05625,0) [0|299.98125] "kph"  HUT,T_Box,DMS,DVR
 SG_ EBDActv_0x137 : 351|1@0+ (1,0) [0|1] ""  HUT
 SG_ ABSActv_0x137 : 347|1@0+ (1,0) [0|1] ""  HUT
 SG_ VehOdoInfoSts_0x137 : 346|1@0+ (1,0) [0|1] ""  HUT,T_Box
 SG_ VehOdoInfo_0x137 : 345|10@0+ (1,0) [0|999] "m"  HUT,T_Box
 SG_ RollingCounter_ABS3_0x137 : 379|4@0+ (1,0) [0|15] ""  HUT
 SG_ FreshnessValue_ESP_FD2 : 455|16@0+ (1,0) [0|65535] "" Vector__XXX
 SG_ MAC_Check_ESP_FD2 : 471|48@0+ (1,0) [0|281474976710655] "" Vector__XXX
 SG_ dummy_ESP_FD2_8 : 79|1@0+ (1,0) [0|1] ""  HUT
 SG_ dummy_ESP_FD2_9 : 74|3@0+ (1,0) [0|7] ""  HUT
 SG_ dummy_ESP_FD2_10 : 80|1@0+ (1,0) [0|1] ""  HUT
 SG_ dummy_ESP_FD2_11 : 102|1@0+ (1,0) [0|1] ""  HUT
 SG_ dummy_ESP_FD2_12 : 97|2@0+ (1,0) [0|3] ""  HUT
 SG_ dummy_ESP_FD2_13 : 111|8@0+ (1,0) [0|255] ""  HUT
 SG_ dummy_ESP_FD2_14 : 119|8@0+ (1,0) [0|255] ""  HUT
 SG_ dummy_ESP_FD2_15 : 127|4@0+ (1,0) [0|15] ""  HUT
 SG_ dummy_ESP_FD2_16 : 139|4@0+ (1,0) [0|15] ""  HUT
 SG_ dummy_ESP_FD2_17 : 147|3@0+ (1,0) [0|7] ""  HUT
 SG_ dummy_ESP_FD2_18 : 175|8@0+ (1,0) [0|255] ""  HUT
 SG_ dummy_ESP_FD2_19 : 183|8@0+ (1,0) [0|255] ""  HUT
 SG_ dummy_ESP_FD2_20 : 191|4@0+ (1,0) [0|15] ""  HUT
 SG_ dummy_ESP_FD2_37 : 350|3@0+ (1,0) [0|7] ""  HUT
 SG_ dummy_ESP_FD2_38 : 367|8@0+ (1,0) [0|255] ""  HUT
 SG_ dummy_ESP_FD2_39 : 375|8@0+ (1,0) [0|255] ""  HUT
 SG_ dummy_ESP_FD2_40 : 383|4@0+ (1,0) [0|15] ""  HUT
 SG_ ESP_FD2_0x137 : 7|512@0+ (1,0) [0|0] ""  HUT

BO_ 368 ESP8: 8 GW
 SG_ CCO_Active : 31|2@0+ (1,0) [0|3] ""  HUT
 SG_ CCO_TgtVel : 36|5@0+ (1,2.6) [2.6|33.6] "kph"  HUT
 SG_ CCO_Warn : 39|2@0+ (1,0) [0|3] ""  HUT
 SG_ EspFuncOffSts_mode : 24|1@0+ (1,0) [0|1] ""  HUT
 SG_ ESP8_0x170 : 7|64@0+ (1,0) [0|0] ""  HUT

BO_ 338 ELD1: 8 GW
 SG_ RearELDLckSts : 39|4@0+ (1,0) [0|15] ""  HUT
 SG_ ELD1_0x152 : 7|64@0+ (1,0) [0|0] ""  HUT

BO_TX_BU_ 829 : T_Box,HUT;
BO_TX_BU_ 748 : DVR,HUT;
CM_ SG_ 51 T_Box_RemtWinCtrl "Remote window controlBD1-CAN To:DDCM,PDCM KBCM";
CM_ SG_ 51 T_Box_RemtTrunkCtrl "Remote trunk controlBD2-CAN To:PLG
BD1-CAN To:KBCM";
CM_ SG_ 51 T_Box_RemtDoorLockCtrl "Remote door lock controlBD1-CAN To:KBCM DDCM PDCM";
CM_ SG_ 51 T_Box_AudioMuteReq "Request HUT mute the Audio.";
CM_ SG_ 51 T_Box_RemtDrvTempSet "Remote driver side temperature setBD1-CAN To:AC";
CM_ SG_ 51 T_Box_RemtAutoCtrl "Remote auto mode controlBD1-CAN To:AC";
CM_ SG_ 51 T_Box_RemtPassTempSet "Remote passenger side temperature setBD1-CAN To:AC";
CM_ SG_ 51 T_Box_RemtSsCtrl "Remote sunshade controlBD1-CAN To:KBCM";
CM_ SG_ 51 T_Box_RemtSrCtrl "Remote sunroof controlBD1-CAN To:KBCM";
CM_ SG_ 51 T_Box_RemtDrvSeatVentnLvlSet "Remote sriver seat ventilation level setBD1-CAN To:HVSM";
CM_ SG_ 51 T_Box_RemtPassSeatVentnLvlSet "Remote passenger seat ventilation level setBD1-CAN To:HVSM";
CM_ SG_ 51 T_Box_RemtAIUReq "Remote  Air Ionizer Unit  requestBD1-CAN To:AC";
CM_ SG_ 51 T_Box_PM25AirQLvl "PM2.5 air quality level";
CM_ SG_ 51 T_Box_RemtCarSearch "Remote car searchBD1-CAN To:KBCM";
CM_ SG_ 51 T_Box_RemtEngCtrl "Remot enging controlBD1-CAN To:KBCM";
CM_ SG_ 51 T_Box_RemtDrvSeatHeatgLvlSet "Remote driver seat heating level  setBD1-CAN To:HVSM";
CM_ SG_ 51 T_Box_RemtPassSeatHeatgLvlSet "Remote passenger seat heating level  setBD1-CAN To:HVSM";
CM_ SG_ 51 T_Box_PM25_Dens "PM2.5 density";
CM_ SG_ 51 MAC_Check_T_Box_FD1 "MAC protection mechanism should comply with the GWM MAC Specificatio";
CM_ SG_ 54 T_Box_PEPSAuth1 "T_BOX_PEPS anti-theft authentication signals,T_box send to PEPSBD1-CAN To:KBCM";
CM_ SG_ 1001 T_Box_SWUpdSts "Software update status";
CM_ SG_ 1001 T_Box_SysErrSts "System error statusADAS-CAN To:IFC
BD2-CAN To:IP";
CM_ SG_ 1001 MAC_Check_T_Box_FD3 "MAC protection mechanism should comply with the GWM MAC Specificatio";
CM_ SG_ 481 T_Box_BMSReMtPreHeatT "Tbox battery pack remote reservation heating timeHC_CAN:To HCU BMS";
CM_ SG_ 481 Phone_ChrgnMode "charging mode including Immediate Charging and Delay Charging set on APPHC_CAN:To HCU";
CM_ SG_ 481 T_Box_IntelEngIdlChrgnSwt "Intelligent  Engine Idle Charging for BMS Setting on APPHC_CAN:To BMS";
CM_ SG_ 481 T_Box_BattKeepTemp "Setting Battery Keep Temperature by user on  APPHC_CAN:To BMS";
CM_ SG_ 481 T_Box_RemtFrntDefrostCtrl "Remote front defrost controlBD1-CAN To:AC";
CM_ SG_ 481 Phone_BattSOCLim "Battery SOC limit set by user on HUT or APPHC_CAN:To HCU,BMS";
CM_ SG_ 481 T_Box_RemtRearDefrostCtrl "Remote rear defrost controlBD2-CAN To:R_Pbox";
CM_ SG_ 481 RemUpgrdModeCmd "Remote Upgrade Mode CommandBD1_CAN:To KBCM";
CM_ SG_ 481 T_Box_RemtVideoMonrEnaReq_APP "remote video monitor enable request from APP";
CM_ SG_ 481 T_Box_BMSReMtPreHeatReq "Battery package remote reservation heating requestHC_CAN:To BMS";
CM_ SG_ 481 T_Box_RemtCockpitClnReq "Remote Cockpit cleaning requestBD1_CAN:To AC";
CM_ SG_ 481 T_Box_RemtSdlMod "T-Box Remote Schedule mode,HCU receive this signal in order to achieve the function of charging,cooling,heating.HC_CAN:To HCU";
CM_ SG_ 72 T_Box_PEPSAuth2 "Anti-theft authentication related signals,T_Box send to PEPSKBCMTBKBD1-CAN To:KBCM";
CM_ SG_ 829 T_BOX_RemtLimitStart "T_BOX Remote Limit Start";
CM_ SG_ 748 DVRRemtCnSts "DVR and TBOX remote connect status";
CM_ SG_ 748 DVR_360VideoCaptureReq "360 video capture requestADAS-CAN To:HAP";
CM_ SG_ 748 DVRSN "DVR serial number";
CM_ SG_ 680 TranPMode_Sts "Transport Mode statusPT_CAN:To ECM
BD2_CAN:To R_PBOX,TPMS
BD1_CAN:ToPDCM,DDCM,DSC,KBCM HVSM AC,F_PBOX,BLE
SC_CAN:To HUT,T_BOX,DMS,DVR,
ADAS_CAN:To HC
From message EEM1";
CM_ SG_ 680 Stat_PwrSv_Lvl "Static Power save levelBD2_CAN:To R_PBOX
BD1_CAN:To PDCM,DDCM,DSC,KBCM,AC,F_PBOX,BLE HVSM
SC_CAN:To HUT
ADAS_CAN:To HC
From message EEM1";
CM_ SG_ 680 DeepSlpCmd "Deep sleep commendSC_CAN:To T_BOX
BD2_CAN:To R_PBOX
BD1_CAN:To KBCM,PEPS,F_PBOX,BLE
From message EEM1";
CM_ SG_ 680 Dyn_PwrSv_Lvl "dynamic Power save levelBD2_CAN:To R_PBOX
BD1_CAN:To PDCM,DDCM,DSC,AC,F_PBOX HVSM
SC_CAN:To,HUT
From message EEM1";
CM_ SG_ 680 LvPwrSysErr "LV power system errorBD2_CAN:To R_PBOX
BD1_CAN:To PDCM,DDCM,DSC,AC,F_PBOX HVSM
SC_CAN:To,HUT
From message EEM1";
CM_ SG_ 680 LimitStartSts "Limit Start States";
CM_ SG_ 699 U_BATT "Battery voltageSC_CAN:To  HUT T_BOX
PT_CAN:To ECM
BD2_CAN:To ABM
ç¬¬ä¸€æ¬¡ä¸Šç”µåˆå§‹åŒ–æ—¶é—´:1.2s
ç¡çœ å”¤é†’ä¹‹åŽåˆå§‹åŒ–æ—¶é—´:0.2s";
CM_ SG_ 699 I_RANGE "Battery current rangeç¬¬ä¸€æ¬¡ä¸Šç”µåˆå§‹åŒ–æ—¶é—´:1.2s
ç¡çœ å”¤é†’ä¹‹åŽåˆå§‹åŒ–æ—¶é—´:0.2s";
CM_ SG_ 699 I_BATT "Battery current,Bosch algorithm:\"E=(N*+Offset) x Factor\"ç¬¬ä¸€æ¬¡ä¸Šç”µåˆå§‹åŒ–æ—¶é—´:1.2s
ç¡çœ å”¤é†’ä¹‹åŽåˆå§‹åŒ–æ—¶é—´:0.2s
**ä¸º:(raw value +offset)*factor";
CM_ SG_ 699 SOC "State of ChargeSC_CAN:To DVR
ç¬¬ä¸€æ¬¡ä¸Šç”µåˆå§‹åŒ–æ—¶é—´:6s
ç¡çœ å”¤é†’ä¹‹åŽåˆå§‹åŒ–æ—¶é—´:5s";
CM_ SG_ 699 SOH_SUL "max.possible SOC,reduced by sulphationç¬¬ä¸€æ¬¡ä¸Šç”µåˆå§‹åŒ–æ—¶é—´:6s
ç¡çœ å”¤é†’ä¹‹åŽåˆå§‹åŒ–æ—¶é—´:5s";
CM_ SG_ 699 SOC_STATE "SOC Statusç¬¬ä¸€æ¬¡ä¸Šç”µåˆå§‹åŒ–æ—¶é—´:6s
ç¡çœ å”¤é†’ä¹‹åŽåˆå§‹åŒ–æ—¶é—´:5s";
CM_ SG_ 699 SOH_SUL_STATE "SOH_SUL_Statusç¬¬ä¸€æ¬¡ä¸Šç”µåˆå§‹åŒ–æ—¶é—´:6s
ç¡çœ å”¤é†’ä¹‹åŽåˆå§‹åŒ–æ—¶é—´:5s";
CM_ SG_ 367 RSDS_IPSoundReq "IP sound Request";
CM_ SG_ 367 BSD_LCA_warningReqRight "Request BSDLCA right side warning element";
CM_ SG_ 367 BSD_LCA_warningReqleft "Request BSDLCA left side warning element";
CM_ SG_ 367 DOW_warningReqRight "Request DOW right side warning element";
CM_ SG_ 367 DOW_warningReqleft "Request DOW left side warning element";
CM_ SG_ 367 RSDS_ErrSts "show the RSDS status of  failure";
CM_ SG_ 367 RSDS_BrkgTrig "Indicate the CTA Braking function had been triggered";
CM_ SG_ 367 RSDS_BliSts "RSDS Blindness States";
CM_ SG_ 367 RSDS_TrailerSts "RSDS Trailer States";
CM_ SG_ 367 RSDS_LCAResp "Indicate LCAï¼ˆLane Change AssistÂ ï¼‰ Switch status";
CM_ SG_ 367 RSDS_DOWResp "Indicate DOW(door open warning) Switch status";
CM_ SG_ 367 RSDS_RCWResp "Indicate RCWï¼ˆRear Collision Warning ï¼‰ Switch status";
CM_ SG_ 367 RSDS_RCTAResp "Indicate CTA  ï¼ˆCross Traffic Assist ï¼‰Switch status";
CM_ SG_ 367 RSDS_RCTABrkResp "Indicate CTA _Brake ï¼ˆCross Traffic Assist With Brakeï¼‰Switch status";
CM_ SG_ 367 RSDS_RCW_Trigger "indicate RCW trigger status";
CM_ SG_ 367 RSDS_CTA_Actv "show the CTA  ï¼ˆCross Traffic Assist ï¼‰status";
CM_ SG_ 367 RCTA_warningReqRight "Request RCTA right side warning element";
CM_ SG_ 367 RCTA_warningReqLeft "Request RCTA left side warning element";
CM_ SG_ 573 Checksum_IFC3 "Use the checksum strategy from document â€œEnd-to-End Communication Protection Specificationâ€";
CM_ SG_ 573 LDWResp "Indicate LDW(Lane Detection Warning) Switch status";
CM_ SG_ 573 LKAResp "Indicate LKA(Â Lane Keeping Assist) Switch status";
CM_ SG_ 573 LCKResp "Indicate LCK(Â Lane Center Keeping ) Switch status";
CM_ SG_ 573 AESResp "Indicate AES(Automatic Emergency Steering) Switch status";
CM_ SG_ 573 ELKResp "Indicate ELK(Â Emergency Lane Keeping ) Switch status";
CM_ SG_ 573 LDW_LKA_Snvty "LDW(Lane Detection Warning)_LKA(Â Lane Keeping Assist)   Sensitivity";
CM_ SG_ 573 IFCHUTInterface "This signal indicates if IFC and HUT communication  interface is available or not.";
CM_ SG_ 573 LSSWarnFormResp "LSS Warning Form Switch status";
CM_ SG_ 573 LSSResp "Indicate LSS(Â Lane Support System ) Switch status";
CM_ SG_ 573 IntelligentEvaResp "Intelligent Evade Switch status Response";
CM_ SG_ 573 ESS_Pedresp "ESS(Â Evasive Steering Support)  Pedestrian Switch status response";
CM_ SG_ 573 ESS_Vehresp "ESS_Inlane(Â Evasive Steering Support in lane) Vehicle Switch status response";
CM_ SG_ 573 AESSts "AES function status";
CM_ SG_ 573 ESSSts "ESS function status";
CM_ SG_ 573 AESErrSts "AES function error status";
CM_ SG_ 573 ESSErrSts "ESS function error status";
CM_ SG_ 573 RollingCounter_IFC3 "RollingCounter_IFC3";
CM_ SG_ 573 Checksum_IFC4 "Use the checksum strategy from document â€œEnd-to-End Communication Protection Specificationâ€";
CM_ SG_ 573 IFCCalibrationSts "Lane Detection Warning Calibration Status
IFC Calibration Status";
CM_ SG_ 573 CameraBlockageSts "Camera Blockage Status";
CM_ SG_ 573 LDW_LKAWarn "LDW waring status";
CM_ SG_ 573 LSSIntervention "LSS(Lane Support System)  torque intercention status";
CM_ SG_ 573 LSSFuncSts "LSS(Lane Support System) status";
CM_ SG_ 573 ELKMainState "ELK Main State";
CM_ SG_ 573 LaneAvailability "Lane availability";
CM_ SG_ 573 TJA_FollowSts "Indicator TJA function lateral control's following status
TJAåŠŸèƒ½æ¨ªå‘æŽ§åˆ¶è·Ÿéšå‰è½¦çŠ¶æ€";
CM_ SG_ 573 LSSErrSts "LSS(Lane Support System)  error status.";
CM_ SG_ 573 IFC_Handsoffwarn "Hands Off Warning";
CM_ SG_ 573 ELKActSts "ELK function active status";
CM_ SG_ 573 IntelligentEvaActSts "Intelligent Evade function active status";
CM_ SG_ 573 LCKStsIndcr "LCK(Lane Center Keeping) Status Indicator";
CM_ SG_ 573 AESintervention "AES intervention status";
CM_ SG_ 573 ESSintervention "ESS intervention status";
CM_ SG_ 573 RollingCounter_IFC4 "RollingCounter_IFC4";
CM_ SG_ 573 Checksum_IFC5 "Use the checksum strategy from document â€œEnd-to-End Communication Protection Specificationâ€";
CM_ SG_ 573 IFC_LaneCurve "Lane curature";
CM_ SG_ 573 IFC_LeLaneTyp "Left lane type";
CM_ SG_ 573 IFC_RiLaneTyp "Right lane type";
CM_ SG_ 573 IFC_NextLeLaneTyp "Left Next lane type";
CM_ SG_ 573 IFC_NextRiLaneTyp "Right Next lane type";
CM_ SG_ 573 IFC_LeLane_dy "Distance from the vehicle to the left next lane";
CM_ SG_ 573 IFC_RiLane_dy "Distance from the vehicle to the right next lane";
CM_ SG_ 573 RollingCounter_IFC5 "RollingCounter_IFC5";
CM_ SG_ 573 Checksum_IFC6 "Use the checksum strategy from document â€œEnd-to-End Communication Protection Specificationâ€";
CM_ SG_ 573 IFC_NextLeLane_dy "Distance from the vehicle to the left lane";
CM_ SG_ 573 IFC_NextRiLane_dy "Distance from the vehicle to the right lane";
CM_ SG_ 573 RollingCounter_IFC6 "RollingCounter_IFC6";
CM_ SG_ 573 MAC_Check_IFC_FD2 "MAC protection mechanism should comply with the GWM MAC Specificatio";
CM_ SG_ 719 TSRResp "Indicate TSR(Traffic Sign Recognition) switch status";
CM_ SG_ 719 TSRSpdLimUnit "Indicate speed limit unit of current rode";
CM_ SG_ 719 TSRSpdLim "Indicate the value of speed limit sign detected by camera";
CM_ SG_ 719 TSRSpdLimCfdc "Indicate the confidience of the speed limit";
CM_ SG_ 719 TSRSts "Indicate current mode of the TSR(Traffic Sign Recognition)";
CM_ SG_ 719 TSRSpdLimSts "Indicate speed limit status of current road";
CM_ SG_ 719 TSRTrfcSignValCfdc "Indicate the confidience of the traffic sign";
CM_ SG_ 719 TSRTrfcSignVal "Indicate the value of speed limit sign detected by camera";
CM_ SG_ 719 TSRSpdLimWarn "Request to warn when this vehicle speed is over speed limit";
CM_ SG_ 719 TSRWarnResp "Indicate TSR(Traffic Sign Warning) switch status";
CM_ SG_ 719 TSR_Snvty "TSR Warning offset";
CM_ SG_ 683 ACC_LeTgt_02_Dy "Lateral distance of the second target in left lane";
CM_ SG_ 683 ACC_LeTgt_02_Dx "Longitudinal distance of the second target in left lane";
CM_ SG_ 683 ACC_LeTgt_02_Typ "Type of the second target in left lane";
CM_ SG_ 683 ACC_LeTargrt_02_Detn "Detection of the second target in left lane";
CM_ SG_ 683 ACC_RiTargrt_02_Detn "Detection of the second target in rignt lane";
CM_ SG_ 683 ACC_RiTgt_02_Dy "Lateral distance of the second target in rignt lane";
CM_ SG_ 683 ACC_RiTgt_02_Dx "Longitudinal distance of the second target in right lane";
CM_ SG_ 683 ACC_RiTgt_02_Typ "Type of the second target in right lane";
CM_ SG_ 683 ACC_LeTgtObjBarDisp "Disply distance to the left target object in AR_HUD";
CM_ SG_ 683 ACC_RiTgtObjBarDisp "Disply distance to the right target object in AR_HUD";
CM_ SG_ 683 Checksum_ACC3 "Use the checksum strategy from document â€œEnd-to-End Communication Protection Specificationâ€";
CM_ SG_ 683 ISL_Resp "Indicate ISL(Intelligent Speed Limit) switch status";
CM_ SG_ 683 ICA_HandsOffResp "Indicate ICA HandsOff Function switch status";
CM_ SG_ 683 Longctrl_VehHldReq_DVR "ACC request ESPÂ Â hold vehicle";
CM_ SG_ 683 Longctrl_DrvOFF_Req_DVR "ACC request ESP(CDD-S) drive off";
CM_ SG_ 683 Longctrl_ModSts_DVR "The status of the Longctrl control unit.
The Longctrl mode should be contained in every message sent by Longctrl.";
CM_ SG_ 683 Longctrl_Decel_Req_DVR "Status of the deceleration request from ACC";
CM_ SG_ 683 Longctrl_EngTrqReq_DVR "Vehilce longitudinal control function Engine torque request";
CM_ SG_ 683 Longctrl_EngTrqReqActive_DVR "Vehilce longitudinal control function Engine torque request active";
CM_ SG_ 683 Longctrl_DecelToStopReq_DVR "The ACC request ESPVLC to decelerate untill standstill.";
CM_ SG_ 683 Longctrl_ParkShiftReq_DVR "ACC Request Park Shift";
CM_ SG_ 683 Longctrl_Decel_ReqValue_DVR "ACC deceleration request from ACC";
CM_ SG_ 683 Longctrl_HCUTrqReqActive_DVR "Vehilce longitudinal control function HCU torque request active";
CM_ SG_ 683 HWA_SnvtySet_Resp "Indicate HWA Change track remind sensibility";
CM_ SG_ 683 HWA_Resp "Indicate Switch  of HWA switch status";
CM_ SG_ 683 ALC_Resp "Indicate Switch  of ALCï¼ˆAutomatic lane change assistanceï¼‰ switch status";
CM_ SG_ 683 ALC_InterSysInfoDisp "Automatic Lane Change";
CM_ SG_ 683 RollingCounter_ACC3 "RollingCounter_ACC3";
CM_ SG_ 683 Checksum_ACC4 "Use the checksum strategy from document â€œEnd-to-End Communication Protection Specificationâ€";
CM_ SG_ 683 ACC_ObjDetecte "An ahead target object detected by ACC, to inform the driver.";
CM_ SG_ 683 ACC_TakeOverReq "The limits of the ACC control reaches, driver should take over.";
CM_ SG_ 683 ACC_InterSysInfoDisp "Provides driver for  text reminder informations of ACC function";
CM_ SG_ 683 ACC_ModDisp "The status of the ACC control unit.";
CM_ SG_ 683 ACC_FctSts "Indicate ACC fuction system working status";
CM_ SG_ 683 ACC_TgtObjBarDisp "Disply distance to the ahead target object in case of \"mid-end\" HMI.";
CM_ SG_ 683 ACC_TimeGapSet "The set timeGap from driver, should be displayed to driver and if the set value changes.";
CM_ SG_ 683 ACC_SpdSetValue "The set speed from driver, should be available as long as ACC is active.";
CM_ SG_ 683 Longctrl_HazActv "Indicate the hazard brake will be actived";
CM_ SG_ 683 TJA_ACC_SelSts "Indicate select status of TJAACC function swicth";
CM_ SG_ 683 ISL_InterSysInfoDisp "Provides driver for  text reminder informations of ISL(Intelligent Speed limit) function";
CM_ SG_ 683 TJA_ICA_ModDisp "provides driver for  text reminder informations of TJAICA function";
CM_ SG_ 683 TJA_ICA_InterSysInfoDisp "Provides driver for  text reminder informations of TJAICA function";
CM_ SG_ 683 CruCha_ModDisp "Cruise Chauffer Status";
CM_ SG_ 683 CruChar_InterSysInfoDisp "Provides driver for  text reminder informations of Cruise Chauffer function";
CM_ SG_ 683 RollingCounter_ACC4 "RollingCounter_ACC4";
CM_ SG_ 683 Checksum_ACC8 "Use the checksum strategy from document â€œEnd-to-End Communication Protection Specificationâ€";
CM_ SG_ 683 Longctrl_HCUTrqReq_DVR "Vehilce longitudinal control function HCU torque request at wheel level.";
CM_ SG_ 683 HWA_warning "HWA  different level warning";
CM_ SG_ 683 HWA_ModDisp "show the status of HWA";
CM_ SG_ 683 HWA_InterSysInfoDisp "Provides driver for  text reminder informations of HWA function";
CM_ SG_ 683 HWA_LaneChangeReq "Lane change is available";
CM_ SG_ 683 HWA_LaneChange "Lane changing";
CM_ SG_ 683 ADAS_DriverInloop_Monitor "Diver Hands-on detection warning and
Driver Attention warning";
CM_ SG_ 683 RollingCounter_ACC8 "RollingCounter_ACC8";
CM_ SG_ 683 Checksum_ACC6 "Use the checksum strategy from document â€œEnd-to-End Communication Protection Specificationâ€";
CM_ SG_ 683 ACC_PotentialTgtDy "Lateral distance of potential target in this lane";
CM_ SG_ 683 ACC_PotentialTgtDx "Longitudinal distance of potential target in this lane";
CM_ SG_ 683 ACC_RlvTgtDetn "Effective target detection.";
CM_ SG_ 683 ACC_EgoStatus "Status of ego vehicle";
CM_ SG_ 683 ACC_RlvTgtDy "Lateral distance of effective target in this lane";
CM_ SG_ 683 ACC_RlvTgtDx "Longitudinal distance of effective target in this lane";
CM_ SG_ 683 ACC_PotentialTgtDetn "Detection of potential targets in this lane";
CM_ SG_ 683 ACC_PotentialTgtTyp "Types of potential targets in this lane";
CM_ SG_ 683 ACC_RlvTgtTyp "Types of effective targets in this lane";
CM_ SG_ 683 RollingCounter_ACC6 "RollingCounter_ACC6";
CM_ SG_ 683 Checksum_ACC7 "Use the checksum strategy from document â€œEnd-to-End Communication Protection Specificationâ€";
CM_ SG_ 683 ACC_LeTgtDy "Lateral distance of the nearest target in left lane";
CM_ SG_ 683 ACC_LeTgtDx "Longitudinal distance of the nearest target in left lane";
CM_ SG_ 683 ACC_LeTgtTyp "Type of the nearest target in left lane";
CM_ SG_ 683 ACC_LeTargrtDection "Detection of the nearest target in left lane";
CM_ SG_ 683 ACC_RiTargrtDetn "Detection of the nearest target in rignt lane";
CM_ SG_ 683 ACC_RiTgtDy "Lateral distance of the nearest target in rignt lane";
CM_ SG_ 683 ACC_RiTgtDx "Longitudinal distance of the nearest target in right lane";
CM_ SG_ 683 ACC_RiTgtTyp "Type of the nearest target in right lane";
CM_ SG_ 683 Request_driveoff "Request driver drive off";
CM_ SG_ 683 RollingCounter_ACC7 "RollingCounter_ACC7";
CM_ SG_ 683 ACC_RlvTgtfusion "fusion flag of  effective target in this laneSC-CANFD To:HUT";
CM_ SG_ 683 ACC_RlvTgtHeading "the heading angle of effective target in this laneSC-CANFD To:HUT";
CM_ SG_ 683 ACC_LeTgtfusion "fusion flag of the nearest target in left laneSC-CANFD To:HUT";
CM_ SG_ 683 ACC_LeTgtHeading "the heading angle of the nearest target in left laneSC-CANFD To:HUT";
CM_ SG_ 683 ACC_RiTgtfusion "fusion flag of the nearest target in right laneSC-CANFD To:HUT";
CM_ SG_ 683 ACC_RiTgtHeading "the heading angle of the nearest target in right laneSC-CANFD To:HUT";
CM_ SG_ 683 ACC_PotentialTgtfusion "fusion flag of potential target in this laneSC-CANFD To:HUT";
CM_ SG_ 683 ACC_PotentialTgtHeading "the heading angle of potential target in this laneSC-CANFD To:HUT";
CM_ SG_ 683 TargetCutinPro "Possibility of target cutting inSC-CANFD To:HUT";
CM_ SG_ 683 TargetCutoutPro "Possibility of target cutting outSC-CANFD To:HUT";
CM_ SG_ 683 MAC_Check_ACC_FD2 "MAC protection mechanism should comply with the GWM MAC Specificatio";
CM_ SG_ 696 AEBObjID "AEB objecttive ID";
CM_ SG_ 696 AEBObjExist "The possibility of AEB objecttive existence";
CM_ SG_ 696 AEBObjVideoCfmd "AEB objective and Video Camera Fusion";
CM_ SG_ 696 AEBObjVx "Longitudinal relative speed of the AEB objecttive with the ego vehicle";
CM_ SG_ 696 AEBObjDx "Longitudinal distance of the AEB objecttive with the ego vehicle";
CM_ SG_ 696 AEBObjCntAlive "Indicate the duration of the AEB objecttive";
CM_ SG_ 696 AEBObjDy "Lateral distance of the AEB objecttive with the ego vehicle";
CM_ SG_ 696 AEBObjState "Indicate AEB objective Status";
CM_ SG_ 696 AEBObjObstcl "AEB Target are the possibility of obstacles";
CM_ SG_ 696 AEBObjVy "Lateral relative speed of the AEB target vehicle with the ego vehicle";
CM_ SG_ 696 CyclistObjExist "The possibility of Cyclist objecttive existence";
CM_ SG_ 696 AEBObjAx "Longitudinal relative speed of the AEB target with the ego vehicle";
CM_ SG_ 696 AEBObjAy "Lateral acceleration of the AEB target with the ego vehicle";
CM_ SG_ 696 CyclistObjDx "Longitudinal distance of the target Cyclist with the ego vehicle";
CM_ SG_ 696 CyclistObjID "Cyclist objecttive ID";
CM_ SG_ 696 CyclistObjObstcl "Target Cyclist are the possibility of obstacles";
CM_ SG_ 696 CyclistObjDy "Lateral distance of the Cyclist objective with the ego vehicle";
CM_ SG_ 696 CyclistObjVx "Longitudinal relative speed of the Cyclist objective with the ego vehicle";
CM_ SG_ 696 CyclistObjCntAlive "Indicate the duration of the target Cyclist's existence";
CM_ SG_ 696 CyclistObjVy "Lateral relative speed of the target Cyclist  with the ego vehicle";
CM_ SG_ 696 CyclistObjState "Cyclist objective Status";
CM_ SG_ 696 CyclistObjVideoCfmd "Cyclist objective and Video Camera Fusion";
CM_ SG_ 696 CyclistObjAx "Longitudinal acceleration of Cyclist objective with ego vehicle";
CM_ SG_ 696 CyclistObjAy "Lateral acceleration of Cyclist objective with ego vehicle";
CM_ SG_ 696 PedObjExist "The possibility of Pedestrian objecttive existence";
CM_ SG_ 696 PedObjID "Pedestrian objective ID";
CM_ SG_ 696 PedObjObstcl "Target Pedestrian are the possibility of obstacles";
CM_ SG_ 696 PedObjDy "Lateral distance of the target Pedestrian with the ego vehicle";
CM_ SG_ 696 PedObjDx "Longitudinal distance of the target Pedestrian with the ego vehicle";
CM_ SG_ 696 PedObjVx "Longitudinal relative speed of the target Pedestrian with the ego vehicle";
CM_ SG_ 696 PedObjVy "Lateral relative speed of the Pedestrian objective with the ego vehicle";
CM_ SG_ 696 PedObjVideoCfmd "Pedestrian objective and Video Camera Fusion";
CM_ SG_ 696 ACCTgtObjDx "Longitudinal distance of the ACCTarget objective with the ego vehicle";
CM_ SG_ 696 PedObjAy "Lateral acceleration of Pedestrian objective with ego vehicle";
CM_ SG_ 696 PedObjCntAlive "Indicate the duration of the Pedestrian objective's existence";
CM_ SG_ 696 PedObjAx "Longitudinal acceleration of Pedestrian objective with ego vehicle";
CM_ SG_ 696 ACCTgtObjID "ACCTarget objecttive ID";
CM_ SG_ 696 ACCTgtObjObstcl "ACCTarget objective are the possibility of obstacles";
CM_ SG_ 696 ACCTgtObjDy "Lateral distance of the ACCTarget objective with the ego vehicle";
CM_ SG_ 696 ACCTgtObjExist "The possibility of ACCTarget objecttive existence";
CM_ SG_ 696 ACCTgtObjVy "Lateral relative speed of the ACCTarget objective with the ego vehicle";
CM_ SG_ 696 ACCTgtObjVx "Longitudinal relative speed of the ACCTarget objective with the ego vehicle";
CM_ SG_ 696 ACCTgtObjAx "Longitudinal acceleration of ACCTarget objective with ego vehicle";
CM_ SG_ 696 ACCTgtObjAy "Lateral acceleration of ACCTarget objective with ego vehicle";
CM_ SG_ 696 ACCTgtObjState "ACCTarget objecttive Status";
CM_ SG_ 696 ACCTgtObjVideoCfmd "ACCTarget objective and Video Camera Fusion";
CM_ SG_ 696 ACCTgtObjCntAlive "Indicate the duration of the ACCTarget objective's existence";
CM_ SG_ 696 RadarHorMisalign "Horizontal Deviation Angle of Radar Installation for Radar Detection";
CM_ SG_ 696 HandsoffDetd "Hands off Detected";
CM_ SG_ 696 DrvgOnHiWay "Drive on Highway";
CM_ SG_ 696 RoadCrvt "Current position curvature";
CM_ SG_ 696 SpdLimitDst "Distance between Current location and speed limit point";
CM_ SG_ 696 RoadCrvtFar "200 m (tentative) road curvature ahead";
CM_ SG_ 696 RampDst "Current location and ramp distance";
CM_ SG_ 696 SpdLimit "Speed limit value";
CM_ SG_ 696 CurveDst "Distance between Current location and curve";
CM_ SG_ 696 NavSpdLimUnit "Speed limit unit";
CM_ SG_ 696 TunnelDst "Distance between Current location and tunnel";
CM_ SG_ 696 DrvgOnRiLane "Drive in the rightmost Lane";
CM_ SG_ 696 BrdgDst "Distance between Current location and bridge";
CM_ SG_ 696 RadarDrvrAttentive "Radar Detect driver's attention";
CM_ SG_ 696 ACC_DataRecReq "Rquest DVR Record Data";
CM_ SG_ 696 ACC_SOSReq "Indicate T-BOX will activative the e-call mode";
CM_ SG_ 696 PedObjState "Pedestrian objective Status";
CM_ SG_ 696 MapDataValid "Map Data is valid or invalid";
CM_ SG_ 696 DrvrSts "Driver State";
CM_ SG_ 696 AEBObjOverlap "Condition of AEB objecttive overlap";
CM_ SG_ 696 AEBObjDrvby "Condition of AEB objecttive driveby";
CM_ SG_ 395 AEB_ABA_Level "ABA level to the ESP HBA.";
CM_ SG_ 395 AEB_ABA_Req "Request of the ABA support from ESP.";
CM_ SG_ 395 EBA_TgtDecel_Req "Request of the EBA deceleration control.";
CM_ SG_ 395 AEB_VehHldReq "AEBÂ Â request ESP hold vehicle";
CM_ SG_ 395 AEB_TgtDecel_Req "Request of the AEB deceleration control.";
CM_ SG_ 395 AEB_TgtDecel_ReqValue "Target deceleration value from AEBEBA";
CM_ SG_ 395 AEB_AWB_Req "Request of the brake jerk warning to ESP.";
CM_ SG_ 395 AEB_AWB_Level "Different level request of the brake jerk.";
CM_ SG_ 395 AEB_ABP_Req "Request of the Prefill to ESP.";
CM_ SG_ 395 AEB_BrkReqFunc "Display which Function request ESP Brake.";
CM_ SG_ 395 AEB_ObjSty "Indicate the style of AEB function trigger object";
CM_ SG_ 551 Checksum_AEB2 "Use the checksum strategy from document â€œEnd-to-End Communication Protection Specificationâ€";
CM_ SG_ 551 AEB_PedResp "Indicate AEB-P(Pedestrian) switch status.";
CM_ SG_ 551 AEB_VehResp "Indicate AEB-V(Vehicle) switch status.";
CM_ SG_ 551 FCW_Snvty "Indicate FCW Sensitive";
CM_ SG_ 551 AEB_JA_Resp "Indicate AEB-JA(Junction Assist) switch status.";
CM_ SG_ 551 RollingCounter_AEB2 "RollingCounter_AEB2";
CM_ SG_ 551 Checksum_AEB3 "Use the checksum strategy from document â€œEnd-to-End Communication Protection Specificationâ€";
CM_ SG_ 551 AEB_VehTrig "Indicate the AEB_Veh function had been triggered";
CM_ SG_ 551 AEB_PedTrig "Indicate the AEB_Ped function had been triggered";
CM_ SG_ 551 FCW_AEB_VehFctSts "Indicate FCWAEB-V fuction system working status";
CM_ SG_ 551 FCW_AEB_PedFctSts "Indicate FCWAEB-P fuction system working status";
CM_ SG_ 551 FCW_Warn "FCW latent(visual) warning or pre(acoustic)  warning. Used with ACC_FCW_ON_OFF signal.";
CM_ SG_ 551 AEB_JAFuncSts "Indicate AEB-JA fuction system working status";
CM_ SG_ 551 AEB_JA_Warn "visual warning oracousticwarning.";
CM_ SG_ 551 AEB_JABrkTrig "Indicate the AEB_JA function had been triggered";
CM_ SG_ 551 RollingCounter_AEB3 "RollingCounter_AEB3";
CM_ SG_ 551 MAC_Check_AEB_FD2 "MAC protection mechanism should comply with the GWM MAC Specificatio";
CM_ SG_ 273 EMS_AuthenResult "This signal describes whether the authorisation result is passed or not.";
CM_ SG_ 273 EngSpd "Engine speed";
CM_ SG_ 273 EngSpdVldty "Engine speed validity";
CM_ SG_ 273 BrkPedalSts "Indicates the brake pedal is pressed or not or incorrect for plausibility check.";
CM_ SG_ 258 AccelPedlPosnDiagc "Physical acceleration pedal position.";
CM_ SG_ 258 AccPedalOverride "Detect Acceleration Pedal Override";
CM_ SG_ 258 ECMRespACC "This signal indicates if ECM control for  ACC torque request is active or not.";
CM_ SG_ 258 ECMACCInterface "This signal indicates if ECM and ACC communication  interface is available or not.";
CM_ SG_ 313 Tgtgear_Up "Target Gear of Upshift";
CM_ SG_ 313 Tgtgear_Down "Target Gear of Downshift";
CM_ SG_ 313 NeutralSts "Neutral status(This signal is actual neutral information.When initialize phase or neutral switch error,ECM sends 0x2:Not Available)";
CM_ SG_ 723 EngSpd_ForIP "Engine speed for IP";
CM_ SG_ 723 EWP_Err "Engine electronic water pump failure prompt";
CM_ SG_ 625 FuelConsumption "Accumulated Fuel quantity injected since IGN ON.
Fuel quantity counter overflow is allowed.";
CM_ SG_ 625 TgtCrsVehSpd "Target cruise speed";
CM_ SG_ 625 CruiseCtrlSts "Cruise control status";
CM_ SG_ 625 AccelPedalPosnVldty "Acceleration pedal postion validity";
CM_ SG_ 625 EngSVSSig "Engine SVSï¼ˆservice vehicle soonï¼‰ Signal";
CM_ SG_ 625 MILSts "MILï¼ˆmalfunction indicator lampï¼‰status";
CM_ SG_ 625 EngState "Engine state";
CM_ SG_ 625 AccelPedalPosn "Acceleration Pedal Position";
CM_ SG_ 881 EngCoolantTemp "Engine coolant temperature";
CM_ SG_ 881 GPF_Warning "This signal is used to display the warning information of GPF on IP.";
CM_ SG_ 881 GentrWarnLmpSts "Generator Warning Lamp State";
CM_ SG_ 881 EngClntTempWarn "Engine coolant temperature warning flag";
CM_ SG_ 881 EngClntTempVldty "Engine coolant temperature validity";
CM_ SG_ 881 SS_Screen_tip "Indicate the driver manual start the engine when the engine can not autostart.";
CM_ SG_ 881 SSSSetSts "Feedback Start_stop status to HUT";
CM_ SG_ 881 SS_Enable_Lamp "Enable StartStop Functionï¼ˆGreen Lampï¼‰";
CM_ SG_ 881 SS_Fault_Lamp "StartStop fault lampï¼ˆYellow Lampï¼‰";
CM_ SG_ 881 BaroPressure "Barometer pressure";
CM_ SG_ 130 NetEngTrq "Current engine flywheel torque.";
CM_ SG_ 130 DrvEngTrqReq "Torque request from acceleration pedal or from CCACC.
It is burning torque, without any torque limitation, without filtering, without  consideration of external intervention, with idle controller, no torque intervention, not minus engine loss.";
CM_ SG_ 130 DrvEngTrqReqVld "driver engine torque valid signal(gas engine)";
CM_ SG_ 132 EngTrqEstimdActGear "Expected flywheel torque for actual gear and actual engine speed (including all the torque interventions except transmission torque request)";
CM_ SG_ 132 EngTrqEstimdActGear_Qf "Expected engine torque for actual gear and actual engine speed quality information";
CM_ SG_ 134 TrqLoss "Torque loss";
CM_ SG_ 949 ECM_VIN "The last 8 bytes of VIN stored in ECM.";
CM_ SG_ 951 ECM_VehDstBackup "Vehicle total distance backup signal to IP.";
CM_ SG_ 951 EngRoStrt_Failure "ECM report the reason for engine romoute start failure.";
CM_ SG_ 166 TgtEngSpdIP "target engine speed for IP";
CM_ SG_ 166 TgtEngSpdIPValid "Valid Flag for target engine speed for IP";
CM_ SG_ 166 TrsmTqIdle "Transmission idlecreep load torque";
CM_ SG_ 545 CurrentGearValid "Current gear valid";
CM_ SG_ 545 CURRENT_GEAR "To indicate which gear the DCT is in now";
CM_ SG_ 545 TGS_LEVER "Transmission gear selector lever position";
CM_ SG_ 545 SHIFT_IN_PROGRESS "Gear shifting progress";
CM_ SG_ 545 ShiftInPrgValid "Shift in progress valid";
CM_ SG_ 545 TargetGearValid "Target gear valid";
CM_ SG_ 545 TARGET_GEAR "Target gear.
The coding 0x0:target gear \"N\" is express that target gear is N gear or P gear. When shift lever is in N or P, target gear shows shift lever position.";
CM_ SG_ 565 CheckSum_DCT7 "Use the checksum strategy from document â€œEnd-to-End Communication Protection Specificationâ€";
CM_ SG_ 565 DCT_RaceModeSts "Vehicle RaceMode staute";
CM_ SG_ 565 DCT_PrsBrk_Warn "Press brake to engage gear";
CM_ SG_ 565 DCT_ShftNotAlwd_Warn "Transmission shifting not allowed";
CM_ SG_ 565 DCT_ShftRecom_M "Transmission  shift recommendation in M mode";
CM_ SG_ 565 DrvWarnMsg "Driver display warning messages";
CM_ SG_ 565 DrvFaiMsg_0x235 "Driver display failure messages";
CM_ SG_ 565 DrvModDisp_0x235 "Driver display drive mode value";
CM_ SG_ 565 DrvModDispSts_0x235 "Driver display drive mode status";
CM_ SG_ 565 DrvAutoGearDisp "Driver display gear value";
CM_ SG_ 565 DrvGearDispSts_0x235 "Driver display gear status";
CM_ SG_ 565 RollingCounter_DCT7 "Rolling Counter_DCT7";
CM_ SG_ 565 MAC_Check_DCT7 "MAC protection mechanism should comply with the GWM MAC Specificatio";
CM_ SG_ 561 FLWheelDriveDirection "Front left wheel Moving direction";
CM_ SG_ 561 FLWheelSpdVld "Front left wheel speed valid";
CM_ SG_ 561 FLWheelSpd "Front left wheel speed(when v <0.1 kph, set value to 0)";
CM_ SG_ 561 FRWheelDriveDirection "Front right wheel  Moving direction";
CM_ SG_ 561 FRWheelSpdVld "Front right wheel speed valid";
CM_ SG_ 561 FRWheelSpd "Front right wheel speed(when v <0.1 kph, set value to 0)";
CM_ SG_ 582 RLWheelDriveDirection "Rear left wheel  Moving direction";
CM_ SG_ 582 RLWheelSpdVld "Rear left wheel speed valid";
CM_ SG_ 582 RLWheelSpd "Rear left wheel speed(when v <0.1 kph, set value to 0)";
CM_ SG_ 582 RRWheelDriveDirection "Rear right wheel Moving direction";
CM_ SG_ 582 RRWheelSpdVld "Rear right wheel speed valid";
CM_ SG_ 582 RRWheelSpd "Rear right wheel speed(when v <0.1 kph, set value to 0)";
CM_ SG_ 613 CheckSum_ABS3_0x265 "Use the checksum strategy from document â€œEnd-to-End Communication Protection Specificationâ€";
CM_ SG_ 613 ABSFailSts_0x265 "ABS system has detected a failure which does no allow a reliable ABS regulation and is therefore switched off";
CM_ SG_ 613 EBDFailSts_0x265 "ESP system has detected a failure which does no allow a reliable ESP regulation and is therefore switched off";
CM_ SG_ 613 VehSpdVld_0x265 "Qualityfault information to current Vehicle speed information.";
CM_ SG_ 613 VehSpd_0x265 "Current Vehicle speed information
(when v <0.1 kph, set value to 0)";
CM_ SG_ 613 VehOdoInfoSts_0x265 "Vehicle odograph information Status";
CM_ SG_ 613 VehOdoInfo_0x265 "Vehicle odograph information";
CM_ SG_ 613 ABSActv_0x265 "Indication that ESP system(especially ABS Module) currently performs a brake intervention. Set when ABS Active.";
CM_ SG_ 613 EBDActv_0x265 "Indication that ESP system(especially ABS Module) currently performs a brake intervention. Set when EBD active.";
CM_ SG_ 613 RollingCounter_ABS3_0x265 "Rolling Counter_ABS3";
CM_ SG_ 363 CheckSum_EPB1 "Use the checksum strategy from document â€œEnd-to-End Communication Protection Specificationâ€";
CM_ SG_ 363 PressBrakePedalPointOut "When driver want to release EPB with button, the system provides driver a reminder if pedal is not applied.";
CM_ SG_ 363 EPBErrSts "error indication of EPB system,and indicated yellow lamp on IP.";
CM_ SG_ 363 EPBSts "EPB status,indicate calipers status.";
CM_ SG_ 363 EPBTextDisp "EPB system status for text display";
CM_ SG_ 363 EPBRedLmpSts "indicate the EPB red lamp status to driver for dashboard";
CM_ SG_ 363 RollingCounter_EPB1 "Rolling Counter_EPB1";
CM_ SG_ 329 CheckSum_ESP1_0x149 "Use the checksum strategy from document â€œEnd-to-End Communication Protection Specificationâ€";
CM_ SG_ 329 ESPFuncOffSts_0x149 "ESP Function Off Stateï¼Œ
when it is 1, ESP off switch is pressed, and ESP function is offï¼ŒESP Off lamp on.
When it is 0,ESP off switch is released, and ESP function is ON, ESP Off lamp off.";
CM_ SG_ 329 ESPActvInfoLmp_0x149 "Active information lamp - Indication that ESP system currently performs a brakeengine intervention";
CM_ SG_ 329 ESPBrkLmpCtrl_0x149 "Brake lamp(onoff),come from ESP,HDC,CDP,EPB,AEB,CDD,AVH function";
CM_ SG_ 329 ESPFailSts_0x149 "ESP fail status";
CM_ SG_ 329 ESP_MasterCylBrkPressVld_0x149 "ESP master cylinder brake pressure valid";
CM_ SG_ 329 MSRActv_0x149 "indicating MSRï¼ˆDTCï¼‰ in active control or not.";
CM_ SG_ 329 VDCActv_0x149 "VDC(Vehicle Dynamics Contro) is active";
CM_ SG_ 329 PTCActv_0x149 "PTC(Power Torque Control) is active";
CM_ SG_ 329 BTCActv_0x149 "BTC(Brake Torque Control) is active";
CM_ SG_ 329 ESP_MasterCylBrkPress_0x149 "ESP master cylinder brake pressure";
CM_ SG_ 329 RollingCounter_ESP1_0x149 "Rolling Counter_ESP1";
CM_ SG_ 329 MAC_Check_ESP1 "MAC protection mechanism should comply with the GWM MAC Specificatio";
CM_ SG_ 325 CheckSum_ESP2_0x145 "Use the checksum strategy from document â€œEnd-to-End Communication Protection Specificationâ€";
CM_ SG_ 325 BrkDskOvrheatd_0x145 "Indicating brake disk temperature too high or not.";
CM_ SG_ 325 NoBrkForce_0x145 "No brake pressure applied; generally it regards wheel cylinder presure.";
CM_ SG_ 325 VehStandstill_0x145 "indicating whether the vehicle is standstill or not;
must not be set until standstill is surely reached.";
CM_ SG_ 325 AEBIBActv_0x145 "AEB IB is active (in deceleration)";
CM_ SG_ 325 AEBBAActv_0x145 "AEB BA is active (in deceleration)";
CM_ SG_ 325 AEBAvailable_0x145 "AEB(Automatic Emergency Brake) is available";
CM_ SG_ 325 ABPAvailable_0x145 "ABP(Automatic Brake Pre-fill) is available";
CM_ SG_ 325 ABPActv_0x145 "ABP(Automatic Brake Pre-fill) is active";
CM_ SG_ 325 ABAavailable_0x145 "the ABA function is available";
CM_ SG_ 325 ABAActv_0x145 "ABA(Adaptive brake Assistance) is active";
CM_ SG_ 325 CDDActv_0x145 "CDD(Controlled Deceleration for Driver Assistance System) is active";
CM_ SG_ 325 CDDAvailable_0x145 "CDD(Controlled Deceleration for Driver Assistance System) is available";
CM_ SG_ 325 AWBAvailable_0x145 "AWB(Automatic Warning Brake) is available";
CM_ SG_ 325 AWBActv_0x145 "AWB(Automatic Warning Brake) is active";
CM_ SG_ 325 HDCFault_0x145 "HDC Fault";
CM_ SG_ 325 HDCCtrl_0x145 "HDC control(OffOn, not active brakingOn, active braking)";
CM_ SG_ 325 AVHErrSts_0x145 "error status of AVH(Automatic Vehicle Hold) function";
CM_ SG_ 325 AVHSts_0x145 "indicates the status of AVH(Automatic Vehicle Hold)";
CM_ SG_ 325 CDPActv_0x145 "CDP(Controlled Deceleration for Parking Brake) is active";
CM_ SG_ 325 DrivingModDis "ESP send the ack of the driver mode request signal";
CM_ SG_ 325 DrivingModReq_ESP "ESP send the driver mode request signal2.this signal is used for the function of All-Terrain Control . However this function is optional . When non-All-Terrain Control , this signal will be transmitted with the coding of \"0x1:standard\".";
CM_ SG_ 325 TAB_Available "Indicates that TAB is available";
CM_ SG_ 325 TAB_Sts "TAB control status";
CM_ SG_ 325 RollingCounter_ESP2_0x145 "Rolling Counter_ESP2";
CM_ SG_ 325 MAC_Check_ESP2 "MAC protection mechanism should comply with the GWM MAC Specificatio";
CM_ SG_ 311 CheckSum_ESP2_0x137 "Use the checksum strategy from document â€œEnd-to-End Communication Protection Specificationâ€";
CM_ SG_ 311 BrkDskOvrheatd_0x137 "Indicating brake disk temperature too high or not.";
CM_ SG_ 311 NoBrkForce_0x137 "No brake pressure applied; generally it regards wheel cylinder presure.";
CM_ SG_ 311 VehStandstill_0x137 "indicating whether the vehicle is standstill or not;
must not be set until standstill is surely reached.";
CM_ SG_ 311 AEBIBActv_0x137 "AEB IB is active (in deceleration)";
CM_ SG_ 311 AEBBAActv_0x137 "AEB BA is active (in deceleration)";
CM_ SG_ 311 AEBAvailable_0x137 "Automatic Emergency Brake is available";
CM_ SG_ 311 ABPAvailable_0x137 "Automatic Brake Prefill is available";
CM_ SG_ 311 ABPActv_0x137 "Automatic Brake Prefill is active";
CM_ SG_ 311 ABAavailable_0x137 "the Automatic Brake Assist function is available";
CM_ SG_ 311 ABAActv_0x137 "adaptive brake assistance is active";
CM_ SG_ 311 HDCFault_0x137 "Hill Descent Control Fault";
CM_ SG_ 311 HDCCtrl_0x137 "Hill Descent Control state";
CM_ SG_ 311 CDDActv_0x137 "Controlled Deceleration for Driver Assistance Systemâ€”Smart is active";
CM_ SG_ 311 CDDAvailable_0x137 "The Controlled Deceleration for Driver Assistance Systemâ€”Smart function is available";
CM_ SG_ 311 AWBAvailable_0x137 "Automatic Warning Brake is available";
CM_ SG_ 311 AWBActv_0x137 "Automatic Warning Brake is active";
CM_ SG_ 311 AVHErrSts_0x137 "error status of Automatic Vehicle Hold function";
CM_ SG_ 311 AVHSts_0x137 "indicates the status of Automatic Vehicle Hold(off,intervention,standby)";
CM_ SG_ 311 CDPActv_0x137 "Controlled Deceleration for Parking Brake";
CM_ SG_ 311 RollingCounter_ESP2_0x137 "Rolling Counter";
CM_ SG_ 311 CheckSum_ESP1_0x137 "Use the checksum strategy from document â€œEnd-to-End Communication Protection Specificationâ€";
CM_ SG_ 311 ESPFuncOffSts_0x137 "ESP Function Off Stateï¼Œ when it is 1, ESP off switch is pressed, and ESP function is offï¼ŒESP Off lamp lights on. When it is 0,ESP off switch is released, and ESP function is ON, ESP Off lamp lights off.";
CM_ SG_ 311 ESPActvInfoLmp_0x137 "Info lamp - Indication that ESP system currently performs a brakeengine intervention";
CM_ SG_ 311 ESPBrkLmpCtrl_0x137 "Brake lamp(onoff),come from ESP,HDC,CDP,EPB,AEB,CDD,AVHfunction";
CM_ SG_ 311 ESPFailSts_0x137 "ESP fault";
CM_ SG_ 311 ESP_MasterCylBrkPressVld_0x137 "ESP_MasterCylinderBrakePressureValid";
CM_ SG_ 311 MSRActv_0x137 "indicating motor control slide retainerï¼ˆDTCï¼‰ in active control or not.";
CM_ SG_ 311 VDCActv_0x137 "Vehicle dynamic control active";
CM_ SG_ 311 PTCActv_0x137 "Powertrain Controller Active";
CM_ SG_ 311 BTCActv_0x137 "Brake torque  Control active";
CM_ SG_ 311 ESP_MasterCylBrkPress_0x137 "ESP_MasterCylinderBrakePressure";
CM_ SG_ 311 RollingCounter_ESP1_0x137 "Rolling Counter";
CM_ SG_ 311 CheckSum_ABS3_0x137 "Use the checksum strategy from document â€œEnd-to-End Communication Protection Specificationâ€";
CM_ SG_ 311 ABSFailSts_0x137 "ABS system has detected a failure which does no allow a reliable ABS regulation and is therefore switched off";
CM_ SG_ 311 EBDFailSts_0x137 "ESP system has detected a failure which does no allow a reliable ESP regulation and is therefore";
CM_ SG_ 311 VehSpdVld_0x137 "Qualityfault information to current Vehicle speed
information. Refer to the \"Veh speed cal\" tab for detail.";
CM_ SG_ 311 VehSpd_0x137 "Current Vehicle speed information
(when v < 0.1 kph, set value to 0.) refer to \"Veh speed cal\" tab for detail.";
CM_ SG_ 311 EBDActv_0x137 "Indication that ESP system(especially ABS Module) currently performs a brake intervention. Set when EBD active.";
CM_ SG_ 311 ABSActv_0x137 "Indication that ESP system(especially ABS Module) currently performs a brake intervention. Set when ABS Active.";
CM_ SG_ 311 VehOdoInfoSts_0x137 "Vehicle odograph information Status";
CM_ SG_ 311 VehOdoInfo_0x137 "Vehicle odograph information";
CM_ SG_ 311 RollingCounter_ABS3_0x137 "Rolling Counter";
CM_ SG_ 311 MAC_Check_ESP_FD2 "MAC protection mechanism should comply with the GWM MAC Specificatio";
CM_ SG_ 368 CCO_Active "Indicates that CCO is active (CCO standby or active velocity control)";
CM_ SG_ 368 CCO_TgtVel "The target velocity of CCO function.";
CM_ SG_ 368 CCO_Warn "Indicate that the driver should release EPB or slow down";
CM_ SG_ 368 EspFuncOffSts_mode "When it is1 , ESP off switch is pressed, and ESP function(TCSVDCDTCRMI) is offï¼ŒESP off lamp lights onï¼Œand display Cross-country expert mode in the IP
When it is 0,ESP off switch is released, and ESP function is ON, ESP Off lamp lights off.";
CM_ SG_ 338 RearELDLckSts "ELD Rear ELock Status";
BA_DEF_ BO_  "DiagRequest" ENUM  "No","Yes";
BA_DEF_ BO_  "DiagResponse" ENUM  "No","Yes";
BA_DEF_ BO_  "DiagState" ENUM  "No","Yes";
BA_DEF_ BO_  "GenMsgCycleTime" INT 0 65535;
BA_DEF_ BO_  "GenMsgCycleTimeFast" INT 0 65535;
BA_DEF_ BO_  "GenMsgILSupport" ENUM  "No","Yes";
BA_DEF_ BO_  "GenMsgNrOfRepetition" INT 0 65535;
BA_DEF_ BO_  "GenMsgSendType" ENUM  "Cyclic","CyclicAndSpontanX","Event";
BA_DEF_ BO_  "NmAsrMessage" ENUM  "No","Yes";
BA_DEF_ BO_  "SCP_AuthInfoTxLength" INT 0 512;
BA_DEF_ BO_  "SCP_DataId" INT 0 65535;
BA_DEF_ BO_  "SCP_FreshnessValueLength" INT 0 512;
BA_DEF_ BO_  "SCP_FreshnessValueTxLength" INT 0 512;
BA_DEF_ BO_  "SC_Message" ENUM  "NO","YES";
BA_DEF_ BO_  "VFrameFormat" ENUM  "StandardCAN","ExtendedCAN","reserved","reserved","reserved","reserved","reserved","reserved","reserved","reserved","reserved","reserved","reserved","reserved","StandardCAN_FD","ExtendedCAN_FD";
BA_DEF_ SG_  "GenSigCycleTime" INT 0 65535;
BA_DEF_ SG_  "GenSigSendType" ENUM  "Cyclic","OnWrite","OnWriteWithRepetition","OnChange","OnChangeWithRepetition","NotUsed","NotUsed","NoSigSendType";
BA_DEF_ SG_  "GenSigStartValue" FLOAT 0 100000000000;
BA_DEF_ SG_  "TransparentInitValue" STRING ;
BA_DEF_ SG_  "SystemSignalLongSymbol" STRING ;
BA_DEF_DEF_  "DiagRequest" "No";
BA_DEF_DEF_  "DiagResponse" "No";
BA_DEF_DEF_  "DiagState" "No";
BA_DEF_DEF_  "GenMsgCycleTime" 0;
BA_DEF_DEF_  "GenMsgCycleTimeFast" 0;
BA_DEF_DEF_  "GenMsgILSupport" "No";
BA_DEF_DEF_  "GenMsgNrOfRepetition" 0;
BA_DEF_DEF_  "GenMsgSendType" "Cyclic";
BA_DEF_DEF_  "NmAsrMessage" "No";
BA_DEF_DEF_  "SCP_AuthInfoTxLength" 0;
BA_DEF_DEF_  "SCP_DataId" 0;
BA_DEF_DEF_  "SCP_FreshnessValueLength" 0;
BA_DEF_DEF_  "SCP_FreshnessValueTxLength" 0;
BA_DEF_DEF_  "SC_Message" "NO";
BA_DEF_DEF_  "VFrameFormat" "";
BA_DEF_DEF_  "GenSigCycleTime" 0;
BA_DEF_DEF_  "GenSigSendType" "Cyclic";
BA_DEF_DEF_  "GenSigStartValue" 0;
BA_DEF_DEF_  "TransparentInitValue" "";
BA_DEF_DEF_  "SystemSignalLongSymbol" "";
BA_ "SC_Message" BO_ 51 1;
BA_ "SCP_FreshnessValueTxLength" BO_ 51 16;
BA_ "SCP_FreshnessValueLength" BO_ 51 64;
BA_ "SCP_DataId" BO_ 51 51;
BA_ "SCP_AuthInfoTxLength" BO_ 51 48;
BA_ "GenMsgSendType" BO_ 51 2;
BA_ "GenMsgNrOfRepetition" BO_ 51 5;
BA_ "GenMsgILSupport" BO_ 51 1;
BA_ "GenMsgCycleTimeFast" BO_ 51 20;
BA_ "VFrameFormat" BO_ 51 14;
BA_ "GenMsgSendType" BO_ 54 2;
BA_ "GenMsgNrOfRepetition" BO_ 54 5;
BA_ "GenMsgILSupport" BO_ 54 1;
BA_ "GenMsgCycleTimeFast" BO_ 54 20;
BA_ "VFrameFormat" BO_ 54 14;
BA_ "SC_Message" BO_ 1001 1;
BA_ "SCP_FreshnessValueTxLength" BO_ 1001 16;
BA_ "SCP_FreshnessValueLength" BO_ 1001 64;
BA_ "SCP_DataId" BO_ 1001 1001;
BA_ "SCP_AuthInfoTxLength" BO_ 1001 48;
BA_ "GenMsgILSupport" BO_ 1001 1;
BA_ "GenMsgCycleTime" BO_ 1001 1000;
BA_ "VFrameFormat" BO_ 1001 14;
BA_ "GenMsgSendType" BO_ 481 2;
BA_ "GenMsgNrOfRepetition" BO_ 481 5;
BA_ "GenMsgILSupport" BO_ 481 1;
BA_ "GenMsgCycleTimeFast" BO_ 481 20;
BA_ "VFrameFormat" BO_ 481 14;
BA_ "GenMsgSendType" BO_ 72 2;
BA_ "GenMsgNrOfRepetition" BO_ 72 5;
BA_ "GenMsgILSupport" BO_ 72 1;
BA_ "GenMsgCycleTimeFast" BO_ 72 20;
BA_ "VFrameFormat" BO_ 72 14;
BA_ "GenMsgSendType" BO_ 829 2;
BA_ "GenMsgNrOfRepetition" BO_ 829 5;
BA_ "GenMsgILSupport" BO_ 829 1;
BA_ "GenMsgCycleTimeFast" BO_ 829 20;
BA_ "VFrameFormat" BO_ 829 14;
BA_ "GenMsgILSupport" BO_ 748 1;
BA_ "GenMsgCycleTime" BO_ 748 100;
BA_ "VFrameFormat" BO_ 748 14;
BA_ "GenMsgILSupport" BO_ 680 1;
BA_ "GenMsgCycleTime" BO_ 680 100;
BA_ "VFrameFormat" BO_ 680 14;
BA_ "GenMsgILSupport" BO_ 699 1;
BA_ "GenMsgCycleTime" BO_ 699 100;
BA_ "VFrameFormat" BO_ 699 14;
BA_ "GenMsgILSupport" BO_ 367 1;
BA_ "GenMsgCycleTime" BO_ 367 20;
BA_ "VFrameFormat" BO_ 367 14;
BA_ "SC_Message" BO_ 573 1;
BA_ "SCP_FreshnessValueTxLength" BO_ 573 16;
BA_ "SCP_FreshnessValueLength" BO_ 573 64;
BA_ "SCP_DataId" BO_ 573 573;
BA_ "SCP_AuthInfoTxLength" BO_ 573 48;
BA_ "GenMsgILSupport" BO_ 573 1;
BA_ "GenMsgCycleTime" BO_ 573 50;
BA_ "VFrameFormat" BO_ 573 14;
BA_ "GenMsgILSupport" BO_ 719 1;
BA_ "GenMsgCycleTime" BO_ 719 100;
BA_ "VFrameFormat" BO_ 719 14;
BA_ "SC_Message" BO_ 683 1;
BA_ "SCP_FreshnessValueTxLength" BO_ 683 16;
BA_ "SCP_FreshnessValueLength" BO_ 683 64;
BA_ "SCP_DataId" BO_ 683 683;
BA_ "SCP_AuthInfoTxLength" BO_ 683 48;
BA_ "GenMsgILSupport" BO_ 683 1;
BA_ "GenMsgCycleTime" BO_ 683 100;
BA_ "VFrameFormat" BO_ 683 14;
BA_ "GenMsgILSupport" BO_ 696 1;
BA_ "GenMsgCycleTime" BO_ 696 100;
BA_ "VFrameFormat" BO_ 696 14;
BA_ "GenMsgILSupport" BO_ 395 1;
BA_ "GenMsgCycleTime" BO_ 395 20;
BA_ "VFrameFormat" BO_ 395 14;
BA_ "SC_Message" BO_ 551 1;
BA_ "SCP_FreshnessValueTxLength" BO_ 551 16;
BA_ "SCP_FreshnessValueLength" BO_ 551 64;
BA_ "SCP_DataId" BO_ 551 551;
BA_ "SCP_AuthInfoTxLength" BO_ 551 48;
BA_ "GenMsgILSupport" BO_ 551 1;
BA_ "GenMsgCycleTime" BO_ 551 50;
BA_ "VFrameFormat" BO_ 551 14;
BA_ "GenMsgILSupport" BO_ 273 1;
BA_ "GenMsgCycleTime" BO_ 273 10;
BA_ "VFrameFormat" BO_ 273 14;
BA_ "GenMsgILSupport" BO_ 258 1;
BA_ "GenMsgCycleTime" BO_ 258 20;
BA_ "VFrameFormat" BO_ 258 14;
BA_ "GenMsgILSupport" BO_ 313 1;
BA_ "GenMsgCycleTime" BO_ 313 20;
BA_ "VFrameFormat" BO_ 313 14;
BA_ "GenMsgILSupport" BO_ 723 1;
BA_ "GenMsgCycleTime" BO_ 723 100;
BA_ "VFrameFormat" BO_ 723 14;
BA_ "GenMsgILSupport" BO_ 625 1;
BA_ "GenMsgCycleTime" BO_ 625 20;
BA_ "VFrameFormat" BO_ 625 14;
BA_ "GenMsgILSupport" BO_ 881 1;
BA_ "GenMsgCycleTime" BO_ 881 100;
BA_ "VFrameFormat" BO_ 881 14;
BA_ "GenMsgILSupport" BO_ 130 1;
BA_ "GenMsgCycleTime" BO_ 130 10;
BA_ "VFrameFormat" BO_ 130 14;
BA_ "GenMsgILSupport" BO_ 132 1;
BA_ "GenMsgCycleTime" BO_ 132 10;
BA_ "VFrameFormat" BO_ 132 14;
BA_ "GenMsgILSupport" BO_ 134 1;
BA_ "GenMsgCycleTime" BO_ 134 10;
BA_ "VFrameFormat" BO_ 134 14;
BA_ "GenMsgILSupport" BO_ 949 1;
BA_ "GenMsgCycleTime" BO_ 949 1000;
BA_ "VFrameFormat" BO_ 949 14;
BA_ "GenMsgILSupport" BO_ 951 1;
BA_ "GenMsgCycleTime" BO_ 951 1000;
BA_ "VFrameFormat" BO_ 951 14;
BA_ "GenMsgILSupport" BO_ 166 1;
BA_ "GenMsgCycleTime" BO_ 166 10;
BA_ "VFrameFormat" BO_ 166 14;
BA_ "GenMsgILSupport" BO_ 545 1;
BA_ "GenMsgCycleTime" BO_ 545 20;
BA_ "VFrameFormat" BO_ 545 14;
BA_ "SC_Message" BO_ 565 1;
BA_ "SCP_FreshnessValueTxLength" BO_ 565 16;
BA_ "SCP_FreshnessValueLength" BO_ 565 64;
BA_ "SCP_DataId" BO_ 565 565;
BA_ "SCP_AuthInfoTxLength" BO_ 565 48;
BA_ "GenMsgILSupport" BO_ 565 1;
BA_ "GenMsgCycleTime" BO_ 565 50;
BA_ "VFrameFormat" BO_ 565 14;
BA_ "GenMsgILSupport" BO_ 561 1;
BA_ "GenMsgCycleTime" BO_ 561 20;
BA_ "VFrameFormat" BO_ 561 14;
BA_ "GenMsgILSupport" BO_ 582 1;
BA_ "GenMsgCycleTime" BO_ 582 20;
BA_ "VFrameFormat" BO_ 582 14;
BA_ "GenMsgILSupport" BO_ 613 1;
BA_ "GenMsgCycleTime" BO_ 613 20;
BA_ "VFrameFormat" BO_ 613 14;
BA_ "GenMsgILSupport" BO_ 363 1;
BA_ "GenMsgCycleTime" BO_ 363 20;
BA_ "VFrameFormat" BO_ 363 14;
BA_ "SC_Message" BO_ 329 1;
BA_ "SCP_FreshnessValueTxLength" BO_ 329 16;
BA_ "SCP_FreshnessValueLength" BO_ 329 64;
BA_ "SCP_DataId" BO_ 329 329;
BA_ "SCP_AuthInfoTxLength" BO_ 329 48;
BA_ "GenMsgILSupport" BO_ 329 1;
BA_ "GenMsgCycleTime" BO_ 329 20;
BA_ "VFrameFormat" BO_ 329 14;
BA_ "SC_Message" BO_ 325 1;
BA_ "SCP_FreshnessValueTxLength" BO_ 325 16;
BA_ "SCP_FreshnessValueLength" BO_ 325 64;
BA_ "SCP_DataId" BO_ 325 325;
BA_ "SCP_AuthInfoTxLength" BO_ 325 48;
BA_ "GenMsgILSupport" BO_ 325 1;
BA_ "GenMsgCycleTime" BO_ 325 20;
BA_ "VFrameFormat" BO_ 325 14;
BA_ "SC_Message" BO_ 311 1;
BA_ "SCP_FreshnessValueTxLength" BO_ 311 16;
BA_ "SCP_FreshnessValueLength" BO_ 311 64;
BA_ "SCP_DataId" BO_ 311 311;
BA_ "SCP_AuthInfoTxLength" BO_ 311 48;
BA_ "GenMsgILSupport" BO_ 311 1;
BA_ "GenMsgCycleTime" BO_ 311 20;
BA_ "VFrameFormat" BO_ 311 14;
BA_ "GenMsgILSupport" BO_ 368 1;
BA_ "GenMsgCycleTime" BO_ 368 20;
BA_ "VFrameFormat" BO_ 368 14;
BA_ "GenMsgILSupport" BO_ 338 1;
BA_ "GenMsgCycleTime" BO_ 338 20;
BA_ "VFrameFormat" BO_ 338 14;
BA_ "GenSigSendType" SG_ 51 T_Box_RemtWinCtrl 2;
BA_ "GenSigSendType" SG_ 51 T_Box_RemtTrunkCtrl 2;
BA_ "GenSigSendType" SG_ 51 T_Box_RemtDoorLockCtrl 2;
BA_ "GenSigSendType" SG_ 51 T_Box_AudioMuteReq 2;
BA_ "GenSigSendType" SG_ 51 T_Box_RemtDrvTempSet 2;
BA_ "GenSigSendType" SG_ 51 T_Box_RemtAutoCtrl 2;
BA_ "GenSigSendType" SG_ 51 T_Box_RemtPassTempSet 2;
BA_ "GenSigSendType" SG_ 51 T_Box_RemtSsCtrl 2;
BA_ "GenSigSendType" SG_ 51 T_Box_RemtSrCtrl 2;
BA_ "GenSigSendType" SG_ 51 T_Box_RemtDrvSeatVentnLvlSet 2;
BA_ "GenSigSendType" SG_ 51 T_Box_RemtPassSeatVentnLvlSet 2;
BA_ "GenSigSendType" SG_ 51 T_Box_RemtAIUReq 2;
BA_ "GenSigStartValue" SG_ 51 T_Box_PM25AirQLvl 7;
BA_ "GenSigSendType" SG_ 51 T_Box_PM25AirQLvl 2;
BA_ "GenSigSendType" SG_ 51 T_Box_RemtCarSearch 2;
BA_ "GenSigSendType" SG_ 51 T_Box_RemtEngCtrl 2;
BA_ "GenSigSendType" SG_ 51 T_Box_RemtDrvSeatHeatgLvlSet 2;
BA_ "GenSigSendType" SG_ 51 T_Box_RemtPassSeatHeatgLvlSet 2;
BA_ "GenSigStartValue" SG_ 51 T_Box_PM25_Dens 1023;
BA_ "GenSigSendType" SG_ 51 T_Box_PM25_Dens 2;
BA_ "GenSigSendType" SG_ 51 FreshnessValue_T_Box_FD1 2;
BA_ "GenSigSendType" SG_ 51 MAC_Check_T_Box_FD1 2;
BA_ "TransparentInitValue" SG_ 51 T_Box_FD1_0x33 "0 0 0 0 0 7 3 255 0 0 0 0 0 0 0 0 ";
BA_ "GenSigSendType" SG_ 51 T_Box_FD1_0x33 2;
BA_ "GenSigSendType" SG_ 54 T_Box_PEPSAuth1 2;
BA_ "GenSigCycleTime" SG_ 1001 T_Box_SWUpdSts 1000;
BA_ "GenSigCycleTime" SG_ 1001 T_Box_SysErrSts 1000;
BA_ "GenSigCycleTime" SG_ 1001 FreshnessValue_T_Box_FD3 1000;
BA_ "GenSigCycleTime" SG_ 1001 MAC_Check_T_Box_FD3 1000;
BA_ "TransparentInitValue" SG_ 1001 T_Box_FD3_0x3E9 "0 0 0 0 0 0 0 0 0 0 0 0 0 0 0 0 ";
BA_ "GenSigCycleTime" SG_ 1001 T_Box_FD3_0x3E9 1000;
BA_ "GenSigSendType" SG_ 481 T_Box_BMSReMtPreHeatT 2;
BA_ "GenSigSendType" SG_ 481 Phone_ChrgnMode 2;
BA_ "GenSigSendType" SG_ 481 T_Box_IntelEngIdlChrgnSwt 2;
BA_ "GenSigSendType" SG_ 481 T_Box_BattKeepTemp 2;
BA_ "GenSigSendType" SG_ 481 T_Box_RemtFrntDefrostCtrl 2;
BA_ "GenSigSendType" SG_ 481 Phone_BattSOCLim 2;
BA_ "GenSigSendType" SG_ 481 T_Box_RemtRearDefrostCtrl 2;
BA_ "GenSigSendType" SG_ 481 RemUpgrdModeCmd 2;
BA_ "GenSigSendType" SG_ 481 T_Box_RemtVideoMonrEnaReq_APP 2;
BA_ "GenSigSendType" SG_ 481 T_Box_BMSReMtPreHeatReq 2;
BA_ "GenSigSendType" SG_ 481 T_Box_RemtCockpitClnReq 2;
BA_ "GenSigStartValue" SG_ 481 T_Box_RemtSdlMod 3;
BA_ "GenSigSendType" SG_ 481 T_Box_RemtSdlMod 2;
BA_ "TransparentInitValue" SG_ 481 T_Box_FD4_0x1E1 "0 0 0 0 0 0 192 0 0 0 0 0 0 0 0 0 ";
BA_ "GenSigSendType" SG_ 481 T_Box_FD4_0x1E1 2;
BA_ "GenSigSendType" SG_ 72 T_Box_PEPSAuth2 2;
BA_ "GenSigSendType" SG_ 829 T_BOX_RemtLimitStart 2;
BA_ "TransparentInitValue" SG_ 829 T_Box_FD6_0x33D "0 0 0 0 0 0 0 0 ";
BA_ "GenSigSendType" SG_ 829 T_Box_FD6_0x33D 2;
BA_ "GenSigCycleTime" SG_ 748 DVRRemtCnSts 100;
BA_ "GenSigCycleTime" SG_ 748 DVR_360VideoCaptureReq 100;
BA_ "GenSigCycleTime" SG_ 748 DVRSN 100;
BA_ "TransparentInitValue" SG_ 748 DVR_FD1_0x2EC "0 0 0 0 0 0 0 0 0 0 0 0 0 0 0 0 0 0 0 0 0 0 0 0 0 0 0 0 0 0 0 0 0 0 0 0 0 0 0 0 0 0 0 0 0 0 0 0 0 0 0 0 0 0 0 0 0 0 0 0 0 0 0 0 ";
BA_ "GenSigCycleTime" SG_ 748 DVR_FD1_0x2EC 100;
BA_ "GenSigCycleTime" SG_ 680 TranPMode_Sts 100;
BA_ "GenSigCycleTime" SG_ 680 Stat_PwrSv_Lvl 100;
BA_ "GenSigCycleTime" SG_ 680 DeepSlpCmd 100;
BA_ "GenSigCycleTime" SG_ 680 Dyn_PwrSv_Lvl 100;
BA_ "GenSigCycleTime" SG_ 680 LvPwrSysErr 100;
BA_ "GenSigCycleTime" SG_ 680 LimitStartSts 100;
BA_ "TransparentInitValue" SG_ 680 EEM1_0x2A8 "0 0 0 0 0 0 0 0 ";
BA_ "GenSigCycleTime" SG_ 680 EEM1_0x2A8 100;
BA_ "GenSigStartValue" SG_ 699 U_BATT 16383;
BA_ "GenSigCycleTime" SG_ 699 U_BATT 100;
BA_ "GenSigStartValue" SG_ 699 I_RANGE 3;
BA_ "GenSigCycleTime" SG_ 699 I_RANGE 100;
BA_ "GenSigStartValue" SG_ 699 I_BATT 65535;
BA_ "GenSigCycleTime" SG_ 699 I_BATT 100;
BA_ "GenSigStartValue" SG_ 699 SOC 255;
BA_ "GenSigCycleTime" SG_ 699 SOC 100;
BA_ "GenSigStartValue" SG_ 699 SOH_SUL 255;
BA_ "GenSigCycleTime" SG_ 699 SOH_SUL 100;
BA_ "GenSigStartValue" SG_ 699 SOC_STATE 3;
BA_ "GenSigCycleTime" SG_ 699 SOC_STATE 100;
BA_ "GenSigStartValue" SG_ 699 SOH_SUL_STATE 3;
BA_ "GenSigCycleTime" SG_ 699 SOH_SUL_STATE 100;
BA_ "TransparentInitValue" SG_ 699 GW_FD1_0x2BB "0 0 0 0 0 0 0 0 255 255 255 255 0 0 0 0 255 255 0 0 0 0 240 0 0 0 0 0 0 0 0 0 0 0 0 0 0 0 0 0 0 0 0 0 0 0 0 0 0 0 0 0 0 0 0 0 0 0 0 0 0 0 0 0 ";
BA_ "GenSigCycleTime" SG_ 699 GW_FD1_0x2BB 100;
BA_ "GenSigCycleTime" SG_ 367 RSDS_IPSoundReq 20;
BA_ "GenSigCycleTime" SG_ 367 BSD_LCA_warningReqRight 20;
BA_ "GenSigCycleTime" SG_ 367 BSD_LCA_warningReqleft 20;
BA_ "GenSigCycleTime" SG_ 367 DOW_warningReqRight 20;
BA_ "GenSigCycleTime" SG_ 367 DOW_warningReqleft 20;
BA_ "GenSigCycleTime" SG_ 367 RSDS_ErrSts 20;
BA_ "GenSigCycleTime" SG_ 367 RSDS_BrkgTrig 20;
BA_ "GenSigCycleTime" SG_ 367 RSDS_BliSts 20;
BA_ "GenSigCycleTime" SG_ 367 RSDS_TrailerSts 20;
BA_ "GenSigCycleTime" SG_ 367 RSDS_LCAResp 20;
BA_ "GenSigCycleTime" SG_ 367 RSDS_DOWResp 20;
BA_ "GenSigCycleTime" SG_ 367 RSDS_RCWResp 20;
BA_ "GenSigCycleTime" SG_ 367 RSDS_RCTAResp 20;
BA_ "GenSigCycleTime" SG_ 367 RSDS_RCTABrkResp 20;
BA_ "GenSigCycleTime" SG_ 367 RSDS_RCW_Trigger 20;
BA_ "GenSigCycleTime" SG_ 367 RSDS_CTA_Actv 20;
BA_ "GenSigCycleTime" SG_ 367 RCTA_warningReqRight 20;
BA_ "GenSigCycleTime" SG_ 367 RCTA_warningReqLeft 20;
BA_ "TransparentInitValue" SG_ 367 RSDS_FD1_0x16F "0 0 0 0 0 0 0 0 0 0 0 0 0 0 0 0 0 0 0 0 0 0 0 0 0 0 0 0 0 0 0 0 0 0 0 0 0 0 0 0 0 0 0 0 0 0 0 0 0 0 0 0 0 0 0 0 0 0 0 0 0 0 0 0 ";
BA_ "GenSigCycleTime" SG_ 367 RSDS_FD1_0x16F 20;
BA_ "GenSigCycleTime" SG_ 573 Checksum_IFC3 50;
BA_ "GenSigCycleTime" SG_ 573 LDWResp 50;
BA_ "GenSigCycleTime" SG_ 573 LKAResp 50;
BA_ "GenSigCycleTime" SG_ 573 LCKResp 50;
BA_ "GenSigCycleTime" SG_ 573 AESResp 50;
BA_ "GenSigCycleTime" SG_ 573 ELKResp 50;
BA_ "GenSigCycleTime" SG_ 573 LDW_LKA_Snvty 50;
BA_ "GenSigCycleTime" SG_ 573 IFCHUTInterface 50;
BA_ "GenSigCycleTime" SG_ 573 LSSWarnFormResp 50;
BA_ "GenSigCycleTime" SG_ 573 LSSResp 50;
BA_ "GenSigCycleTime" SG_ 573 IntelligentEvaResp 50;
BA_ "GenSigCycleTime" SG_ 573 ESS_Pedresp 50;
BA_ "GenSigCycleTime" SG_ 573 ESS_Vehresp 50;
BA_ "GenSigCycleTime" SG_ 573 AESSts 50;
BA_ "GenSigCycleTime" SG_ 573 ESSSts 50;
BA_ "GenSigCycleTime" SG_ 573 AESErrSts 50;
BA_ "GenSigCycleTime" SG_ 573 ESSErrSts 50;
BA_ "GenSigCycleTime" SG_ 573 RollingCounter_IFC3 50;
BA_ "GenSigCycleTime" SG_ 573 Checksum_IFC4 50;
BA_ "GenSigCycleTime" SG_ 573 IFCCalibrationSts 50;
BA_ "GenSigCycleTime" SG_ 573 CameraBlockageSts 50;
BA_ "GenSigCycleTime" SG_ 573 LDW_LKAWarn 50;
BA_ "GenSigCycleTime" SG_ 573 LSSIntervention 50;
BA_ "GenSigCycleTime" SG_ 573 LSSFuncSts 50;
BA_ "GenSigCycleTime" SG_ 573 ELKMainState 50;
BA_ "GenSigCycleTime" SG_ 573 LaneAvailability 50;
BA_ "GenSigCycleTime" SG_ 573 TJA_FollowSts 50;
BA_ "GenSigCycleTime" SG_ 573 LSSErrSts 50;
BA_ "GenSigCycleTime" SG_ 573 IFC_Handsoffwarn 50;
BA_ "GenSigCycleTime" SG_ 573 ELKActSts 50;
BA_ "GenSigCycleTime" SG_ 573 IntelligentEvaActSts 50;
BA_ "GenSigCycleTime" SG_ 573 LCKStsIndcr 50;
BA_ "GenSigCycleTime" SG_ 573 AESintervention 50;
BA_ "GenSigCycleTime" SG_ 573 ESSintervention 50;
BA_ "GenSigCycleTime" SG_ 573 RollingCounter_IFC4 50;
BA_ "GenSigCycleTime" SG_ 573 Checksum_IFC5 50;
BA_ "GenSigStartValue" SG_ 573 IFC_LaneCurve 2047;
BA_ "GenSigCycleTime" SG_ 573 IFC_LaneCurve 50;
BA_ "GenSigCycleTime" SG_ 573 IFC_LeLaneTyp 50;
BA_ "GenSigCycleTime" SG_ 573 IFC_RiLaneTyp 50;
BA_ "GenSigCycleTime" SG_ 573 IFC_NextLeLaneTyp 50;
BA_ "GenSigCycleTime" SG_ 573 IFC_NextRiLaneTyp 50;
BA_ "GenSigStartValue" SG_ 573 IFC_LeLane_dy 2496;
BA_ "GenSigCycleTime" SG_ 573 IFC_LeLane_dy 50;
BA_ "GenSigStartValue" SG_ 573 IFC_RiLane_dy 2496;
BA_ "GenSigCycleTime" SG_ 573 IFC_RiLane_dy 50;
BA_ "GenSigCycleTime" SG_ 573 RollingCounter_IFC5 50;
BA_ "GenSigCycleTime" SG_ 573 Checksum_IFC6 50;
BA_ "GenSigStartValue" SG_ 573 IFC_NextLeLane_dy 2496;
BA_ "GenSigCycleTime" SG_ 573 IFC_NextLeLane_dy 50;
BA_ "GenSigStartValue" SG_ 573 IFC_NextRiLane_dy 2496;
BA_ "GenSigCycleTime" SG_ 573 IFC_NextRiLane_dy 50;
BA_ "GenSigCycleTime" SG_ 573 RollingCounter_IFC6 50;
BA_ "GenSigCycleTime" SG_ 573 FreshnessValue_IFC_FD2 50;
BA_ "GenSigCycleTime" SG_ 573 MAC_Check_IFC_FD2 50;
BA_ "TransparentInitValue" SG_ 573 IFC_FD2_0x23D "0 0 0 0 0 0 0 0 0 0 0 0 0 0 0 0 0 0 0 0 0 0 0 0 0 127 240 0 156 9 192 0 0 156 9 192 0 0 0 0 0 0 0 0 0 0 0 0 0 0 0 0 0 0 0 0 0 0 0 0 0 0 0 0 ";
BA_ "GenSigCycleTime" SG_ 573 IFC_FD2_0x23D 50;
BA_ "GenSigCycleTime" SG_ 719 TSRResp 100;
BA_ "GenSigStartValue" SG_ 719 TSRSpdLimUnit 1;
BA_ "GenSigCycleTime" SG_ 719 TSRSpdLimUnit 100;
BA_ "GenSigCycleTime" SG_ 719 TSRSpdLim 100;
BA_ "GenSigCycleTime" SG_ 719 TSRSpdLimCfdc 100;
BA_ "GenSigCycleTime" SG_ 719 TSRSts 100;
BA_ "GenSigCycleTime" SG_ 719 TSRSpdLimSts 100;
BA_ "GenSigCycleTime" SG_ 719 TSRTrfcSignValCfdc 100;
BA_ "GenSigCycleTime" SG_ 719 TSRTrfcSignVal 100;
BA_ "GenSigCycleTime" SG_ 719 TSRSpdLimWarn 100;
BA_ "GenSigCycleTime" SG_ 719 TSRWarnResp 100;
BA_ "GenSigStartValue" SG_ 719 TSR_Snvty 15;
BA_ "GenSigCycleTime" SG_ 719 TSR_Snvty 100;
BA_ "TransparentInitValue" SG_ 719 IFC_FD3_0x2CF "0 0 0 0 0 0 0 0 0 32 0 0 15 0 0 0 0 0 0 0 0 0 0 0 0 0 0 0 0 0 0 0 0 0 0 0 0 0 0 0 0 0 0 0 0 0 0 0 0 0 0 0 0 0 0 0 0 0 0 0 0 0 0 0 ";
BA_ "GenSigCycleTime" SG_ 719 IFC_FD3_0x2CF 100;
BA_ "GenSigCycleTime" SG_ 683 ACC_LeTgt_02_Dy 100;
BA_ "GenSigCycleTime" SG_ 683 ACC_LeTgt_02_Dx 100;
BA_ "GenSigCycleTime" SG_ 683 ACC_LeTgt_02_Typ 100;
BA_ "GenSigCycleTime" SG_ 683 ACC_LeTargrt_02_Detn 100;
BA_ "GenSigCycleTime" SG_ 683 ACC_RiTargrt_02_Detn 100;
BA_ "GenSigCycleTime" SG_ 683 ACC_RiTgt_02_Dy 100;
BA_ "GenSigCycleTime" SG_ 683 ACC_RiTgt_02_Dx 100;
BA_ "GenSigCycleTime" SG_ 683 ACC_RiTgt_02_Typ 100;
BA_ "GenSigCycleTime" SG_ 683 ACC_LeTgtObjBarDisp 100;
BA_ "GenSigCycleTime" SG_ 683 ACC_RiTgtObjBarDisp 100;
BA_ "GenSigCycleTime" SG_ 683 Checksum_ACC3 100;
BA_ "GenSigCycleTime" SG_ 683 ISL_Resp 100;
BA_ "GenSigCycleTime" SG_ 683 ICA_HandsOffResp 100;
BA_ "GenSigCycleTime" SG_ 683 Longctrl_VehHldReq_DVR 100;
BA_ "GenSigCycleTime" SG_ 683 Longctrl_DrvOFF_Req_DVR 100;
BA_ "GenSigCycleTime" SG_ 683 Longctrl_ModSts_DVR 100;
BA_ "GenSigCycleTime" SG_ 683 Longctrl_Decel_Req_DVR 100;
BA_ "GenSigStartValue" SG_ 683 Longctrl_EngTrqReq_DVR 32767;
BA_ "GenSigCycleTime" SG_ 683 Longctrl_EngTrqReq_DVR 100;
BA_ "GenSigCycleTime" SG_ 683 Longctrl_EngTrqReqActive_DVR 100;
BA_ "GenSigCycleTime" SG_ 683 Longctrl_DecelToStopReq_DVR 100;
BA_ "GenSigCycleTime" SG_ 683 Longctrl_ParkShiftReq_DVR 100;
BA_ "GenSigCycleTime" SG_ 683 Longctrl_Decel_ReqValue_DVR 100;
BA_ "GenSigCycleTime" SG_ 683 Longctrl_HCUTrqReqActive_DVR 100;
BA_ "GenSigCycleTime" SG_ 683 HWA_SnvtySet_Resp 100;
BA_ "GenSigCycleTime" SG_ 683 HWA_Resp 100;
BA_ "GenSigCycleTime" SG_ 683 ALC_Resp 100;
BA_ "GenSigCycleTime" SG_ 683 ALC_InterSysInfoDisp 100;
BA_ "GenSigCycleTime" SG_ 683 RollingCounter_ACC3 100;
BA_ "GenSigCycleTime" SG_ 683 Checksum_ACC4 100;
BA_ "GenSigCycleTime" SG_ 683 ACC_ObjDetecte 100;
BA_ "GenSigCycleTime" SG_ 683 ACC_TakeOverReq 100;
BA_ "GenSigCycleTime" SG_ 683 ACC_InterSysInfoDisp 100;
BA_ "GenSigCycleTime" SG_ 683 ACC_ModDisp 100;
BA_ "GenSigCycleTime" SG_ 683 ACC_FctSts 100;
BA_ "GenSigCycleTime" SG_ 683 ACC_TgtObjBarDisp 100;
BA_ "GenSigCycleTime" SG_ 683 ACC_TimeGapSet 100;
BA_ "GenSigStartValue" SG_ 683 ACC_SpdSetValue 255;
BA_ "GenSigCycleTime" SG_ 683 ACC_SpdSetValue 100;
BA_ "GenSigCycleTime" SG_ 683 Longctrl_HazActv 100;
BA_ "GenSigCycleTime" SG_ 683 TJA_ACC_SelSts 100;
BA_ "GenSigCycleTime" SG_ 683 ISL_InterSysInfoDisp 100;
BA_ "GenSigCycleTime" SG_ 683 TJA_ICA_ModDisp 100;
BA_ "GenSigCycleTime" SG_ 683 TJA_ICA_InterSysInfoDisp 100;
BA_ "GenSigCycleTime" SG_ 683 CruCha_ModDisp 100;
BA_ "GenSigCycleTime" SG_ 683 CruChar_InterSysInfoDisp 100;
BA_ "GenSigCycleTime" SG_ 683 RollingCounter_ACC4 100;
BA_ "GenSigCycleTime" SG_ 683 Checksum_ACC8 100;
BA_ "GenSigCycleTime" SG_ 683 Longctrl_HCUTrqReq_DVR 100;
BA_ "GenSigCycleTime" SG_ 683 HWA_warning 100;
BA_ "GenSigCycleTime" SG_ 683 HWA_ModDisp 100;
BA_ "GenSigCycleTime" SG_ 683 HWA_InterSysInfoDisp 100;
BA_ "GenSigCycleTime" SG_ 683 HWA_LaneChangeReq 100;
BA_ "GenSigCycleTime" SG_ 683 HWA_LaneChange 100;
BA_ "GenSigCycleTime" SG_ 683 ADAS_DriverInloop_Monitor 100;
BA_ "GenSigCycleTime" SG_ 683 RollingCounter_ACC8 100;
BA_ "GenSigCycleTime" SG_ 683 Checksum_ACC6 100;
BA_ "GenSigCycleTime" SG_ 683 ACC_PotentialTgtDy 100;
BA_ "GenSigCycleTime" SG_ 683 ACC_PotentialTgtDx 100;
BA_ "GenSigCycleTime" SG_ 683 ACC_RlvTgtDetn 100;
BA_ "GenSigCycleTime" SG_ 683 ACC_EgoStatus 100;
BA_ "GenSigCycleTime" SG_ 683 ACC_RlvTgtDy 100;
BA_ "GenSigCycleTime" SG_ 683 ACC_RlvTgtDx 100;
BA_ "GenSigCycleTime" SG_ 683 ACC_PotentialTgtDetn 100;
BA_ "GenSigCycleTime" SG_ 683 ACC_PotentialTgtTyp 100;
BA_ "GenSigCycleTime" SG_ 683 ACC_RlvTgtTyp 100;
BA_ "GenSigCycleTime" SG_ 683 RollingCounter_ACC6 100;
BA_ "GenSigCycleTime" SG_ 683 Checksum_ACC7 100;
BA_ "GenSigCycleTime" SG_ 683 ACC_LeTgtDy 100;
BA_ "GenSigCycleTime" SG_ 683 ACC_LeTgtDx 100;
BA_ "GenSigCycleTime" SG_ 683 ACC_LeTgtTyp 100;
BA_ "GenSigCycleTime" SG_ 683 ACC_LeTargrtDection 100;
BA_ "GenSigCycleTime" SG_ 683 ACC_RiTargrtDetn 100;
BA_ "GenSigCycleTime" SG_ 683 ACC_RiTgtDy 100;
BA_ "GenSigCycleTime" SG_ 683 ACC_RiTgtDx 100;
BA_ "GenSigCycleTime" SG_ 683 ACC_RiTgtTyp 100;
BA_ "GenSigCycleTime" SG_ 683 Request_driveoff 100;
BA_ "GenSigCycleTime" SG_ 683 RollingCounter_ACC7 100;
BA_ "GenSigCycleTime" SG_ 683 ACC_RlvTgtfusion 100;
BA_ "GenSigCycleTime" SG_ 683 ACC_RlvTgtHeading 100;
BA_ "GenSigCycleTime" SG_ 683 ACC_LeTgtfusion 100;
BA_ "GenSigCycleTime" SG_ 683 ACC_LeTgtHeading 100;
BA_ "GenSigCycleTime" SG_ 683 ACC_RiTgtfusion 100;
BA_ "GenSigCycleTime" SG_ 683 ACC_RiTgtHeading 100;
BA_ "GenSigCycleTime" SG_ 683 ACC_PotentialTgtfusion 100;
BA_ "GenSigCycleTime" SG_ 683 ACC_PotentialTgtHeading 100;
BA_ "GenSigCycleTime" SG_ 683 TargetCutinPro 100;
BA_ "GenSigCycleTime" SG_ 683 TargetCutoutPro 100;
BA_ "GenSigCycleTime" SG_ 683 FreshnessValue_ACC_FD2 100;
BA_ "GenSigCycleTime" SG_ 683 MAC_Check_ACC_FD2 100;
BA_ "TransparentInitValue" SG_ 683 ACC_FD2_0x2AB "0 0 0 0 0 0 0 0 0 0 0 127 255 0 0 0 0 0 0 0 0 0 255 0 0 0 0 0 0 0 0 0 0 0 0 0 0 0 0 0 0 0 0 0 0 0 0 0 0 0 0 0 0 0 0 0 0 0 0 0 0 0 0 0 ";
BA_ "GenSigCycleTime" SG_ 683 ACC_FD2_0x2AB 100;
BA_ "GenSigStartValue" SG_ 696 AEBObjID 255;
BA_ "GenSigCycleTime" SG_ 696 AEBObjID 100;
BA_ "GenSigCycleTime" SG_ 696 AEBObjExist 100;
BA_ "GenSigCycleTime" SG_ 696 AEBObjVideoCfmd 100;
BA_ "GenSigCycleTime" SG_ 696 AEBObjVx 100;
BA_ "GenSigCycleTime" SG_ 696 AEBObjDx 100;
BA_ "GenSigCycleTime" SG_ 696 AEBObjCntAlive 100;
BA_ "GenSigCycleTime" SG_ 696 AEBObjDy 100;
BA_ "GenSigCycleTime" SG_ 696 AEBObjState 100;
BA_ "GenSigCycleTime" SG_ 696 AEBObjObstcl 100;
BA_ "GenSigCycleTime" SG_ 696 AEBObjVy 100;
BA_ "GenSigCycleTime" SG_ 696 CyclistObjExist 100;
BA_ "GenSigCycleTime" SG_ 696 AEBObjAx 100;
BA_ "GenSigCycleTime" SG_ 696 AEBObjAy 100;
BA_ "GenSigCycleTime" SG_ 696 CyclistObjDx 100;
BA_ "GenSigStartValue" SG_ 696 CyclistObjID 255;
BA_ "GenSigCycleTime" SG_ 696 CyclistObjID 100;
BA_ "GenSigCycleTime" SG_ 696 CyclistObjObstcl 100;
BA_ "GenSigCycleTime" SG_ 696 CyclistObjDy 100;
BA_ "GenSigCycleTime" SG_ 696 CyclistObjVx 100;
BA_ "GenSigCycleTime" SG_ 696 CyclistObjCntAlive 100;
BA_ "GenSigCycleTime" SG_ 696 CyclistObjVy 100;
BA_ "GenSigCycleTime" SG_ 696 CyclistObjState 100;
BA_ "GenSigCycleTime" SG_ 696 CyclistObjVideoCfmd 100;
BA_ "GenSigCycleTime" SG_ 696 CyclistObjAx 100;
BA_ "GenSigCycleTime" SG_ 696 CyclistObjAy 100;
BA_ "GenSigCycleTime" SG_ 696 PedObjExist 100;
BA_ "GenSigStartValue" SG_ 696 PedObjID 255;
BA_ "GenSigCycleTime" SG_ 696 PedObjID 100;
BA_ "GenSigCycleTime" SG_ 696 PedObjObstcl 100;
BA_ "GenSigCycleTime" SG_ 696 PedObjDy 100;
BA_ "GenSigCycleTime" SG_ 696 PedObjDx 100;
BA_ "GenSigCycleTime" SG_ 696 PedObjVx 100;
BA_ "GenSigCycleTime" SG_ 696 PedObjVy 100;
BA_ "GenSigCycleTime" SG_ 696 PedObjVideoCfmd 100;
BA_ "GenSigCycleTime" SG_ 696 ACCTgtObjDx 100;
BA_ "GenSigCycleTime" SG_ 696 PedObjAy 100;
BA_ "GenSigCycleTime" SG_ 696 PedObjCntAlive 100;
BA_ "GenSigCycleTime" SG_ 696 PedObjAx 100;
BA_ "GenSigStartValue" SG_ 696 ACCTgtObjID 255;
BA_ "GenSigCycleTime" SG_ 696 ACCTgtObjID 100;
BA_ "GenSigCycleTime" SG_ 696 ACCTgtObjObstcl 100;
BA_ "GenSigCycleTime" SG_ 696 ACCTgtObjDy 100;
BA_ "GenSigCycleTime" SG_ 696 ACCTgtObjExist 100;
BA_ "GenSigCycleTime" SG_ 696 ACCTgtObjVy 100;
BA_ "GenSigCycleTime" SG_ 696 ACCTgtObjVx 100;
BA_ "GenSigCycleTime" SG_ 696 ACCTgtObjAx 100;
BA_ "GenSigCycleTime" SG_ 696 ACCTgtObjAy 100;
BA_ "GenSigCycleTime" SG_ 696 ACCTgtObjState 100;
BA_ "GenSigCycleTime" SG_ 696 ACCTgtObjVideoCfmd 100;
BA_ "GenSigCycleTime" SG_ 696 ACCTgtObjCntAlive 100;
BA_ "GenSigCycleTime" SG_ 696 RadarHorMisalign 100;
BA_ "GenSigCycleTime" SG_ 696 HandsoffDetd 100;
BA_ "GenSigCycleTime" SG_ 696 DrvgOnHiWay 100;
BA_ "GenSigStartValue" SG_ 696 RoadCrvt 511;
BA_ "GenSigCycleTime" SG_ 696 RoadCrvt 100;
BA_ "GenSigStartValue" SG_ 696 SpdLimitDst 63;
BA_ "GenSigCycleTime" SG_ 696 SpdLimitDst 100;
BA_ "GenSigStartValue" SG_ 696 RoadCrvtFar 511;
BA_ "GenSigCycleTime" SG_ 696 RoadCrvtFar 100;
BA_ "GenSigStartValue" SG_ 696 RampDst 63;
BA_ "GenSigCycleTime" SG_ 696 RampDst 100;
BA_ "GenSigStartValue" SG_ 696 SpdLimit 254;
BA_ "GenSigCycleTime" SG_ 696 SpdLimit 100;
BA_ "GenSigStartValue" SG_ 696 CurveDst 63;
BA_ "GenSigCycleTime" SG_ 696 CurveDst 100;
BA_ "GenSigCycleTime" SG_ 696 NavSpdLimUnit 100;
BA_ "GenSigStartValue" SG_ 696 TunnelDst 63;
BA_ "GenSigCycleTime" SG_ 696 TunnelDst 100;
BA_ "GenSigCycleTime" SG_ 696 DrvgOnRiLane 100;
BA_ "GenSigStartValue" SG_ 696 BrdgDst 63;
BA_ "GenSigCycleTime" SG_ 696 BrdgDst 100;
BA_ "GenSigCycleTime" SG_ 696 RadarDrvrAttentive 100;
BA_ "GenSigCycleTime" SG_ 696 ACC_DataRecReq 100;
BA_ "GenSigCycleTime" SG_ 696 ACC_SOSReq 100;
BA_ "GenSigCycleTime" SG_ 696 PedObjState 100;
BA_ "GenSigCycleTime" SG_ 696 MapDataValid 100;
BA_ "GenSigCycleTime" SG_ 696 DrvrSts 100;
BA_ "GenSigCycleTime" SG_ 696 AEBObjOverlap 100;
BA_ "GenSigCycleTime" SG_ 696 AEBObjDrvby 100;
BA_ "TransparentInitValue" SG_ 696 ACC_FD4_0x2B8 "255 0 0 0 0 0 0 0 0 0 0 0 0 0 0 255 0 0 0 0 0 0 0 0 0 0 255 0 0 0 0 0 0 0 0 0 0 0 0 255 0 0 0 0 0 0 0 0 0 0 0 0 127 255 127 255 254 252 252 252 0 0 0 0 ";
BA_ "GenSigCycleTime" SG_ 696 ACC_FD4_0x2B8 100;
BA_ "GenSigCycleTime" SG_ 395 AEB_ABA_Level 20;
BA_ "GenSigCycleTime" SG_ 395 AEB_ABA_Req 20;
BA_ "GenSigCycleTime" SG_ 395 EBA_TgtDecel_Req 20;
BA_ "GenSigCycleTime" SG_ 395 AEB_VehHldReq 20;
BA_ "GenSigCycleTime" SG_ 395 AEB_TgtDecel_Req 20;
BA_ "GenSigCycleTime" SG_ 395 AEB_TgtDecel_ReqValue 20;
BA_ "GenSigCycleTime" SG_ 395 AEB_AWB_Req 20;
BA_ "GenSigCycleTime" SG_ 395 AEB_AWB_Level 20;
BA_ "GenSigCycleTime" SG_ 395 AEB_ABP_Req 20;
BA_ "GenSigCycleTime" SG_ 395 AEB_BrkReqFunc 20;
BA_ "GenSigCycleTime" SG_ 395 AEB_ObjSty 20;
BA_ "TransparentInitValue" SG_ 395 AEB_FD1_0x18B "0 0 0 0 0 0 0 0 0 0 0 0 0 0 0 0 0 0 0 0 0 0 0 0 0 0 0 0 0 0 0 0 0 0 0 0 0 0 0 0 0 0 0 0 0 0 0 0 0 0 0 0 0 0 0 0 0 0 0 0 0 0 0 0 ";
BA_ "GenSigCycleTime" SG_ 395 AEB_FD1_0x18B 20;
BA_ "GenSigCycleTime" SG_ 551 Checksum_AEB2 50;
BA_ "GenSigStartValue" SG_ 551 AEB_PedResp 1;
BA_ "GenSigCycleTime" SG_ 551 AEB_PedResp 50;
BA_ "GenSigStartValue" SG_ 551 AEB_VehResp 1;
BA_ "GenSigCycleTime" SG_ 551 AEB_VehResp 50;
BA_ "GenSigCycleTime" SG_ 551 FCW_Snvty 50;
BA_ "GenSigStartValue" SG_ 551 AEB_JA_Resp 1;
BA_ "GenSigCycleTime" SG_ 551 AEB_JA_Resp 50;
BA_ "GenSigCycleTime" SG_ 551 RollingCounter_AEB2 50;
BA_ "GenSigCycleTime" SG_ 551 Checksum_AEB3 50;
BA_ "GenSigCycleTime" SG_ 551 AEB_VehTrig 50;
BA_ "GenSigCycleTime" SG_ 551 AEB_PedTrig 50;
BA_ "GenSigCycleTime" SG_ 551 FCW_AEB_VehFctSts 50;
BA_ "GenSigCycleTime" SG_ 551 FCW_AEB_PedFctSts 50;
BA_ "GenSigCycleTime" SG_ 551 FCW_Warn 50;
BA_ "GenSigCycleTime" SG_ 551 AEB_JAFuncSts 50;
BA_ "GenSigCycleTime" SG_ 551 AEB_JA_Warn 50;
BA_ "GenSigCycleTime" SG_ 551 AEB_JABrkTrig 50;
BA_ "GenSigCycleTime" SG_ 551 RollingCounter_AEB3 50;
BA_ "GenSigCycleTime" SG_ 551 FreshnessValue_AEB_FD2 50;
BA_ "GenSigCycleTime" SG_ 551 MAC_Check_AEB_FD2 50;
BA_ "TransparentInitValue" SG_ 551 AEB_FD2_0x227 "0 0 0 0 0 0 0 0 0 200 0 0 0 0 0 0 0 0 0 0 0 0 0 0 0 0 0 0 0 0 0 0 0 0 0 0 0 0 0 0 0 0 0 0 0 0 0 0 0 0 0 0 0 0 0 0 0 0 0 0 0 0 0 0 ";
BA_ "GenSigCycleTime" SG_ 551 AEB_FD2_0x227 50;
BA_ "GenSigCycleTime" SG_ 273 EMS_AuthenResult 10;
BA_ "GenSigCycleTime" SG_ 273 EngSpd 10;
BA_ "GenSigStartValue" SG_ 273 EngSpdVldty 2;
BA_ "GenSigCycleTime" SG_ 273 EngSpdVldty 10;
BA_ "GenSigCycleTime" SG_ 273 BrkPedalSts 10;
BA_ "TransparentInitValue" SG_ 273 ECM1_0x111 "0 0 0 0 0 0 0 128 ";
BA_ "GenSigCycleTime" SG_ 273 ECM1_0x111 10;
BA_ "GenSigCycleTime" SG_ 258 AccelPedlPosnDiagc 20;
BA_ "GenSigCycleTime" SG_ 258 AccPedalOverride 20;
BA_ "GenSigCycleTime" SG_ 258 ECMRespACC 20;
BA_ "GenSigCycleTime" SG_ 258 ECMACCInterface 20;
BA_ "TransparentInitValue" SG_ 258 ECM9_0x102 "0 0 0 0 0 0 0 0 ";
BA_ "GenSigCycleTime" SG_ 258 ECM9_0x102 20;
BA_ "GenSigCycleTime" SG_ 313 Tgtgear_Up 20;
BA_ "GenSigCycleTime" SG_ 313 Tgtgear_Down 20;
BA_ "GenSigCycleTime" SG_ 313 NeutralSts 20;
BA_ "TransparentInitValue" SG_ 313 ECM10_0x139 "0 0 0 0 0 0 0 0 ";
BA_ "GenSigCycleTime" SG_ 313 ECM10_0x139 20;
BA_ "GenSigCycleTime" SG_ 723 EngSpd_ForIP 100;
BA_ "GenSigCycleTime" SG_ 723 EWP_Err 100;
BA_ "TransparentInitValue" SG_ 723 ECM11_0x2D3 "0 0 0 0 0 0 0 0 ";
BA_ "GenSigCycleTime" SG_ 723 ECM11_0x2D3 100;
BA_ "GenSigCycleTime" SG_ 625 FuelConsumption 20;
BA_ "GenSigCycleTime" SG_ 625 TgtCrsVehSpd 20;
BA_ "GenSigCycleTime" SG_ 625 CruiseCtrlSts 20;
BA_ "GenSigStartValue" SG_ 625 AccelPedalPosnVldty 2;
BA_ "GenSigCycleTime" SG_ 625 AccelPedalPosnVldty 20;
BA_ "GenSigCycleTime" SG_ 625 EngSVSSig 20;
BA_ "GenSigCycleTime" SG_ 625 MILSts 20;
BA_ "GenSigCycleTime" SG_ 625 EngState 20;
BA_ "GenSigCycleTime" SG_ 625 AccelPedalPosn 20;
BA_ "TransparentInitValue" SG_ 625 ECM2_0x271 "0 0 0 0 0 0 4 0 ";
BA_ "GenSigCycleTime" SG_ 625 ECM2_0x271 20;
BA_ "GenSigCycleTime" SG_ 881 EngCoolantTemp 100;
BA_ "GenSigCycleTime" SG_ 881 GPF_Warning 100;
BA_ "GenSigCycleTime" SG_ 881 GentrWarnLmpSts 100;
BA_ "GenSigCycleTime" SG_ 881 EngClntTempWarn 100;
BA_ "GenSigStartValue" SG_ 881 EngClntTempVldty 2;
BA_ "GenSigCycleTime" SG_ 881 EngClntTempVldty 100;
BA_ "GenSigCycleTime" SG_ 881 SS_Screen_tip 100;
BA_ "GenSigStartValue" SG_ 881 SSSSetSts 1;
BA_ "GenSigCycleTime" SG_ 881 SSSSetSts 100;
BA_ "GenSigCycleTime" SG_ 881 SS_Enable_Lamp 100;
BA_ "GenSigCycleTime" SG_ 881 SS_Fault_Lamp 100;
BA_ "GenSigCycleTime" SG_ 881 BaroPressure 100;
BA_ "TransparentInitValue" SG_ 881 ECM3_0x371 "0 0 0 0 0 16 128 0 ";
BA_ "GenSigCycleTime" SG_ 881 ECM3_0x371 100;
BA_ "GenSigStartValue" SG_ 130 NetEngTrq 32767;
BA_ "GenSigCycleTime" SG_ 130 NetEngTrq 10;
BA_ "GenSigStartValue" SG_ 130 DrvEngTrqReq 32767;
BA_ "GenSigCycleTime" SG_ 130 DrvEngTrqReq 10;
BA_ "GenSigStartValue" SG_ 130 DrvEngTrqReqVld 1;
BA_ "GenSigCycleTime" SG_ 130 DrvEngTrqReqVld 10;
BA_ "TransparentInitValue" SG_ 130 ECM4_0x82 "0 127 255 127 255 0 0 128 ";
BA_ "GenSigCycleTime" SG_ 130 ECM4_0x82 10;
BA_ "GenSigStartValue" SG_ 132 EngTrqEstimdActGear 32767;
BA_ "GenSigCycleTime" SG_ 132 EngTrqEstimdActGear 10;
BA_ "GenSigStartValue" SG_ 132 EngTrqEstimdActGear_Qf 1;
BA_ "GenSigCycleTime" SG_ 132 EngTrqEstimdActGear_Qf 10;
BA_ "TransparentInitValue" SG_ 132 ECM7_0x84 "0 0 0 127 255 0 0 64 ";
BA_ "GenSigCycleTime" SG_ 132 ECM7_0x84 10;
BA_ "GenSigStartValue" SG_ 134 TrqLoss 32767;
BA_ "GenSigCycleTime" SG_ 134 TrqLoss 10;
BA_ "TransparentInitValue" SG_ 134 ECM8_0x86 "0 0 0 0 0 127 255 0 ";
BA_ "GenSigCycleTime" SG_ 134 ECM8_0x86 10;
BA_ "GenSigCycleTime" SG_ 949 ECM_VIN 1000;
BA_ "TransparentInitValue" SG_ 949 ECM19_0x3B5 "0 0 0 0 0 0 0 0 ";
BA_ "GenSigCycleTime" SG_ 949 ECM19_0x3B5 1000;
BA_ "GenSigCycleTime" SG_ 951 ECM_VehDstBackup 1000;
BA_ "GenSigCycleTime" SG_ 951 EngRoStrt_Failure 1000;
BA_ "TransparentInitValue" SG_ 951 ECM20_0x3B7 "0 0 0 0 0 0 0 0 ";
BA_ "GenSigCycleTime" SG_ 951 ECM20_0x3B7 1000;
BA_ "GenSigCycleTime" SG_ 166 TgtEngSpdIP 10;
BA_ "GenSigCycleTime" SG_ 166 TgtEngSpdIPValid 10;
BA_ "GenSigCycleTime" SG_ 166 TrsmTqIdle 10;
BA_ "TransparentInitValue" SG_ 166 DCT3_0xA6 "0 0 0 0 0 0 0 0 ";
BA_ "GenSigCycleTime" SG_ 166 DCT3_0xA6 10;
BA_ "GenSigCycleTime" SG_ 545 CurrentGearValid 20;
BA_ "GenSigCycleTime" SG_ 545 CURRENT_GEAR 20;
BA_ "GenSigStartValue" SG_ 545 TGS_LEVER 14;
BA_ "GenSigCycleTime" SG_ 545 TGS_LEVER 20;
BA_ "GenSigCycleTime" SG_ 545 SHIFT_IN_PROGRESS 20;
BA_ "GenSigCycleTime" SG_ 545 ShiftInPrgValid 20;
BA_ "GenSigCycleTime" SG_ 545 TargetGearValid 20;
BA_ "GenSigCycleTime" SG_ 545 TARGET_GEAR 20;
BA_ "TransparentInitValue" SG_ 545 DCT5_0x221 "0 0 0 0 0 0 14 0 ";
BA_ "GenSigCycleTime" SG_ 545 DCT5_0x221 20;
BA_ "GenSigCycleTime" SG_ 565 CheckSum_DCT7 50;
BA_ "GenSigCycleTime" SG_ 565 DCT_RaceModeSts 50;
BA_ "GenSigCycleTime" SG_ 565 DCT_PrsBrk_Warn 50;
BA_ "GenSigCycleTime" SG_ 565 DCT_ShftNotAlwd_Warn 50;
BA_ "GenSigCycleTime" SG_ 565 DCT_ShftRecom_M 50;
BA_ "GenSigCycleTime" SG_ 565 DrvWarnMsg 50;
BA_ "GenSigCycleTime" SG_ 565 DrvFaiMsg_0x235 50;
BA_ "GenSigCycleTime" SG_ 565 DrvModDisp_0x235 50;
BA_ "GenSigCycleTime" SG_ 565 DrvModDispSts_0x235 50;
BA_ "GenSigCycleTime" SG_ 565 DrvAutoGearDisp 50;
BA_ "GenSigCycleTime" SG_ 565 DrvGearDispSts_0x235 50;
BA_ "GenSigCycleTime" SG_ 565 RollingCounter_DCT7 50;
BA_ "GenSigCycleTime" SG_ 565 FreshnessValue_DCT7 50;
BA_ "GenSigCycleTime" SG_ 565 MAC_Check_DCT7 50;
BA_ "TransparentInitValue" SG_ 565 DCT7_0x235 "0 0 0 0 0 0 0 0 0 0 0 0 0 0 0 0 ";
BA_ "GenSigCycleTime" SG_ 565 DCT7_0x235 50;
BA_ "GenSigCycleTime" SG_ 561 FLWheelDriveDirection 20;
BA_ "GenSigCycleTime" SG_ 561 FLWheelSpdVld 20;
BA_ "GenSigCycleTime" SG_ 561 FLWheelSpd 20;
BA_ "GenSigCycleTime" SG_ 561 FRWheelDriveDirection 20;
BA_ "GenSigCycleTime" SG_ 561 FRWheelSpdVld 20;
BA_ "GenSigCycleTime" SG_ 561 FRWheelSpd 20;
BA_ "TransparentInitValue" SG_ 561 ABS1_0x231 "0 0 0 0 0 0 0 0 ";
BA_ "GenSigCycleTime" SG_ 561 ABS1_0x231 20;
BA_ "GenSigCycleTime" SG_ 582 RLWheelDriveDirection 20;
BA_ "GenSigCycleTime" SG_ 582 RLWheelSpdVld 20;
BA_ "GenSigCycleTime" SG_ 582 RLWheelSpd 20;
BA_ "GenSigCycleTime" SG_ 582 RRWheelDriveDirection 20;
BA_ "GenSigCycleTime" SG_ 582 RRWheelSpdVld 20;
BA_ "GenSigCycleTime" SG_ 582 RRWheelSpd 20;
BA_ "TransparentInitValue" SG_ 582 ABS2_0x246 "0 0 0 0 0 0 0 0 ";
BA_ "GenSigCycleTime" SG_ 582 ABS2_0x246 20;
BA_ "GenSigCycleTime" SG_ 613 CheckSum_ABS3_0x265 20;
BA_ "GenSigStartValue" SG_ 613 ABSFailSts_0x265 1;
BA_ "GenSigCycleTime" SG_ 613 ABSFailSts_0x265 20;
BA_ "GenSigCycleTime" SG_ 613 EBDFailSts_0x265 20;
BA_ "GenSigCycleTime" SG_ 613 VehSpdVld_0x265 20;
BA_ "GenSigCycleTime" SG_ 613 VehSpd_0x265 20;
BA_ "GenSigStartValue" SG_ 613 VehOdoInfoSts_0x265 1;
BA_ "GenSigCycleTime" SG_ 613 VehOdoInfoSts_0x265 20;
BA_ "GenSigCycleTime" SG_ 613 VehOdoInfo_0x265 20;
BA_ "GenSigCycleTime" SG_ 613 ABSActv_0x265 20;
BA_ "GenSigCycleTime" SG_ 613 EBDActv_0x265 20;
BA_ "GenSigCycleTime" SG_ 613 RollingCounter_ABS3_0x265 20;
BA_ "TransparentInitValue" SG_ 613 ABS3_0x265 "0 128 0 4 0 0 0 0 0 0 0 0 0 0 0 0 ";
BA_ "GenSigCycleTime" SG_ 613 ABS3_0x265 20;
BA_ "GenSigCycleTime" SG_ 363 CheckSum_EPB1 20;
BA_ "GenSigCycleTime" SG_ 363 PressBrakePedalPointOut 20;
BA_ "GenSigCycleTime" SG_ 363 EPBErrSts 20;
BA_ "GenSigCycleTime" SG_ 363 EPBSts 20;
BA_ "GenSigCycleTime" SG_ 363 EPBTextDisp 20;
BA_ "GenSigCycleTime" SG_ 363 EPBRedLmpSts 20;
BA_ "GenSigCycleTime" SG_ 363 RollingCounter_EPB1 20;
BA_ "TransparentInitValue" SG_ 363 EPB1_0x16B "0 0 0 0 0 0 0 0 ";
BA_ "GenSigCycleTime" SG_ 363 EPB1_0x16B 20;
BA_ "GenSigCycleTime" SG_ 329 CheckSum_ESP1_0x149 20;
BA_ "GenSigCycleTime" SG_ 329 ESPFuncOffSts_0x149 20;
BA_ "GenSigCycleTime" SG_ 329 ESPActvInfoLmp_0x149 20;
BA_ "GenSigCycleTime" SG_ 329 ESPBrkLmpCtrl_0x149 20;
BA_ "GenSigCycleTime" SG_ 329 ESPFailSts_0x149 20;
BA_ "GenSigStartValue" SG_ 329 ESP_MasterCylBrkPressVld_0x149 1;
BA_ "GenSigCycleTime" SG_ 329 ESP_MasterCylBrkPressVld_0x149 20;
BA_ "GenSigCycleTime" SG_ 329 MSRActv_0x149 20;
BA_ "GenSigCycleTime" SG_ 329 VDCActv_0x149 20;
BA_ "GenSigCycleTime" SG_ 329 PTCActv_0x149 20;
BA_ "GenSigCycleTime" SG_ 329 BTCActv_0x149 20;
BA_ "GenSigCycleTime" SG_ 329 ESP_MasterCylBrkPress_0x149 20;
BA_ "GenSigCycleTime" SG_ 329 RollingCounter_ESP1_0x149 20;
BA_ "GenSigCycleTime" SG_ 329 FreshnessValue_ESP1 20;
BA_ "GenSigCycleTime" SG_ 329 MAC_Check_ESP1 20;
BA_ "TransparentInitValue" SG_ 329 ESP1_0x149 "0 0 1 0 0 0 0 0 0 0 0 0 0 0 0 0 ";
BA_ "GenSigCycleTime" SG_ 329 ESP1_0x149 20;
BA_ "GenSigCycleTime" SG_ 325 CheckSum_ESP2_0x145 20;
BA_ "GenSigCycleTime" SG_ 325 BrkDskOvrheatd_0x145 20;
BA_ "GenSigCycleTime" SG_ 325 NoBrkForce_0x145 20;
BA_ "GenSigCycleTime" SG_ 325 VehStandstill_0x145 20;
BA_ "GenSigCycleTime" SG_ 325 AEBIBActv_0x145 20;
BA_ "GenSigCycleTime" SG_ 325 AEBBAActv_0x145 20;
BA_ "GenSigCycleTime" SG_ 325 AEBAvailable_0x145 20;
BA_ "GenSigCycleTime" SG_ 325 ABPAvailable_0x145 20;
BA_ "GenSigCycleTime" SG_ 325 ABPActv_0x145 20;
BA_ "GenSigCycleTime" SG_ 325 ABAavailable_0x145 20;
BA_ "GenSigCycleTime" SG_ 325 ABAActv_0x145 20;
BA_ "GenSigCycleTime" SG_ 325 CDDActv_0x145 20;
BA_ "GenSigCycleTime" SG_ 325 CDDAvailable_0x145 20;
BA_ "GenSigCycleTime" SG_ 325 AWBAvailable_0x145 20;
BA_ "GenSigCycleTime" SG_ 325 AWBActv_0x145 20;
BA_ "GenSigCycleTime" SG_ 325 HDCFault_0x145 20;
BA_ "GenSigCycleTime" SG_ 325 HDCCtrl_0x145 20;
BA_ "GenSigCycleTime" SG_ 325 AVHErrSts_0x145 20;
BA_ "GenSigCycleTime" SG_ 325 AVHSts_0x145 20;
BA_ "GenSigCycleTime" SG_ 325 CDPActv_0x145 20;
BA_ "GenSigCycleTime" SG_ 325 DrivingModDis 20;
BA_ "GenSigStartValue" SG_ 325 DrivingModReq_ESP 1;
BA_ "GenSigCycleTime" SG_ 325 DrivingModReq_ESP 20;
BA_ "GenSigCycleTime" SG_ 325 TAB_Available 20;
BA_ "GenSigCycleTime" SG_ 325 TAB_Sts 20;
BA_ "GenSigCycleTime" SG_ 325 RollingCounter_ESP2_0x145 20;
BA_ "GenSigCycleTime" SG_ 325 FreshnessValue_ESP2 20;
BA_ "GenSigCycleTime" SG_ 325 MAC_Check_ESP2 20;
BA_ "TransparentInitValue" SG_ 325 ESP2_0x145 "0 0 0 0 0 16 0 0 0 0 0 0 0 0 0 0 ";
BA_ "GenSigCycleTime" SG_ 325 ESP2_0x145 20;
BA_ "GenSigCycleTime" SG_ 311 CheckSum_ESP2_0x137 20;
BA_ "GenSigCycleTime" SG_ 311 BrkDskOvrheatd_0x137 20;
BA_ "GenSigCycleTime" SG_ 311 NoBrkForce_0x137 20;
BA_ "GenSigCycleTime" SG_ 311 VehStandstill_0x137 20;
BA_ "GenSigCycleTime" SG_ 311 AEBIBActv_0x137 20;
BA_ "GenSigCycleTime" SG_ 311 AEBBAActv_0x137 20;
BA_ "GenSigCycleTime" SG_ 311 AEBAvailable_0x137 20;
BA_ "GenSigCycleTime" SG_ 311 ABPAvailable_0x137 20;
BA_ "GenSigCycleTime" SG_ 311 ABPActv_0x137 20;
BA_ "GenSigCycleTime" SG_ 311 ABAavailable_0x137 20;
BA_ "GenSigCycleTime" SG_ 311 ABAActv_0x137 20;
BA_ "GenSigCycleTime" SG_ 311 HDCFault_0x137 20;
BA_ "GenSigCycleTime" SG_ 311 HDCCtrl_0x137 20;
BA_ "GenSigCycleTime" SG_ 311 CDDActv_0x137 20;
BA_ "GenSigCycleTime" SG_ 311 CDDAvailable_0x137 20;
BA_ "GenSigCycleTime" SG_ 311 AWBAvailable_0x137 20;
BA_ "GenSigCycleTime" SG_ 311 AWBActv_0x137 20;
BA_ "GenSigCycleTime" SG_ 311 AVHErrSts_0x137 20;
BA_ "GenSigCycleTime" SG_ 311 AVHSts_0x137 20;
BA_ "GenSigCycleTime" SG_ 311 CDPActv_0x137 20;
BA_ "GenSigCycleTime" SG_ 311 RollingCounter_ESP2_0x137 20;
BA_ "GenSigCycleTime" SG_ 311 CheckSum_ESP1_0x137 20;
BA_ "GenSigCycleTime" SG_ 311 ESPFuncOffSts_0x137 20;
BA_ "GenSigCycleTime" SG_ 311 ESPActvInfoLmp_0x137 20;
BA_ "GenSigCycleTime" SG_ 311 ESPBrkLmpCtrl_0x137 20;
BA_ "GenSigCycleTime" SG_ 311 ESPFailSts_0x137 20;
BA_ "GenSigStartValue" SG_ 311 ESP_MasterCylBrkPressVld_0x137 1;
BA_ "GenSigCycleTime" SG_ 311 ESP_MasterCylBrkPressVld_0x137 20;
BA_ "GenSigCycleTime" SG_ 311 MSRActv_0x137 20;
BA_ "GenSigCycleTime" SG_ 311 VDCActv_0x137 20;
BA_ "GenSigCycleTime" SG_ 311 PTCActv_0x137 20;
BA_ "GenSigCycleTime" SG_ 311 BTCActv_0x137 20;
BA_ "GenSigCycleTime" SG_ 311 ESP_MasterCylBrkPress_0x137 20;
BA_ "GenSigCycleTime" SG_ 311 RollingCounter_ESP1_0x137 20;
BA_ "GenSigCycleTime" SG_ 311 CheckSum_ABS3_0x137 20;
BA_ "GenSigStartValue" SG_ 311 ABSFailSts_0x137 1;
BA_ "GenSigCycleTime" SG_ 311 ABSFailSts_0x137 20;
BA_ "GenSigCycleTime" SG_ 311 EBDFailSts_0x137 20;
BA_ "GenSigCycleTime" SG_ 311 VehSpdVld_0x137 20;
BA_ "GenSigCycleTime" SG_ 311 VehSpd_0x137 20;
BA_ "GenSigCycleTime" SG_ 311 EBDActv_0x137 20;
BA_ "GenSigCycleTime" SG_ 311 ABSActv_0x137 20;
BA_ "GenSigStartValue" SG_ 311 VehOdoInfoSts_0x137 1;
BA_ "GenSigCycleTime" SG_ 311 VehOdoInfoSts_0x137 20;
BA_ "GenSigCycleTime" SG_ 311 VehOdoInfo_0x137 20;
BA_ "GenSigCycleTime" SG_ 311 RollingCounter_ABS3_0x137 20;
BA_ "GenSigCycleTime" SG_ 311 FreshnessValue_ESP_FD2 20;
BA_ "GenSigCycleTime" SG_ 311 MAC_Check_ESP_FD2 20;
BA_ "TransparentInitValue" SG_ 311 ESP_FD2_0x137 "0 0 0 0 0 0 0 0 0 0 0 0 0 0 0 0 0 0 1 0 0 0 0 0 0 0 0 0 0 0 0 0 0 0 0 0 0 0 0 0 0 128 0 4 0 0 0 0 0 0 0 0 0 0 0 0 0 0 0 0 0 0 0 0 ";
BA_ "GenSigCycleTime" SG_ 311 ESP_FD2_0x137 20;
BA_ "GenSigCycleTime" SG_ 368 CCO_Active 20;
BA_ "GenSigCycleTime" SG_ 368 CCO_TgtVel 20;
BA_ "GenSigCycleTime" SG_ 368 CCO_Warn 20;
BA_ "GenSigCycleTime" SG_ 368 EspFuncOffSts_mode 20;
BA_ "TransparentInitValue" SG_ 368 ESP8_0x170 "0 0 0 0 0 0 0 0 ";
BA_ "GenSigCycleTime" SG_ 368 ESP8_0x170 20;
BA_ "GenSigCycleTime" SG_ 338 RearELDLckSts 20;
BA_ "TransparentInitValue" SG_ 338 ELD1_0x152 "0 0 0 0 0 0 0 0 ";
BA_ "GenSigCycleTime" SG_ 338 ELD1_0x152 20;
VAL_ 51 T_Box_RemtWinCtrl 0 "No Action" 1 "Close" 2 "Open(reserved)" 3 "Half_Open(reserved)" 4 "reserved" 7 "reserved" ;
VAL_ 51 T_Box_RemtTrunkCtrl 0 "No action" 1 "Open" 2 "Close" 3 "Reserved" ;
VAL_ 51 T_Box_RemtDoorLockCtrl 0 "No Action" 1 "Driver door unlock" 2 "All doors unlock" 3 "Lock" 4 "Invalid" 5 "reserved" 7 "reserved" ;
VAL_ 51 T_Box_AudioMuteReq 0 "No action" 1 "Request mute" 2 "Request unmute" 3 "Reserved" ;
VAL_ 51 T_Box_RemtDrvTempSet 0 "No action" 1 "Valid Value(Phys = 0.5 * raw + 16)" 31 "Valid Value(Phys = 0.5 * raw + 16)" 32 "Reserved" 63 "Reserved" ;
VAL_ 51 T_Box_RemtAutoCtrl 0 "No action" 1 "Off" 2 "On" 3 "Reserved" ;
VAL_ 51 T_Box_RemtPassTempSet 0 "No action" 1 "Valid Value(Phys = 0.5 * raw + 16)" 31 "Valid Value(Phys = 0.5 * raw + 16)" 32 "Reserved" 63 "Reserved" ;
VAL_ 51 T_Box_RemtSsCtrl 0 "No action" 1 "Full closed" 2 "10%" 3 "20%" 4 "30%" 5 "40%" 6 "50%" 7 "60%" 8 "70%" 9 "80%" 10 "90%" 11 "Full open" 12 "Stop" 13 "Reserved" 15 "Reserved" ;
VAL_ 51 T_Box_RemtSrCtrl 0 "No action" 1 "Full closed" 2 "Tile Up" 3 "10%" 4 "20%" 5 "30%" 6 "40%" 7 "50%" 8 "60%" 9 "70%" 10 "80%" 11 "90%" 12 "Full open" 13 "Stop" 14 "Reserved" 15 "Reserved" ;
VAL_ 51 T_Box_RemtDrvSeatVentnLvlSet 0 "No Action" 1 "OFF" 2 "Level1ï¼ˆä½Žï¼‰" 3 "Level2ï¼ˆä¸­ï¼‰" 4 "Level3ï¼ˆé«˜ï¼‰" 5 "Reserved" 7 "Reserved" ;
VAL_ 51 T_Box_RemtPassSeatVentnLvlSet 0 "No Action" 1 "OFF" 2 "Level1_low" 3 "Level2_Middle" 4 "Level3_high" 5 "Reserved" 7 "Reserved" ;
VAL_ 51 T_Box_RemtAIUReq 0 "no action" 1 "inactive" 2 "active" 3 "reserved" ;
VAL_ 51 T_Box_PM25AirQLvl 0 "Level 1" 1 "Level 2" 2 "Level 3" 3 "Level 4" 4 "Level 5" 5 "Level 6" 6 "Reserved" 7 "TSP return error" 8 "Current city no information" 9 "No network signal" 10 "Reserved" 15 "Reserved" ;
VAL_ 51 T_Box_RemtCarSearch 0 "No action" 1 "Whistle" 2 "Light" 3 "Light+Whistle" ;
VAL_ 51 T_Box_RemtEngCtrl 0 "No Action" 1 "Start" 2 "Stop" 3 "InValid" ;
VAL_ 51 T_Box_RemtDrvSeatHeatgLvlSet 0 "No Action" 1 "OFF" 2 "Level1ï¼ˆä½Žï¼‰" 3 "Level2ï¼ˆä¸­ï¼‰" 4 "Level3ï¼ˆé«˜ï¼‰" 5 "Reserved" 7 "Reserved" ;
VAL_ 51 T_Box_RemtPassSeatHeatgLvlSet 0 "No Action" 1 "OFF" 2 "Level1_low" 3 "Level2ï¼ˆä¸­ï¼‰" 4 "Level3ï¼ˆé«˜ï¼‰" 5 "Reserved" 7 "Reserved" ;
VAL_ 51 T_Box_PM25_Dens 0 "PM2.5 density" 999 "PM2.5 density" 1000 "Current city no information" 1001 "No network signal" 1002 "Reserved" 1022 "Reserved" 1023 "Invalid" ;
VAL_ 1001 T_Box_SWUpdSts 0 "Idle" 1 "NAD start update" 2 "NAD update inprogress" 3 "NAD update done" 4 "NAD update failed" 5 "MCU start update" 6 "MCU update done" 7 "Reserved" ;
VAL_ 1001 T_Box_SysErrSts 0 "No error" 1 "Error" 2 "Standby Battery Error" 3 "Reserved" 31 "Reserved" ;
VAL_ 481 T_Box_BMSReMtPreHeatT 0 "Default" 1 "Valid values" 1440 "Valid values" 1441 "Reserved" 2047 "Reserved" ;
VAL_ 481 Phone_ChrgnMode 0 "Immediate Charging" 1 "Delay Charging" 2 "Invalid" 3 "No action" ;
VAL_ 481 T_Box_IntelEngIdlChrgnSwt 0 "Default" 1 "ON" 2 "Off" 3 "Reserved" ;
VAL_ 481 T_Box_BattKeepTemp 0 "Default" 1 "ON" 2 "Off" 3 "Reserved" ;
VAL_ 481 T_Box_RemtFrntDefrostCtrl 0 "No action" 1 "Off" 2 "On" 3 "Reserved" ;
VAL_ 481 Phone_BattSOCLim 0 "100%" 1 "50%" 2 "60%" 3 "70%" 4 "80%" 5 "90%" 6 "No action" 7 "Reserved" ;
VAL_ 481 T_Box_RemtRearDefrostCtrl 0 "No action" 1 "Off" 2 "On" 3 "Reserved" ;
VAL_ 481 RemUpgrdModeCmd 0 "No action" 1 "Enter the Remote upgrade mode" 2 "End the Remote upgrade mode" 3 "Reserved" ;
VAL_ 481 T_Box_RemtVideoMonrEnaReq_APP 0 "No action" 1 "Disable" 2 "Enable" 3 "Reserved" ;
VAL_ 481 T_Box_BMSReMtPreHeatReq 0 "Default" 1 "Request" 2 "No Request" 3 "Reserved" ;
VAL_ 481 T_Box_RemtCockpitClnReq 0 "no action" 1 "open" 2 "reserved" 3 "reserved" ;
VAL_ 481 T_Box_RemtSdlMod 0 "Charging" 1 "AC ON" 2 "Intelligent Engine Idle Charging start" 3 "No action" ;
VAL_ 829 T_BOX_RemtLimitStart 0 "No Action" 1 "Cancel Temp Limit" 2 "Temp Limit Start" 3 "Cancel  Limit Start" ;
VAL_ 748 DVRRemtCnSts 0 "Default" 1 "Connect success" 2 "Connect fail" 3 "Reserved" ;
VAL_ 748 DVR_360VideoCaptureReq 0 "Off" 1 "On" ;
VAL_ 680 TranPMode_Sts 0 "Normal Mode" 1 "Transport Mode" ;
VAL_ 680 Stat_PwrSv_Lvl 0 "Normal" 1 "Level 1" 2 "Level 2" 3 "Reserved" 7 "Reserved" ;
VAL_ 680 DeepSlpCmd 0 "Normal" 1 "Sleep Commend" 2 "Deep Sleep Commend" 3 "Reserved" ;
VAL_ 680 Dyn_PwrSv_Lvl 0 "Normal" 1 "Level 1" 2 "Level 2" 3 "Level 3" 4 "Level 4" 5 "Level 5" 6 "Reserved" 7 "Reserved" ;
VAL_ 680 LvPwrSysErr 0 "No error" 1 "error" 2 "Reservrd" 3 "Reservrd" ;
VAL_ 680 LimitStartSts 0 "Cancel Temp Limit Start States" 1 "Temp Limit Start States" 2 "Cancel  Limit Start States" 3 "Reserved" ;
VAL_ 699 U_BATT 0 "valid value" 15360 "valid value" 15361 "Reserved" 16382 "Reserved" 16383 "Invalid" ;
VAL_ 699 I_RANGE 0 "current Range [-1, 1A]" 1 "current Range [-200, 200A]" 2 "current Range [-1500, 1500A]" 3 "Invalid" ;
VAL_ 699 I_BATT 7168 "valid value [-200, 200A]" 8768 "valid value  [-1500, 1500A]" 31744 "valid value[-1, 1A]" 33792 "valid value[-1, 1A]" 56768 "valid value  [-1500, 1500A]" 58368 "valid value [-200, 200A]" 65535 "Invalid" ;
VAL_ 699 SOC 0 "valid value" 100 "valid value" 101 "Reserved" 254 "Reserved" 255 "Invalid" ;
VAL_ 699 SOH_SUL 0 "valid value" 100 "valid value" 101 "Reserved" 254 "Reserved" 255 "Invalid" ;
VAL_ 699 SOC_STATE 0 "deviation > 15%" 1 "deviation <15%" 2 "deviation < 10%" 3 "Invalid" ;
VAL_ 699 SOH_SUL_STATE 0 "not learned" 1 "learned" 2 "Reserved" 3 "Invalid" ;
VAL_ 367 RSDS_IPSoundReq 0 "No warning" 1 "Warning level 1ï¼ˆ2Hzå£°éŸ³ï¼‰" 2 "Warning level 2ï¼ˆ4Hzå£°éŸ³ï¼‰" 3 "Warning level 3ï¼ˆå¸¸å“ï¼‰" ;
VAL_ 367 BSD_LCA_warningReqRight 0 "No warning" 1 "Warning level 1" 2 "Warning level 2" 3 "Reserved" ;
VAL_ 367 BSD_LCA_warningReqleft 0 "No warning" 1 "Warning level 1" 2 "Warning level 2" 3 "Reserved" ;
VAL_ 367 DOW_warningReqRight 0 "No warning" 1 "Warning level 1" 2 "Warning level 2" 3 "Reserved" ;
VAL_ 367 DOW_warningReqleft 0 "No warning" 1 "Warning level 1" 2 "Warning level 2" 3 "Reserved" ;
VAL_ 367 RSDS_ErrSts 0 "No Error" 1 "Error" ;
VAL_ 367 RSDS_BrkgTrig 0 "Not tirggered" 1 "Triggered" ;
VAL_ 367 RSDS_BliSts 0 "No Blindness" 1 "Blindness" ;
VAL_ 367 RSDS_TrailerSts 0 "None" 1 "Trailer" ;
VAL_ 367 RSDS_LCAResp 0 "OFF" 1 "ON" ;
VAL_ 367 RSDS_DOWResp 0 "OFF" 1 "ON" ;
VAL_ 367 RSDS_RCWResp 0 "OFF" 1 "ON" ;
VAL_ 367 RSDS_RCTAResp 0 "OFF" 1 "ON" ;
VAL_ 367 RSDS_RCTABrkResp 0 "OFF" 1 "ON" ;
VAL_ 367 RSDS_RCW_Trigger 0 "No warning" 1 "RCW level 1" 2 "RCW level 2" 3 "Reserved" ;
VAL_ 367 RSDS_CTA_Actv 0 "Not active" 1 "Active" ;
VAL_ 367 RCTA_warningReqRight 0 "No warning" 1 "Warning level 2" ;
VAL_ 367 RCTA_warningReqLeft 0 "No warning" 1 "Warning level 2" ;
VAL_ 573 Checksum_IFC3 0 "Valid value" 255 "Valid value" ;
VAL_ 573 LDWResp 0 "OFF" 1 "ON" ;
VAL_ 573 LKAResp 0 "OFF" 1 "ON" ;
VAL_ 573 LCKResp 0 "OFF" 1 "ON" ;
VAL_ 573 AESResp 0 "OFF" 1 "ON" ;
VAL_ 573 ELKResp 0 "OFF" 1 "ON" ;
VAL_ 573 LDW_LKA_Snvty 0 "Normal" 1 "High sensitivity" 2 "Low sensitivity" 3 "Reserved" ;
VAL_ 573 IFCHUTInterface 0 "No response" 1 "Response" ;
VAL_ 573 LSSWarnFormResp 0 "Voice" 1 "Haptic" 2 "Voice+Haptic" 3 "Reserved" ;
VAL_ 573 LSSResp 0 "OFF" 1 "ON" ;
VAL_ 573 IntelligentEvaResp 0 "OFF" 1 "ON" ;
VAL_ 573 ESS_Pedresp 0 "OFF" 1 "ON" ;
VAL_ 573 ESS_Vehresp 0 "OFF" 1 "ON" ;
VAL_ 573 AESSts 0 "OFF" 1 "ON" 2 "Reserved" 3 "Reserved" ;
VAL_ 573 ESSSts 0 "OFF" 1 "ON" 2 "Reserved" 3 "Reserved" ;
VAL_ 573 AESErrSts 0 "No Error" 1 "Error" ;
VAL_ 573 ESSErrSts 0 "No Error" 1 "Error" ;
VAL_ 573 RollingCounter_IFC3 0 "Valid value" 14 "Valid value" 15 "Invalid value" ;
VAL_ 573 Checksum_IFC4 0 "Valid value" 255 "Valid value" ;
VAL_ 573 IFCCalibrationSts 0 "Calibration Success" 1 "Calibration In Process" 2 "Calibration Failed" 3 "Reserved" ;
VAL_ 573 CameraBlockageSts 0 "Camera Not Blocked" 1 "Camera Blocked" ;
VAL_ 573 LDW_LKAWarn 0 "No LDW_LKA warning" 1 "LDW_LKA left warning" 2 "LDW_LKA right warning" 3 "Reserved" ;
VAL_ 573 LSSIntervention 0 "No warning and Intervention" 1 "Left warning" 2 "Right warning" 3 "Left Intervention" 4 "Right Intervention" 5 "Both Intervention" 6 "Left warn only reminder" 7 "Right warn only reminder" ;
VAL_ 573 LSSFuncSts 0 "OFF" 1 "LDW on" 2 "LKA on" 3 "LCK ON" 4 "Reserved" 7 "Reserved" ;
VAL_ 573 ELKMainState 0 "ELK-OFF(å…³é—­)" 1 "ELK-Standby(å¼€å¯)" 2 "ELK-Enable(å·²ä½¿èƒ½ï¼Œä¸æ»¡è¶³æ‰­çŸ©ä»‹å…¥æ¡ä»¶)" 3 "ELK-Road edge Active(é“è·¯è¾¹ç¼˜æ‰­çŸ©ä»‹å…¥)" 4 "ELK-Oncoming Activeï¼ˆoncomingæ‰­çŸ©ä»‹å…¥ï¼‰" 5 "ELK-Overtaking Activeï¼ˆovertakingæ‰­çŸ©ä»‹å…¥ï¼‰" 6 "ELK-Failure" 7 "Reserved" ;
VAL_ 573 LaneAvailability 0 "Not Avaliable" 1 "Left Lane Marker Available" 2 "Right Lane Marker Available" 3 "Both Lane Markers Available" ;
VAL_ 573 TJA_FollowSts 0 "No Follow" 1 "Follow Vehicle" 2 "Reserved" 3 "Reserved" ;
VAL_ 573 LSSErrSts 0 "No error" 1 "LDW error" 2 "LKA error" 3 "LCK error" 4 "ELK error" 5 "ESS error" 6 "Reserved" 7 "Reserved" ;
VAL_ 573 IFC_Handsoffwarn 0 "no warning" 1 "Level1 warning" 2 "Level2 warning" 3 "Level3 warning" 4 "Level4 warning" 5 "Level5 warning" 6 "Reserved" 7 "Reserved" ;
VAL_ 573 ELKActSts 0 "Inactive" 1 "Left Active" 2 "Right active" 3 "Reserved" ;
VAL_ 573 IntelligentEvaActSts 0 "Inactive" 1 "Left Eva" 2 "Right Eva" 3 "Reserved" ;
VAL_ 573 LCKStsIndcr 0 "No indicator" 1 "Active indicator" 2 "Passive indicator" 3 "Reserved" ;
VAL_ 573 AESintervention 0 "No intervention" 1 "Left intervention" 2 "Right intervention" 3 "Reserved" ;
VAL_ 573 ESSintervention 0 "No intervention" 1 "Left intervention" 2 "Right intervention" 3 "Reserved" ;
VAL_ 573 RollingCounter_IFC4 0 "Valid value" 14 "Valid value" 15 "Invalid value" ;
VAL_ 573 Checksum_IFC5 0 "Valid value" 255 "Valid value" ;
VAL_ 573 IFC_LaneCurve 0 "Valid value" 4094 "Valid value" 4095 "Reserved" ;
VAL_ 573 IFC_LeLaneTyp 0 "No display" 1 "Solid lane" 2 "Dashed lane" 3 "Rode edge" 4 "Reserved" 7 "Reserved" ;
VAL_ 573 IFC_RiLaneTyp 0 "No display" 1 "Solid lane" 2 "Dashed lane" 3 "Rode edge" 4 "Reserved" 7 "Reserved" ;
VAL_ 573 IFC_NextLeLaneTyp 0 "No display" 1 "Solid lane" 2 "Dashed lane" 3 "Rode edge" 4 "Reserved" 7 "Reserved" ;
VAL_ 573 IFC_NextRiLaneTyp 0 "No display" 1 "Solid lane" 2 "Dashed lane" 3 "Rode edge" 4 "Reserved" 7 "Reserved" ;
VAL_ 573 IFC_LeLane_dy 0 "Valid value" 4094 "Valid value" 4095 "Invalid value" ;
VAL_ 573 IFC_RiLane_dy 0 "Valid value" 4094 "Valid value" 4095 "Invalid value" ;
VAL_ 573 RollingCounter_IFC5 0 "Valid value" 14 "Valid value" 15 "Invalid value" ;
VAL_ 573 Checksum_IFC6 0 "Valid value" 255 "Valid value" ;
VAL_ 573 IFC_NextLeLane_dy 0 "Valid value" 4094 "Valid value" 4095 "Invalid value" ;
VAL_ 573 IFC_NextRiLane_dy 0 "Valid value" 4094 "Valid value" 4095 "Invalid value" ;
VAL_ 573 RollingCounter_IFC6 0 "Valid value" 14 "Valid value" 15 "Invalid value" ;
VAL_ 719 TSRResp 0 "OFF" 1 "ON" ;
VAL_ 719 TSRSpdLimUnit 0 "Unknown" 1 "KMH" 2 "MPH" 3 "Reserved" ;
VAL_ 719 TSRSpdLim 0 "No Display" 1 "SPL 5" 2 "SPL 10" 3 "SPL 15" 4 "SPL 20" 5 "SPL 25" 6 "SPL 30" 7 "SPL 35" 8 "SPL 40" 9 "SPL 45" 10 "SPL 50" 11 "SPL 55" 12 "SPL 60" 13 "SPL 65" 14 "SPL 70" 15 "SPL 75" 16 "SPL 80" 17 "SPL 85" 18 "SPL 90" 19 "SPL 95" 20 "SPL 100" 21 "SPL 105" 22 "SPL 110" 23 "SPL 115" 24 "SPL 120" 25 "SPL 125" 26 "SPL 130" 27 "SPL 135" 28 "SPL 140" 29 "SPL 145" 30 "SPL 150" 31 "Reserved" 62 "Reserved" 63 "Invalid" ;
VAL_ 719 TSRSpdLimCfdc 0 "Null" 1 "Implicit" 2 "Explicit" 3 "Reserved" ;
VAL_ 719 TSRSts 0 "Off" 1 "Fusion mode" 2 "Vision mode" 3 "Navigation only mode" 4 "Failed" 5 "Reserved" 7 "Reserved" ;
VAL_ 719 TSRSpdLimSts 0 "No Speed Limit" 1 "Speed Limit" 2 "Speed Limit Cancel" 3 "Reserved" ;
VAL_ 719 TSRTrfcSignValCfdc 0 "Null" 1 "Implicit" 2 "Explicit" 3 "Reserved" ;
VAL_ 719 TSRTrfcSignVal 0 "None" 1 "Snow" 2 "Fog" 3 "ThunderStorm" 4 "Rain" 5 "FWay" 6 "EFWay" 7 "Straight" 8 "FrontageLeft" 9 "TurnLeftRight" 10 "FrontageRight" 11 "Right" 12 "TurnRight" 13 "Left" 14 "TurnLeft" 15 "RelieveNoOvertake" 16 "NoOvertake" 17 "StopGiveWay" 18 "GiveWay" 19 "NoPass" 20 "NoEntry" 21 "NoCar" 22 "NoTruck" 23 "NoBus" 24 "NoTurnaround" 25 "NoStraightLeftTurn" 26 "NoStraightRightTurn" 27 "NoLeftRightTurn" 28 "NoLeftTurn" 29 "NoRightTurn" 30 "NoStraight" 31 "WarnKids" 32 "WarnPed" 33 "WarnBike" 34 "WarnWorks" 35 "WarnWildanimal" 36 "WarnCattle" 37 "AccidentProneSection" 38 "Town" 39 "Slow" 40 "SharpTurnR" 41 "SharpTurnL" 42 "ReverseCurveL" 43 "ReverseCurveR" 44 "ContinuousBend" 45 "Crossroads" 46 "ConfluenceR" 47 "ConfluenceL" 48 "RainWetness" 49 "SnowIcy" 50 "Time" 51 "Distance For" 52 "Distance In" 53 "Straight" 54 "FrontageLeft" 55 "TurnLeftRight" 56 "FrontageRight" 57 "Right" 58 "Turn Right" 59 "Left" 60 "Turn Left" 61 "Highway Start" 62 "Highway End" 63 "Mortorway Start" 64 "Mortorway End" 65 "City Entry" 66 "City Exit" 67 "Residential zones Entry" 68 "Residential zones Exit" 69 "Trailer" 70 "Reserved" 254 "Reserved" 255 "Invalid" ;
VAL_ 719 TSRSpdLimWarn 0 "No Warning" 1 "Warning" ;
VAL_ 719 TSRWarnResp 0 "OFF" 1 "ON" ;
VAL_ 719 TSR_Snvty 0 "valid" 30 "valid" 31 "Invalid" ;
VAL_ 683 ACC_LeTgt_02_Dy 0 "Valid value" 81 "Valid value" 82 "Reserved" 127 "Reserved" ;
VAL_ 683 ACC_LeTgt_02_Dx 0 "Valid value" 300 "Valid value" 301 "Reserved" 511 "Reserved" ;
VAL_ 683 ACC_LeTgt_02_Typ 0 "Unkown" 1 "Sedan" 2 "Truck" 3 "Motorcycle" 4 "Pedestrian" 5 "Bicycle" 6 "Reserved" 7 "Invalid" ;
VAL_ 683 ACC_LeTargrt_02_Detn 0 "Not dectected" 1 "Dectected" 2 "Reserved" 3 "Invalid" ;
VAL_ 683 ACC_RiTargrt_02_Detn 0 "Not dectected" 1 "Dectected" 2 "Reserved" 3 "Invalid" ;
VAL_ 683 ACC_RiTgt_02_Dy 0 "Valid value" 81 "Valid value" 82 "Reserved" 127 "Reserved" ;
VAL_ 683 ACC_RiTgt_02_Dx 0 "Valid value" 300 "Valid value" 301 "Reserved" 511 "Reserved" ;
VAL_ 683 ACC_RiTgt_02_Typ 0 "Unkown" 1 "Sedan" 2 "Truck" 3 "Motorcycle" 4 "Pedestrian" 5 "Bicycle" 6 "Reserved" 7 "Invalid" ;
VAL_ 683 ACC_LeTgtObjBarDisp 0 "No display" 1 "Distance_1 one bar" 2 "Distance_2 two bars" 3 "Distance_3 three bars" 4 "Distance_4 four bars" 5 "Resvered" 7 "Resvered" ;
VAL_ 683 ACC_RiTgtObjBarDisp 0 "No display" 1 "Distance_1 one bar" 2 "Distance_2 two bars" 3 "Distance_3 three bars" 4 "Distance_4 four bars" 5 "Resvered" 7 "Resvered" ;
VAL_ 683 Checksum_ACC3 0 "Valid value" 255 "Valid value" ;
VAL_ 683 ISL_Resp 0 "OFF" 1 "ON" ;
VAL_ 683 ICA_HandsOffResp 0 "OFF" 1 "ON" ;
VAL_ 683 Longctrl_VehHldReq_DVR 0 "No Request" 1 "Request" ;
VAL_ 683 Longctrl_DrvOFF_Req_DVR 0 "No Request" 1 "Request" ;
VAL_ 683 Longctrl_ModSts_DVR 0 "OFF mode" 1 "Passive mode(Reject)" 2 "Passive mode(Stand-by)" 3 "Active-Control mode" 4 "Brake-only mode" 5 "Override" 6 "Standstill" 7 "Failure mode Longctrl" 8 "Reserved" 9 "Shut off" 10 "Reserved" 15 "Reserved" ;
VAL_ 683 Longctrl_Decel_Req_DVR 0 "No Request" 1 "Request" ;
VAL_ 683 Longctrl_EngTrqReq_DVR 0 "Valid value" 65535 "Valid value" ;
VAL_ 683 Longctrl_EngTrqReqActive_DVR 0 "Not active" 1 "Active" ;
VAL_ 683 Longctrl_DecelToStopReq_DVR 0 "No Request" 1 "Request" ;
VAL_ 683 Longctrl_ParkShiftReq_DVR 0 "No request" 1 "Request park Shift" 2 "Invalid" 3 "Reserved" ;
VAL_ 683 Longctrl_Decel_ReqValue_DVR 0 "Valid value" 255 "Valid value" ;
VAL_ 683 Longctrl_HCUTrqReqActive_DVR 0 "Not active" 1 "Active" ;
VAL_ 683 HWA_SnvtySet_Resp 0 "Normal" 1 "High sensitivity" 2 "Low sensitivity" 3 "Reserved" ;
VAL_ 683 HWA_Resp 0 "OFF" 1 "ON" ;
VAL_ 683 ALC_Resp 0 "OFF" 1 "ON" ;
VAL_ 683 ALC_InterSysInfoDisp 0 "No display" 1 "Automatic lane change function failure" 2 "Reserve" 3 "Reserve" ;
VAL_ 683 RollingCounter_ACC3 0 "Valid value" 14 "Valid value" 15 "Invalid value" ;
VAL_ 683 Checksum_ACC4 0 "Valid value" 255 "Valid value" ;
VAL_ 683 ACC_ObjDetecte 0 "No object" 1 "Target object detected" ;
VAL_ 683 ACC_TakeOverReq 0 "No TakeOver request" 1 "Valid TakeOver request" ;
VAL_ 683 ACC_InterSysInfoDisp 0 "No display" 1 "Unable to activate ACC due to speed not achive" 2 "ACC active control is cancelled" 3 "Resvered" 4 "ACC and PEBS temporary unavailable" 5 "Unable to activate ACC due to other limitation(except speed not achive)" 6 "ACC and PEBS error" 7 "ACC temporary unavailable" 8 "Resvered" 9 "Blindness" 10 "Resvered" 31 "Resvered" ;
VAL_ 683 ACC_ModDisp 0 "OFF Mode" 1 "Passive Mode" 2 "StandBy Mode" 3 "Active-Control Mode" 4 "Brake-Only Mode" 5 "Override" 6 "Reserved" 7 "ACC and PEBS Failure mode" 8 "ACC Failure mode" 9 "Reserved" 31 "Reserved" ;
VAL_ 683 ACC_FctSts 0 "Fuction Not  Available" 1 "Fuction Available" 2 "Performance degradation" 3 "Reserved" ;
VAL_ 683 ACC_TgtObjBarDisp 0 "No display" 1 "Distance_1 one bar" 2 "Distance_2 two bars" 3 "Distance_3 three bars" 4 "Distance_4 four bars" 5 "Resvered" 7 "Resvered" ;
VAL_ 683 ACC_TimeGapSet 0 "No display" 1 "TimeGap_1 1s" 2 "TimeGap_2 1.4s" 3 "TimeGap_3 1.8s" 4 "TimeGap_4 2.1s" 5 "Reserved" 7 "Reserved" ;
VAL_ 683 ACC_SpdSetValue 0 "Valid value" 254 "Valid value" 255 "No display" ;
VAL_ 683 Longctrl_HazActv 0 "Not active" 1 "AEB active" 2 "Safestop active" 3 "Reserved" ;
VAL_ 683 TJA_ACC_SelSts 0 "off" 1 "ACC selected" 2 "TJAICA selected" 3 "Off selected" 4 "ACC on" 5 "TJAICA on" 6 "Reserved" 7 "Reserved" ;
VAL_ 683 ISL_InterSysInfoDisp 0 "No display" 1 "Speed Limit Confirm Request" 2 "Speed Limit Take Over Request" 3 "Resvered" ;
VAL_ 683 TJA_ICA_ModDisp 0 "OFF mode" 1 "Passive mode" 2 "Active mode" 3 "Ready mode" 4 "Failure" 5 "Reserved" 7 "Reserved" ;
VAL_ 683 TJA_ICA_InterSysInfoDisp 0 "No display" 1 "Unable to activate TJAICA due to other limitation" 2 "TJAICA active control is cancelled" 3 "TJAICA   temporarily unavailable" 4 "Current IGN Cycle Function Inhibit" 5 "Resvered" 7 "Resvered" ;
VAL_ 683 CruCha_ModDisp 0 "OFF mode" 1 "Idle mode" 2 "Ready mode" 3 "Active" 4 "Reserved" 5 "Warning Level 1" 6 "Warning Level 2" 7 "Warning Level 3" 8 "Reserved" 9 "Failure" 10 "Reserved" 15 "Reserved" ;
VAL_ 683 CruChar_InterSysInfoDisp 0 "No display" 1 "Unable to activate CruiseChauffer due to other limitation" 2 "CruiseChauffer active control is cancelled" 3 "CruiseChauffer temporarily unavailable" 4 "Take over request" 5 "Current IGN Cycle Function Inhibit" 6 "Please Keep Attention" 7 "To cross the tunnel, please take over  in time" 8 "Have a branch road ahead. Please take over in time" 9 "Hands off warning" 10 "Reserved" 15 "Reserved" ;
VAL_ 683 RollingCounter_ACC4 0 "Valid value" 14 "Valid value" 15 "Invalid value" ;
VAL_ 683 Checksum_ACC8 0 "Valid value" 255 "Valid value" ;
VAL_ 683 Longctrl_HCUTrqReq_DVR 0 "Valid value" 65535 "Valid value" ;
VAL_ 683 HWA_warning 0 "No Warning" 1 "Warning Level 1" 2 "Warning Level 2" 3 "Warning Level 3" ;
VAL_ 683 HWA_ModDisp 0 "OFF" 1 "Safstop" 2 "Passive" 3 "Ready" 4 "Active" 5 "Override" 6 "Slow retreat" 7 "Standstill" 8 "Reserved" 14 "Reserved" 15 "Fault" ;
VAL_ 683 HWA_InterSysInfoDisp 0 "No display" 1 "Unable to activate HWA due to other limitation" 2 "HWA active control is cancelled" 3 "Turn off the turn light" 4 "Active confirm" 5 "Overtime for lane change" 6 "lane change is cancelled" 7 "HWA temporary unavailable" 8 "Speed is too low to support lane change" 9 "HWA need to restart the engine" 10 "Take over request" 11 "Please Keep Attention" 12 "To cross the tunnel, please take overÂ Â in time" 13 "Have a branch road ahead. Please take over in time" 14 "Reserve" 15 "Reserve" ;
VAL_ 683 HWA_LaneChangeReq 0 "No display" 1 "left satisfied" 2 "right satisfied" 3 "left not satisfied" 4 "right not satisfied" 5 "reserved" 7 "reserved" ;
VAL_ 683 HWA_LaneChange 0 "No display" 1 "left" 2 "right" 3 "reserved" ;
VAL_ 683 ADAS_DriverInloop_Monitor 0 "No Display" 1 "HOD Level 1" 2 "HOD Level 2" 3 "DAM Warning" 4 "Resvered" 7 "Resvered" ;
VAL_ 683 RollingCounter_ACC8 0 "Valid value" 14 "Valid value" 15 "Invalid value" ;
VAL_ 683 Checksum_ACC6 0 "Valid value" 255 "Valid value" ;
VAL_ 683 ACC_PotentialTgtDy 0 "Valid value" 160 "Valid value" 161 "Reserved" 255 "Reserved" ;
VAL_ 683 ACC_PotentialTgtDx 0 "Valid value" 300 "Valid value" 301 "Reserved" 511 "Reserved" ;
VAL_ 683 ACC_RlvTgtDetn 0 "Not dectected" 1 "Dectected" 2 "Reserved" 3 "Invalid" ;
VAL_ 683 ACC_EgoStatus 0 "No Display" 1 "Override" 2 "Deceleration" 3 "Reserved" ;
VAL_ 683 ACC_RlvTgtDy 0 "Valid value" 160 "Valid value" 161 "Reserved" 255 "Reserved" ;
VAL_ 683 ACC_RlvTgtDx 0 "Valid value" 300 "Valid value" 301 "Reserved" 511 "Reserved" ;
VAL_ 683 ACC_PotentialTgtDetn 0 "Not dectected" 1 "Dectected" 2 "Reserved" 3 "Invalid" ;
VAL_ 683 ACC_PotentialTgtTyp 0 "Unkown" 1 "Sedan" 2 "Truck" 3 "Motorcycle" 4 "Pedestrian" 5 "Bicycle" 6 "Reserved" 7 "Invalid" ;
VAL_ 683 ACC_RlvTgtTyp 0 "Unkown" 1 "Sedan" 2 "Truck" 3 "Motorcycle" 4 "Pedestrian" 5 "Bicycle" 6 "Reserved" 7 "Invalid" ;
VAL_ 683 RollingCounter_ACC6 0 "Valid value" 14 "Valid value" 15 "Invalid value" ;
VAL_ 683 Checksum_ACC7 0 "Valid value" 255 "Valid value" ;
VAL_ 683 ACC_LeTgtDy 0 "Valid value" 160 "Valid value" 161 "Reserved" 255 "Reserved" ;
VAL_ 683 ACC_LeTgtDx 0 "Valid value" 300 "Valid value" 301 "Reserved" 511 "Reserved" ;
VAL_ 683 ACC_LeTgtTyp 0 "Unkown" 1 "Sedan" 2 "Truck" 3 "Motorcycle" 4 "Pedestrian" 5 "Bicycle" 6 "Reserved" 7 "Invalid" ;
VAL_ 683 ACC_LeTargrtDection 0 "Not dectected" 1 "Dectected" 2 "Reserved" 3 "Invalid" ;
VAL_ 683 ACC_RiTargrtDetn 0 "Not dectected" 1 "Dectected" 2 "Reserved" 3 "Invalid" ;
VAL_ 683 ACC_RiTgtDy 0 "Valid value" 160 "Valid value" 161 "Reserved" 255 "Reserved" ;
VAL_ 683 ACC_RiTgtDx 0 "Valid value" 300 "Valid value" 301 "Reserved" 511 "Reserved" ;
VAL_ 683 ACC_RiTgtTyp 0 "Unkown" 1 "Sedan" 2 "Truck" 3 "Motorcycle" 4 "Pedestrian" 5 "Bicycle" 6 "Reserved" 7 "Invalid" ;
VAL_ 683 Request_driveoff 0 "no request" 1 "The front car has started" 2 "The front car has started,Please pay attention to the road environment" 3 "The front car has started,please keep your attention" 4 "The front car has started,please take over the car" 5 "Reserved" 7 "Reserved" ;
VAL_ 683 RollingCounter_ACC7 0 "Valid value" 14 "Valid value" 15 "Invalid value" ;
VAL_ 683 ACC_RlvTgtfusion 0 "no fusion" 1 "fusion" ;
VAL_ 683 ACC_RlvTgtHeading 0 "valid value" 60 "valid value" 61 "Reserved" 63 "Reserved" ;
VAL_ 683 ACC_LeTgtfusion 0 "no fusion" 1 "fusion" ;
VAL_ 683 ACC_LeTgtHeading 0 "valid value" 60 "valid value" 61 "Reserved" 63 "Reserved" ;
VAL_ 683 ACC_RiTgtfusion 0 "no fusion" 1 "fusion" ;
VAL_ 683 ACC_RiTgtHeading 0 "valid value" 60 "valid value" 61 "Reserved" 63 "Reserved" ;
VAL_ 683 ACC_PotentialTgtfusion 0 "no fusion" 1 "fusion" ;
VAL_ 683 ACC_PotentialTgtHeading 0 "valid value" 60 "valid value" 61 "Reserved" 63 "Reserved" ;
VAL_ 683 TargetCutinPro 0 "valid value" 50 "Reserved" 63 "Reserved" ;
VAL_ 683 TargetCutoutPro 0 "valid value" 50 "Reserved" 63 "Reserved" ;
VAL_ 696 AEBObjID 0 "Valid Value" 254 "Valid Value" 255 "No Object" ;
VAL_ 696 AEBObjExist 0 "Valid Value" 63 "Valid Value" ;
VAL_ 696 AEBObjVideoCfmd 0 "No Fusion" 1 "Fusion" ;
VAL_ 696 AEBObjVx 0 "Valid Value" 2047 "Valid Value" 4081 "Reserved" 4095 "Reserved" ;
VAL_ 696 AEBObjDx 0 "Valid Value" 4095 "Valid Value" ;
VAL_ 696 AEBObjCntAlive 0 "Valid Value" 3855 "Valid Value" 3856 "Reserved" 4095 "Reserved" ;
VAL_ 696 AEBObjDy 0 "Valid Value" 2047 "Valid Value" ;
VAL_ 696 AEBObjState 0 "UNDEFINED" 1 "PRECEDING" 2 "STATIONARY" 3 "STOPPED" 4 "Reserved" 7 "Reserved" ;
VAL_ 696 AEBObjObstcl 0 "Valid Value" 31 "Valid Value" ;
VAL_ 696 AEBObjVy 0 "Valid Value" 1023 "Valid Value" ;
VAL_ 696 CyclistObjExist 0 "Valid Value" 63 "Valid Value" ;
VAL_ 696 AEBObjAx 0 "Valid Value" 1023 "Valid Value" ;
VAL_ 696 AEBObjAy 0 "Valid Value" 1023 "Valid Value" ;
VAL_ 696 CyclistObjDx 0 "Valid Value" 4095 "Valid Value" ;
VAL_ 696 CyclistObjID 0 "Valid Value" 254 "Valid Value" 255 "No Object" ;
VAL_ 696 CyclistObjObstcl 0 "Valid Value" 31 "Valid Value" ;
VAL_ 696 CyclistObjDy 0 "Valid Value" 2047 "Valid Value" ;
VAL_ 696 CyclistObjVx 0 "Valid Value" 4080 "Valid Value" 4081 "Reserved" 4095 "Reserved" ;
VAL_ 696 CyclistObjCntAlive 0 "Valid Value" 3855 "Valid Value" 3856 "Reserved" 4095 "Reserved" ;
VAL_ 696 CyclistObjVy 0 "Valid Value" 1023 "Valid Value" ;
VAL_ 696 CyclistObjState 0 "UNDEFINED" 1 "PRECEDING" 2 "STATIONARY" 3 "STOPPED" 4 "Reserved" 7 "Reserved" ;
VAL_ 696 CyclistObjVideoCfmd 0 "No Fusion" 1 "Fusion" ;
VAL_ 696 CyclistObjAx 0 "Valid Value" 1023 "Valid Value" ;
VAL_ 696 CyclistObjAy 0 "Valid Value" 1023 "Valid Value" ;
VAL_ 696 PedObjExist 0 "Valid Value" 63 "Valid Value" ;
VAL_ 696 PedObjID 0 "Valid Value" 254 "Valid Value" 255 "No Object" ;
VAL_ 696 PedObjObstcl 0 "Valid Value" 31 "Valid Value" ;
VAL_ 696 PedObjDy 0 "Valid Value" 2047 "Valid Value" ;
VAL_ 696 PedObjDx 0 "Valid Value" 4095 "Valid Value" ;
VAL_ 696 PedObjVx 0 "Valid Value" 4080 "Valid Value" 4081 "Reserved" 4095 "Reserved" ;
VAL_ 696 PedObjVy 0 "Valid Value" 1023 "Valid Value" ;
VAL_ 696 PedObjVideoCfmd 0 "No Fusion" 1 "Fusion" ;
VAL_ 696 ACCTgtObjDx 0 "Valid Value" 4095 "Valid Value" ;
VAL_ 696 PedObjAy 0 "Valid Value" 1023 "Valid Value" ;
VAL_ 696 PedObjCntAlive 0 "Valid Value" 3855 "Valid Value" 3856 "Reserved" 4095 "Reserved" ;
VAL_ 696 PedObjAx 0 "Valid Value" 1023 "Valid Value" ;
VAL_ 696 ACCTgtObjID 0 "Valid Value" 254 "Valid Value" 255 "No Object" ;
VAL_ 696 ACCTgtObjObstcl 0 "Valid Value" 31 "Valid Value" ;
VAL_ 696 ACCTgtObjDy 0 "Valid Value" 2047 "Valid Value" ;
VAL_ 696 ACCTgtObjExist 0 "Valid Value" 63 "Valid Value" ;
VAL_ 696 ACCTgtObjVy 0 "Valid Value" 1023 "Valid Value" ;
VAL_ 696 ACCTgtObjVx 0 "Valid Value" 4080 "Valid Value" 4081 "Reserved" 4095 "Reserved" ;
VAL_ 696 ACCTgtObjAx 0 "Valid Value" 1023 "Valid Value" ;
VAL_ 696 ACCTgtObjAy 0 "Valid Value" 1023 "Valid Value" ;
VAL_ 696 ACCTgtObjState 0 "UNDEFINED" 1 "PRECEDING" 2 "STATIONARY" 3 "STOPPED" 4 "Reserved" 7 "Reserved" ;
VAL_ 696 ACCTgtObjVideoCfmd 0 "No Fusion" 1 "Fusion" ;
VAL_ 696 ACCTgtObjCntAlive 0 "Valid Value" 3855 "Valid Value" 3856 "Reserved" 4095 "Reserved" ;
VAL_ 696 RadarHorMisalign 0 "Valid Value" 4095 "Valid Value" ;
VAL_ 696 HandsoffDetd 0 "Unknown" 1 "Hands off" 2 "Not hands off" 3 "Reserved" ;
VAL_ 696 DrvgOnHiWay 0 "Unknown" 1 "On Hignway" 2 "Not on hgh way" 3 "Reserved" ;
VAL_ 696 RoadCrvt 0 "Valid Value(Left bend)" 510 "Valid Value(Left bend)" 511 "Straightaway" 512 "Valid Value((Reft bend))" 1021 "Valid Value((Reft bend))" 1022 "Reserved" 1023 "Unknown" ;
VAL_ 696 SpdLimitDst 0 "Valid Value" 60 "Valid Value" 61 "Out of Range" 62 "Reserved" 63 "Unknown" ;
VAL_ 696 RoadCrvtFar 0 "Valid Value(Left bend)" 510 "Valid Value(Left bend)" 511 "Straightaway" 512 "Valid Value((Reft bend))" 1021 "Valid Value((Reft bend))" 1022 "Reserved" 1023 "Unknown" ;
VAL_ 696 RampDst 0 "Valid Value" 60 "Valid Value" 61 "Out of Range" 62 "Reserved" 63 "Unknown" ;
VAL_ 696 SpdLimit 0 "No SPL" 1 "SPL 5" 2 "SPL 10" 3 "SPL 15" 4 "SPL 20" 5 "SPL 25" 6 "SPL 30" 7 "SPL 35" 8 "SPL 40" 9 "SPL 45" 10 "SPL 50" 11 "SPL 55" 12 "SPL 60" 13 "SPL 65" 14 "SPL 70" 15 "SPL 75" 16 "SPL 80" 17 "SPL 85" 18 "SPL 90" 19 "SPL 95" 20 "SPL 100" 21 "SPL 105" 22 "SPL 110" 23 "SPL 115" 24 "SPL 120" 25 "SPL 120" 26 "SPL 130" 27 "SPL 135" 28 "SPL 140" 29 "SPL 145" 30 "SPL 150" 31 "Reserved" 62 "Reserved" 63 "Invalid" ;
VAL_ 696 CurveDst 0 "Valid Value" 60 "Valid Value" 61 "Out of Range" 62 "Reserved" 63 "Unknown" ;
VAL_ 696 NavSpdLimUnit 0 "Unknown" 1 "KMH" 2 "MPH" 3 "Reserved" ;
VAL_ 696 TunnelDst 0 "Valid Value" 60 "Valid Value" 61 "Out of Range" 62 "Reserved" 63 "Unknown" ;
VAL_ 696 DrvgOnRiLane 0 "Unknown" 1 "On right most lane" 2 "Not on right most lane" 3 "Reserved" ;
VAL_ 696 BrdgDst 0 "Valid Value" 60 "Valid Value" 61 "Out of Range" 62 "Reserved" 63 "Unknown" ;
VAL_ 696 RadarDrvrAttentive 0 "Inattentive" 1 "Attentive" ;
VAL_ 696 ACC_DataRecReq 0 "No Demand" 1 "TakeOver Demand" 2 "SafeStop Demand" 3 "AEB Demand" 4 "Reserved" 7 "Reserved" ;
VAL_ 696 ACC_SOSReq 0 "No Request" 1 "Request" 2 "Reserved" 3 "Invalid" ;
VAL_ 696 PedObjState 0 "UNDEFINED" 1 "PRECEDING" 2 "STATIONARY" 3 "STOPPED" 4 "Reserved" 7 "Reserved" ;
VAL_ 696 MapDataValid 0 "Valid" 1 "Invalid" ;
VAL_ 696 DrvrSts 0 "Good" 1 "Unbelievable" 2 "Low" 3 "Middle" 4 "High Level 1" 5 "High Level 2" 6 "Reserved" 7 "Reserved" ;
VAL_ 696 AEBObjOverlap 0 "Valid" 20 "Valid" 21 "reserved" 30 "reserved" 31 "invalid" ;
VAL_ 696 AEBObjDrvby 0 "Valid" 20 "Valid" 21 "reserved" 30 "reserved" 31 "invalid" ;
VAL_ 395 AEB_ABA_Level 0 "Level 0" 1 "Level 1" 2 "Level 2" 3 "Level 3" ;
VAL_ 395 AEB_ABA_Req 0 "No Request" 1 "Request" ;
VAL_ 395 EBA_TgtDecel_Req 0 "No Request" 1 "Request" ;
VAL_ 395 AEB_VehHldReq 0 "No Request" 1 "Request" ;
VAL_ 395 AEB_TgtDecel_Req 0 "No Request" 1 "Request" ;
VAL_ 395 AEB_TgtDecel_ReqValue 0 "Valid value" 65534 "Valid value" 65535 "Invalid" ;
VAL_ 395 AEB_AWB_Req 0 "No Request" 1 "Request" ;
VAL_ 395 AEB_AWB_Level 0 "No level" 1 "Level 1" 2 "Level 2" 3 "Level 3" 4 "Level 4" 5 "Resvered" 15 "Resvered" ;
VAL_ 395 AEB_ABP_Req 0 "No Request" 1 "Request" ;
VAL_ 395 AEB_BrkReqFunc 0 "No Request" 1 "AEB-V" 2 "AEB-VRU" 3 "AEB-JA" 4 "Reserved" 5 "AEB-FCTB" 6 "Reserved" 7 "Reserved" ;
VAL_ 395 AEB_ObjSty 0 "No Object" 1 "Vehicle" 2 "Pedestrian" 3 "Cyclist" 4 "Unknown" 5 "Resvered" 7 "Resvered" ;
VAL_ 551 Checksum_AEB2 0 "Valid value" 255 "Valid value" ;
VAL_ 551 AEB_PedResp 0 "OFF" 1 "ON" ;
VAL_ 551 AEB_VehResp 0 "OFF" 1 "ON" ;
VAL_ 551 FCW_Snvty 0 "Normal" 1 "High sensitivity" 2 "Low sensitivity" 3 "Reserved" ;
VAL_ 551 AEB_JA_Resp 0 "OFF" 1 "ON" ;
VAL_ 551 RollingCounter_AEB2 0 "Valid value" 14 "Valid value" 15 "Invalid value" ;
VAL_ 551 Checksum_AEB3 0 "Valid value" 255 "Valid value" ;
VAL_ 551 AEB_VehTrig 0 "not tirggered" 1 "triggered" ;
VAL_ 551 AEB_PedTrig 0 "not tirggered" 1 "triggered" ;
VAL_ 551 FCW_AEB_VehFctSts 0 "No display" 1 "error" 2 "FCWAEB_V temporarily unavailable" 3 "FCWAEB_V Performance degradation" ;
VAL_ 551 FCW_AEB_PedFctSts 0 "No display" 1 "error" 2 "FCWAEB_P temporarily unavailable" 3 "FCWAEB_P Performance degradation" ;
VAL_ 551 FCW_Warn 0 "No warning" 1 "Latent warning" 2 "warning Level 1" 3 "warning Level 2" ;
VAL_ 551 AEB_JAFuncSts 0 "No display" 1 "error" 2 "FCWAEB_JA temporarily unavailable" 3 "FCWAEB_JA Performance degradation" ;
VAL_ 551 AEB_JA_Warn 0 "No warning" 1 "Warning  for vehicle" 2 "Warning for pedestrian" 3 "reverse" ;
VAL_ 551 AEB_JABrkTrig 0 "Not tirggered" 1 "AEB_JA Function Triggered for vehicle" 2 "AEB_JA Function Triggered for pedestrian" 3 "reverse" ;
VAL_ 551 RollingCounter_AEB3 0 "Valid value" 14 "Valid value" 15 "Invalid value" ;
VAL_ 273 EMS_AuthenResult 0 "Nothing" 1 "Authentication failure" 2 "Authentication success" 3 "Reserved" ;
VAL_ 273 EngSpd 0 "Valid values" 65535 "Valid values" ;
VAL_ 273 EngSpdVldty 0 "Invalid" 1 "Valid" 2 "Initial value" 3 "Reserved" ;
VAL_ 273 BrkPedalSts 0 "Not pressed" 1 "Pressed" 2 "Reserved" 3 "Error" ;
VAL_ 258 AccelPedlPosnDiagc 0 "Valid values" 255 "Valid values" ;
VAL_ 258 AccPedalOverride 0 "not override" 1 "override" ;
VAL_ 258 ECMRespACC 0 "No response" 1 "Response" ;
VAL_ 258 ECMACCInterface 0 "No response" 1 "Response" ;
VAL_ 313 Tgtgear_Up 0 "Gear shiftup display off" 1 "Gear shiftup display on" ;
VAL_ 313 Tgtgear_Down 0 "Gear shiftdown display off" 1 "Gear shiftdown display on" ;
VAL_ 313 NeutralSts 0 "Gear not in neutral" 1 "Gear in neutral" 2 "Not Available" 3 "Reserved" ;
VAL_ 723 EngSpd_ForIP 0 "Valid values" 65535 "Valid values" ;
VAL_ 723 EWP_Err 0 "No error" 1 "Error" ;
VAL_ 625 FuelConsumption 0 "Valid values" 65535 "Valid values" ;
VAL_ 625 TgtCrsVehSpd 0 "Valid values" 255 "Valid values" ;
VAL_ 625 CruiseCtrlSts 0 "Inactive" 1 "Active" 2 "Standby" 3 "Reserved" ;
VAL_ 625 AccelPedalPosnVldty 0 "Invalid" 1 "Valid" 2 "Init value" 3 "Reserved" ;
VAL_ 625 EngSVSSig 0 "SVS off" 1 "SVS on" ;
VAL_ 625 MILSts 0 "Off" 1 "On" ;
VAL_ 625 EngState 0 "Stopped" 1 "Cranking" 2 "Running" 3 "Stalling" ;
VAL_ 625 AccelPedalPosn 0 "Valid values" 255 "Valid values" ;
VAL_ 881 EngCoolantTemp 0 "Valid values" 255 "Valid values" ;
VAL_ 881 GPF_Warning 0 "No Warning" 1 "GPF is regenerating" 2 "GPF need to regenerate" 3 "Reserved" ;
VAL_ 881 GentrWarnLmpSts 0 "Off" 1 "On" ;
VAL_ 881 EngClntTempWarn 0 "No" 1 "Yes" ;
VAL_ 881 EngClntTempVldty 0 "Invalid" 1 "Valid" 2 "Init value" 3 "Reserved" ;
VAL_ 881 SS_Screen_tip 0 "no screen tip" 1 "screen tip" ;
VAL_ 881 SSSSetSts 0 "Off" 1 "On" ;
VAL_ 881 SS_Enable_Lamp 0 "Lamp off" 1 "Lamp on" ;
VAL_ 881 SS_Fault_Lamp 0 "Lamp off" 1 "Lamp on" ;
VAL_ 881 BaroPressure 0 "Valid values" 254 "Valid values" 255 "Invalid value" ;
VAL_ 130 NetEngTrq 0 "Valid values" 65534 "Valid values" 65535 "Invalid" ;
VAL_ 130 DrvEngTrqReq 0 "Valid values" 65535 "Valid values" ;
VAL_ 130 DrvEngTrqReqVld 0 "Invalid" 1 "Valid" ;
VAL_ 132 EngTrqEstimdActGear 0 "Valid values" 65535 "Valid values" ;
VAL_ 132 EngTrqEstimdActGear_Qf 0 "Invalid" 1 "Valid" ;
VAL_ 134 TrqLoss 0 "Valid values" 65535 "Valid values" ;
VAL_ 951 ECM_VehDstBackup 0 "0-9999999-km" 9999999 "0-9999999-km" 10000000 "Reserved" 16777214 "Reserved" 16777215 "Invalid" ;
VAL_ 951 EngRoStrt_Failure 0 "No error" 1 "Engine auth no passed" 2 "Vehicle not in remote mode" 4 "BCM checksum or" 8 "Engine speed â‰ 0" 16 "The shift lever signal is" 32 "Engine shift lever is not in" 64 "Engine is fault(mil on)" 128 "The vehicle is not stop" 256 "The fuel is less" 512 "The veihcle in collision state" 1024 "Exceed the max run time" ;
VAL_ 166 TgtEngSpdIP 0 "Valid values" 4095 "Valid values" ;
VAL_ 166 TgtEngSpdIPValid 0 "Invalid" 1 "valid" ;
VAL_ 166 TrsmTqIdle 0 "Valid values" 65534 "Valid values" 65535 "Invalid" ;
VAL_ 545 CurrentGearValid 0 "Invalid" 1 "Valid" ;
VAL_ 545 CURRENT_GEAR 0 "Current gear 'N' or 'P'" 1 "Current gear '1'" 2 "Current gear '2'" 3 "Current gear '3'" 4 "Current gear '4'" 5 "Current gear '5'" 6 "Current gear '6'" 7 "Current gear '7'" 8 "Current gear 'R'" 9 "Reserved" 15 "Reserved" ;
VAL_ 545 TGS_LEVER 0 "Select lever in position 'P'" 1 "Reserved" 2 "Reserved" 3 "Reserved" 4 "Reserved" 5 "Select lever in position 'D'" 6 "Select lever in position 'N'" 7 "Select lever in position 'R'" 8 "Select lever in position 'M'" 9 "Reserved" 13 "Reserved" 14 "Intermediate position" 15 "Invalid" ;
VAL_ 545 SHIFT_IN_PROGRESS 0 "Gear Shift NOT in progress." 1 "Gear Shif is in progress" ;
VAL_ 545 ShiftInPrgValid 0 "Invalid" 1 "Valid" ;
VAL_ 545 TargetGearValid 0 "Invalid" 1 "Valid" ;
VAL_ 545 TARGET_GEAR 0 "Target gear 'N' or 'P '" 1 "Target gear '1'" 2 "Target gear '2'" 3 "Target gear '3'" 4 "Target gear '4'" 5 "Target gear '5'" 6 "Target gear '6'" 7 "Target gear '7'" 8 "Target gear 'R'" 9 "Reserved" 15 "Reserved" ;
VAL_ 565 CheckSum_DCT7 0 "Valid values" 255 "Valid values" ;
VAL_ 565 DCT_RaceModeSts 0 "Inactive" 1 "Active" 2 "Turn Off" 3 "Forbidden" 4 "Reserved (treat as 0x0 inactive)" 7 "Reserved (treat as 0x0 inactive)" ;
VAL_ 565 DCT_PrsBrk_Warn 0 "No warning" 1 "Press brake and Unlock-button to shift" 2 "Press Unlock-button to shift" 3 "Press brake to shift" ;
VAL_ 565 DCT_ShftNotAlwd_Warn 0 "No warning" 1 "Vehicle speed too high, shift not allowed" 2 "Engage P not allowed due to high vehicle speed" 3 "Transmission is in N, park-lock is not locked" ;
VAL_ 565 DCT_ShftRecom_M 0 "No Recommendation" 1 "Up Shift" 2 "Down Shift" 3 "Reserved" ;
VAL_ 565 DrvWarnMsg 0 "No Text" 1 "PressBrake" 2 "TransToo_Hot" 3 "Reserved" 7 "Reserved" ;
VAL_ 565 DrvFaiMsg_0x235 0 "No Message" 1 "Transmission Malfunction" 2 "Transmission P engagement fault" 3 "Transmission P disengagement fault" 4 "Authentication failure" 5 "Reserved" 14 "Reserved" 15 "transmission limit function" ;
VAL_ 565 DrvModDisp_0x235 0 "P" 1 "R" 2 "N" 3 "D" 4 "M" 5 "Reserved" 7 "Reserved" ;
VAL_ 565 DrvModDispSts_0x235 0 "BlankNo Display" 1 "On" 2 "Flashing" 3 "Reserved(treat as BlankNo Display)" ;
VAL_ 565 DrvAutoGearDisp 0 "Neutral" 1 "1st Gear" 2 "2nd Gear" 3 "3rd Gear" 4 "4th Gear" 5 "5th Gear" 6 "6th Gear" 7 "7th Gear" 8 "Reserved" 15 "Reserved" ;
VAL_ 565 DrvGearDispSts_0x235 0 "Blank  No display" 1 "On" 2 "Flashing" 3 "Reserved (treat as BlankNo display)" ;
VAL_ 565 RollingCounter_DCT7 0 "Valid value" 14 "Valid value" 15 "Invalid value" ;
VAL_ 561 FLWheelDriveDirection 0 "Invalid" 1 "Forward" 2 "Backward" 3 "Stop" ;
VAL_ 561 FLWheelSpdVld 0 "Invalid" 1 "Valid" ;
VAL_ 561 FLWheelSpd 0 "Valid values" 5333 "Valid values" 5334 "Reserved" 8191 "Reserved" ;
VAL_ 561 FRWheelDriveDirection 0 "Invalid" 1 "Forward" 2 "Backward" 3 "Stop" ;
VAL_ 561 FRWheelSpdVld 0 "Invalid" 1 "Valid" ;
VAL_ 561 FRWheelSpd 0 "Valid values" 5333 "Valid values" 5334 "Reserved" 8191 "Reserved" ;
VAL_ 582 RLWheelDriveDirection 0 "Invalid" 1 "Forward" 2 "Backward" 3 "Stop" ;
VAL_ 582 RLWheelSpdVld 0 "Invalid" 1 "Valid" ;
VAL_ 582 RLWheelSpd 0 "Valid values" 5333 "Valid values" 5334 "Reserved" 8191 "Reserved" ;
VAL_ 582 RRWheelDriveDirection 0 "Invalid" 1 "Forward" 2 "Backward" 3 "Stop" ;
VAL_ 582 RRWheelSpdVld 0 "Invalid" 1 "Valid" ;
VAL_ 582 RRWheelSpd 0 "Valid values" 5333 "Valid values" 5334 "Reserved" 8191 "Reserved" ;
VAL_ 613 CheckSum_ABS3_0x265 0 "Valid values" 255 "Valid values" ;
VAL_ 613 ABSFailSts_0x265 0 "No failure" 1 "Failure" ;
VAL_ 613 EBDFailSts_0x265 0 "No failure" 1 "Failure" ;
VAL_ 613 VehSpdVld_0x265 0 "Invalid" 1 "Valid" ;
VAL_ 613 VehSpd_0x265 0 "Valid values" 5333 "Valid values" 5334 "Reserved" 8191 "Reserved" ;
VAL_ 613 VehOdoInfoSts_0x265 0 "Invalid" 1 "Valid" ;
VAL_ 613 VehOdoInfo_0x265 0 "Valid values" 999 "Valid values" 1000 "Reserved" 1023 "Reserved" ;
VAL_ 613 ABSActv_0x265 0 "Not active" 1 "Active" ;
VAL_ 613 EBDActv_0x265 0 "Not active" 1 "Active" ;
VAL_ 613 RollingCounter_ABS3_0x265 0 "Valid value" 14 "Valid value" 15 "Invalid value" ;
VAL_ 363 CheckSum_EPB1 0 "Valid values" 255 "Valid values" ;
VAL_ 363 PressBrakePedalPointOut 0 "No reminder" 1 "Pedal needs to be applied" ;
VAL_ 363 EPBErrSts 0 "Undefined" 1 "No Error" 2 "Error" 3 "Diagnosis" ;
VAL_ 363 EPBSts 0 "Released" 1 "Closed" 2 "In progress" 3 "unknown" ;
VAL_ 363 EPBTextDisp 0 "No display" 1 "Gradient too high" 2 "Park brake force not enough" 3 "Park brake system overheated" 4 "Remind driver to apply safety belt" 5 "Park brake maintenance mode" 6 "Roller bench mode" 7 "Please Release EPB" 8 "Please Release Rear ELD" 9 "Reserved" 15 "Reserved" ;
VAL_ 363 EPBRedLmpSts 0 "Lamp off" 1 "Lamp on" 2 "Lamp flash" 3 "Reserved" ;
VAL_ 363 RollingCounter_EPB1 0 "Valid value" 14 "Valid value" 15 "Invalid value" ;
VAL_ 329 CheckSum_ESP1_0x149 0 "Valid values" 255 "Valid values" ;
VAL_ 329 ESPFuncOffSts_0x149 0 "AvailableOn" 1 "UnavailableOff" ;
VAL_ 329 ESPActvInfoLmp_0x149 0 "Not active" 1 "Active" ;
VAL_ 329 ESPBrkLmpCtrl_0x149 0 "Brake light off" 1 "Brake light on" ;
VAL_ 329 ESPFailSts_0x149 0 "No failure" 1 "Failure" ;
VAL_ 329 ESP_MasterCylBrkPressVld_0x149 0 "Invalid" 1 "Valid" ;
VAL_ 329 MSRActv_0x149 0 "Not active" 1 "Active" ;
VAL_ 329 VDCActv_0x149 0 "Not active" 1 "Active" ;
VAL_ 329 PTCActv_0x149 0 "Not active" 1 "Active" ;
VAL_ 329 BTCActv_0x149 0 "Not active" 1 "Active" ;
VAL_ 329 ESP_MasterCylBrkPress_0x149 0 "Valid value" 14960 "Valid value" 14961 "Reserved" 65535 "Reserved" ;
VAL_ 329 RollingCounter_ESP1_0x149 0 "Valid value" 14 "Valid value" 15 "Invalid value" ;
VAL_ 325 CheckSum_ESP2_0x145 0 "Valid values" 255 "Valid values" ;
VAL_ 325 BrkDskOvrheatd_0x145 0 "Not high" 1 "Temp too high" ;
VAL_ 325 NoBrkForce_0x145 0 "EXist brake force" 1 "No brake force" ;
VAL_ 325 VehStandstill_0x145 0 "Not standstill" 1 "Standstill" 2 "Invalid (short unavailability, maX 3s)" 3 "Reserved" ;
VAL_ 325 AEBIBActv_0x145 0 "Not active" 1 "Active" ;
VAL_ 325 AEBBAActv_0x145 0 "Not active" 1 "Active" ;
VAL_ 325 AEBAvailable_0x145 0 "Unusable" 1 "Usable" ;
VAL_ 325 ABPAvailable_0x145 0 "Unusable" 1 "Usable" ;
VAL_ 325 ABPActv_0x145 0 "Not active" 1 "Active" ;
VAL_ 325 ABAavailable_0x145 0 "Unusable" 1 "Usable" ;
VAL_ 325 ABAActv_0x145 0 "Not active" 1 "Active" ;
VAL_ 325 CDDActv_0x145 0 "Not active" 1 "Active" ;
VAL_ 325 CDDAvailable_0x145 0 "Not available" 1 "Available" ;
VAL_ 325 AWBAvailable_0x145 0 "Unusable" 1 "Usable" ;
VAL_ 325 AWBActv_0x145 0 "Not active" 1 "Active" ;
VAL_ 325 HDCFault_0x145 0 "No failure" 1 "Failure when HDC is on need" 2 "Failure when is not on need" 3 "Reserved" ;
VAL_ 325 HDCCtrl_0x145 0 "OFF" 1 "On active braking" 2 "On not active braking" 3 "Reserved" ;
VAL_ 325 AVHErrSts_0x145 0 "No failure" 1 "Failure when AVH is on need" 2 "Failure when is not on need" 3 "Reserved" ;
VAL_ 325 AVHSts_0x145 0 "Off" 1 "Standby" 2 "active" 3 "Reserved" ;
VAL_ 325 CDPActv_0x145 0 "Not active" 1 "Active" ;
VAL_ 325 DrivingModDis 0 "Standard" 1 "Sport" 2 "Snow" 3 "Mud" 4 "Sand" 5 "4L(reserved)" 6 "Economic" 7 "Mode Unkown" 8 "Reserved" 9 "Sport+" 10 "Off road" 11 "Standard_2H(reserved)" 12 "Reserved" 13 "Standard_4Hï¼ˆreservedï¼‰" 14 "Failed" 15 "Invalid Value" 16 "Snow_4H(reserved)" 17 "Normal_4L(reserved)" 18 "Rock_4L(reserved)" 19 "Pothle_4L(reserved)" 20 "MudSand_4L(reserved)" 21 "Mountain_4L(reserved)" 22 "reserved" 31 "reserved" ;
VAL_ 325 DrivingModReq_ESP 0 "No Terrain Control" 1 "Standard" 2 "Sport" 3 "Snow_Nex" 4 "Reserved" 5 "Deep Mud" 6 "Reserved" 7 "Soft sand" 8 "Reserved" 9 "4Lï¼ˆreservedï¼‰" 10 "Economic" 11 "Reserved" 12 "Snow_TODï¼ˆreserved)" 13 "Off road" 14 "Sport+(reserved)" 15 "nvalid Value" 16 "Standard_2H(reserved)" 17 "Reserved" 18 "Standard_4H(reserved)" 19 "Snow_4H(reserved)" 20 "Normal_4L(reserved)" 21 "Rock_4L(reserved)" 22 "Pothole_4L(reserved)" 23 "MudSand_4L(reserved)" 24 "Mountain_4L(reserved)" 25 "Reserved" 31 "Reserved" ;
VAL_ 325 TAB_Available 0 "TAB not available" 1 "TAB available" ;
VAL_ 325 TAB_Sts 0 "Function OFF" 1 "Standby" 2 "Active" 3 "Failure" ;
VAL_ 325 RollingCounter_ESP2_0x145 0 "Valid value" 14 "Valid value" 15 "Invalid value" ;
VAL_ 311 CheckSum_ESP2_0x137 0 "Valid values" 255 "Valid values" ;
VAL_ 311 BrkDskOvrheatd_0x137 0 "Not high" 1 "Temp too high" ;
VAL_ 311 NoBrkForce_0x137 0 "Exist brake force" 1 "No brake force" ;
VAL_ 311 VehStandstill_0x137 0 "Not standstill" 1 "Standstill" 2 "InValid values (short unavailability, max 3s)" 3 "Reserved" ;
VAL_ 311 AEBIBActv_0x137 0 "Not active" 1 "Active" ;
VAL_ 311 AEBBAActv_0x137 0 "Not active" 1 "Active" ;
VAL_ 311 AEBAvailable_0x137 0 "Unusable" 1 "Usable" ;
VAL_ 311 ABPAvailable_0x137 0 "Unusable" 1 "Usable" ;
VAL_ 311 ABPActv_0x137 0 "Not active" 1 "Active" ;
VAL_ 311 ABAavailable_0x137 0 "Unusable" 1 "Usable" ;
VAL_ 311 ABAActv_0x137 0 "Not active" 1 "Active" ;
VAL_ 311 HDCFault_0x137 0 "No failure" 1 "Failure when HDC is on need" 2 "Failure when is not on need" 3 "Reserved" ;
VAL_ 311 HDCCtrl_0x137 0 "OFF" 1 "On active braking" 2 "On not active braking" ;
VAL_ 311 CDDActv_0x137 0 "Not active" 1 "Active" ;
VAL_ 311 CDDAvailable_0x137 0 "Not available" 1 "Available" ;
VAL_ 311 AWBAvailable_0x137 0 "Unusable" 1 "Usable" ;
VAL_ 311 AWBActv_0x137 0 "Not active" 1 "Active" ;
VAL_ 311 AVHErrSts_0x137 0 "No failure" 1 "Failure when AVH is on need" 2 "Failure when is not on need" 3 "Reserved" ;
VAL_ 311 AVHSts_0x137 0 "Off" 1 "Standby" 2 "active" ;
VAL_ 311 CDPActv_0x137 0 "Not active" 1 "Active" ;
VAL_ 311 RollingCounter_ESP2_0x137 0 "Valid value" 14 "Valid value" 15 "Invalid value" ;
VAL_ 311 CheckSum_ESP1_0x137 0 "Valid values" 255 "Valid values" ;
VAL_ 311 ESPFuncOffSts_0x137 0 "AvailableOn" 1 "UnavailableOff" ;
VAL_ 311 ESPActvInfoLmp_0x137 0 "Not active" 1 "Active" ;
VAL_ 311 ESPBrkLmpCtrl_0x137 0 "Brake light off" 1 "Brake light on" ;
VAL_ 311 ESPFailSts_0x137 0 "No failure" 1 "Failure" ;
VAL_ 311 ESP_MasterCylBrkPressVld_0x137 0 "Invalid" 1 "Valid" ;
VAL_ 311 MSRActv_0x137 0 "Not active" 1 "Active" ;
VAL_ 311 VDCActv_0x137 0 "Not active" 1 "Active" ;
VAL_ 311 PTCActv_0x137 0 "Not active" 1 "Active" ;
VAL_ 311 BTCActv_0x137 0 "Not active" 1 "Active" ;
VAL_ 311 ESP_MasterCylBrkPress_0x137 0 "Valid values" 14960 "Valid values" 14961 "Reserved" 65535 "Reserved" ;
VAL_ 311 RollingCounter_ESP1_0x137 0 "Valid value" 14 "Valid value" 15 "Invalid value" ;
VAL_ 311 CheckSum_ABS3_0x137 0 "Valid values" 255 "Valid values" ;
VAL_ 311 ABSFailSts_0x137 0 "No failure" 1 "Failure" ;
VAL_ 311 EBDFailSts_0x137 0 "No failure" 1 "Failure" ;
VAL_ 311 VehSpdVld_0x137 0 "Invalid values" 1 "Valid values" ;
VAL_ 311 VehSpd_0x137 0 "Valid values" 5333 "Valid values" 5334 "Reserved" 8191 "Reserved" ;
VAL_ 311 EBDActv_0x137 0 "Not active" 1 "Active" ;
VAL_ 311 ABSActv_0x137 0 "Not active" 1 "Active" ;
VAL_ 311 VehOdoInfoSts_0x137 0 "Invalid value" 1 "Valid value" ;
VAL_ 311 VehOdoInfo_0x137 0 "Valid values" 999 "Valid values" 1000 "Reserved" 1023 "Reserved" ;
VAL_ 311 RollingCounter_ABS3_0x137 0 "Valid value" 14 "Valid value" 15 "Invalid value" ;
VAL_ 368 CCO_Active 0 "Not Active" 1 "Active" 2 "Stand by" 3 "Failed" ;
VAL_ 368 CCO_TgtVel 0 "Valid values" 31 "Valid values" ;
VAL_ 368 CCO_Warn 0 "No Warn" 1 "Please Release EPB" 2 "Please  slow down" 3 "Reserved" ;
VAL_ 368 EspFuncOffSts_mode 0 "AvailableOn" 1 "Cross-country expert mode" ;
VAL_ 338 RearELDLckSts 0 "UnLocked" 1 "Locked" 2 "Over-Speed Warning" 3 "Driving Mode Select Error" 4 "Lock Request Deny" 5 "Reserved" 13 "Reserved" 14 "Fault" 15 "Invalid" ;
SIG_GROUP_ 573 IFC3_IFC_FD2 1 : Checksum_IFC3 LDWResp LKAResp LCKResp ELKResp AESResp LDW_LKA_Snvty IFCHUTInterface ESS_Pedresp ESS_Vehresp LSSWarnFormResp LSSResp IntelligentEvaResp AESSts ESSSts AESErrSts ESSErrSts dummy_IFC_FD2_8 dummy_IFC_FD2_9 dummy_IFC_FD2_10 dummy_IFC_FD2_11 dummy_IFC_FD2_12 RollingCounter_IFC3;
SIG_GROUP_ 573 IFC4_IFC_FD2 1 : Checksum_IFC4 LDW_LKAWarn LSSIntervention LSSFuncSts ELKMainState LaneAvailability TJA_FollowSts LSSErrSts IFC_Handsoffwarn IFCCalibrationSts CameraBlockageSts ELKActSts IntelligentEvaActSts LCKStsIndcr dummy_IFC_FD2_13 dummy_IFC_FD2_14 dummy_IFC_FD2_15 AESintervention ESSintervention RollingCounter_IFC4;
SIG_GROUP_ 573 IFC5_IFC_FD2 1 : Checksum_IFC5 IFC_LaneCurve IFC_LeLaneTyp IFC_RiLaneTyp IFC_NextLeLaneTyp IFC_NextRiLaneTyp IFC_LeLane_dy IFC_RiLane_dy dummy_IFC_FD2_16 RollingCounter_IFC5;
SIG_GROUP_ 573 IFC6_IFC_FD2 1 : Checksum_IFC6 IFC_NextLeLane_dy IFC_NextRiLane_dy dummy_IFC_FD2_17 dummy_IFC_FD2_18 dummy_IFC_FD2_19 dummy_IFC_FD2_20 RollingCounter_IFC6;
SIG_GROUP_ 683 ACC3_ACC_FD2 1 : Checksum_ACC3 ISL_Resp ICA_HandsOffResp HWA_Resp HWA_SnvtySet_Resp dummy_ACC_FD2_4 ALC_Resp dummy_ACC_FD2_5 Longctrl_VehHldReq_DVR Longctrl_DrvOFF_Req_DVR Longctrl_ModSts_DVR Longctrl_Decel_Req_DVR Longctrl_EngTrqReqActive_DVR Longctrl_EngTrqReq_DVR Longctrl_Decel_ReqValue_DVR Longctrl_DecelToStopReq_DVR Longctrl_ParkShiftReq_DVR Longctrl_HCUTrqReqActive_DVR dummy_ACC_FD2_6 ALC_InterSysInfoDisp dummy_ACC_FD2_7 RollingCounter_ACC3;
SIG_GROUP_ 683 ACC4_ACC_FD2 1 : Checksum_ACC4 ACC_ObjDetecte ACC_TakeOverReq ACC_InterSysInfoDisp dummy_ACC_FD2_8 ACC_ModDisp ACC_FctSts dummy_ACC_FD2_9 ACC_TgtObjBarDisp Longctrl_HazActv TJA_ACC_SelSts CruCha_ModDisp TJA_ICA_InterSysInfoDisp dummy_ACC_FD2_10 TJA_ICA_ModDisp ISL_InterSysInfoDisp ACC_TimeGapSet ACC_SpdSetValue CruChar_InterSysInfoDisp RollingCounter_ACC4;
SIG_GROUP_ 683 ACC8_ACC_FD2 1 : Checksum_ACC8 HWA_ModDisp HWA_InterSysInfoDisp dummy_ACC_FD2_11 HWA_LaneChange ADAS_DriverInloop_Monitor dummy_ACC_FD2_12 HWA_LaneChangeReq dummy_ACC_FD2_13 HWA_warning Longctrl_HCUTrqReq_DVR dummy_ACC_FD2_14 dummy_ACC_FD2_15 RollingCounter_ACC8;
SIG_GROUP_ 683 ACC6_ACC_FD2 1 : Checksum_ACC6 ACC_PotentialTgtDy ACC_PotentialTgtDx ACC_RlvTgtDetn ACC_EgoStatus ACC_RlvTgtTyp ACC_RlvTgtDy ACC_RlvTgtDx dummy_ACC_FD2_16 ACC_PotentialTgtDetn ACC_PotentialTgtTyp dummy_ACC_FD2_17 dummy_ACC_FD2_18 RollingCounter_ACC6;
SIG_GROUP_ 683 ACC7_ACC_FD2 1 : Checksum_ACC7 ACC_LeTgtDy ACC_LeTgtDx ACC_LeTgtTyp ACC_LeTargrtDection ACC_RiTargrtDetn ACC_RiTgtDy ACC_RiTgtDx ACC_RiTgtTyp dummy_ACC_FD2_19 Request_driveoff dummy_ACC_FD2_20 RollingCounter_ACC7;
SIG_GROUP_ 551 AEB2_AEB_FD2 1 : Checksum_AEB2 AEB_PedResp AEB_VehResp FCW_Snvty AEB_JA_Resp dummy_AEB_FD2_8 dummy_AEB_FD2_9 dummy_AEB_FD2_10 dummy_AEB_FD2_11 dummy_AEB_FD2_12 dummy_AEB_FD2_13 dummy_AEB_FD2_14 RollingCounter_AEB2;
SIG_GROUP_ 551 AEB3_AEB_FD2 1 : Checksum_AEB3 AEB_VehTrig AEB_PedTrig dummy_AEB_FD2_15 FCW_AEB_VehFctSts dummy_AEB_FD2_16 FCW_AEB_PedFctSts FCW_Warn AEB_JAFuncSts AEB_JA_Warn AEB_JABrkTrig dummy_AEB_FD2_17 dummy_AEB_FD2_18 dummy_AEB_FD2_19 dummy_AEB_FD2_20 dummy_AEB_FD2_21 RollingCounter_AEB3;
SIG_GROUP_ 565 DCT7 1 : CheckSum_DCT7 dummy_DCT7_0 DCT_RaceModeSts dummy_DCT7_1 DCT_PrsBrk_Warn DCT_ShftNotAlwd_Warn DCT_ShftRecom_M dummy_DCT7_2 DrvWarnMsg DrvFaiMsg_0x235 dummy_DCT7_3 DrvModDisp_0x235 DrvModDispSts_0x235 dummy_DCT7_4 DrvGearDispSts_0x235 dummy_DCT7_5 DrvAutoGearDisp RollingCounter_DCT7;
SIG_GROUP_ 613 ABS3 1 : CheckSum_ABS3_0x265 ABSFailSts_0x265 EBDFailSts_0x265 VehSpdVld_0x265 VehSpd_0x265 EBDActv_0x265 dummy_ABS3_0 ABSActv_0x265 VehOdoInfoSts_0x265 VehOdoInfo_0x265 dummy_ABS3_1 dummy_ABS3_2 dummy_ABS3_3 RollingCounter_ABS3_0x265;
SIG_GROUP_ 363 EPB1 1 : CheckSum_EPB1 dummy_EPB1_0 dummy_EPB1_1 PressBrakePedalPointOut dummy_EPB1_2 dummy_EPB1_3 EPBSts EPBErrSts EPBRedLmpSts EPBTextDisp dummy_EPB1_4 dummy_EPB1_5 dummy_EPB1_6 dummy_EPB1_7 RollingCounter_EPB1;
SIG_GROUP_ 329 ESP1 1 : CheckSum_ESP1_0x149 ESPFailSts_0x149 ESPBrkLmpCtrl_0x149 ESPActvInfoLmp_0x149 ESPFuncOffSts_0x149 dummy_ESP1_0 BTCActv_0x149 PTCActv_0x149 MSRActv_0x149 VDCActv_0x149 dummy_ESP1_1 ESP_MasterCylBrkPressVld_0x149 ESP_MasterCylBrkPress_0x149 dummy_ESP1_2 dummy_ESP1_3 dummy_ESP1_4 RollingCounter_ESP1_0x149;
SIG_GROUP_ 325 ESP2 1 : CheckSum_ESP2_0x145 dummy_ESP2_0 VehStandstill_0x145 NoBrkForce_0x145 BrkDskOvrheatd_0x145 dummy_ESP2_1 ABAActv_0x145 ABAavailable_0x145 ABPActv_0x145 ABPAvailable_0x145 AEBAvailable_0x145 AEBBAActv_0x145 AEBIBActv_0x145 dummy_ESP2_2 AWBActv_0x145 AWBAvailable_0x145 CDDAvailable_0x145 CDDActv_0x145 HDCCtrl_0x145 HDCFault_0x145 CDPActv_0x145 dummy_ESP2_3 AVHSts_0x145 AVHErrSts_0x145 dummy_ESP2_4 DrivingModReq_ESP dummy_ESP2_5 TAB_Available DrivingModDis dummy_ESP2_6 TAB_Sts dummy_ESP2_7 RollingCounter_ESP2_0x145;
SIG_GROUP_ 311 ESP2_ESP_FD2 1 : CheckSum_ESP2_0x137 dummy_ESP_FD2_8 VehStandstill_0x137 NoBrkForce_0x137 BrkDskOvrheatd_0x137 dummy_ESP_FD2_9 ABAActv_0x137 ABAavailable_0x137 ABPActv_0x137 ABPAvailable_0x137 AEBAvailable_0x137 AEBBAActv_0x137 AEBIBActv_0x137 dummy_ESP_FD2_10 AWBActv_0x137 AWBAvailable_0x137 CDDAvailable_0x137 CDDActv_0x137 HDCCtrl_0x137 HDCFault_0x137 CDPActv_0x137 dummy_ESP_FD2_11 AVHSts_0x137 AVHErrSts_0x137 dummy_ESP_FD2_12 dummy_ESP_FD2_13 dummy_ESP_FD2_14 dummy_ESP_FD2_15 RollingCounter_ESP2_0x137;
SIG_GROUP_ 311 ESP1_ESP_FD2 1 : CheckSum_ESP1_0x137 ESPFailSts_0x137 ESPBrkLmpCtrl_0x137 ESPActvInfoLmp_0x137 ESPFuncOffSts_0x137 dummy_ESP_FD2_16 BTCActv_0x137 PTCActv_0x137 MSRActv_0x137 VDCActv_0x137 dummy_ESP_FD2_17 ESP_MasterCylBrkPressVld_0x137 ESP_MasterCylBrkPress_0x137 dummy_ESP_FD2_18 dummy_ESP_FD2_19 dummy_ESP_FD2_20 RollingCounter_ESP1_0x137;
SIG_GROUP_ 311 ABS3_ESP_FD2 1 : CheckSum_ABS3_0x137 ABSFailSts_0x137 EBDFailSts_0x137 VehSpdVld_0x137 VehSpd_0x137 EBDActv_0x137 dummy_ESP_FD2_37 ABSActv_0x137 VehOdoInfoSts_0x137 VehOdoInfo_0x137 dummy_ESP_FD2_38 dummy_ESP_FD2_39 dummy_ESP_FD2_40 RollingCounter_ABS3_0x137;
