VERSION "created by dbc creator v1.0"

NS_ :

BS_:

BU_: T_Box GW DMS DVR HUT Tester

BO_ 659 HUT_IP1: 8 HUT
 SG_ IP_CurrTheme : 20|3@0+ (1,0) [0|7] ""  T_Box
 SG_ IP_VehSpdDisp : 15|9@0+ (0.5,0) [0|255] "kmh" Vector__XXX
 SG_ IP_FuelMainTankR : 17|10@0+ (1,0) [10|1000] "Ohm"  GW
 SG_ IP_FuelAuxTankR : 39|10@0+ (1,0) [10|1000] "Ohm"  GW
 SG_ IP_VelSpdDisp_Mile : 51|8@0+ (1,0) [0|255] "Mile per hour" Vector__XXX
 SG_ IP_LagueSet : 45|4@0+ (1,0) [0|15] "" Vector__XXX
 SG_ HUT_IP1_0x293 : 7|64@0+ (1,0) [0|0] "" Vector__XXX

BO_ 639 HUT_IP2: 16 HUT
 SG_ CheckSum_IP2 : 7|8@0+ (1,0) [0|255] ""  GW
 SG_ IP_DrvSeatBeltWarnLmpFailSts : 51|2@0+ (1,0) [0|3] ""  GW
 SG_ IP_PassSeatBeltWarnLmpFailSts : 49|2@0+ (1,0) [0|3] ""  GW
 SG_ IP_VehTotDistance : 15|24@0+ (0.1,0) [0|999999.9] "Km"  GW,T_Box,DMS,DVR
 SG_ IP_FuelLvlInfo : 39|8@0+ (1,0) [0|200] "L"  GW,T_Box
 SG_ IP_FuelLvlLowLmpSts : 45|2@0+ (1,0) [0|3] ""  T_Box
 SG_ IP_BattChrgLmpSts : 43|2@0+ (1,0) [0|3] "" Vector__XXX
 SG_ IP_EngOilPressLowLmpSts : 41|2@0+ (1,0) [0|3] "" Vector__XXX
 SG_ IP_ABMWarnLmpFailrSts : 55|2@0+ (1,0) [0|3] ""  GW
 SG_ IP_Err : 52|1@0+ (1,0) [0|1] ""  GW
 SG_ IP_ACCErr : 47|1@0+ (1,0) [0|1] ""  GW
 SG_ IP_VehTotDistanceValid : 46|1@0+ (1,0) [0|1] ""  GW,T_Box,DMS,DVR
 SG_ IP_VehSpdUnit : 53|1@0+ (1,0) [0|1] ""  GW
 SG_ IP_VINcompr : 63|1@0+ (1,0) [0|1] ""  GW
 SG_ RollingCounter_IP2 : 59|4@0+ (1,0) [0|15] ""  GW
 SG_ FreshnessValue_HUT_IP2 : 71|16@0+ (1,0) [0|65535] ""  GW
 SG_ MAC_Check_HUT_IP2 : 87|48@0+ (1,0) [0|281474976710655] ""  GW
 SG_ HUT_IP2_0x27F : 7|128@0+ (1,0) [0|0] "" Vector__XXX

BO_ 842 HUT_IP3: 16 HUT
 SG_ IP_RemainDistance : 15|12@0+ (1,0) [0|2000] "km"  T_Box
 SG_ IP_InstFuelConsUnit : 19|1@0+ (1,0) [0|1] "" Vector__XXX
 SG_ IP_EBDFailSts : 18|1@0+ (1,0) [0|1] "" Vector__XXX
 SG_ IP_AvgFuelCons : 31|12@0+ (0.01,0) [0|29.99] "L100km"  T_Box
 SG_ IP_InstFuelCons : 35|14@0+ (0.01,0) [0|99.99] "L100km"  T_Box
 SG_ HUT_IP3_0x34A : 7|128@0+ (1,0) [0|0] "" Vector__XXX

BO_ 707 HUT_FD1: 64 HUT
 SG_ SSSSet_HUT : 64|1@0+ (1,0) [0|1] ""  GW
 SG_ IFC_SnvtySet : 77|2@0+ (1,0) [0|3] ""  GW
 SG_ DOWSwtReq : 104|1@0+ (1,0) [0|1] ""  GW
 SG_ AEB_PedSwtReq : 105|1@0+ (1,0) [0|1] ""  GW
 SG_ ALCMLightLvlSet : 75|4@0+ (1,0) [0|15] ""  GW
 SG_ FlashLmpSwtReq : 86|1@0+ (1,0) [0|1] ""  GW
 SG_ LCASwtReq : 85|1@0+ (1,0) [0|1] ""  GW
 SG_ RCTASwtReq : 84|1@0+ (1,0) [0|1] ""  GW
 SG_ RCTABrkSwtReq : 83|1@0+ (1,0) [0|1] ""  GW
 SG_ RCWSwtReq : 82|1@0+ (1,0) [0|1] ""  GW
 SG_ FCW_SnvtySet : 81|2@0+ (1,0) [0|3] ""  GW
 SG_ AEB_VehSwtReq : 95|1@0+ (1,0) [0|1] ""  GW
 SG_ LKASwtReq : 93|1@0+ (1,0) [0|1] ""  GW
 SG_ LCKSwtReq : 92|1@0+ (1,0) [0|1] ""  GW
 SG_ ELKSwtReq : 91|1@0+ (1,0) [0|1] ""  GW
 SG_ ESS_PedSwtReq : 90|1@0+ (1,0) [0|1] ""  GW
 SG_ ESS_VehSwtReq : 89|1@0+ (1,0) [0|1] ""  GW
 SG_ LDWSwtReq : 88|1@0+ (1,0) [0|1] ""  GW
 SG_ TSRSwtReq : 102|1@0+ (1,0) [0|1] ""  GW
 SG_ TSRWarnSwtReq : 101|1@0+ (1,0) [0|1] ""  GW
 SG_ ICA_HandsOffSwtReq : 127|1@0+ (1,0) [0|1] ""  GW
 SG_ ISLSwtReq : 126|1@0+ (1,0) [0|1] ""  GW
 SG_ TSR_SnvtySet : 125|5@0+ (1,-15) [-15|15] "kmh"  GW
 SG_ BrkPedalFeelReq : 79|2@0+ (1,0) [0|3] "" Vector__XXX
 SG_ HFASwtSts : 87|1@0+ (1,0) [0|1] ""  GW
 SG_ EPSSteerModSwtReq : 114|2@0+ (1,0) [0|3] ""  GW
 SG_ DSTSwtReq : 112|1@0+ (1,0) [0|1] ""  GW
 SG_ HUT_ESPFuncOffSwtSts : 98|1@0+ (1,0) [0|1] ""  GW
 SG_ DrivingModReq_HUT : 111|4@0+ (1,0) [0|15] ""  GW
 SG_ LSSSwtReq : 106|1@0+ (1,0) [0|1] ""  GW
 SG_ LSSWarnFormSwtReq : 100|2@0+ (1,0) [0|3] ""  GW
 SG_ IntelligentEvaSwtReq : 107|1@0+ (1,0) [0|1] ""  GW
 SG_ HUT_BattSOCLimSaveMod : 119|5@0+ (1,0) [0|31] ""  GW
 SG_ DrvgModeMemReq : 120|1@0+ (1,0) [0|1] ""  GW
 SG_ HUTRadioFrq : 143|12@0+ (1,0) [0|4095] "AM: kHzFM: MHz" Vector__XXX
 SG_ MediaPlaySrc : 159|4@0+ (1,0) [0|15] "" Vector__XXX
 SG_ HUT_DrvModReq : 167|4@0+ (1,0) [0|15] ""  GW
 SG_ HUT_WadeModeSet : 161|1@0+ (1,0) [0|1] ""  GW
 SG_ USB_AudioSts : 169|2@0+ (1,0) [0|3] "" Vector__XXX
 SG_ USB_VideoSts : 177|2@0+ (1,0) [0|3] "" Vector__XXX
 SG_ BT_AudioSts : 179|2@0+ (1,0) [0|3] "" Vector__XXX
 SG_ IPod_Sts : 181|2@0+ (1,0) [0|3] "" Vector__XXX
 SG_ AM_Sts : 183|2@0+ (1,0) [0|3] "" Vector__XXX
 SG_ FM_Sts : 185|2@0+ (1,0) [0|3] "" Vector__XXX
 SG_ APPLink_Sts : 187|2@0+ (1,0) [0|3] "" Vector__XXX
 SG_ QQMusic_Sts : 189|2@0+ (1,0) [0|3] "" Vector__XXX
 SG_ KaolaFM_Sts : 191|2@0+ (1,0) [0|3] "" Vector__XXX
 SG_ OnlineNews_Sts : 145|2@0+ (1,0) [0|3] "" Vector__XXX
 SG_ ChairMemPosnSet : 244|2@0+ (1,0) [0|3] ""  GW
 SG_ CCOSwtReq_HUT : 242|1@0+ (1,0) [0|1] ""  GW
 SG_ ChairMemPosnSetResult : 255|4@0+ (1,0) [0|15] ""  GW
 SG_ TABSwtReq_HUT : 224|1@0+ (1,0) [0|1] ""  GW
 SG_ NavVehToTrafEyeDist : 239|10@0+ (1,0) [0|1023] ""  GW
 SG_ NavRoadType : 311|4@0+ (1,0) [0|15] ""  GW
 SG_ NavSpdLimType : 307|2@0+ (1,0) [0|3] ""  GW
 SG_ NavSpdLimValue : 271|6@0+ (1,0) [0|63] ""  GW
 SG_ NavSpdLimUnit_HUT : 265|2@0+ (1,0) [0|3] ""  GW
 SG_ NavCtryType : 279|10@0+ (1,0) [0|1023] ""  GW
 SG_ HWA_SwtReq : 280|1@0+ (1,0) [0|1] ""  GW
 SG_ HWA_SnvtySet : 303|2@0+ (1,0) [0|3] ""  GW
 SG_ ALC_SwtReq : 296|1@0+ (1,0) [0|1] ""  GW
 SG_ NavSpdLimSignSts : 285|3@0+ (1,0) [0|7] ""  GW
 SG_ NavTSRTrafSign : 295|8@0+ (1,0) [0|255] ""  GW
 SG_ FCTASwtReq : 301|1@0+ (1,0) [0|1] ""  GW
 SG_ FCTABrkSwtReq : 300|1@0+ (1,0) [0|1] ""  GW
 SG_ AEB_JASwtReq : 299|1@0+ (1,0) [0|1] ""  GW
 SG_ AESSwtReq : 298|1@0+ (1,0) [0|1] ""  GW
 SG_ ADAS_Posn_MsgTye : 327|3@0+ (1,0) [0|7] ""  GW
 SG_ ADAS_Posn_Offset : 324|13@0+ (1,0) [0|8190] "m"  GW
 SG_ ADAS_Posn_CycCnt : 343|2@0+ (1,0) [0|3] ""  GW
 SG_ ADAS_Posn_Pathldx : 341|6@0+ (1,0) [0|63] ""  GW
 SG_ ADAS_Posn_Idx : 351|2@0+ (1,0) [0|3] "m"  GW
 SG_ ADAS_Posn_PosProbb : 349|5@0+ (3.33,0) [0|100] ""  GW
 SG_ ADAS_Posn_Age : 344|9@0+ (5,0) [0|2545] "ms"  GW
 SG_ ADAS_Posn_PosConfdc : 366|3@0+ (1,0) [0|7] ""  GW
 SG_ ADAS_Posn_CurLane : 363|3@0+ (1,0) [0|7] ""  GW
 SG_ ADAS_Posn_Spd : 360|9@0+ (0.2,-12.8) [-12.8|89.2] "ms"  GW
 SG_ ADAS_Posn_Rehead : 383|8@0+ (1,0) [0|358.583] ""  GW
 SG_ FreshnessValue_HUT_FD1 : 455|16@0+ (1,0) [0|65535] ""  GW
 SG_ MAC_Check_HUT_FD1 : 471|48@0+ (1,0) [0|281474976710655] ""  GW
 SG_ HUT_FD1_0x2C3 : 7|512@0+ (1,0) [0|0] "" Vector__XXX

BO_ 648 HUT_FD2: 64 HUT
 SG_ HUT_OD_Obj0_ID : 15|4@0+ (1,0) [0|9] ""  GW
 SG_ HUT_OD_Obj0_type : 23|3@0+ (1,0) [0|7] ""  GW
 SG_ HUT_OD_Obj0_Confidence : 11|4@0+ (0.1,0) [0|1] ""  GW
 SG_ HUT_OD_Obj0_width : 20|7@0+ (0.1,0) [0|12.6] "m"  GW
 SG_ HUT_OD_Obj0_Ground_Pos_X : 39|12@0+ (0.01,0) [0|40] "m"  GW
 SG_ HUT_OD_Obj0_Ground_Pos_Y : 43|12@0+ (0.01,-20) [-20|20] "m"  GW
 SG_ HTU_OD_Obj1_ID : 79|4@0+ (1,0) [0|9] ""  GW
 SG_ HUT_OD_Obj1_type : 87|3@0+ (1,0) [0|7] ""  GW
 SG_ HUT_OD_Obj1_Confidence : 75|4@0+ (0.1,0) [0|1] ""  GW
 SG_ HUT_OD_Obj1_width : 84|7@0+ (0.1,0) [0|12.6] "m"  GW
 SG_ HUT_OD_Obj1_Ground_Pos_X : 103|12@0+ (0.01,0) [0|40] "m"  GW
 SG_ HUT_OD_Obj1_Ground_Pos_Y : 107|12@0+ (0.01,-20) [-20|20] "m"  GW
 SG_ HUT_OD_Obj2_ID : 143|4@0+ (1,0) [0|9] ""  GW
 SG_ HUT_OD_Obj2_type : 151|3@0+ (1,0) [0|7] ""  GW
 SG_ HUT_OD_Obj2_Confidence : 139|4@0+ (0.1,0) [0|1] ""  GW
 SG_ HUT_OD_Obj2_width : 148|7@0+ (0.1,0) [0|12.6] "m"  GW
 SG_ HUT_OD_Obj2_Ground_Pos_X : 167|12@0+ (0.01,0) [0|40] "m"  GW
 SG_ HUT_OD_Obj2_Ground_Pos_Y : 171|12@0+ (0.01,-20) [-20|20] "m"  GW
 SG_ HUT_OD_Obj3_ID : 207|4@0+ (1,0) [0|9] ""  GW
 SG_ HUT_OD_Obj3_type : 215|3@0+ (1,0) [0|7] ""  GW
 SG_ HUT_OD_Obj3_Confidence : 203|4@0+ (0.1,0) [0|1] ""  GW
 SG_ HUT_OD_Obj3_width : 212|7@0+ (0.1,0) [0|12.6] "m"  GW
 SG_ HUT_OD_Obj3_Ground_Pos_X : 231|12@0+ (0.01,0) [0|40] "m"  GW
 SG_ HUT_OD_Obj3_Ground_Pos_Y : 235|12@0+ (0.01,-20) [-20|20] "m"  GW
 SG_ HUT_OD_Obj4_ID : 271|4@0+ (1,0) [0|9] ""  GW
 SG_ HUT_OD_Obj4_type : 279|3@0+ (1,0) [0|7] ""  GW
 SG_ HUT_OD_Obj4_Confidence : 267|4@0+ (0.1,0) [0|1] ""  GW
 SG_ HUT_OD_Obj4_width : 276|7@0+ (0.1,0) [0|12.6] "m"  GW
 SG_ HUT_OD_Obj4_Ground_Pos_X : 295|12@0+ (0.01,0) [0|40] "m"  GW
 SG_ HUT_OD_Obj4_Ground_Pos_Y : 299|12@0+ (0.01,-20) [-20|20] "m"  GW
 SG_ HUT_OD_Obj5_ID : 335|4@0+ (1,0) [0|9] ""  GW
 SG_ HUT_OD_Obj5_type : 343|3@0+ (1,0) [0|7] ""  GW
 SG_ HUT_OD_Obj5_Confidence : 331|4@0+ (0.1,0) [0|1] ""  GW
 SG_ HUT_OD_Obj5_width : 340|7@0+ (0.1,0) [0|12.6] "m"  GW
 SG_ HUT_OD_Obj5_Ground_Pos_X : 359|12@0+ (0.01,0) [0|40] "m"  GW
 SG_ HUT_OD_Obj5_Ground_Pos_Y : 363|12@0+ (0.01,-20) [-20|20] "m"  GW
 SG_ HUT_OD_Obj6_ID : 399|4@0+ (1,0) [0|9] ""  GW
 SG_ HUT_OD_Obj6_type : 407|3@0+ (1,0) [0|7] ""  GW
 SG_ HUT_OD_Obj6_Confidence : 395|4@0+ (0.1,0) [0|1] ""  GW
 SG_ HUT_OD_Obj6_width : 404|7@0+ (0.1,0) [0|12.6] "m"  GW
 SG_ HUT_OD_Obj6_Ground_Pos_X : 423|12@0+ (0.01,0) [0|40] "m"  GW
 SG_ HUT_OD_Obj6_Ground_Pos_Y : 427|12@0+ (0.01,-20) [-20|20] "m"  GW
 SG_ HUT_FD2_0x288 : 7|512@0+ (1,0) [0|0] "" Vector__XXX

BO_ 745 HUT_FD3: 64 HUT
 SG_ HUT_OD_Obj7_ID : 15|4@0+ (1,0) [0|9] ""  GW
 SG_ HUT_OD_Obj7_type : 23|3@0+ (1,0) [0|7] ""  GW
 SG_ HUT_OD_Obj7_Confidence : 11|4@0+ (0.1,0) [0|1] ""  GW
 SG_ HUT_OD_Obj7_width : 20|7@0+ (0.1,0) [0|12.6] "m"  GW
 SG_ HUT_OD_Obj7_Ground_Pos_X : 39|12@0+ (0.01,0) [0|40] "m"  GW
 SG_ HUT_OD_Obj7_Ground_Pos_Y : 43|12@0+ (0.01,-20) [-20|20] "m"  GW
 SG_ HUT_OD_WorkSts : 113|2@0+ (1,0) [0|3] ""  GW
 SG_ HUT_OD_Obj_Timestamp : 79|16@0+ (1,0) [0|65535] "ms"  GW
 SG_ HUT_FSD1_distance : 95|6@0+ (0.1,0) [0|6] "m"  GW
 SG_ HUT_FSD2_distance : 89|6@0+ (0.1,0) [0|6] "m"  GW
 SG_ HUT_FSD3_distance : 99|6@0+ (0.1,0) [0|6] "m"  GW
 SG_ HUT_FSD4_distance : 109|6@0+ (0.1,0) [0|6] "m"  GW
 SG_ HUT_FSD5_distance : 119|6@0+ (0.1,0) [0|6] "m"  GW
 SG_ HUT_FSD6_distance : 143|6@0+ (0.1,0) [0|6] "m"  GW
 SG_ HUT_FSD7_distance : 137|6@0+ (0.1,0) [0|6] "m"  GW
 SG_ HUT_FSD8_distance : 147|6@0+ (0.1,0) [0|6] "m"  GW
 SG_ HUT_FSD9_distance : 157|6@0+ (0.1,0) [0|6] "m"  GW
 SG_ HUT_FSD10_distance : 167|6@0+ (0.1,0) [0|6] "m"  GW
 SG_ HUT_FSD11_distance : 161|6@0+ (0.1,0) [0|6] "m"  GW
 SG_ HUT_FSD12_distance : 171|6@0+ (0.1,0) [0|6] "m"  GW
 SG_ HUT_FSD13_distance : 181|6@0+ (0.1,0) [0|6] "m"  GW
 SG_ HUT_FSD14_distance : 207|6@0+ (0.1,0) [0|6] "m"  GW
 SG_ HUT_FSD15_distance : 201|6@0+ (0.1,0) [0|6] "m"  GW
 SG_ HUT_FSD16_distance : 211|6@0+ (0.1,0) [0|6] "m"  GW
 SG_ HUT_FSD17_distance : 221|6@0+ (0.1,0) [0|6] "m"  GW
 SG_ HUT_FSD18_distance : 231|6@0+ (0.1,0) [0|6] "m"  GW
 SG_ HUT_FD3_0x2E9 : 7|512@0+ (1,0) [0|0] "" Vector__XXX

BO_ 1045 HUT19: 8 HUT
 SG_ ADAS_Meta_MsgTyp : 7|3@0+ (1,0) [0|7] ""  GW
 SG_ ADAS_Meta_MapProvider : 4|3@0+ (1,0) [0|7] ""  GW
 SG_ ADAS_Meta_CountryCode : 1|10@0+ (1,0) [0|1023] ""  GW
 SG_ ADAS_Meta_CycCnt : 23|2@0+ (1,0) [0|3] ""  GW
 SG_ ADAS_Meta_ProtVer_Major : 21|2@0+ (1,0) [0|3] ""  GW
 SG_ ADAS_Meta_ProtVer_MinorSub : 19|3@0+ (1,0) [0|7] ""  GW
 SG_ ADAS_Meta_HwVer : 16|9@0+ (1,0) [0|511] ""  GW
 SG_ ADAS_Meta_DrvSide : 39|1@0+ (1,0) [0|1] ""  GW
 SG_ ADAS_Meta_RegionCode : 38|15@0+ (1,0) [0|32767] ""  GW
 SG_ ADAS_Meta_MapVerQtr : 55|2@0+ (1,0) [0|3] ""  GW
 SG_ ADAS_Meta_MapVerYear : 53|6@0+ (1,0) [0|63] ""  GW
 SG_ ADAS_Meta_SpdUnits : 60|1@0+ (1,0) [0|1] ""  GW
 SG_ ADAS_Meta_ProtVer_Minor : 59|4@0+ (1,0) [0|15] ""  GW
 SG_ HUT19_0x415 : 7|64@0+ (1,0) [0|0] "" Vector__XXX

BO_ 840 HUT16: 8 HUT
 SG_ PowerSet : 39|1@0+ (1,0) [0|1] ""  GW
 SG_ HUT16_0x348 : 7|64@0+ (1,0) [0|0] "" Vector__XXX

BO_ 796 HUT13: 8 HUT
 SG_ AudioMuteSts : 15|2@0+ (1,0) [0|3] ""  T_Box
 SG_ OrvmPosnEnaSts : 13|3@0+ (1,0) [0|7] ""  GW
 SG_ VSGSwtSet : 8|1@0+ (1,0) [0|1] ""  GW
 SG_ HUT13_0x31C : 7|64@0+ (1,0) [0|0] "" Vector__XXX

BO_ 871 HUT1: 8 HUT
 SG_ DomeLmpDlyTimSet : 7|3@0+ (1,0) [0|7] ""  GW
 SG_ FolwMeHomeDlyTimSet : 3|3@0+ (1,0) [0|7] ""  GW
 SG_ TranPMode_Req : 15|1@0+ (1,0) [0|1] ""  GW
 SG_ RearviewFoldModSet : 14|1@0+ (1,0) [0|1] ""  GW
 SG_ BattSaveDelayTimeSet : 13|2@0+ (1,0) [0|3] ""  GW
 SG_ ACDualReq_TC : 21|2@0+ (1,0) [0|3] ""  GW
 SG_ ACAutoModReq_TC : 19|2@0+ (1,0) [0|3] ""  GW
 SG_ ACAirInletReq_TC : 17|2@0+ (1,0) [0|3] ""  GW
 SG_ ACAQSReq_TC : 31|2@0+ (1,0) [0|3] ""  GW
 SG_ ACCmprReq_TC : 29|2@0+ (1,0) [0|3] ""  GW
 SG_ ACFrntDefrstReq_TC : 27|2@0+ (1,0) [0|3] ""  GW
 SG_ ACFrntBlwrSpdDecReq_TC : 25|2@0+ (1,0) [0|3] ""  GW
 SG_ DrvDrowsnsDetnSet : 36|1@0+ (1,0) [0|1] ""  GW
 SG_ ACFrntBlwrSpdIncReq_TC : 47|2@0+ (1,0) [0|3] ""  GW
 SG_ ACDrvAirDistribModReq_TC : 45|3@0+ (1,0) [0|7] ""  GW
 SG_ ACDrvTempDecReq_TC : 42|2@0+ (1,0) [0|3] ""  GW
 SG_ ChairMemPosnEna : 40|1@0+ (1,0) [0|1] ""  GW
 SG_ ACDrvTempIncReq_TC : 55|2@0+ (1,0) [0|3] ""  GW
 SG_ ACFrntPassTempDecReq_TC : 53|2@0+ (1,0) [0|3] ""  GW
 SG_ ACFrntPassTempIncReq_TC : 51|2@0+ (1,0) [0|3] ""  GW
 SG_ ACAIUReq_TC : 48|1@0+ (1,0) [0|1] ""  GW
 SG_ ACOffReq_TC : 63|2@0+ (1,0) [0|3] ""  GW
 SG_ ACBlwrsteplsSpdReq_TC : 59|4@0+ (1,0) [0|15] ""  GW
 SG_ HUT1_0x367 : 7|64@0+ (1,0) [0|0] "" Vector__XXX

BO_ 873 HUT2: 8 HUT
 SG_ AMP_MediaCallSourceSet : 7|4@0+ (1,0) [0|15] ""  GW
 SG_ AMP_NaviSourceSet : 39|3@0+ (1,0) [0|7] ""  GW
 SG_ AMP_BeepSourceSet : 2|3@0+ (1,0) [0|7] ""  GW
 SG_ AMP_LRAudioBalanceSet : 15|5@0+ (1,0) [0|20] ""  GW
 SG_ AMP_AudioVolVSCModReq : 9|2@0+ (1,0) [0|3] ""  GW
 SG_ AMP_FRAudioFaderSet : 23|5@0+ (1,0) [0|20] ""  GW
 SG_ AMP_LRDrvSideSet : 17|1@0+ (1,0) [0|1] ""  GW
 SG_ AMP_LowFrqAudioSet : 31|5@0+ (1,0) [0|20] ""  GW
 SG_ AMP_MuteSet : 25|1@0+ (1,0) [0|1] ""  GW
 SG_ AMP_MidFrqAudioSet : 47|5@0+ (1,0) [0|20] ""  GW
 SG_ AMP_HighFrqAudioSet : 55|5@0+ (1,0) [0|20] ""  GW
 SG_ T_box_ECallSet : 50|1@0+ (1,0) [0|1] ""  GW
 SG_ QLISurroundSet : 49|1@0+ (1,0) [0|1] ""  GW
 SG_ ANCSwtSet : 36|1@0+ (1,0) [0|1] ""  GW
 SG_ RearWinHeatCmd_TC : 41|2@0+ (1,0) [0|3] ""  GW
 SG_ FrntWinHeatSwt : 42|1@0+ (1,0) [0|1] ""  GW
 SG_ HUT2_0x369 : 7|64@0+ (1,0) [0|0] "" Vector__XXX

BO_ 875 HUT3: 8 HUT
 SG_ AMP_HFMVolSet : 7|6@0+ (1,0) [0|39] ""  GW
 SG_ AMP_TTSVolSet_VR : 15|6@0+ (1,0) [0|39] ""  GW
 SG_ AMP_NaviVolSet : 23|6@0+ (1,0) [0|39] ""  GW
 SG_ AMP_MainVolSet : 31|6@0+ (1,0) [0|39] ""  GW
 SG_ AMP_GetSWInfoReq : 33|1@0+ (1,0) [0|1] ""  GW
 SG_ AMP_GetHWInfoReq : 32|1@0+ (1,0) [0|1] ""  GW
 SG_ AMP_GetTempInfoReq : 41|1@0+ (1,0) [0|1] ""  GW
 SG_ AMP_GetIntVoltInfoReq : 40|1@0+ (1,0) [0|1] ""  GW
 SG_ AMP_GetDTCInfoReq : 49|1@0+ (1,0) [0|1] ""  GW
 SG_ IESS_MdlSwtReq : 35|2@0+ (1,0) [0|3] ""  GW
 SG_ IESS_MdlInfoReq : 1|1@0+ (1,0) [0|1] ""  GW
 SG_ AMP_BestListegPosnReq : 39|3@0+ (1,0) [0|7] ""  GW
 SG_ AMP_Clari_FiReq : 43|1@0+ (1,0) [0|1] ""  GW
 SG_ HUT3_0x36B : 7|64@0+ (1,0) [0|0] "" Vector__XXX

BO_ 877 HUT4: 8 HUT
 SG_ DrvSeatHeatgLvlSet : 15|2@0+ (1,0) [0|3] ""  GW
 SG_ PassSeatHeatgLvlSet : 12|2@0+ (1,0) [0|3] ""  GW
 SG_ DrvSeatVentnLvlSet : 9|2@0+ (1,0) [0|3] ""  GW
 SG_ PassSeatVentnLvlSet : 23|2@0+ (1,0) [0|3] ""  GW
 SG_ ACAutoModReq_VR : 25|2@0+ (1,0) [0|3] ""  GW
 SG_ ACCmprReq_VR : 39|2@0+ (1,0) [0|3] ""  GW
 SG_ ACPowerReq_VR : 37|2@0+ (1,0) [0|3] ""  GW
 SG_ ACBlwrSpdReq_VR : 35|4@0+ (1,0) [0|15] ""  GW
 SG_ ACDrvTempReq_VR : 47|6@0+ (0.5,15.5) [16|32] "Â°C"  GW
 SG_ ACFrntDefrostReq_VR : 41|2@0+ (1,0) [0|3] ""  GW
 SG_ ACDrvAirDistribModReq_VR : 55|3@0+ (1,0) [0|7] ""  GW
 SG_ ACAirInletReq_VR : 52|2@0+ (1,0) [0|3] ""  GW
 SG_ ACModReq_HUT : 63|2@0+ (1,0) [0|3] "" Vector__XXX
 SG_ ElecSideSteppingSysSet : 21|1@0+ (1,0) [0|1] ""  GW
 SG_ RoofModSet : 18|1@0+ (1,0) [0|1] ""  GW
 SG_ AllTerrainDislSet : 29|1@0+ (1,0) [0|1] ""  GW
 SG_ RemUpgrdSts : 56|1@0+ (1,0) [0|1] ""  GW,T_Box
 SG_ HUT4_0x36D : 7|64@0+ (1,0) [0|0] "" Vector__XXX

BO_ 74 HUT6: 8 HUT
 SG_ AUTODefrost_TC : 6|2@0+ (1,0) [0|3] ""  GW
 SG_ AUTODefrost_VR : 4|2@0+ (1,0) [0|3] ""  GW
 SG_ LaneCalActvtCmd : 42|1@0+ (1,0) [0|1] ""  GW
 SG_ MODChgReq : 62|1@0+ (1,0) [0|1] ""  GW
 SG_ Radar_DispCmd : 40|1@0+ (1,0) [0|1] ""  GW
 SG_ Guid_Ovl_Display_Cmd : 7|1@0+ (1,0) [0|1] ""  GW
 SG_ Sgl_View_Sel : 36|4@0+ (1,0) [0|15] ""  GW
 SG_ SwToFieldCalRstCmd : 58|1@0+ (1,0) [0|1] ""  GW
 SG_ AutoViewChgCmd : 55|1@0+ (1,0) [0|1] ""  GW
 SG_ MdlColrChgCmd : 53|1@0+ (1,0) [0|1] ""  GW
 SG_ CarMdlTrsprcySwtCmd : 49|1@0+ (1,0) [0|1] ""  GW
 SG_ CarMdlDispCmd : 63|1@0+ (1,0) [0|1] ""  GW
 SG_ AutoAVMSwSet_Cmd : 57|1@0+ (1,0) [0|1] ""  GW
 SG_ FPAS_AutoModSwt : 60|1@0+ (1,0) [0|1] ""  GW
 SG_ MEBSwtSet : 61|1@0+ (1,0) [0|1] ""  GW
 SG_ WshSoftSwt : 56|1@0+ (1,0) [0|1] ""  GW
 SG_ View_SoftswitchCmd : 59|1@0+ (1,0) [0|1] ""  GW
 SG_ HUT6_0x4A : 7|64@0+ (1,0) [0|0] "" Vector__XXX

BO_ 880 HUT34: 8 HUT
 SG_ TimeMod : 16|1@0+ (1,0) [0|1] ""  GW,DMS,DVR
 SG_ TimeIndcn : 17|1@0+ (1,0) [0|1] ""  GW,DMS,DVR
 SG_ Time_Hour : 15|5@0+ (1,0) [0|31] ""  GW,T_Box,DMS,DVR
 SG_ Time_Minutes : 23|6@0+ (1,0) [0|63] ""  GW,T_Box,DMS,DVR
 SG_ Time_Second : 31|6@0+ (1,0) [0|63] ""  GW,T_Box,DMS,DVR
 SG_ Time_Year_Left : 39|4@0+ (1,0) [0|15] ""  GW,T_Box,DMS,DVR
 SG_ Time_Year_Right : 35|4@0+ (1,0) [0|15] ""  GW,T_Box,DMS,DVR
 SG_ Time_Month : 47|4@0+ (1,0) [0|15] ""  GW,T_Box,DMS,DVR
 SG_ Time_Day : 55|5@0+ (1,0) [0|31] ""  GW,T_Box,DMS,DVR
 SG_ HUT34_0x370 : 7|64@0+ (1,0) [0|0] "" Vector__XXX

BO_ 817 HUT10: 8 HUT
 SG_ HUT_EgyRecvrySet : 5|2@0+ (1,0) [0|3] ""  GW
 SG_ ACDualReq_VR : 11|2@0+ (1,0) [0|3] ""  GW
 SG_ ACAQSReq_VR : 9|2@0+ (1,0) [0|3] ""  GW
 SG_ ACRearDefrstReq_VR : 41|2@0+ (1,0) [0|3] ""  GW
 SG_ ACPassTempReq_VR : 53|6@0+ (0.5,15.5) [16|32] "Â°C"  GW
 SG_ ACAIUReq_VR : 57|2@0+ (1,0) [0|3] ""  GW
 SG_ IPVolSet : 63|6@0+ (1,0) [0|63] ""  GW
 SG_ ALCMStatSwt : 47|1@0+ (1,0) [0|1] ""  GW
 SG_ ALCMDynSwt : 46|1@0+ (1,0) [0|1] ""  GW
 SG_ ALCMClrSet : 37|6@0+ (1,0) [0|63] ""  GW
 SG_ ALCMRhmSwt : 24|1@0+ (1,0) [0|1] ""  GW
 SG_ PASSwtReq_VR : 55|2@0+ (1,0) [0|3] ""  GW
 SG_ HUT10_0x331 : 7|64@0+ (1,0) [0|0] "" Vector__XXX

BO_ 494 HUT15: 16 HUT
 SG_ ACOperMod_TC : 7|2@0+ (1,0) [0|3] ""  GW
 SG_ ACOperMod_VR : 5|2@0+ (1,0) [0|3] ""  GW
 SG_ SteerWheelHeatSwtReq : 3|2@0+ (1,0) [0|3] ""  GW
 SG_ ACDrvSetTempSteplsReq_TC : 23|6@0+ (0.5,15.5) [16|32] ""  GW
 SG_ ACPassSetTempSteplsReq_TC : 31|6@0+ (0.5,15.5) [16|32] ""  GW
 SG_ SDWSwtSet : 39|1@0+ (1,0) [0|1] ""  GW
 SG_ APSSwtReq_VR : 55|2@0+ (1,0) [0|3] ""  GW
 SG_ PASExitSpdSwt : 53|2@0+ (1,0) [0|3] ""  GW
 SG_ APSPrkgTypSeln : 34|2@0+ (1,0) [0|3] ""  GW
 SG_ SunShadeSwtReq_VR : 43|4@0+ (1,0) [0|15] ""  GW
 SG_ SunRoofSwtReq_VR : 47|4@0+ (1,0) [0|15] ""  GW
 SG_ SportModLightSet : 1|2@0+ (1,0) [0|3] ""  GW
 SG_ ABSLmpSet : 14|1@0+ (1,0) [0|1] ""  GW
 SG_ AutoWshWipSet : 12|2@0+ (1,0) [0|3] ""  GW
 SG_ SeekVehSet : 10|2@0+ (1,0) [0|3] ""  GW
 SG_ SpdAutoLockModSet : 25|2@0+ (1,0) [0|3] ""  GW
 SG_ ParkLmpSet : 8|1@0+ (1,0) [0|1] ""  GW
 SG_ DoorUnlockModSet : 15|1@0+ (1,0) [0|1] ""  GW
 SG_ ACEAHReq_TC : 32|1@0+ (1,0) [0|1] "" Vector__XXX
 SG_ ACEAHReq_VR : 38|2@0+ (1,0) [0|3] "" Vector__XXX
 SG_ FreshnessValue_HUT15 : 71|16@0+ (1,0) [0|65535] ""  GW
 SG_ MAC_Check_HUT15 : 87|48@0+ (1,0) [0|281474976710655] ""  GW
 SG_ HUT15_0x1EE : 7|128@0+ (1,0) [0|0] "" Vector__XXX

BO_ 827 HUT17: 8 HUT
 SG_ AVMSwtReq : 19|1@0+ (1,0) [0|1] ""  GW
 SG_ NaviMediaVolLvlReq : 31|4@0+ (1,0) [0|15] ""  GW
 SG_ AVMMediaVolLvlReq : 27|4@0+ (1,0) [0|15] ""  GW
 SG_ FPASChanSwtReq : 18|1@0+ (1,0) [0|1] ""  GW
 SG_ RPASChanSwtReq : 17|1@0+ (1,0) [0|1] ""  GW
 SG_ BackgroundLightLvlSet : 39|4@0+ (1,0) [0|15] ""  GW
 SG_ ManCmpSet : 35|4@0+ (1,0) [0|15] "" Vector__XXX
 SG_ DispModSet : 47|2@0+ (1,0) [0|3] "" Vector__XXX
 SG_ OPDSwtSts : 53|2@0+ (1,0) [0|3] ""  GW
 SG_ PLGReq_VR : 55|2@0+ (1,0) [0|3] ""  GW
 SG_ WPC_SwtReq : 23|2@0+ (1,0) [0|3] ""  GW
 SG_ HUT17_0x33B : 7|64@0+ (1,0) [0|0] "" Vector__XXX

BO_ 734 HUT20: 8 HUT
 SG_ ADAS_ProfLong_MsgTyp : 7|3@0+ (1,0) [0|7] ""  GW
 SG_ ADAS_ProfLong_Offset : 4|13@0+ (1,0) [0|8190] "m"  GW
 SG_ ADAS_ProfLong_CycCnt : 23|2@0+ (1,0) [0|3] ""  GW
 SG_ ADAS_ProfLong_PathIdx : 21|6@0+ (1,0) [0|63] ""  GW
 SG_ ADAS_ProfLong_ProfTyp : 31|5@0+ (1,0) [0|31] ""  GW
 SG_ ADAS_ProfLong_CtrlPoint : 26|1@0+ (1,0) [0|1] ""  GW
 SG_ ADAS_ProfLong_Retr : 25|1@0+ (1,0) [0|1] ""  GW
 SG_ ADAS_ProfLong_Update : 24|1@0+ (1,0) [0|1] ""  GW
 SG_ ADAS_ProfLong_Value : 39|32@0+ (1,0) [0|4294967295] ""  GW
 SG_ HUT20_0x2DE : 7|64@0+ (1,0) [0|0] "" Vector__XXX

BO_ 733 HUT21: 8 HUT
 SG_ ADAS_ProfShort_MsgTyp : 7|3@0+ (1,0) [0|7] ""  GW
 SG_ ADAS_ProfShort_Offset : 4|13@0+ (1,0) [0|8190] "m"  GW
 SG_ ADAS_ProfShort_CycCnt : 23|2@0+ (1,0) [0|3] ""  GW
 SG_ ADAS_ProfShort_PathIdx : 21|6@0+ (1,0) [0|63] ""  GW
 SG_ ADAS_ProfShort_ProfTyp : 31|5@0+ (1,0) [0|31] ""  GW
 SG_ ADAS_ProfShort_CtrlPoint : 26|1@0+ (1,0) [0|1] ""  GW
 SG_ ADAS_ProfShort_Retr : 25|1@0+ (1,0) [0|1] ""  GW
 SG_ ADAS_ProfShort_Update : 24|1@0+ (1,0) [0|1] ""  GW
 SG_ ADAS_ProfShort_AccurClass : 39|2@0+ (1,0) [0|3] ""  GW
 SG_ ADAS_ProfShort_Dist1 : 37|10@0+ (1,0) [0|1022] "m"  GW
 SG_ ADAS_ProfShort_Value0 : 43|10@0+ (1,0) [0|1022] ""  GW
 SG_ ADAS_ProfShort_Value1 : 49|10@0+ (1,0) [0|1022] ""  GW
 SG_ HUT21_0x2DD : 7|64@0+ (1,0) [0|0] "" Vector__XXX

BO_ 730 HUT22: 8 HUT
 SG_ ADAS_Seg_MsgTyp : 7|3@0+ (1,0) [0|7] ""  GW
 SG_ ADAS_Seg_Offset : 4|13@0+ (1,0) [0|8190] "m"  GW
 SG_ ADAS_Seg_CycCnt : 23|2@0+ (1,0) [0|3] ""  GW
 SG_ ADAS_Seg_PathIdx : 21|6@0+ (1,0) [0|63] ""  GW
 SG_ ADAS_Seg_Tunnel : 31|2@0+ (1,0) [0|3] ""  GW
 SG_ ADAS_Seg_Brdg : 29|2@0+ (1,0) [0|3] ""  GW
 SG_ ADAS_Seg_BuildUpArea : 27|2@0+ (1,0) [0|3] ""  GW
 SG_ ADAS_Seg_Retr : 25|1@0+ (1,0) [0|1] ""  GW
 SG_ ADAS_Seg_Update : 24|1@0+ (1,0) [0|1] ""  GW
 SG_ ADAS_Seg_RelProbb : 39|5@0+ (1,0) [0|100] ""  GW
 SG_ ADAS_Seg_FuncRoadClass : 34|3@0+ (1,0) [0|7] ""  GW
 SG_ ADAS_Seg_PartOfCalcRoute : 47|2@0+ (1,0) [0|3] ""  GW
 SG_ ADAS_Seg_CmplxInsct : 45|2@0+ (1,0) [0|3] ""  GW
 SG_ ADAS_Seg_FormOfWay : 43|4@0+ (1,0) [0|15] ""  GW
 SG_ ADAS_Seg_EffSpdLmt : 55|5@0+ (1,0) [0|31] ""  GW
 SG_ ADAS_Seg_EffSpdLmtTyp : 50|3@0+ (1,0) [0|7] ""  GW
 SG_ ADAS_Seg_DivideRoad : 62|2@0+ (1,0) [0|3] ""  GW
 SG_ ADAS_Seg_NumOfLaneOppDir : 60|2@0+ (1,0) [0|3] ""  GW
 SG_ ADAS_Seg_NumOfLaneDrvDir : 58|3@0+ (1,0) [0|7] ""  GW
 SG_ HUT22_0x2DA : 7|64@0+ (1,0) [0|0] "" Vector__XXX

BO_ 728 HUT23: 8 HUT
 SG_ ADAS_Stub_MsgTyp : 7|3@0+ (1,0) [0|7] ""  GW
 SG_ ADAS_Stub_Offset : 4|13@0+ (1,0) [0|8190] "m"  GW
 SG_ ADAS_Stub_CycCnt : 23|2@0+ (1,0) [0|3] ""  GW
 SG_ ADAS_Stub_PathIdx : 21|6@0+ (1,0) [0|63] ""  GW
 SG_ ADAS_Stub_StubPathIdx : 31|6@0+ (1,0) [0|63] ""  GW
 SG_ ADAS_Stub_Retr : 25|1@0+ (1,0) [0|1] ""  GW
 SG_ ADAS_Stub_Update : 24|1@0+ (1,0) [0|1] ""  GW
 SG_ ADAS_Stub_RelProbb : 39|5@0+ (1,0) [0|100] ""  GW
 SG_ ADAS_Stub_FuncRoadClass : 34|3@0+ (1,0) [0|7] ""  GW
 SG_ ADAS_Stub_PartOfCalcRoute : 47|2@0+ (1,0) [0|3] ""  GW
 SG_ ADAS_Stub_CmplxInsct : 45|2@0+ (1,0) [0|3] ""  GW
 SG_ ADAS_Stub_FormOfWay : 43|4@0+ (1,0) [0|15] ""  GW
 SG_ ADAS_Stub_TurnAngl : 55|8@0+ (1,0) [0|358.583] ""  GW
 SG_ ADAS_Stub_LastStub : 63|1@0+ (1,0) [0|1] ""  GW
 SG_ ADAS_Stub_RtOfWay : 62|2@0+ (1,0) [0|3] ""  GW
 SG_ ADAS_Stub_NumOfLaneOppDir : 60|2@0+ (1,0) [0|3] ""  GW
 SG_ ADAS_Stub_NumOfLaneDrvDir : 58|3@0+ (1,0) [0|7] ""  GW
 SG_ HUT23_0x2D8 : 7|64@0+ (1,0) [0|0] "" Vector__XXX

BO_ 489 HUT30: 8 HUT
 SG_ IdnResultReq_HUT : 1|2@0+ (1,0) [0|3] ""  DMS
 SG_ BackReq_AVM : 13|1@0+ (1,0) [0|1] ""  GW
 SG_ HUD_HeightLvlSwt : 12|5@0+ (1,0) [0|31] ""  GW
 SG_ HUD_BrightnessLvlSwt : 31|4@0+ (1,0) [0|15] ""  GW
 SG_ HUD_SwtReq : 25|2@0+ (1,0) [0|3] ""  GW
 SG_ ExprsnSetUp : 37|2@0+ (1,0) [0|3] ""  DMS
 SG_ DistrctnDetnSet : 35|2@0+ (1,0) [0|3] ""  DMS
 SG_ DrowsnsDetnSet : 33|2@0+ (1,0) [0|3] ""  DMS
 SG_ FaceIdnSet : 47|2@0+ (1,0) [0|3] ""  DMS
 SG_ VoiceIdnSet : 45|2@0+ (1,0) [0|3] ""  DMS
 SG_ EraseAllFaceUsersReq : 43|2@0+ (1,0) [0|3] ""  DMS
 SG_ EraseAllVoiceUsersReq : 41|2@0+ (1,0) [0|3] ""  DMS
 SG_ CancelVoiceIdn : 55|2@0+ (1,0) [0|3] ""  DMS
 SG_ EnrollFaceReq : 53|2@0+ (1,0) [0|3] ""  DMS
 SG_ EnrollUserIDResult : 51|4@0+ (1,0) [0|15] ""  DMS
 SG_ DeleteUserIDFaceData : 63|4@0+ (1,0) [0|15] ""  DMS
 SG_ DeleteUserIDVoiceData : 59|4@0+ (1,0) [0|15] ""  DMS
 SG_ HUT30_0x1E9 : 7|64@0+ (1,0) [0|0] "" Vector__XXX

BO_ 623 HUT32: 8 HUT
 SG_ CheckSum_HUT32 : 7|8@0+ (1,0) [0|255] ""  GW
 SG_ ScrnOpSts : 47|2@0+ (1,0) [0|3] ""  GW
 SG_ XLvl : 23|11@0+ (1,0) [0|2047] ""  GW
 SG_ YLvl : 26|11@0+ (1,0) [0|2047] ""  GW
 SG_ DetVideoLost : 9|1@0+ (1,0) [0|1] ""  GW
 SG_ PrkgCtrlModReqValid : 10|1@0+ (1,0) [0|1] ""  GW
 SG_ PrkgCtrlModReq : 13|2@0+ (1,0) [0|3] ""  GW
 SG_ ContnPrkgReqValid : 8|1@0+ (1,0) [0|1] ""  GW
 SG_ ContnPrkgReq : 15|2@0+ (1,0) [0|3] ""  GW
 SG_ VolLampDispSts : 43|4@0+ (1,0) [0|15] ""  GW
 SG_ PrkStraightSwtReq_HUT : 11|1@0+ (1,0) [0|1] ""  GW
 SG_ PrkStraightSuspendOrFinishReq_HU : 28|2@0+ (1,0) [0|3] ""  GW
 SG_ PrkStraightModSel_HUT : 63|3@0+ (1,0) [0|3] ""  GW
 SG_ PrkStraightSts_HUT : 60|1@0+ (1,0) [0|1] ""  GW
 SG_ PrkStraightStrtReq_HUT : 45|1@0+ (1,0) [0|1] ""  GW
 SG_ PrkStraightVehStrtReq_HUT_Valid : 44|1@0+ (1,0) [0|1] ""  GW
 SG_ PrkStraightContinueReq_HUT : 55|1@0+ (1,0) [0|1] ""  GW
 SG_ RollingCounter_HUT32 : 59|4@0+ (1,0) [0|15] ""  GW
 SG_ HUT32_0x26F : 7|64@0+ (1,0) [0|0] "" Vector__XXX

BO_ 493 HUT33: 8 HUT
 SG_ MbrMonrEnReq_TC : 1|2@0+ (1,0) [0|3] ""  GW
 SG_ ChairMemPosnSetSwt : 10|3@0+ (1,0) [0|7] ""  GW
 SG_ ApproachLampSet : 7|2@0+ (1,0) [0|3] ""  GW
 SG_ FlaoutUnlockSet : 5|2@0+ (1,0) [0|3] ""  GW
 SG_ SuperLockSet : 3|2@0+ (1,0) [0|3] ""  GW
 SG_ PrkInDirChoice : 12|2@0+ (1,0) [0|3] ""  GW
 SG_ PathLrngFinshCmd : 17|1@0+ (1,0) [0|1] ""  GW
 SG_ PathLrngStartCmd : 18|1@0+ (1,0) [0|1] ""  GW
 SG_ SelPrkOutDirReq : 23|3@0+ (1,0) [0|7] ""  GW
 SG_ ParkMdlCmd : 19|1@0+ (1,0) [0|1] ""  GW
 SG_ BackReq_APS : 20|1@0+ (1,0) [0|1] ""  GW
 SG_ StartPrkgPath2Cmd : 25|1@0+ (1,0) [0|1] ""  GW
 SG_ DeletePath2Cmd : 26|1@0+ (1,0) [0|1] ""  GW
 SG_ StartPrkgPath1Cmd : 27|1@0+ (1,0) [0|1] ""  GW
 SG_ DeletePath1Cmd : 28|1@0+ (1,0) [0|1] ""  GW
 SG_ SelPrkgFctnCmd : 31|3@0+ (1,0) [0|7] ""  GW
 SG_ RLWinSwtReq_VR : 34|3@0+ (1,0) [0|7] ""  GW
 SG_ RRWinSwtReq_VR : 55|3@0+ (1,0) [0|7] ""  GW
 SG_ DrvWinSwtReq_VR : 15|3@0+ (1,0) [0|7] ""  GW
 SG_ PassWinSwtReq_VR : 37|3@0+ (1,0) [0|7] ""  GW
 SG_ ALCMDynModSet : 52|3@0+ (1,0) [0|7] ""  GW
 SG_ HUT33_0x1ED : 7|64@0+ (1,0) [0|0] "" Vector__XXX

BO_ 825 HUT25: 8 HUT
 SG_ CarWashMode_Req : 31|2@0+ (1,0) [0|3] ""  GW
 SG_ HUT_ChrgnMode : 29|2@0+ (1,0) [0|3] ""  GW,T_Box
 SG_ HUT_RemtEngCtrl : 27|2@0+ (1,0) [0|3] ""  T_Box
 SG_ HUT_BattKeepTemp : 25|2@0+ (1,0) [0|3] ""  GW,T_Box
 SG_ HUT_IntelEngIdlChrgnSet : 49|2@0+ (1,0) [0|3] ""  GW
 SG_ HUT_BattSOCLim : 63|3@0+ (1,0) [0|7] ""  GW,T_Box
 SG_ HUT_IntelBattTempMagSet : 57|2@0+ (1,0) [0|3] ""  GW,T_Box
 SG_ HUT25_0x339 : 7|64@0+ (1,0) [0|0] "" Vector__XXX

BO_ 589 DMS_FD1: 64 HUT
 SG_ DrowsnsLvl : 13|3@0+ (1,0) [0|7] "" Vector__XXX
 SG_ DrowsnsLvlQlty : 10|7@0+ (1,0) [0|100] "%" Vector__XXX
 SG_ DMSProc : 19|3@0+ (1,0) [0|7] "" Vector__XXX
 SG_ DMSProcResult : 16|4@0+ (1,0) [0|15] "" Vector__XXX
 SG_ DMSProcSts : 28|4@0+ (1,0) [0|15] "" Vector__XXX
 SG_ DMSIdnResult : 24|4@0+ (1,0) [0|15] "" Vector__XXX
 SG_ GenderSts : 36|2@0+ (1,0) [0|3] "" Vector__XXX
 SG_ ExprsnSts : 34|3@0+ (1,0) [0|7] "" Vector__XXX
 SG_ GenderStsQlty : 47|7@0+ (1,0) [0|100] "%" Vector__XXX
 SG_ ExprsnStsQlty : 55|7@0+ (1,0) [0|100] "%" Vector__XXX
 SG_ Checksum_DMS2 : 71|8@0+ (1,0) [0|255] ""  GW
 SG_ DistrctnLvl_ACC : 95|3@0+ (1,0) [0|7] ""  GW
 SG_ DistrctnLvlQlty_ACC : 79|7@0+ (1,0) [0|100] "%"  GW
 SG_ DrowsnsLvl_ACC : 92|3@0+ (1,0) [0|7] ""  GW
 SG_ DrowsnsLvlQlty_ACC : 87|7@0+ (1,0) [0|100] "%"  GW
 SG_ DistrctnLvl : 103|3@0+ (1,0) [0|7] "" Vector__XXX
 SG_ DistrctnLvlQlty : 111|7@0+ (1,0) [0|100] "%" Vector__XXX
 SG_ RollingCounter_DMS2 : 123|4@0+ (1,0) [0|15] ""  GW
 SG_ Checksum_DMS3 : 135|8@0+ (1,0) [0|255] ""  GW
 SG_ HeadPosnX : 143|11@0+ (1,-500) [-500|1000] "mm"  GW
 SG_ HeadPosnY : 148|11@0+ (1,-500) [-500|500] "mm"  GW
 SG_ HeadPosnZ : 153|11@0+ (1,-500) [-500|500] "mm"  GW
 SG_ HeadPosQlty : 174|7@0+ (1,0) [0|100] "%"  GW
 SG_ DrvBehvSts : 190|3@0+ (1,0) [0|7] "" Vector__XXX
 SG_ RollingCounter_DMS3 : 187|4@0+ (1,0) [0|15] ""  GW
 SG_ GazePosnX : 207|11@0+ (1,-500) [-500|1000] "mm"  GW
 SG_ GazePosnY : 212|11@0+ (1,-500) [-500|500] "mm"  GW
 SG_ GazePosnZ : 217|11@0+ (1,-500) [-500|500] "mm"  GW
 SG_ DrvGazeAreaSts : 254|3@0+ (1,0) [0|7] "" Vector__XXX
 SG_ Checksum_DMS5 : 263|8@0+ (1,0) [0|255] ""  GW
 SG_ DMSSts : 303|3@0+ (1,0) [0|7] ""  GW
 SG_ HeadDetn : 288|1@0+ (1,0) [0|1] ""  GW
 SG_ HeadYawAng : 271|8@0+ (1,-75) [-75|75] "degree"  GW
 SG_ HeadPitchAng : 279|8@0+ (1,-25) [-25|45] "degree"  GW
 SG_ HeadRollAng : 287|8@0+ (1,-45) [-45|45] "degree"  GW
 SG_ HeadRotAngQlty : 295|7@0+ (1,0) [0|100] "%"  GW
 SG_ RollingCounter_DMS5 : 315|4@0+ (1,0) [0|15] ""  GW
 SG_ Checksum_DMS6 : 327|8@0+ (1,0) [0|255] ""  GW
 SG_ LEyeOpenSts : 375|2@0+ (1,0) [0|3] ""  GW
 SG_ LEyeOpenStsQlty : 351|7@0+ (1,0) [0|100] "%"  GW
 SG_ REyeOpenSts : 373|2@0+ (1,0) [0|3] ""  GW
 SG_ REyeOpenStsQlty : 359|7@0+ (1,0) [0|100] "%"  GW
 SG_ RobustGazeYawAng : 335|8@0+ (1,-90) [-90|90] "degree"  GW
 SG_ RobustGazePitchAng : 343|8@0+ (1,-90) [-90|90] "degree"  GW
 SG_ RobustGazeAngQlty : 367|7@0+ (1,0) [0|100] "%"  GW
 SG_ RollingCounter_DMS6 : 379|4@0+ (1,0) [0|15] ""  GW
 SG_ dummy_DMS_FD1_5 : 72|1@0+ (1,0) [0|1] "" Vector__XXX
 SG_ dummy_DMS_FD1_6 : 80|1@0+ (1,0) [0|1] "" Vector__XXX
 SG_ dummy_DMS_FD1_7 : 89|2@0+ (1,0) [0|3] "" Vector__XXX
 SG_ dummy_DMS_FD1_8 : 100|5@0+ (1,0) [0|31] "" Vector__XXX
 SG_ dummy_DMS_FD1_9 : 104|1@0+ (1,0) [0|1] "" Vector__XXX
 SG_ dummy_DMS_FD1_10 : 119|8@0+ (1,0) [0|255] "" Vector__XXX
 SG_ dummy_DMS_FD1_11 : 127|4@0+ (1,0) [0|15] "" Vector__XXX
 SG_ dummy_DMS_FD1_12 : 183|8@0+ (1,0) [0|255] "" Vector__XXX
 SG_ dummy_DMS_FD1_13 : 191|1@0+ (1,0) [0|1] "" Vector__XXX
 SG_ dummy_DMS_FD1_19 : 300|5@0+ (1,0) [0|31] "" Vector__XXX
 SG_ dummy_DMS_FD1_20 : 311|8@0+ (1,0) [0|255] "" Vector__XXX
 SG_ dummy_DMS_FD1_21 : 319|4@0+ (1,0) [0|15] "" Vector__XXX
 SG_ dummy_DMS_FD1_22 : 344|1@0+ (1,0) [0|1] "" Vector__XXX
 SG_ dummy_DMS_FD1_23 : 352|1@0+ (1,0) [0|1] "" Vector__XXX
 SG_ dummy_DMS_FD1_24 : 360|1@0+ (1,0) [0|1] "" Vector__XXX
 SG_ dummy_DMS_FD1_25 : 371|4@0+ (1,0) [0|15] "" Vector__XXX
 SG_ dummy_DMS_FD1_26 : 383|4@0+ (1,0) [0|15] "" Vector__XXX
 SG_ DMS_FD1_0x24D : 7|512@0+ (1,0) [0|0] "" Vector__XXX

CM_ SG_ 659 IP_CurrTheme "Indicate the current theme by IP.The coding detailed definition according to specific project";
CM_ SG_ 659 IP_VehSpdDisp "The vehilce speed display by IP";
CM_ SG_ 659 IP_FuelMainTankR "IP external main fuel tank resistance valuePT-CAN To:ECM";
CM_ SG_ 659 IP_FuelAuxTankR "IP external auxiliary fuel tank resistance valuePT-CAN To:ECM";
CM_ SG_ 659 IP_VelSpdDisp_Mile "The vehicle speed display by IP(Mile)";
CM_ SG_ 659 IP_LagueSet "Language set";
CM_ SG_ 639 CheckSum_IP2 "Use the checksum strategy from document â€œEnd-to-End Communication Protection Specificationâ€PT-CANFD To:ESP,Ibooster";
CM_ SG_ 639 IP_DrvSeatBeltWarnLmpFailSts "Driver Seat Belt  warning lamp failure statusBD2-CAN To:ABM";
CM_ SG_ 639 IP_PassSeatBeltWarnLmpFailSts "Passenger  Seat Belt warning lamp failure statusBD2-CAN To:ABM";
CM_ SG_ 639 IP_VehTotDistance "Vehicle total distanceBD1-CAN To:CSA,WPC,KBCM,AC,F_Pbox,DDCM,PDCM,BLE
BD2-CAN To:ABM,RPAS,R_Pbox,HUD,TPMS,PLG,Traller,AMP
PT-CAN To:ECM,ESP,SBWM,7DCT450,ELD,Haldex,EPS
ADAS-CAN To:IFC,HC,RSDS_R,RSDS_L,HAP,HAP_IPAS
HC-CANFD To:HCU,TMCU,GMCU,BMS,OBC,DCDC";
CM_ SG_ 639 IP_FuelLvlInfo "Fuel Level Information.PT-CAN To:ECM
DHTç³»ç»ŸT_BOXä¸æŽ¥æ”¶
HC-CAN To:HCU(HEVPHEV)";
CM_ SG_ 639 IP_FuelLvlLowLmpSts "Fuel Level Low indication lamp ON or OFF status.";
CM_ SG_ 639 IP_BattChrgLmpSts "Indicate Battery charging  lamp ON or OFF status.";
CM_ SG_ 639 IP_EngOilPressLowLmpSts "Engine Oil pressure Low indication lamp status..";
CM_ SG_ 639 IP_ABMWarnLmpFailrSts "Airbag warning lamp failure statusBD2-CAN To:ABM";
CM_ SG_ 639 IP_Err "Error in the IP control unit or the dashboardADAS-CAN To:IFC";
CM_ SG_ 639 IP_ACCErr "IP Check ACC error(Checksum,RollingCounter,Missing message)status,if any error were detected by IP will send this signalADAS-CAN To:IFC";
CM_ SG_ 639 IP_VehTotDistanceValid "Vaild information to current Vehicle travelled total distanceBD1-CAN To:CSA,WPC,KBCM,AC,F_Pbox,DDCM,PDCM,BLE
BD2-CAN To:RPAS,R_Pbox,HUD,TPMS,PLG,Traller,AMP
PT-CAN To:ECM,ESP,SBWM,7DCT450,ELD,Haldex,EPS
ADAS-CAN To:IFC,HC,RSDS_R,RSDS_L,HAP,HAP_IPAS
HC-CANFD To:HCU,TMCU,GMCU,BMS,OBC,DCDC";
CM_ SG_ 639 IP_VehSpdUnit "Indicate the vehicle speed unit used by IP.PT-CAN To:ECM,7DCT450
ADAS-CAN To:IFC
HC-CANFD To:HCU";
CM_ SG_ 639 IP_VINcompr "IP compare inner VIN with VIN ECM sendPT-CAN To:ECM";
CM_ SG_ 639 RollingCounter_IP2 "Rolling counter_IP2PT-CANFD To:ESP,Ibooster";
CM_ SG_ 639 MAC_Check_HUT_IP2 "MAC protection mechanism should comply with the GWM MAC Specificatio";
CM_ SG_ 842 IP_RemainDistance "the value was calculated by IPï¼Œwhen Remain Distance<50km,IP will send value \"0xFFF\"display";
CM_ SG_ 842 IP_InstFuelConsUnit "the unit  of instant fuel consumption";
CM_ SG_ 842 IP_EBDFailSts "the Brake System Fault status";
CM_ SG_ 842 IP_AvgFuelCons "the value of average fuel consumption";
CM_ SG_ 842 IP_InstFuelCons "the value  of instant fuel consumption - when the unit is L100kmï¼Œmax value 29.99,when  unit is Lhï¼Œmax value 99.99When the vehicle is idling,the unit of this signal is Lh.
When the vehicle is runing,the unit of this signal is Lkm";
CM_ SG_ 707 SSSSet_HUT "Smart Start and stop set by HUTPT-CAN To:ECM";
CM_ SG_ 707 IFC_SnvtySet "IFC(Intelligent Forward Camera) sensitivity setADAS-CAN To:IFC";
CM_ SG_ 707 DOWSwtReq "Request of DOW(Door Open Warning) function SwitchADAS-CAN To:RSDS_R,RSDS_L";
CM_ SG_ 707 AEB_PedSwtReq "Request of AEB(Auto Emergency Brake) function Switch for Pedestrian modeADAS-CAN To:IFC";
CM_ SG_ 707 ALCMLightLvlSet "ALCM(Ambient Light Control Module) Light level setBD1_CAN:To ALCM";
CM_ SG_ 707 FlashLmpSwtReq "Request of Flash Lamp SwitchBD1-CAN To:KBCM";
CM_ SG_ 707 LCASwtReq "Request of LCA (Lane Change Assist) function SwitchADAS-CAN To:RSDS_R,RSDS_L";
CM_ SG_ 707 RCTASwtReq "Request of CTA(Cross Traffic Assist) function SwitchADAS-CAN To:RSDS_R,RSDS_L";
CM_ SG_ 707 RCTABrkSwtReq "Request of CTABrake(Cross Traffic Assist with Brake) SwitchADAS-CAN To:RSDS_R,RSDS_L";
CM_ SG_ 707 RCWSwtReq "Request of Control RCW (Rear Collision Warning ) SwitchADAS-CAN To:RSDS_R,RSDS_L";
CM_ SG_ 707 FCW_SnvtySet "FCW(Front Crash Warning) sensitivity setADAS-CAN To:IFC";
CM_ SG_ 707 AEB_VehSwtReq "Request of Control AEB (Auto Emergency Brake) Switch for Vehicle modeADAS-CAN To:IFC";
CM_ SG_ 707 LKASwtReq "Request of Control LKA(Lane Keeping Assist) SwitchADAS-CAN To:IFC";
CM_ SG_ 707 LCKSwtReq "Request of Control LCK(Lane Center Keeping) SwitchADAS-CAN To:IFC";
CM_ SG_ 707 ELKSwtReq "Request of Control ELK(Emergency Lane Keeping) SwitchADAS-CAN To:IFC";
CM_ SG_ 707 ESS_PedSwtReq "ESS(Evasive Steering Support)-Pedestrian switch requestADAS-CAN To:IFC";
CM_ SG_ 707 ESS_VehSwtReq "ESS(Evasive Steering Support)-Vehicle switch requestADAS-CAN To:IFC";
CM_ SG_ 707 LDWSwtReq "Request of Control LDW(Lane Detection Warning) SwitchADAS-CAN To:IFC";
CM_ SG_ 707 TSRSwtReq "Request of Control TSR(Traffic Sign Recognition) SwitchADAS-CAN To:IFC";
CM_ SG_ 707 TSRWarnSwtReq "Request of Control TSRWarn(Traffic Sign Recognition Warning) SwitchADAS-CAN To:IFC";
CM_ SG_ 707 ICA_HandsOffSwtReq "Request of Control ICA_HandsOff(Intelligent Cruise Assist Hands Off) SwitchADAS-CAN To:IFC";
CM_ SG_ 707 ISLSwtReq "Request of Control ISL(Intelligent Speed Limit) SwitchADAS-CAN To:IFC";
CM_ SG_ 707 TSR_SnvtySet "TSR(Traffic Sign Recognition) sensitivity setADAS-CAN To:IFC";
CM_ SG_ 707 BrkPedalFeelReq "Brake pedal feel mode requested by driver";
CM_ SG_ 707 HFASwtSts "HFA(Hands Free Access) Switch StatusBD1-CAN To:KBCM";
CM_ SG_ 707 EPSSteerModSwtReq "Resquet of EPS(Electric Power Steering) steering mode switchPT-CAN To:EPS";
CM_ SG_ 707 DSTSwtReq "Request of DST(Dynamic Steering Torque) SwitchPT_CAN:To ESP";
CM_ SG_ 707 HUT_ESPFuncOffSwtSts "Control ESP switch status of HUTã€‚
When it is 0x0, switch is not pressed,ESP function is ON
when it is 0x1, switch is pressed,ESP function is OffPT_CAN:To ESP";
CM_ SG_ 707 DrivingModReq_HUT "Driving mode request by HUT(Head Unit System)BD2-CAN To:AMP
PT-CAN To:ESP";
CM_ SG_ 707 LSSSwtReq "Request of Control  LSS(Lane Support System) SwitchADAS-CAN To:IFC";
CM_ SG_ 707 LSSWarnFormSwtReq "LSS(Lane Support System) Warning Form SwitchADAS-CAN To:IFC";
CM_ SG_ 707 IntelligentEvaSwtReq "Intelligent evade switch requestADAS-CANFD To:IFC";
CM_ SG_ 707 HUT_BattSOCLimSaveMod "Setting charging level for SOC in SAVE
mode function descriptionPT_CAN:To HCU";
CM_ SG_ 707 DrvgModeMemReq "Driving mode memory requestBD1_CAN:To KBCM
KBCM_LIN3:To CCSM";
CM_ SG_ 707 HUTRadioFrq "HUT(Head Unit System) Radio frequencyç‹¬ç«‹AMP";
CM_ SG_ 707 MediaPlaySrc "Media Play Sourcesä¸ŽRHDSåŒæ­¥";
CM_ SG_ 707 HUT_DrvModReq "driver mode requestPT-CAN:To HCU";
CM_ SG_ 707 HUT_WadeModeSet "Wade Mode SetPT-CAN To:HCU";
CM_ SG_ 707 USB_AudioSts "USB Audio Statusä¸ŽRHDSåŒæ­¥";
CM_ SG_ 707 USB_VideoSts "USB Video Statusä¸ŽRHDSåŒæ­¥";
CM_ SG_ 707 BT_AudioSts "BT Audio Statusä¸ŽRHDSåŒæ­¥";
CM_ SG_ 707 IPod_Sts "IPod Statusä¸ŽRHDSåŒæ­¥";
CM_ SG_ 707 AM_Sts "AM Statusä¸ŽRHDSåŒæ­¥";
CM_ SG_ 707 FM_Sts "FM Statusä¸ŽRHDSåŒæ­¥";
CM_ SG_ 707 APPLink_Sts "APPLink Statusä¸ŽRHDSåŒæ­¥";
CM_ SG_ 707 QQMusic_Sts "QQ Music Statusä¸ŽRHDSåŒæ­¥";
CM_ SG_ 707 KaolaFM_Sts "Kaola FM Statusä¸ŽRHDSåŒæ­¥";
CM_ SG_ 707 OnlineNews_Sts "Online News Statusä¸ŽRHDSåŒæ­¥";
CM_ SG_ 707 ChairMemPosnSet "Chair Memory Position SetBD1_CAN:To DSC";
CM_ SG_ 707 CCOSwtReq_HUT "CCO Switch RequestPT_CAN:To ESP";
CM_ SG_ 707 ChairMemPosnSetResult "Chair memory position set resultBD1_CAN:To DSC";
CM_ SG_ 707 TABSwtReq_HUT "TAB(Turning Assistant by Braking) Switch RequestPT-CAN To:ESP";
CM_ SG_ 707 NavVehToTrafEyeDist "Indicate the distance between the vehicle and  traffic EyeADAS-CAN To:IFC";
CM_ SG_ 707 NavRoadType "Indicate the rode type of current location that this vehicle is driving detected by navigationADAS-CAN To:IFC";
CM_ SG_ 707 NavSpdLimType "Indicate speed limit  sign type of current road detected by navigationADAS-CAN To:IFC";
CM_ SG_ 707 NavSpdLimValue "Indicate the value of speed limit sign of current road detected by navigationADAS-CAN To:IFC";
CM_ SG_ 707 NavSpdLimUnit_HUT "Indicate speed limit unit of current rode detected by navigationADAS-CAN To:IFC";
CM_ SG_ 707 NavCtryType "Indicate the country type of current location that this vehicle is drivingADAS-CAN To:IFC";
CM_ SG_ 707 HWA_SwtReq "HWA Switch RequestADAS-CANFD To:IDC_L2";
CM_ SG_ 707 HWA_SnvtySet "HWA Sensitive SetADAS-CANFD To:IDC_L2";
CM_ SG_ 707 ALC_SwtReq "ALC(Automatic lane change assistance) fuction switch requestADAS-CANFD To:IDC_L2";
CM_ SG_ 707 NavSpdLimSignSts "Indicate whether the navigation detects single or multiple speed limit signsADAS-CAN To:IFC";
CM_ SG_ 707 NavTSRTrafSign "Indicate the value of traffic sign of current road detected by navigationADAS-CAN To:IFC";
CM_ SG_ 707 FCTASwtReq "FCTA Switch RequestADAS_CAN:To CR";
CM_ SG_ 707 FCTABrkSwtReq "FCTA Brake Switch RequestADAS_CAN:To CR";
CM_ SG_ 707 AEB_JASwtReq "AEB-JA fuction switch requestADAS-CAN To:IFC";
CM_ SG_ 707 AESSwtReq "AES(Automatic Emergency Steering) function switch requestADAS-CAN To:IFC";
CM_ SG_ 707 ADAS_Posn_MsgTye "Identify type of messageADAS-CAN To:IFC";
CM_ SG_ 707 ADAS_Posn_Offset "Distance btween vehicle and start locationADAS-CAN To:IFC";
CM_ SG_ 707 ADAS_Posn_CycCnt "Message rollingcounterADAS-CAN To:IFC";
CM_ SG_ 707 ADAS_Posn_Pathldx "Current path quotation markADAS-CAN To:IFC";
CM_ SG_ 707 ADAS_Posn_Idx "If  Av2HP supports Positioning alternative ,this is condidate quotation markADAS-CAN To:IFC";
CM_ SG_ 707 ADAS_Posn_PosProbb "ADAS_Posn_PosProbbADAS-CAN To:IFC";
CM_ SG_ 707 ADAS_Posn_Age "Duration between message transmits and vehcle position is gotADAS-CAN To:IFC";
CM_ SG_ 707 ADAS_Posn_PosConfdc "Confidence degree of positionADAS-CAN To:IFC";
CM_ SG_ 707 ADAS_Posn_CurLane "Type of currentADAS-CAN To:IFC";
CM_ SG_ 707 ADAS_Posn_Spd "Estimated speed of vehicles along the pathADAS-CAN To:IFC";
CM_ SG_ 707 ADAS_Posn_Rehead "Head orientation relative to pathADAS-CAN To:IFC";
CM_ SG_ 707 MAC_Check_HUT_FD1 "MAC protection mechanism should comply with the GWM MAC Specificatio";
CM_ SG_ 648 HUT_OD_Obj0_ID "ID of the Target obstacleADAS-CANFD To:HAP_PAS";
CM_ SG_ 648 HUT_OD_Obj0_type "OD_typeADAS-CANFD To:HAP_PAS";
CM_ SG_ 648 HUT_OD_Obj0_Confidence "Confidence of the Target obstacleADAS-CANFD To:HAP_PAS";
CM_ SG_ 648 HUT_OD_Obj0_width "Width of the Target obstacleADAS-CANFD To:HAP_PAS";
CM_ SG_ 648 HUT_OD_Obj0_Ground_Pos_X "X-Axis Position of the Target obstacleADAS-CANFD To:HAP_PAS";
CM_ SG_ 648 HUT_OD_Obj0_Ground_Pos_Y "Y-Axis Position of the Target obstacleADAS-CANFD To:HAP_PAS";
CM_ SG_ 648 HTU_OD_Obj1_ID "ID of the Target obstacleADAS-CANFD To:HAP_PAS";
CM_ SG_ 648 HUT_OD_Obj1_type "OD_typeADAS-CANFD To:HAP_PAS";
CM_ SG_ 648 HUT_OD_Obj1_Confidence "Confidence of the Target obstacleADAS-CANFD To:HAP_PAS";
CM_ SG_ 648 HUT_OD_Obj1_width "Width of the Target obstacleADAS-CANFD To:HAP_PAS";
CM_ SG_ 648 HUT_OD_Obj1_Ground_Pos_X "X-Axis Position of the Target obstacleADAS-CANFD To:HAP_PAS";
CM_ SG_ 648 HUT_OD_Obj1_Ground_Pos_Y "Y-Axis Position of the Target obstacleADAS-CANFD To:HAP_PAS";
CM_ SG_ 648 HUT_OD_Obj2_ID "ID of the Target obstacleADAS-CANFD To:HAP_PAS";
CM_ SG_ 648 HUT_OD_Obj2_type "OD_typeADAS-CANFD To:HAP_PAS";
CM_ SG_ 648 HUT_OD_Obj2_Confidence "Confidence of the Target obstacleADAS-CANFD To:HAP_PAS";
CM_ SG_ 648 HUT_OD_Obj2_width "Width of the Target obstacleADAS-CANFD To:HAP_PAS";
CM_ SG_ 648 HUT_OD_Obj2_Ground_Pos_X "X-Axis Position of the Target obstacleADAS-CANFD To:HAP_PAS";
CM_ SG_ 648 HUT_OD_Obj2_Ground_Pos_Y "Y-Axis Position of the Target obstacleADAS-CANFD To:HAP_PAS";
CM_ SG_ 648 HUT_OD_Obj3_ID "ID of the Target obstacleADAS-CANFD To:HAP_PAS";
CM_ SG_ 648 HUT_OD_Obj3_type "OD_typeADAS-CANFD To:HAP_PAS";
CM_ SG_ 648 HUT_OD_Obj3_Confidence "Confidence of the Target obstacleADAS-CANFD To:HAP_PAS";
CM_ SG_ 648 HUT_OD_Obj3_width "Width of the Target obstacleADAS-CANFD To:HAP_PAS";
CM_ SG_ 648 HUT_OD_Obj3_Ground_Pos_X "X-Axis Position of the Target obstacleADAS-CANFD To:HAP_PAS";
CM_ SG_ 648 HUT_OD_Obj3_Ground_Pos_Y "Y-Axis Position of the Target obstacleADAS-CANFD To:HAP_PAS";
CM_ SG_ 648 HUT_OD_Obj4_ID "ID of the Target obstacleADAS-CANFD To:HAP_PAS";
CM_ SG_ 648 HUT_OD_Obj4_type "OD_typeADAS-CANFD To:HAP_PAS";
CM_ SG_ 648 HUT_OD_Obj4_Confidence "Confidence of the Target obstacleADAS-CANFD To:HAP_PAS";
CM_ SG_ 648 HUT_OD_Obj4_width "Width of the Target obstacleADAS-CANFD To:HAP_PAS";
CM_ SG_ 648 HUT_OD_Obj4_Ground_Pos_X "X-Axis Position of the Target obstacleADAS-CANFD To:HAP_PAS";
CM_ SG_ 648 HUT_OD_Obj4_Ground_Pos_Y "Y-Axis Position of the Target obstacleADAS-CANFD To:HAP_PAS";
CM_ SG_ 648 HUT_OD_Obj5_ID "ID of the Target obstacleADAS-CANFD To:HAP_PAS";
CM_ SG_ 648 HUT_OD_Obj5_type "OD_typeADAS-CANFD To:HAP_PAS";
CM_ SG_ 648 HUT_OD_Obj5_Confidence "Confidence of the Target obstacleADAS-CANFD To:HAP_PAS";
CM_ SG_ 648 HUT_OD_Obj5_width "Width of the Target obstacleADAS-CANFD To:HAP_PAS";
CM_ SG_ 648 HUT_OD_Obj5_Ground_Pos_X "X-Axis Position of the Target obstacleADAS-CANFD To:HAP_PAS";
CM_ SG_ 648 HUT_OD_Obj5_Ground_Pos_Y "Y-Axis Position of the Target obstacleADAS-CANFD To:HAP_PAS";
CM_ SG_ 648 HUT_OD_Obj6_ID "ID of the Target obstacleADAS-CANFD To:HAP_PAS";
CM_ SG_ 648 HUT_OD_Obj6_type "OD_typeADAS-CANFD To:HAP_PAS";
CM_ SG_ 648 HUT_OD_Obj6_Confidence "Confidence of the Target obstacleADAS-CANFD To:HAP_PAS";
CM_ SG_ 648 HUT_OD_Obj6_width "Width of the Target obstacleADAS-CANFD To:HAP_PAS";
CM_ SG_ 648 HUT_OD_Obj6_Ground_Pos_X "X-Axis Position of the Target obstacleADAS-CANFD To:HAP_PAS";
CM_ SG_ 648 HUT_OD_Obj6_Ground_Pos_Y "Y-Axis Position of the Target obstacleADAS-CANFD To:HAP_PAS";
CM_ SG_ 745 HUT_OD_Obj7_ID "ID of the Target obstacleADAS-CANFD To:HAP_PAS";
CM_ SG_ 745 HUT_OD_Obj7_type "OD_typeADAS-CANFD To:HAP_PAS";
CM_ SG_ 745 HUT_OD_Obj7_Confidence "Confidence of the Target obstacleADAS-CANFD To:HAP_PAS";
CM_ SG_ 745 HUT_OD_Obj7_width "Width of the Target obstacleADAS-CANFD To:HAP_PAS";
CM_ SG_ 745 HUT_OD_Obj7_Ground_Pos_X "X-Axis Position of the Target obstacleADAS-CANFD To:HAP_PAS";
CM_ SG_ 745 HUT_OD_Obj7_Ground_Pos_Y "Y-Axis Position of the Target obstacleADAS-CANFD To:HAP_PAS";
CM_ SG_ 745 HUT_OD_WorkSts "Working Status of HUT CameraADAS-CANFD To:HAP_PAS";
CM_ SG_ 745 HUT_OD_Obj_Timestamp "Timestamp of detecting the targetADAS-CANFD To:HAP_PAS
è¾“å‡ºæ•°æ®ä¸ºï¼ŒèŽ·å–MEBæ€»çº¿Timestampå¯¹åº”æ—¶åˆ»çš„æ•°æ®ï¼Œç”¨äºŽåŒæ­¥æ•°æ®";
CM_ SG_ 745 HUT_FSD1_distance "Freespace_distance to pointADAS-CANFD To:HAP_PAS";
CM_ SG_ 745 HUT_FSD2_distance "Freespace_distance to pointADAS-CANFD To:HAP_PAS";
CM_ SG_ 745 HUT_FSD3_distance "Freespace_distance to pointADAS-CANFD To:HAP_PAS";
CM_ SG_ 745 HUT_FSD4_distance "Freespace_distance to pointADAS-CANFD To:HAP_PAS";
CM_ SG_ 745 HUT_FSD5_distance "Freespace_distance to pointADAS-CANFD To:HAP_PAS";
CM_ SG_ 745 HUT_FSD6_distance "Freespace_distance to pointADAS-CANFD To:HAP_PAS";
CM_ SG_ 745 HUT_FSD7_distance "Freespace_distance to pointADAS-CANFD To:HAP_PAS";
CM_ SG_ 745 HUT_FSD8_distance "Freespace_distance to pointADAS-CANFD To:HAP_PAS";
CM_ SG_ 745 HUT_FSD9_distance "Freespace_distance to pointADAS-CANFD To:HAP_PAS";
CM_ SG_ 745 HUT_FSD10_distance "Freespace_distance to pointADAS-CANFD To:HAP_PAS";
CM_ SG_ 745 HUT_FSD11_distance "Freespace_distance to pointADAS-CANFD To:HAP_PAS";
CM_ SG_ 745 HUT_FSD12_distance "Freespace_distance to pointADAS-CANFD To:HAP_PAS";
CM_ SG_ 745 HUT_FSD13_distance "Freespace_distance to pointADAS-CANFD To:HAP_PAS";
CM_ SG_ 745 HUT_FSD14_distance "Freespace_distance to pointADAS-CANFD To:HAP_PAS";
CM_ SG_ 745 HUT_FSD15_distance "Freespace_distance to pointADAS-CANFD To:HAP_PAS";
CM_ SG_ 745 HUT_FSD16_distance "Freespace_distance to pointADAS-CANFD To:HAP_PAS";
CM_ SG_ 745 HUT_FSD17_distance "Freespace_distance to pointADAS-CANFD To:HAP_PAS";
CM_ SG_ 745 HUT_FSD18_distance "Freespace_distance to pointADAS-CANFD To:HAP_PAS";
CM_ SG_ 1045 ADAS_Meta_MsgTyp "Identify type of messageADAS-CAN To:IFC";
CM_ SG_ 1045 ADAS_Meta_MapProvider "Provider mapADAS-CAN To:IFC";
CM_ SG_ 1045 ADAS_Meta_CountryCode "CountryCodeADAS-CAN To:IFC";
CM_ SG_ 1045 ADAS_Meta_CycCnt "Message rollingcounterADAS-CAN To:IFC";
CM_ SG_ 1045 ADAS_Meta_ProtVer_Major "Main protocol versionADAS-CAN To:IFC";
CM_ SG_ 1045 ADAS_Meta_ProtVer_MinorSub "Minor protocol versionADAS-CAN To:IFC";
CM_ SG_ 1045 ADAS_Meta_HwVer "Hardwar version or software versionADAS-CAN To:IFC";
CM_ SG_ 1045 ADAS_Meta_DrvSide "Driving directionADAS-CAN To:IFC";
CM_ SG_ 1045 ADAS_Meta_RegionCode "Region CodeADAS-CAN To:IFC";
CM_ SG_ 1045 ADAS_Meta_MapVerQtr "Map version quarterlyADAS-CAN To:IFC";
CM_ SG_ 1045 ADAS_Meta_MapVerYear "Map version yearADAS-CAN To:IFC";
CM_ SG_ 1045 ADAS_Meta_SpdUnits "speed limit unitADAS-CAN To:IFC";
CM_ SG_ 1045 ADAS_Meta_ProtVer_Minor "Minor protocol versionADAS-CAN To:IFC";
CM_ SG_ 840 PowerSet "AMP power set. When the systerm power mode (from PEPS or BCM)change to OFF,the bluetooh communication should't be interrupted ,so AMP need this signal to turn off.BD2-CAN To:AMP";
CM_ SG_ 796 AudioMuteSts "Audio Mute Status.";
CM_ SG_ 796 OrvmPosnEnaSts "Outside rear view mirror position set enable ststusBD1_CAN:To DDCM,PDCM,BDC";
CM_ SG_ 796 VSGSwtSet "Control VSG switch onoff setBD2_CAN:To VSG";
CM_ SG_ 871 DomeLmpDlyTimSet "Dome lamp delay time set:3s 10s2030s.BD1-CAN To:KBCM,DDCM";
CM_ SG_ 871 FolwMeHomeDlyTimSet "Follow me home delay time set:0s 30s60s90s.BD1-CAN To:KBCM";
CM_ SG_ 871 TranPMode_Req "Transport Mode Switch";
CM_ SG_ 871 RearviewFoldModSet "Rearview mirror fold mode setBD1-CAN To:DDCM,PDCM KBCM";
CM_ SG_ 871 BattSaveDelayTimeSet "Battery saver delay time set:2m5m8m.BD1-CAN To:KBCM,DDCM
BD2-CAN To:R_Pbox";
CM_ SG_ 871 ACDualReq_TC "AC(Air Conditioning) Dual Request-Touch ControlBD1-CAN To:AC";
CM_ SG_ 871 ACAutoModReq_TC "AC(Air Conditioning) Auto Mode Request-Touch ControlBD1-CAN To:AC";
CM_ SG_ 871 ACAirInletReq_TC "AC(Air Conditioning) FreshRecirculation mode request-Touch ControlBD1-CAN To:AC";
CM_ SG_ 871 ACAQSReq_TC "AC(Air Conditioning) AQS(air quality sensor)  Request-Touch ControlBD1-CAN To:AC";
CM_ SG_ 871 ACCmprReq_TC "AC(Air Conditioning) Compressor request -Touch ControlBD1-CAN To:AC";
CM_ SG_ 871 ACFrntDefrstReq_TC "AC(Air Conditioning) Front Defrost OnOff  request-Touch ControlBD1-CAN To:AC";
CM_ SG_ 871 ACFrntBlwrSpdDecReq_TC "AC(Air Conditioning) Front Blower Speed Decrease request -Touch ControlBD1-CAN To:AC";
CM_ SG_ 871 DrvDrowsnsDetnSet "DMS(Driver Monitoring System) Driver drowsiness detection setBD1-CAN To:KBCM";
CM_ SG_ 871 ACFrntBlwrSpdIncReq_TC "AC(Air Conditioning) Front Blower Speed Increase  Request-Touch ControlBD1-CAN To:AC";
CM_ SG_ 871 ACDrvAirDistribModReq_TC "AC(Air Conditioning) Driver Air Distribution Mode Request-Touch ControlBD1-CAN To:AC";
CM_ SG_ 871 ACDrvTempDecReq_TC "AC(Air Conditioning) Driver Temperature Decrease Request-Touch ControlBD1-CAN To:AC";
CM_ SG_ 871 ChairMemPosnEna "Chair  memory position enableBD1_CAN:To DSC";
CM_ SG_ 871 ACDrvTempIncReq_TC "AC(Air Conditioning) Driver Temperature Increase  Request-Touch ControlBD1-CAN To:AC";
CM_ SG_ 871 ACFrntPassTempDecReq_TC "AC(Air Conditioning) Front passenger Temperature Decrease Request-Touch ControlBD1-CAN To:AC";
CM_ SG_ 871 ACFrntPassTempIncReq_TC "AC(Air Conditioning) Front passenger Temperature Increase Request-Touch ControlBD1-CAN To:AC";
CM_ SG_ 871 ACAIUReq_TC "Control AC(Air Conditioning) Air Ionizer Unit Request-Touch ControlBD1-CAN To:AC";
CM_ SG_ 871 ACOffReq_TC "Turn Off AC(Air Conditioning) Request by HUT(Head Unit System)-Touch ControlBD1-CAN To:AC";
CM_ SG_ 871 ACBlwrsteplsSpdReq_TC "Blower Stepless speed request for AC(Air Conditioning) controlling-Touch ControlBD1-CAN To:AC";
CM_ SG_ 873 AMP_MediaCallSourceSet "MediaCall Source SetBD2-CAN To:AMP";
CM_ SG_ 873 AMP_NaviSourceSet "Navigation source set.BD2-CAN To:AMP";
CM_ SG_ 873 AMP_BeepSourceSet "Beep source set.BD2-CAN To:AMP";
CM_ SG_ 873 AMP_LRAudioBalanceSet "LeftRight Audio Balance setBD2-CAN To:AMP";
CM_ SG_ 873 AMP_AudioVolVSCModReq "Audio volume Vehicle Speed Compensation mode(onoff) request.BD2-CAN To:AMP";
CM_ SG_ 873 AMP_FRAudioFaderSet "Frontrear audio fader setBD2-CAN To:AMP";
CM_ SG_ 873 AMP_LRDrvSideSet "Drive side set(Left helm drive or right helm drive).BD2-CAN To:AMP";
CM_ SG_ 873 AMP_LowFrqAudioSet "Low frequency audio setBD2-CAN To:AMP";
CM_ SG_ 873 AMP_MuteSet "Mute all speakersBD2-CAN To:AMP";
CM_ SG_ 873 AMP_MidFrqAudioSet "Mid frequency audio setBD2-CAN To:AMP";
CM_ SG_ 873 AMP_HighFrqAudioSet "Middle frequency audio setBD2-CAN To:AMP";
CM_ SG_ 873 T_box_ECallSet "T_box Ecall(emergency call)  set (mute all speakers).When T_Box Ecall occurred,HUT sent this signal to AMP mute all speakers,off is not mute,on is mute.BD2-CAN To:AMP";
CM_ SG_ 873 QLISurroundSet "quantum logic surround or Stereo set.BD2-CAN To:AMP";
CM_ SG_ 873 ANCSwtSet "ANC(Active Noise Control) function switch set.BD2-CAN To:AMP";
CM_ SG_ 873 RearWinHeatCmd_TC "Rear Window Heating OnOff request-Touch ControlBD2-CAN To:R_Pbox";
CM_ SG_ 873 FrntWinHeatSwt "Front Window Heating SwitchBD1-CAN To:AC";
CM_ SG_ 875 AMP_HFMVolSet "HFM(Hand Free Mode), RT(Ring Tone) and Tbox-IBcall(InformationBreakdown call) volume set.BD2-CAN To:AMP";
CM_ SG_ 875 AMP_TTSVolSet_VR "TTS(text to sound) volume set.(Voice Request)BD2-CAN To:AMP";
CM_ SG_ 875 AMP_NaviVolSet "Navigation volume set.BD2-CAN To:AMP";
CM_ SG_ 875 AMP_MainVolSet "Main volume set.BD2-CAN To:AMP";
CM_ SG_ 875 AMP_GetSWInfoReq "Get Amplifier Software Information RequestBD2-CAN To:AMP";
CM_ SG_ 875 AMP_GetHWInfoReq "Get Amplifier Hardware Information RequestBD2-CAN To:AMP";
CM_ SG_ 875 AMP_GetTempInfoReq "Get Amplifier temperature Value requestBD2-CAN To:AMP";
CM_ SG_ 875 AMP_GetIntVoltInfoReq "Get Amplifier internal voltage information request.BD2-CAN To:AMP";
CM_ SG_ 875 AMP_GetDTCInfoReq "Get Amplifier DTC(Diagnostic Trouble Code) information request.BD2-CAN To:AMP";
CM_ SG_ 875 IESS_MdlSwtReq "IESS(Internal Electronic Sound Synthesis)  Model requestBD2-CAN To:AMP";
CM_ SG_ 875 IESS_MdlInfoReq "IESS(Internal Electronic Sound Synthesis) Model information requestBD2-CAN To:AMP";
CM_ SG_ 875 AMP_BestListegPosnReq "Best listenting Position request.BD2-CAN To:AMP";
CM_ SG_ 875 AMP_Clari_FiReq "Clari_Fi request.ï¼ˆAudio source repair Technology Request)BD2-CAN To:AMP";
CM_ SG_ 877 DrvSeatHeatgLvlSet "Driver Seat Heating level  setBD1-CAN To:HVSM";
CM_ SG_ 877 PassSeatHeatgLvlSet "Passenger Seat Heating level setBD1-CAN To:HVSM";
CM_ SG_ 877 DrvSeatVentnLvlSet "Driver Seat ventilation level setBD1-CAN To:HVSM";
CM_ SG_ 877 PassSeatVentnLvlSet "Passenger Seat ventilation level setBD1-CAN To:HVSM";
CM_ SG_ 877 ACAutoModReq_VR "Auto mode request for AC(Air Conditioning) controlling  (Voice Request)BD1-CAN To:AC";
CM_ SG_ 877 ACCmprReq_VR "Compressor Request  for AC(Air Conditioning) controlling(Voice Request)BD1-CAN To:AC";
CM_ SG_ 877 ACPowerReq_VR "AC system power onoff request  for AC controlling  (Voice Request)BD1-CAN To:AC";
CM_ SG_ 877 ACBlwrSpdReq_VR "Blower speed request  for AC(Air Conditioning) controlling  (Voice Request)BD1-CAN To:AC";
CM_ SG_ 877 ACDrvTempReq_VR "Driver side temperature request  for AC(Air Conditioning) controlling  (Voice Request)BD1-CAN To:AC";
CM_ SG_ 877 ACFrntDefrostReq_VR "Front defrost request  for AC(Air Conditioning) controlling  (Voice Request)BD1-CAN To:AC";
CM_ SG_ 877 ACDrvAirDistribModReq_VR "Driver Air Distribution Mode Request for AC(Air Conditioning) controlling  (Voice Request)BD1-CAN To:AC";
CM_ SG_ 877 ACAirInletReq_VR "Air Conditioning FreshRecirculation mode request for AC controlling  (Voice Request)BD1-CAN To:AC";
CM_ SG_ 877 ACModReq_HUT "AC mode request by HUT(Head Unit System)";
CM_ SG_ 877 ElecSideSteppingSysSet "Electric side stepping system setBD1-CAN To:CP";
CM_ SG_ 877 RoofModSet "Roof mode setBD1-CAN To:CP";
CM_ SG_ 877 AllTerrainDislSet "All terrain disable setBD1-CAN To:CP";
CM_ SG_ 877 RemUpgrdSts "Remote upgrade modeBD1-CAN To KBCM";
CM_ SG_ 74 AUTODefrost_TC "AUTO Defrost Request-Touch ControlBD1-CAN To:AC";
CM_ SG_ 74 AUTODefrost_VR "AUTO Defrost request for AC controlling  (Voice Request)BD1-CAN To:AC";
CM_ SG_ 74 LaneCalActvtCmd "Lane-Calibration Activate CommandADAS-CAN To:HAP,HAP_IPAS";
CM_ SG_ 74 MODChgReq "MOD change requestADAS-CAN To:HAP,HAP_IPAS";
CM_ SG_ 74 Radar_DispCmd "Used to configure the display mothod of guidance overlayADAS-CAN To:HAP,HAP_IPAS";
CM_ SG_ 74 Guid_Ovl_Display_Cmd "Used to configure the display mothod of guidance overlayADAS-CAN To:HAP,HAP_IPAS";
CM_ SG_ 74 Sgl_View_Sel "Single View SelectionADAS-CAN To:HAP,HAP_IPAS";
CM_ SG_ 74 SwToFieldCalRstCmd "Return to Auto or Manual  Calibration Result commandADAS-CAN To:HAP,HAP_IPAS";
CM_ SG_ 74 AutoViewChgCmd "Auto change view function switchADAS-CAN To:HAP,HAP_IPAS";
CM_ SG_ 74 MdlColrChgCmd "Switch the color of car modelADAS-CAN To:HAP,HAP_IPAS";
CM_ SG_ 74 CarMdlTrsprcySwtCmd "Car Model Transparency Switch CommandADAS-CAN To:HAP,HAP_IPAS";
CM_ SG_ 74 CarMdlDispCmd "Change 2D3D display mode commandADAS-CAN To:HAP,HAP_IPAS";
CM_ SG_ 74 AutoAVMSwSet_Cmd "Auto Around view swtich command to AVM.ADAS-CAN To:HAP,HAP_IPAS";
CM_ SG_ 74 FPAS_AutoModSwt "Front Park Assistant System Automatic mode RequestADAS-CAN To:HAP,HAP_IPAS
BD2-CAN To:PAS";
CM_ SG_ 74 MEBSwtSet "Maneuver Braking Assistance  switch SetADAS-CAN To:HAP,HAP_IPAS
BD2-CAN To:RPAS";
CM_ SG_ 74 WshSoftSwt "Car wash function softswitchADAS-CAN To:HAP,HAP_IPAS";
CM_ SG_ 74 View_SoftswitchCmd "View mode SoftswitchADAS-CAN To:HAP,HAP_IPAS";
CM_ SG_ 880 TimeMod "Time ModeBD1-CAN To:WPC,AC,DDCM,PDCM,CP,BLE
BD2-CAN To:ABM,PLG,AMP
PT-CAN To:ELD
ADAS-CAN To:IFC,HAP,HAP_IPAS
HC-CANFD To: TMCU,GMCU,BMS,OBC,DCDC";
CM_ SG_ 880 TimeIndcn "Indicaion for  time :am or pmBD1-CAN To:WPC,AC,DDCM,PDCM,CP,BLE
BD2-CAN To:ABM,PLG,AMP
PT-CAN To:ELD
ADAS-CAN To:IFC,HAP,HAP_IPAS
HC-CANFD To: TMCU,GMCU,BMS,OBC,DCDC";
CM_ SG_ 880 Time_Hour "The value for hoursBD1-CAN To:CSA,WPC,KBCM,AC,F_Pbox,DDCM,PDCM,CP,BLE
BD2-CAN To:ABM,RPAS,R_Pbox,HUD,TPMS,PLG,Traller,AMP
PT-CAN To:ECM,ESP,SBWM,7DCT450,ELD,Haldex,EPS
ADAS-CAN To:IFC,HC,RSDS_R,RSDS_L,HAP,HAP_IPAS
HC-CANFD To: TMCU,GMCU,BMS,OBC,DCDC";
CM_ SG_ 880 Time_Minutes "The value for minutesBD1-CAN To:CSA,WPC,KBCM,AC,F_Pbox,DDCM,PDCM,CP,BLE
BD2-CAN To:ABM,RPAS,R_Pbox,HUD,TPMS,PLG,Traller,AMP
PT-CAN To:ECM,ESP,SBWM,7DCT450,ELD,Haldex,EPS
ADAS-CAN To:IFC,HC,RSDS_R,RSDS_L,HAP,HAP_IPAS
HC-CANFD To: TMCU,GMCU,BMS,OBC,DCDC";
CM_ SG_ 880 Time_Second "The value for secondsBD1-CAN To:AC,DDCM,PDCM,CP
BD2-CAN To:ABM,TPMS,PLG,AMP
PT-CAN To:ELD
ADAS-CAN To:IFC,RSDS_R,RSDS_L,HAP,HAP_IPAS
HC-CANFD To: TMCU,GMCU,BMS,OBC,DCDC";
CM_ SG_ 880 Time_Year_Left "The value for yearsBD1-CAN To:CSA,WPC,KBCM,AC,F_Pbox,DDCM,PDCM,CP,BLE
BD2-CAN To:ABM,RPAS,R_Pbox,HUD,TPMS,PLG,Traller,AMP
PT-CAN To:ECM,ESP,SBWM,7DCT450,ELD,Haldex,EPS
ADAS-CAN To:IFC,HC,RSDS_R,RSDS_L,HAP,HAP_IPAS
HC-CANFD To: TMCU,GMCU,BMS,OBC,DCDC";
CM_ SG_ 880 Time_Year_Right "The value for yearsBD1-CAN To:CSA,WPC,KBCM,AC,F_Pbox,DDCM,PDCM,CP,BLE
BD2-CAN To:ABM,RPAS,R_Pbox,HUD,TPMS,PLG,Traller,AMP
PT-CAN To:ECM,ESP,SBWM,7DCT450,ELD,Haldex,EPS
ADAS-CAN To:IFC,HC,RSDS_R,RSDS_L,HAP,HAP_IPAS
HC-CANFD To: TMCU,GMCU,BMS,OBC,DCDC";
CM_ SG_ 880 Time_Month "The value for monthsBD1-CAN To:CSA,WPC,KBCM,AC,F_Pbox,DDCM,PDCM,CP,BLE
BD2-CAN To:ABM,RPAS,R_Pbox,HUD,TPMS,PLG,Traller,AMP
PT-CAN To:ECM,ESP,SBWM,7DCT450,ELD,Haldex,EPS
ADAS-CAN To:IFC,HC,RSDS_R,RSDS_L,HAP,HAP_IPAS
HC-CANFD To: TMCU,GMCU,BMS,OBC,DCDC";
CM_ SG_ 880 Time_Day "The value for daysBD1-CAN To:CSA,WPC,KBCM,AC,F_Pbox,DDCM,PDCM,CP,BLE
BD2-CAN To:ABM,RPAS,R_Pbox,HUD,TPMS,PLG,Traller,AMP
PT-CAN To:ECM,ESP,SBWM,7DCT450,ELD,Haldex,EPS
ADAS-CAN To:IFC,HC,RSDS_R,RSDS_L,HAP,HAP_IPAS
HC-CANFD To: TMCU,GMCU,BMS,OBC,DCDC";
CM_ SG_ 817 HUT_EgyRecvrySet "HUT energy recovery setHC_CAN:To HCU";
CM_ SG_ 817 ACDualReq_VR "AC(Air Conditioning) Dual Request(Voice Request)BD1-CAN To:AC
BD2-CAN To:AMP";
CM_ SG_ 817 ACAQSReq_VR "AC(Air Conditioning) AQS(air quality sensor) Request(Voice Request)BD1-CAN To:AC";
CM_ SG_ 817 ACRearDefrstReq_VR "AC(Air Conditioning) Rear Defrost request(Voice Request)BD2-CAN To:R_Pbox";
CM_ SG_ 817 ACPassTempReq_VR "AC(Air Conditioning) Front Passenger Temperature Requset(Voice Request)BD1-CAN To:AC";
CM_ SG_ 817 ACAIUReq_VR "AC(Air Conditioning) Control Air Ionizer Unit Request(Voice Request)BD1-CAN To:AC";
CM_ SG_ 817 IPVolSet "IP Volume SetBD2-CAN To:AMP";
CM_ SG_ 817 ALCMStatSwt "Unlimited ALCM(Ambient Light Control Module) static switchç‹¬ç«‹ALCM
BD1_CAN:To ALCM";
CM_ SG_ 817 ALCMDynSwt "Unlimited ALCM(Ambient Light Control Module) dynamic switchç‹¬ç«‹ALCM
BD1_CAN:To ALCM";
CM_ SG_ 817 ALCMClrSet "Unlimited ALCM(Ambient Light Control Module) colour setç‹¬ç«‹ALCM
BD1_CAN:To ALCM";
CM_ SG_ 817 ALCMRhmSwt "ALCM(Ambient Light Control Module) rhythm switchç‹¬ç«‹ALCM
BD1_CAN:To ALCM";
CM_ SG_ 817 PASSwtReq_VR "Radar switch Request(Voice Request)BD1-CAN To:KBCM";
CM_ SG_ 494 ACOperMod_TC "AC(Air Conditioning) operation mode request-Touch ControlBD1-CAN To:AC";
CM_ SG_ 494 ACOperMod_VR "AC(Air Conditioning) operation mode request (Voice Request)BD1-CAN To:AC";
CM_ SG_ 494 SteerWheelHeatSwtReq "Steer wheel Heating Switch Request by HUTBD1-CAN To:CSA";
CM_ SG_ 494 ACDrvSetTempSteplsReq_TC "AC(Air Conditioning) Driver Set Temperature Stepless Request-Touch ControlBD1-CAN To:AC";
CM_ SG_ 494 ACPassSetTempSteplsReq_TC "AC(Air Conditioning) Passenger Set Temperature Stepless Request-Touch ControlBD1-CAN To:AC";
CM_ SG_ 494 SDWSwtSet "Side Distance Warning  switch SetADAS-CAN To:HAP";
CM_ SG_ 494 APSSwtReq_VR "APS(Automatic Parking System) switch request(Voice Request)ADAS-CAN To:HAP";
CM_ SG_ 494 PASExitSpdSwt "PAS exit speed switchBD1_CAN:To KBCM";
CM_ SG_ 494 APSPrkgTypSeln "APS(Automatic Parking System) parking type selectionADAS-CAN To:HAP";
CM_ SG_ 494 SunShadeSwtReq_VR "Sun shade switch request(Voice Request)BD1-CAN To:KBCM";
CM_ SG_ 494 SunRoofSwtReq_VR "Sun roof switch request(Voice Request)BD1-CAN To:KBCM";
CM_ SG_ 494 SportModLightSet "The light mode set in the sport modeBD1-CAN To:KBCM";
CM_ SG_ 494 ABSLmpSet "ABS Lamp SettingBD1-CAN To:KBCM";
CM_ SG_ 494 AutoWshWipSet "Auto Wash Wipe SettingBD1-CAN To:KBCM";
CM_ SG_ 494 SeekVehSet "Seek Vehicle SettingBD1-CAN To:KBCM";
CM_ SG_ 494 SpdAutoLockModSet "Speed Auto Lock Mode SettingBD1-CAN To:KBCM";
CM_ SG_ 494 ParkLmpSet "Set the park lamp stateBD1-CAN To:KBCM";
CM_ SG_ 494 DoorUnlockModSet "Door  Unlock Mode SettingBD1-CAN To:KBCM";
CM_ SG_ 494 ACEAHReq_TC "AC(Air Conditioning) EAH request -Touch Control";
CM_ SG_ 494 ACEAHReq_VR "EAH Request  for AC(Air Conditioning) controlling(Voice Request)";
CM_ SG_ 494 MAC_Check_HUT15 "MAC protection mechanism should comply with the GWM MAC Specificatio";
CM_ SG_ 827 AVMSwtReq "AVM(Around View Monitoring) switch requestç‹¬ç«‹AVM
BD2-CAN To:AMP";
CM_ SG_ 827 NaviMediaVolLvlReq "Navigation Media Volume Level Requestç‹¬ç«‹AVM
BD2-CAN To:AMP";
CM_ SG_ 827 AVMMediaVolLvlReq "AVM(Around View Monitoring) Media Volume Level Requestç‹¬ç«‹AVM
BD2-CAN To:AMP";
CM_ SG_ 827 FPASChanSwtReq "Front  Park Assistant System channel Status RequestBD2-CAN To:AMP";
CM_ SG_ 827 RPASChanSwtReq "Rear Park Assistant System channel Status RequeståŽé›·è¾¾
BD2-CAN To:AMP";
CM_ SG_ 827 BackgroundLightLvlSet "Back ground Light level SetBD1-CAN To:KBCM";
CM_ SG_ 827 ManCmpSet "Manual compensation setç‹¬ç«‹AMP";
CM_ SG_ 827 DispModSet "Display Mode Setç‹¬ç«‹AMP";
CM_ SG_ 827 OPDSwtSts "One Pedal driving Switch StatusPT-CANFD To:HCU(DHT)";
CM_ SG_ 827 PLGReq_VR "Power Lift Gate Module request by HUT(Voice Request)BD2_CAN:To PLG
BD1_CAN:To KBCM";
CM_ SG_ 827 WPC_SwtReq "Request of WPC(Wireless Power Charger) SwitchBD1_CAN:To WPC";
CM_ SG_ 734 ADAS_ProfLong_MsgTyp "Identify type of messageADAS_CAN:To IFC";
CM_ SG_ 734 ADAS_ProfLong_Offset "Displacement duration between start position and profile spotADAS_CAN:To IFC";
CM_ SG_ 734 ADAS_ProfLong_CycCnt "Message rollingcounterADAS_CAN:To IFC";
CM_ SG_ 734 ADAS_ProfLong_PathIdx "ADAS_ProfLong_PathIdxADAS_CAN:To IFC";
CM_ SG_ 734 ADAS_ProfLong_ProfTyp "profile long typeADAS_CAN:To IFC";
CM_ SG_ 734 ADAS_ProfLong_CtrlPoint "Contrl pointADAS_CAN:To IFC";
CM_ SG_ 734 ADAS_ProfLong_Retr "ADAS_ProfLong_RetrADAS_CAN:To IFC";
CM_ SG_ 734 ADAS_ProfLong_Update "profile long  updateADAS_CAN:To IFC";
CM_ SG_ 734 ADAS_ProfLong_Value "profile long valueADAS_CAN:To IFC";
CM_ SG_ 733 ADAS_ProfShort_MsgTyp "Identify type of messageADAS_CAN:To IFC";
CM_ SG_ 733 ADAS_ProfShort_Offset "Displacement duration between start position and profile spotADAS_CAN:To IFC";
CM_ SG_ 733 ADAS_ProfShort_CycCnt "Message rollingcounterADAS_CAN:To IFC";
CM_ SG_ 733 ADAS_ProfShort_PathIdx "ADAS_ProfShort_PathIdxADAS_CAN:To IFC";
CM_ SG_ 733 ADAS_ProfShort_ProfTyp "profile short  typeADAS_CAN:To IFC";
CM_ SG_ 733 ADAS_ProfShort_CtrlPoint "Contrl pointADAS_CAN:To IFC";
CM_ SG_ 733 ADAS_ProfShort_Retr "ADAS_ProfShort_RetrADAS_CAN:To IFC";
CM_ SG_ 733 ADAS_ProfShort_Update "Profile short updateADAS_CAN:To IFC";
CM_ SG_ 733 ADAS_ProfShort_AccurClass "AccuracyADAS_CAN:To IFC";
CM_ SG_ 733 ADAS_ProfShort_Dist1 "Distance from the first profile spot to the second profile spotADAS_CAN:To IFC";
CM_ SG_ 733 ADAS_ProfShort_Value0 "Profile value in offsetADAS_CAN:To IFC";
CM_ SG_ 733 ADAS_ProfShort_Value1 "profile value in offset+distance1ADAS_CAN:To IFC";
CM_ SG_ 730 ADAS_Seg_MsgTyp "Identify type of messageADAS_CAN:To IFC";
CM_ SG_ 730 ADAS_Seg_Offset "Distance from segment start to Path startADAS_CAN:To IFC";
CM_ SG_ 730 ADAS_Seg_CycCnt "Message rollingcounterADAS_CAN:To IFC";
CM_ SG_ 730 ADAS_Seg_PathIdx "ADAS_Seg_PathIdxADAS_CAN:To IFC";
CM_ SG_ 730 ADAS_Seg_Tunnel "segment tunnel informationADAS_CAN:To IFC";
CM_ SG_ 730 ADAS_Seg_Brdg "segment bridge informationADAS_CAN:To IFC";
CM_ SG_ 730 ADAS_Seg_BuildUpArea "segment position informationADAS_CAN:To IFC";
CM_ SG_ 730 ADAS_Seg_Retr "ADAS_Seg_RetrADAS_CAN:To IFC";
CM_ SG_ 730 ADAS_Seg_Update "Segment updateADAS_CAN:To IFC";
CM_ SG_ 730 ADAS_Seg_RelProbb "ADAS_Seg_RelProbbADAS_CAN:To IFC";
CM_ SG_ 730 ADAS_Seg_FuncRoadClass "segment FRC informationADAS_CAN:To IFC";
CM_ SG_ 730 ADAS_Seg_PartOfCalcRoute "Whether segment plan path informationADAS_CAN:To IFC";
CM_ SG_ 730 ADAS_Seg_CmplxInsct "Complex intersection information from segmentADAS_CAN:To IFC";
CM_ SG_ 730 ADAS_Seg_FormOfWay "Roadfacilities information from segmentADAS_CAN:To IFC";
CM_ SG_ 730 ADAS_Seg_EffSpdLmt "Speed limt information from segmentADAS_CAN:To IFC";
CM_ SG_ 730 ADAS_Seg_EffSpdLmtTyp "Effective speed limt type information segmentADAS_CAN:To IFC";
CM_ SG_ 730 ADAS_Seg_DivideRoad "Isolation dtrip information from segmentADAS_CAN:To IFC";
CM_ SG_ 730 ADAS_Seg_NumOfLaneOppDir "Number of tfaffic lane in opposite  direction from segmentADAS_CAN:To IFC";
CM_ SG_ 730 ADAS_Seg_NumOfLaneDrvDir "Number of tfaffic lane in forward  direction from segmentADAS_CAN:To IFC";
CM_ SG_ 728 ADAS_Stub_MsgTyp "Identify type of messageADAS_CAN:To IFC";
CM_ SG_ 728 ADAS_Stub_Offset "Distance from stub start to Path startADAS_CAN:To IFC";
CM_ SG_ 728 ADAS_Stub_CycCnt "Message rollingcounterADAS_CAN:To IFC";
CM_ SG_ 728 ADAS_Stub_PathIdx "ADAS_Stub_PathIdxADAS_CAN:To IFC";
CM_ SG_ 728 ADAS_Stub_StubPathIdx "stub path  indexesADAS_CAN:To IFC";
CM_ SG_ 728 ADAS_Stub_Retr "ADAS_Stub_RetrADAS_CAN:To IFC";
CM_ SG_ 728 ADAS_Stub_Update "Stub Segment updateADAS_CAN:To IFC";
CM_ SG_ 728 ADAS_Stub_RelProbb "Relative probability of new path at the intersectionADAS_CAN:To IFC";
CM_ SG_ 728 ADAS_Stub_FuncRoadClass "stub FRC informationï¼ˆfor lane typeï¼‰ADAS_CAN:To IFC";
CM_ SG_ 728 ADAS_Stub_PartOfCalcRoute "Whether stub plan path informationADAS_CAN:To IFC";
CM_ SG_ 728 ADAS_Stub_CmplxInsct "complex intersection information from stubADAS_CAN:To IFC";
CM_ SG_ 728 ADAS_Stub_FormOfWay "Road facilities information from stubADAS_CAN:To IFC";
CM_ SG_ 728 ADAS_Stub_TurnAngl "Steering angle information from stubADAS_CAN:To IFC";
CM_ SG_ 728 ADAS_Stub_LastStub "ADAS_Stub_LastStubADAS_CAN:To IFC";
CM_ SG_ 728 ADAS_Stub_RtOfWay "Right of way information from stubADAS_CAN:To IFC";
CM_ SG_ 728 ADAS_Stub_NumOfLaneOppDir "Number of tfaffic lane in opposite  direction from stubADAS_CAN:To IFC";
CM_ SG_ 728 ADAS_Stub_NumOfLaneDrvDir "Number of tfaffic lane in forward  direction from stubADAS_CAN:To IFC";
CM_ SG_ 489 IdnResultReq_HUT "Facial and voiceprint recognition result request";
CM_ SG_ 489 BackReq_AVM "Exit AVM and back to HUT interface requestBD1_CAN:To KBCM";
CM_ SG_ 489 HUD_HeightLvlSwt "HUD Height Level switchBD2_CAN:To HUD";
CM_ SG_ 489 HUD_BrightnessLvlSwt "HUD Brightness Level switchBD2_CAN:To HUD";
CM_ SG_ 489 HUD_SwtReq "HUD switch requestBD2_CAN:To HUD";
CM_ SG_ 489 ExprsnSetUp "Expression function disable or enable";
CM_ SG_ 489 DistrctnDetnSet "Distraction detection function disable or enable";
CM_ SG_ 489 DrowsnsDetnSet "Drowsiness detection function disable or enable";
CM_ SG_ 489 FaceIdnSet "Face Identification function disable or enable";
CM_ SG_ 489 VoiceIdnSet "Voice Identification function disable or enable";
CM_ SG_ 489 EraseAllFaceUsersReq "Erase All Face Users Request";
CM_ SG_ 489 EraseAllVoiceUsersReq "Erase All Voice Users Request";
CM_ SG_ 489 CancelVoiceIdn "Cancel voice identification this time";
CM_ SG_ 489 EnrollFaceReq "Request enrolling face";
CM_ SG_ 489 EnrollUserIDResult "Request enrolling faceDefined by HUT when eroll";
CM_ SG_ 489 DeleteUserIDFaceData "Delete user ID's face feature data";
CM_ SG_ 489 DeleteUserIDVoiceData "Delete user ID's voiceprint data";
CM_ SG_ 623 CheckSum_HUT32 "Use the checksum strategy from document â€œEnd-to-End Communication Protection Specificationâ€ADAS-CAN To:HAP";
CM_ SG_ 623 ScrnOpSts "HUT screen operate statusADAS-CAN To:HAP,HAP_IPAS";
CM_ SG_ 623 XLvl "View's global X-coordinate signalADAS-CAN To:HAP,HAP_IPAS";
CM_ SG_ 623 YLvl "View's global Y-coordinate signalADAS-CAN To:HAP,HAP_IPAS";
CM_ SG_ 623 DetVideoLost "HUT detect video lostADAS-CAN To:HAP,HAP_IPAS";
CM_ SG_ 623 PrkgCtrlModReqValid "Parking control mode request validADAS-CAN To:HAP";
CM_ SG_ 623 PrkgCtrlModReq "Parking control mode requestADAS-CAN To:HAP";
CM_ SG_ 623 ContnPrkgReqValid "Continue parking request validADAS-CAN To:HAP";
CM_ SG_ 623 ContnPrkgReq "Continue parking requestADAS-CAN To:HAP";
CM_ SG_ 623 VolLampDispSts "Volume Lamp Display StatusBD1_CAN:To STBS";
CM_ SG_ 623 PrkStraightSwtReq_HUT "Remote parking straight Switch requestADAS-CANFD To:HAP";
CM_ SG_ 623 PrkStraightSuspendOrFinishReq_HU "User suspend or finish parking straight functionADAS-CANFD To:HAP";
CM_ SG_ 623 PrkStraightModSel_HUT "Remote parking straight mode selection requestADAS-CANFD To:HAP";
CM_ SG_ 623 PrkStraightSts_HUT "Remote parking straight statusADAS-CANFD To:HAP";
CM_ SG_ 623 PrkStraightStrtReq_HUT "Remote parking straight handshake requestADAS-CANFD To:HAP";
CM_ SG_ 623 PrkStraightVehStrtReq_HUT_Valid "Remote parking straight handshake request validADAS-CANFD To:HAP";
CM_ SG_ 623 PrkStraightContinueReq_HUT "Remote parking straight continue forward or backwark requestADAS-CANFD To:HAP";
CM_ SG_ 623 RollingCounter_HUT32 "Rolling Counter_HUT32ADAS-CAN To:HAP";
CM_ SG_ 493 MbrMonrEnReq_TC "Member monitoring enable request(touch control)BD1_CAN:To VMDR";
CM_ SG_ 493 ChairMemPosnSetSwt "Chair Memory Position Set switchBD1-CAN To:DSC";
CM_ SG_ 493 ApproachLampSet "Approach lamp setBD1_CAN:To KBCM";
CM_ SG_ 493 FlaoutUnlockSet "Flameout unlock setBD1_CAN:To KBCM";
CM_ SG_ 493 SuperLockSet "Super lock setBD1_CAN:To KBCM";
CM_ SG_ 493 PrkInDirChoice "UsedÂ toÂ chooseÂ whetherÂ toÂ parkÂ inÂ frontÂ orÂ rear of carADAS-CAN To:HAP";
CM_ SG_ 493 PathLrngFinshCmd "Path learning finished commandADAS-CAN To:HAP";
CM_ SG_ 493 PathLrngStartCmd "Start path learning commandADAS-CAN To:HAP";
CM_ SG_ 493 SelPrkOutDirReq "Select parking out direction requestADAS-CAN To:HAP";
CM_ SG_ 493 ParkMdlCmd "Parking mode change requestADAS-CAN To:HAP";
CM_ SG_ 493 BackReq_APS "Back to AVM interface requestADAS-CAN To:HAP";
CM_ SG_ 493 StartPrkgPath2Cmd "Start parking path two commandADAS-CAN To:HAP";
CM_ SG_ 493 DeletePath2Cmd "Delete path two commandADAS-CAN To:HAP";
CM_ SG_ 493 StartPrkgPath1Cmd "Start parking path one commandADAS-CAN To:HAP";
CM_ SG_ 493 DeletePath1Cmd "Delete path one commandADAS-CAN To:HAP";
CM_ SG_ 493 SelPrkgFctnCmd "Select Parking function commandADAS-CAN To:HAP";
CM_ SG_ 493 RLWinSwtReq_VR "Rear left window Switch request status(Voice Request)BD1-CAN To:DDCM";
CM_ SG_ 493 RRWinSwtReq_VR "Rear right window Switch request status(Voice Request)BD1-CAN To:PDCM";
CM_ SG_ 493 DrvWinSwtReq_VR "Driver window Switch request status(Voice Request)BD1-CAN To:DDCM";
CM_ SG_ 493 PassWinSwtReq_VR "Passenger window Switch request status(Voice Request)BD1-CAN To:PDCM";
CM_ SG_ 493 ALCMDynModSet "ALCM dynamic mode setBD1-CAN To:ALCM";
CM_ SG_ 825 CarWashMode_Req "Car wash mode switchHC_CAN:To HCU";
CM_ SG_ 825 HUT_ChrgnMode "Charging mode including Immediate Charging and Delay Charging set on HUTHC_CAN:To HCU";
CM_ SG_ 825 HUT_RemtEngCtrl "Remote engine control";
CM_ SG_ 825 HUT_BattKeepTemp "Setting Battery Keep Temperature by user on  HUTHC_CAN:To BMS(DHT)";
CM_ SG_ 825 HUT_IntelEngIdlChrgnSet "Intelligent  Engine Idle Charging for BMS Setting on HUTDHTç³»ç»ŸTBOXä¸æŽ¥æ”¶
HC_CAN:To BMS(DHT)";
CM_ SG_ 825 HUT_BattSOCLim "Setting external charging level for SOCHC_CAN:To HCU(DHT),BMS(DHT)";
CM_ SG_ 825 HUT_IntelBattTempMagSet "Intelligent Battery Temperature Management Setting on HUTHC_CAN:To HCU(DHT)";
CM_ SG_ 589 DrowsnsLvl "Drowsiness levelBD2-CAN To:IP";
CM_ SG_ 589 DrowsnsLvlQlty "Drowsiness level QualityBD2-CAN To:IP";
CM_ SG_ 589 DMSProc "indication about running process in DMSBD2-CAN To:IP";
CM_ SG_ 589 DMSProcResult "Result of running process in DMSBD2-CAN To:IP";
CM_ SG_ 589 DMSProcSts "Status of running process in DMSBD2-CAN To:IP";
CM_ SG_ 589 DMSIdnResult "Result of identification in DMS";
CM_ SG_ 589 GenderSts "Gender Status";
CM_ SG_ 589 ExprsnSts "Expression Status";
CM_ SG_ 589 GenderStsQlty "Gender Status Quality";
CM_ SG_ 589 ExprsnStsQlty "Expression Status Quality";
CM_ SG_ 589 Checksum_DMS2 "Use the checksum strategy from document â€œEnd-to-End Communication Protection Specificationâ€ADAS-CANFD To:IDC_L2";
CM_ SG_ 589 DistrctnLvl_ACC "Distraction level to ACCADAS-CAN To:IFC";
CM_ SG_ 589 DistrctnLvlQlty_ACC "Distraction level Quality to ACCADAS-CAN To:IFC";
CM_ SG_ 589 DrowsnsLvl_ACC "Drowsiness level to ACCADAS-CAN To:IFC";
CM_ SG_ 589 DrowsnsLvlQlty_ACC "Drowsiness level Quality to ACCADAS-CAN To:IFC";
CM_ SG_ 589 DistrctnLvl "Distraction levelBD2-CAN To:IP";
CM_ SG_ 589 DistrctnLvlQlty "Distraction level QualityBD2-CAN To:IP";
CM_ SG_ 589 RollingCounter_DMS2 "RollingCounter_DMS2ADAS-CANFD To:IDC_L2";
CM_ SG_ 589 Checksum_DMS3 "Use the checksum strategy from document â€œEnd-to-End Communication Protection Specificationâ€ADAS-CANFD To:IDC_L2";
CM_ SG_ 589 HeadPosnX "Head position at X-axisADAS-CAN To:IFC";
CM_ SG_ 589 HeadPosnY "Head position at Y-axisADAS-CAN To:IFC";
CM_ SG_ 589 HeadPosnZ "Head position at Z-axisADAS-CAN To:IFC";
CM_ SG_ 589 HeadPosQlty "Head position qualityADAS-CAN To:IFC";
CM_ SG_ 589 DrvBehvSts "Driver Behaviora Area Status";
CM_ SG_ 589 RollingCounter_DMS3 "RollingCounter_DMS3ADAS-CANFD To:IDC_L2";
CM_ SG_ 589 GazePosnX "Gaze position at X-axisADAS-CAN To:IFC";
CM_ SG_ 589 GazePosnY "Gaze position at Y-axisADAS-CAN To:IFC";
CM_ SG_ 589 GazePosnZ "Gaze position at Z-axisADAS-CAN To:IFC";
CM_ SG_ 589 DrvGazeAreaSts "Driver Gaze Area Status";
CM_ SG_ 589 Checksum_DMS5 "Use the checksum strategy from document â€œEnd-to-End Communication Protection Specificationâ€ADAS-CANFD To:IDC_L2";
CM_ SG_ 589 DMSSts "DMS StatusADAS-CAN To:IFC";
CM_ SG_ 589 HeadDetn "Head DetectionADAS-CAN To:IFC";
CM_ SG_ 589 HeadYawAng "Head Yaw AngleADAS-CAN To:IFC";
CM_ SG_ 589 HeadPitchAng "Head Pitch AngleADAS-CAN To:IFC";
CM_ SG_ 589 HeadRollAng "Head Roll AngleADAS-CAN To:IFC";
CM_ SG_ 589 HeadRotAngQlty "Head Rotation angle QualityADAS-CAN To:IFC";
CM_ SG_ 589 RollingCounter_DMS5 "RollingCounter_DMS5ADAS-CANFD To:IDC_L2";
CM_ SG_ 589 Checksum_DMS6 "Use the checksum strategy from document â€œEnd-to-End Communication Protection Specificationâ€ADAS-CANFD To:IDC_L2";
CM_ SG_ 589 LEyeOpenSts "Left eye open statusADAS-CAN To:IFC";
CM_ SG_ 589 LEyeOpenStsQlty "Left eye open status qualityADAS-CAN To:IFC";
CM_ SG_ 589 REyeOpenSts "Right eye open statusADAS-CAN To:IFC";
CM_ SG_ 589 REyeOpenStsQlty "Right eye open status qualityADAS-CAN To:IFC";
CM_ SG_ 589 RobustGazeYawAng "Robust gaze yaw angleADAS-CAN To:IFC";
CM_ SG_ 589 RobustGazePitchAng "Robust gaze Pitch angleADAS-CAN To:IFC";
CM_ SG_ 589 RobustGazeAngQlty "Robust gaze angle qualityADAS-CAN To:IFC";
CM_ SG_ 589 RollingCounter_DMS6 "RollingCounter_DMS6ADAS-CANFD To:IDC_L2";
BA_DEF_ BO_  "DiagRequest" ENUM  "No","Yes";
BA_DEF_ BO_  "DiagResponse" ENUM  "No","Yes";
BA_DEF_ BO_  "DiagState" ENUM  "No","Yes";
BA_DEF_ BO_  "GenMsgCycleTime" INT 0 65535;
BA_DEF_ BO_  "GenMsgCycleTimeFast" INT 0 65535;
BA_DEF_ BO_  "GenMsgILSupport" ENUM  "No","Yes";
BA_DEF_ BO_  "GenMsgNrOfRepetition" INT 0 65535;
BA_DEF_ BO_  "GenMsgSendType" ENUM  "Cyclic","CyclicAndSpontanX","Event";
BA_DEF_ BO_  "NmAsrMessage" ENUM  "No","Yes";
BA_DEF_ BO_  "SCP_AuthInfoTxLength" INT 0 512;
BA_DEF_ BO_  "SCP_DataId" INT 0 65535;
BA_DEF_ BO_  "SCP_FreshnessValueLength" INT 0 512;
BA_DEF_ BO_  "SCP_FreshnessValueTxLength" INT 0 512;
BA_DEF_ BO_  "SC_Message" ENUM  "NO","YES";
BA_DEF_ BO_  "VFrameFormat" ENUM  "StandardCAN","ExtendedCAN","reserved","reserved","reserved","reserved","reserved","reserved","reserved","reserved","reserved","reserved","reserved","reserved","StandardCAN_FD","ExtendedCAN_FD";
BA_DEF_ SG_  "GenSigCycleTime" INT 0 65535;
BA_DEF_ SG_  "GenSigSendType" ENUM  "Cyclic","OnWrite","OnWriteWithRepetition","OnChange","OnChangeWithRepetition","NotUsed","NotUsed","NoSigSendType";
BA_DEF_ SG_  "GenSigStartValue" FLOAT 0 100000000000;
BA_DEF_ SG_  "TransparentInitValue" STRING ;
BA_DEF_ BU_  "NmAsrNode" ENUM  "No","Yes";
BA_DEF_  "BusType" STRING ;
BA_DEF_  "DBName" STRING ;
BA_DEF_  "NmAsrBaseAddress" HEX 1024 536870911;
BA_DEF_  "NmAsrCanMsgCycleTime" INT 1 65535;
BA_DEF_  "NmAsrMessageCount" INT 1 256;
BA_DEF_  "NmAsrRepeatMessageTime" INT 1 65535;
BA_DEF_  "NmAsrTimeoutTime" INT 1 65535;
BA_DEF_  "NmAsrWaitBusSleepTime" INT 1 65535;
BA_DEF_  "NmType" STRING ;
BA_DEF_ SG_  "SystemSignalLongSymbol" STRING ;
BA_DEF_DEF_  "DiagRequest" "No";
BA_DEF_DEF_  "DiagResponse" "No";
BA_DEF_DEF_  "DiagState" "No";
BA_DEF_DEF_  "GenMsgCycleTime" 0;
BA_DEF_DEF_  "GenMsgCycleTimeFast" 0;
BA_DEF_DEF_  "GenMsgILSupport" "No";
BA_DEF_DEF_  "GenMsgNrOfRepetition" 0;
BA_DEF_DEF_  "GenMsgSendType" "Cyclic";
BA_DEF_DEF_  "NmAsrMessage" "No";
BA_DEF_DEF_  "SCP_AuthInfoTxLength" 0;
BA_DEF_DEF_  "SCP_DataId" 0;
BA_DEF_DEF_  "SCP_FreshnessValueLength" 0;
BA_DEF_DEF_  "SCP_FreshnessValueTxLength" 0;
BA_DEF_DEF_  "SC_Message" "NO";
BA_DEF_DEF_  "VFrameFormat" "";
BA_DEF_DEF_  "GenSigCycleTime" 0;
BA_DEF_DEF_  "GenSigSendType" "Cyclic";
BA_DEF_DEF_  "GenSigStartValue" 0;
BA_DEF_DEF_  "TransparentInitValue" "";
BA_DEF_DEF_  "NmAsrNode" "Yes";
BA_DEF_DEF_  "BusType" "";
BA_DEF_DEF_  "DBName" "B30_for_SC_CAN_V3_2";
BA_DEF_DEF_  "NmAsrBaseAddress" 1280;
BA_DEF_DEF_  "NmAsrCanMsgCycleTime" 500;
BA_DEF_DEF_  "NmAsrMessageCount" 100;
BA_DEF_DEF_  "NmAsrRepeatMessageTime" 1500;
BA_DEF_DEF_  "NmAsrTimeoutTime" 2000;
BA_DEF_DEF_  "NmAsrWaitBusSleepTime" 5000;
BA_DEF_DEF_  "NmType" "NmAsr";
BA_DEF_DEF_  "SystemSignalLongSymbol" "";
BA_ "BusType" "CAN FD";
BA_ "GenMsgILSupport" BO_ 659 1;
BA_ "GenMsgCycleTime" BO_ 659 100;
BA_ "VFrameFormat" BO_ 659 14;
BA_ "SC_Message" BO_ 639 1;
BA_ "SCP_FreshnessValueTxLength" BO_ 639 16;
BA_ "SCP_FreshnessValueLength" BO_ 639 64;
BA_ "SCP_DataId" BO_ 639 639;
BA_ "SCP_AuthInfoTxLength" BO_ 639 48;
BA_ "GenMsgILSupport" BO_ 639 1;
BA_ "GenMsgCycleTime" BO_ 639 50;
BA_ "VFrameFormat" BO_ 639 14;
BA_ "GenMsgILSupport" BO_ 842 1;
BA_ "GenMsgCycleTime" BO_ 842 500;
BA_ "VFrameFormat" BO_ 842 14;
BA_ "SC_Message" BO_ 707 1;
BA_ "SCP_FreshnessValueTxLength" BO_ 707 16;
BA_ "SCP_FreshnessValueLength" BO_ 707 64;
BA_ "SCP_DataId" BO_ 707 707;
BA_ "SCP_AuthInfoTxLength" BO_ 707 48;
BA_ "GenMsgILSupport" BO_ 707 1;
BA_ "GenMsgCycleTime" BO_ 707 100;
BA_ "VFrameFormat" BO_ 707 14;
BA_ "GenMsgILSupport" BO_ 648 1;
BA_ "GenMsgCycleTime" BO_ 648 100;
BA_ "VFrameFormat" BO_ 648 14;
BA_ "GenMsgILSupport" BO_ 745 1;
BA_ "GenMsgCycleTime" BO_ 745 100;
BA_ "VFrameFormat" BO_ 745 14;
BA_ "GenMsgILSupport" BO_ 1045 1;
BA_ "GenMsgCycleTime" BO_ 1045 5000;
BA_ "VFrameFormat" BO_ 1045 14;
BA_ "GenMsgILSupport" BO_ 840 1;
BA_ "GenMsgCycleTime" BO_ 840 500;
BA_ "VFrameFormat" BO_ 840 14;
BA_ "GenMsgILSupport" BO_ 796 1;
BA_ "GenMsgCycleTime" BO_ 796 100;
BA_ "VFrameFormat" BO_ 796 14;
BA_ "GenMsgSendType" BO_ 871 2;
BA_ "GenMsgNrOfRepetition" BO_ 871 5;
BA_ "GenMsgILSupport" BO_ 871 1;
BA_ "GenMsgCycleTimeFast" BO_ 871 20;
BA_ "VFrameFormat" BO_ 871 14;
BA_ "GenMsgSendType" BO_ 873 2;
BA_ "GenMsgNrOfRepetition" BO_ 873 5;
BA_ "GenMsgILSupport" BO_ 873 1;
BA_ "GenMsgCycleTimeFast" BO_ 873 20;
BA_ "VFrameFormat" BO_ 873 14;
BA_ "GenMsgSendType" BO_ 875 2;
BA_ "GenMsgNrOfRepetition" BO_ 875 5;
BA_ "GenMsgILSupport" BO_ 875 1;
BA_ "GenMsgCycleTimeFast" BO_ 875 20;
BA_ "VFrameFormat" BO_ 875 14;
BA_ "GenMsgSendType" BO_ 877 2;
BA_ "GenMsgNrOfRepetition" BO_ 877 5;
BA_ "GenMsgILSupport" BO_ 877 1;
BA_ "GenMsgCycleTimeFast" BO_ 877 20;
BA_ "VFrameFormat" BO_ 877 14;
BA_ "GenMsgSendType" BO_ 74 2;
BA_ "GenMsgNrOfRepetition" BO_ 74 5;
BA_ "GenMsgILSupport" BO_ 74 1;
BA_ "GenMsgCycleTimeFast" BO_ 74 20;
BA_ "VFrameFormat" BO_ 74 14;
BA_ "GenMsgILSupport" BO_ 880 1;
BA_ "GenMsgCycleTime" BO_ 880 1000;
BA_ "VFrameFormat" BO_ 880 14;
BA_ "GenMsgSendType" BO_ 817 2;
BA_ "GenMsgNrOfRepetition" BO_ 817 5;
BA_ "GenMsgILSupport" BO_ 817 1;
BA_ "GenMsgCycleTimeFast" BO_ 817 20;
BA_ "VFrameFormat" BO_ 817 14;
BA_ "SC_Message" BO_ 494 1;
BA_ "SCP_FreshnessValueTxLength" BO_ 494 16;
BA_ "SCP_FreshnessValueLength" BO_ 494 64;
BA_ "SCP_DataId" BO_ 494 494;
BA_ "SCP_AuthInfoTxLength" BO_ 494 48;
BA_ "GenMsgSendType" BO_ 494 2;
BA_ "GenMsgNrOfRepetition" BO_ 494 5;
BA_ "GenMsgILSupport" BO_ 494 1;
BA_ "GenMsgCycleTimeFast" BO_ 494 20;
BA_ "VFrameFormat" BO_ 494 14;
BA_ "GenMsgSendType" BO_ 827 2;
BA_ "GenMsgNrOfRepetition" BO_ 827 5;
BA_ "GenMsgILSupport" BO_ 827 1;
BA_ "GenMsgCycleTimeFast" BO_ 827 20;
BA_ "VFrameFormat" BO_ 827 14;
BA_ "GenMsgSendType" BO_ 734 2;
BA_ "GenMsgNrOfRepetition" BO_ 734 5;
BA_ "GenMsgILSupport" BO_ 734 1;
BA_ "GenMsgCycleTimeFast" BO_ 734 20;
BA_ "VFrameFormat" BO_ 734 14;
BA_ "GenMsgSendType" BO_ 733 2;
BA_ "GenMsgNrOfRepetition" BO_ 733 5;
BA_ "GenMsgILSupport" BO_ 733 1;
BA_ "GenMsgCycleTimeFast" BO_ 733 20;
BA_ "VFrameFormat" BO_ 733 14;
BA_ "GenMsgSendType" BO_ 730 2;
BA_ "GenMsgNrOfRepetition" BO_ 730 5;
BA_ "GenMsgILSupport" BO_ 730 1;
BA_ "GenMsgCycleTimeFast" BO_ 730 20;
BA_ "VFrameFormat" BO_ 730 14;
BA_ "GenMsgSendType" BO_ 728 2;
BA_ "GenMsgNrOfRepetition" BO_ 728 5;
BA_ "GenMsgILSupport" BO_ 728 1;
BA_ "GenMsgCycleTimeFast" BO_ 728 20;
BA_ "VFrameFormat" BO_ 728 14;
BA_ "GenMsgSendType" BO_ 489 2;
BA_ "GenMsgNrOfRepetition" BO_ 489 5;
BA_ "GenMsgILSupport" BO_ 489 1;
BA_ "GenMsgCycleTimeFast" BO_ 489 20;
BA_ "VFrameFormat" BO_ 489 14;
BA_ "GenMsgILSupport" BO_ 623 1;
BA_ "GenMsgCycleTime" BO_ 623 50;
BA_ "VFrameFormat" BO_ 623 14;
BA_ "GenMsgSendType" BO_ 493 2;
BA_ "GenMsgNrOfRepetition" BO_ 493 5;
BA_ "GenMsgILSupport" BO_ 493 1;
BA_ "GenMsgCycleTimeFast" BO_ 493 20;
BA_ "VFrameFormat" BO_ 493 14;
BA_ "GenMsgSendType" BO_ 825 2;
BA_ "GenMsgNrOfRepetition" BO_ 825 5;
BA_ "GenMsgILSupport" BO_ 825 1;
BA_ "GenMsgCycleTimeFast" BO_ 825 20;
BA_ "VFrameFormat" BO_ 825 14;
BA_ "GenMsgILSupport" BO_ 589 1;
BA_ "GenMsgCycleTime" BO_ 589 50;
BA_ "VFrameFormat" BO_ 589 14;
BA_ "GenSigStartValue" SG_ 659 IP_CurrTheme 4;
BA_ "GenSigCycleTime" SG_ 659 IP_CurrTheme 100;
BA_ "GenSigCycleTime" SG_ 659 IP_VehSpdDisp 100;
BA_ "GenSigStartValue" SG_ 659 IP_FuelMainTankR 10;
BA_ "GenSigCycleTime" SG_ 659 IP_FuelMainTankR 100;
BA_ "GenSigStartValue" SG_ 659 IP_FuelAuxTankR 10;
BA_ "GenSigCycleTime" SG_ 659 IP_FuelAuxTankR 100;
BA_ "GenSigCycleTime" SG_ 659 IP_VelSpdDisp_Mile 100;
BA_ "GenSigStartValue" SG_ 659 IP_LagueSet 15;
BA_ "GenSigCycleTime" SG_ 659 IP_LagueSet 100;
BA_ "TransparentInitValue" SG_ 659 HUT_IP1_0x293 "0 0 16 10 2 188 0 0 ";
BA_ "GenSigCycleTime" SG_ 659 HUT_IP1_0x293 100;
BA_ "GenSigCycleTime" SG_ 639 CheckSum_IP2 50;
BA_ "GenSigCycleTime" SG_ 639 IP_DrvSeatBeltWarnLmpFailSts 50;
BA_ "GenSigCycleTime" SG_ 639 IP_PassSeatBeltWarnLmpFailSts 50;
BA_ "GenSigCycleTime" SG_ 639 IP_VehTotDistance 50;
BA_ "GenSigCycleTime" SG_ 639 IP_FuelLvlInfo 50;
BA_ "GenSigCycleTime" SG_ 639 IP_FuelLvlLowLmpSts 50;
BA_ "GenSigCycleTime" SG_ 639 IP_BattChrgLmpSts 50;
BA_ "GenSigCycleTime" SG_ 639 IP_EngOilPressLowLmpSts 50;
BA_ "GenSigCycleTime" SG_ 639 IP_ABMWarnLmpFailrSts 50;
BA_ "GenSigCycleTime" SG_ 639 IP_Err 50;
BA_ "GenSigCycleTime" SG_ 639 IP_ACCErr 50;
BA_ "GenSigCycleTime" SG_ 639 IP_VehTotDistanceValid 50;
BA_ "GenSigCycleTime" SG_ 639 IP_VehSpdUnit 50;
BA_ "GenSigCycleTime" SG_ 639 IP_VINcompr 50;
BA_ "GenSigCycleTime" SG_ 639 RollingCounter_IP2 50;
BA_ "GenSigCycleTime" SG_ 639 FreshnessValue_HUT_IP2 50;
BA_ "GenSigCycleTime" SG_ 639 MAC_Check_HUT_IP2 50;
BA_ "TransparentInitValue" SG_ 639 HUT_IP2_0x27F "0 0 0 0 0 0 0 0 0 0 0 0 0 0 0 0 ";
BA_ "GenSigCycleTime" SG_ 639 HUT_IP2_0x27F 50;
BA_ "GenSigCycleTime" SG_ 842 IP_RemainDistance 500;
BA_ "GenSigCycleTime" SG_ 842 IP_InstFuelConsUnit 500;
BA_ "GenSigCycleTime" SG_ 842 IP_EBDFailSts 500;
BA_ "GenSigStartValue" SG_ 842 IP_AvgFuelCons 4095;
BA_ "GenSigCycleTime" SG_ 842 IP_AvgFuelCons 500;
BA_ "GenSigStartValue" SG_ 842 IP_InstFuelCons 16383;
BA_ "GenSigCycleTime" SG_ 842 IP_InstFuelCons 500;
BA_ "TransparentInitValue" SG_ 842 HUT_IP3_0x34A "0 0 0 255 255 255 192 0 0 0 0 0 0 0 0 0 ";
BA_ "GenSigCycleTime" SG_ 842 HUT_IP3_0x34A 500;
BA_ "GenSigStartValue" SG_ 707 SSSSet_HUT 1;
BA_ "GenSigCycleTime" SG_ 707 SSSSet_HUT 100;
BA_ "GenSigCycleTime" SG_ 707 IFC_SnvtySet 100;
BA_ "GenSigCycleTime" SG_ 707 DOWSwtReq 100;
BA_ "GenSigStartValue" SG_ 707 AEB_PedSwtReq 1;
BA_ "GenSigCycleTime" SG_ 707 AEB_PedSwtReq 100;
BA_ "GenSigStartValue" SG_ 707 ALCMLightLvlSet 5;
BA_ "GenSigCycleTime" SG_ 707 ALCMLightLvlSet 100;
BA_ "GenSigStartValue" SG_ 707 FlashLmpSwtReq 1;
BA_ "GenSigCycleTime" SG_ 707 FlashLmpSwtReq 100;
BA_ "GenSigCycleTime" SG_ 707 LCASwtReq 100;
BA_ "GenSigCycleTime" SG_ 707 RCTASwtReq 100;
BA_ "GenSigCycleTime" SG_ 707 RCTABrkSwtReq 100;
BA_ "GenSigCycleTime" SG_ 707 RCWSwtReq 100;
BA_ "GenSigCycleTime" SG_ 707 FCW_SnvtySet 100;
BA_ "GenSigStartValue" SG_ 707 AEB_VehSwtReq 1;
BA_ "GenSigCycleTime" SG_ 707 AEB_VehSwtReq 100;
BA_ "GenSigCycleTime" SG_ 707 LKASwtReq 100;
BA_ "GenSigCycleTime" SG_ 707 LCKSwtReq 100;
BA_ "GenSigCycleTime" SG_ 707 ELKSwtReq 100;
BA_ "GenSigCycleTime" SG_ 707 ESS_PedSwtReq 100;
BA_ "GenSigCycleTime" SG_ 707 ESS_VehSwtReq 100;
BA_ "GenSigCycleTime" SG_ 707 LDWSwtReq 100;
BA_ "GenSigCycleTime" SG_ 707 TSRSwtReq 100;
BA_ "GenSigCycleTime" SG_ 707 TSRWarnSwtReq 100;
BA_ "GenSigCycleTime" SG_ 707 ICA_HandsOffSwtReq 100;
BA_ "GenSigCycleTime" SG_ 707 ISLSwtReq 100;
BA_ "GenSigStartValue" SG_ 707 TSR_SnvtySet 15;
BA_ "GenSigCycleTime" SG_ 707 TSR_SnvtySet 100;
BA_ "GenSigCycleTime" SG_ 707 BrkPedalFeelReq 100;
BA_ "GenSigStartValue" SG_ 707 HFASwtSts 1;
BA_ "GenSigCycleTime" SG_ 707 HFASwtSts 100;
BA_ "GenSigCycleTime" SG_ 707 EPSSteerModSwtReq 100;
BA_ "GenSigCycleTime" SG_ 707 DSTSwtReq 100;
BA_ "GenSigCycleTime" SG_ 707 HUT_ESPFuncOffSwtSts 100;
BA_ "GenSigCycleTime" SG_ 707 DrivingModReq_HUT 100;
BA_ "GenSigCycleTime" SG_ 707 LSSSwtReq 100;
BA_ "GenSigCycleTime" SG_ 707 LSSWarnFormSwtReq 100;
BA_ "GenSigCycleTime" SG_ 707 IntelligentEvaSwtReq 100;
BA_ "GenSigStartValue" SG_ 707 HUT_BattSOCLimSaveMod 4;
BA_ "GenSigCycleTime" SG_ 707 HUT_BattSOCLimSaveMod 100;
BA_ "GenSigCycleTime" SG_ 707 DrvgModeMemReq 100;
BA_ "GenSigCycleTime" SG_ 707 HUTRadioFrq 100;
BA_ "GenSigCycleTime" SG_ 707 MediaPlaySrc 100;
BA_ "GenSigCycleTime" SG_ 707 HUT_DrvModReq 100;
BA_ "GenSigCycleTime" SG_ 707 HUT_WadeModeSet 100;
BA_ "GenSigCycleTime" SG_ 707 USB_AudioSts 100;
BA_ "GenSigCycleTime" SG_ 707 USB_VideoSts 100;
BA_ "GenSigCycleTime" SG_ 707 BT_AudioSts 100;
BA_ "GenSigCycleTime" SG_ 707 IPod_Sts 100;
BA_ "GenSigCycleTime" SG_ 707 AM_Sts 100;
BA_ "GenSigCycleTime" SG_ 707 FM_Sts 100;
BA_ "GenSigCycleTime" SG_ 707 APPLink_Sts 100;
BA_ "GenSigCycleTime" SG_ 707 QQMusic_Sts 100;
BA_ "GenSigCycleTime" SG_ 707 KaolaFM_Sts 100;
BA_ "GenSigCycleTime" SG_ 707 OnlineNews_Sts 100;
BA_ "GenSigCycleTime" SG_ 707 ChairMemPosnSet 100;
BA_ "GenSigCycleTime" SG_ 707 CCOSwtReq_HUT 100;
BA_ "GenSigCycleTime" SG_ 707 ChairMemPosnSetResult 100;
BA_ "GenSigCycleTime" SG_ 707 TABSwtReq_HUT 100;
BA_ "GenSigCycleTime" SG_ 707 NavVehToTrafEyeDist 100;
BA_ "GenSigCycleTime" SG_ 707 NavRoadType 100;
BA_ "GenSigCycleTime" SG_ 707 NavSpdLimType 100;
BA_ "GenSigCycleTime" SG_ 707 NavSpdLimValue 100;
BA_ "GenSigStartValue" SG_ 707 NavSpdLimUnit_HUT 1;
BA_ "GenSigCycleTime" SG_ 707 NavSpdLimUnit_HUT 100;
BA_ "GenSigStartValue" SG_ 707 NavCtryType 156;
BA_ "GenSigCycleTime" SG_ 707 NavCtryType 100;
BA_ "GenSigStartValue" SG_ 707 HWA_SwtReq 1;
BA_ "GenSigCycleTime" SG_ 707 HWA_SwtReq 100;
BA_ "GenSigCycleTime" SG_ 707 HWA_SnvtySet 100;
BA_ "GenSigCycleTime" SG_ 707 ALC_SwtReq 100;
BA_ "GenSigCycleTime" SG_ 707 NavSpdLimSignSts 100;
BA_ "GenSigCycleTime" SG_ 707 NavTSRTrafSign 100;
BA_ "GenSigCycleTime" SG_ 707 FCTASwtReq 100;
BA_ "GenSigCycleTime" SG_ 707 FCTABrkSwtReq 100;
BA_ "GenSigCycleTime" SG_ 707 AEB_JASwtReq 100;
BA_ "GenSigCycleTime" SG_ 707 AESSwtReq 100;
BA_ "GenSigCycleTime" SG_ 707 ADAS_Posn_MsgTye 100;
BA_ "GenSigStartValue" SG_ 707 ADAS_Posn_Offset 8191;
BA_ "GenSigCycleTime" SG_ 707 ADAS_Posn_Offset 100;
BA_ "GenSigCycleTime" SG_ 707 ADAS_Posn_CycCnt 100;
BA_ "GenSigCycleTime" SG_ 707 ADAS_Posn_Pathldx 100;
BA_ "GenSigCycleTime" SG_ 707 ADAS_Posn_Idx 100;
BA_ "GenSigCycleTime" SG_ 707 ADAS_Posn_PosProbb 100;
BA_ "GenSigCycleTime" SG_ 707 ADAS_Posn_Age 100;
BA_ "GenSigCycleTime" SG_ 707 ADAS_Posn_PosConfdc 100;
BA_ "GenSigCycleTime" SG_ 707 ADAS_Posn_CurLane 100;
BA_ "GenSigStartValue" SG_ 707 ADAS_Posn_Spd 511;
BA_ "GenSigCycleTime" SG_ 707 ADAS_Posn_Spd 100;
BA_ "GenSigCycleTime" SG_ 707 ADAS_Posn_Rehead 100;
BA_ "GenSigCycleTime" SG_ 707 FreshnessValue_HUT_FD1 100;
BA_ "GenSigCycleTime" SG_ 707 MAC_Check_HUT_FD1 100;
BA_ "TransparentInitValue" SG_ 707 HUT_FD1_0x2C3 "0 0 0 0 0 0 0 0 1 5 192 128 0 2 32 30 0 0 0 0 0 0 0 0 0 0 0 0 0 0 0 0 0 1 39 1 0 0 0 0 31 255 0 0 0 1 255 0 0 0 0 0 0 0 0 0 0 0 0 0 0 0 0 0 ";
BA_ "GenSigCycleTime" SG_ 707 HUT_FD1_0x2C3 100;
BA_ "GenSigCycleTime" SG_ 648 HUT_OD_Obj0_ID 100;
BA_ "GenSigCycleTime" SG_ 648 HUT_OD_Obj0_type 100;
BA_ "GenSigCycleTime" SG_ 648 HUT_OD_Obj0_Confidence 100;
BA_ "GenSigCycleTime" SG_ 648 HUT_OD_Obj0_width 100;
BA_ "GenSigCycleTime" SG_ 648 HUT_OD_Obj0_Ground_Pos_X 100;
BA_ "GenSigCycleTime" SG_ 648 HUT_OD_Obj0_Ground_Pos_Y 100;
BA_ "GenSigCycleTime" SG_ 648 HTU_OD_Obj1_ID 100;
BA_ "GenSigCycleTime" SG_ 648 HUT_OD_Obj1_type 100;
BA_ "GenSigCycleTime" SG_ 648 HUT_OD_Obj1_Confidence 100;
BA_ "GenSigCycleTime" SG_ 648 HUT_OD_Obj1_width 100;
BA_ "GenSigCycleTime" SG_ 648 HUT_OD_Obj1_Ground_Pos_X 100;
BA_ "GenSigCycleTime" SG_ 648 HUT_OD_Obj1_Ground_Pos_Y 100;
BA_ "GenSigCycleTime" SG_ 648 HUT_OD_Obj2_ID 100;
BA_ "GenSigCycleTime" SG_ 648 HUT_OD_Obj2_type 100;
BA_ "GenSigCycleTime" SG_ 648 HUT_OD_Obj2_Confidence 100;
BA_ "GenSigCycleTime" SG_ 648 HUT_OD_Obj2_width 100;
BA_ "GenSigCycleTime" SG_ 648 HUT_OD_Obj2_Ground_Pos_X 100;
BA_ "GenSigCycleTime" SG_ 648 HUT_OD_Obj2_Ground_Pos_Y 100;
BA_ "GenSigCycleTime" SG_ 648 HUT_OD_Obj3_ID 100;
BA_ "GenSigCycleTime" SG_ 648 HUT_OD_Obj3_type 100;
BA_ "GenSigCycleTime" SG_ 648 HUT_OD_Obj3_Confidence 100;
BA_ "GenSigCycleTime" SG_ 648 HUT_OD_Obj3_width 100;
BA_ "GenSigCycleTime" SG_ 648 HUT_OD_Obj3_Ground_Pos_X 100;
BA_ "GenSigCycleTime" SG_ 648 HUT_OD_Obj3_Ground_Pos_Y 100;
BA_ "GenSigCycleTime" SG_ 648 HUT_OD_Obj4_ID 100;
BA_ "GenSigCycleTime" SG_ 648 HUT_OD_Obj4_type 100;
BA_ "GenSigCycleTime" SG_ 648 HUT_OD_Obj4_Confidence 100;
BA_ "GenSigCycleTime" SG_ 648 HUT_OD_Obj4_width 100;
BA_ "GenSigCycleTime" SG_ 648 HUT_OD_Obj4_Ground_Pos_X 100;
BA_ "GenSigCycleTime" SG_ 648 HUT_OD_Obj4_Ground_Pos_Y 100;
BA_ "GenSigCycleTime" SG_ 648 HUT_OD_Obj5_ID 100;
BA_ "GenSigCycleTime" SG_ 648 HUT_OD_Obj5_type 100;
BA_ "GenSigCycleTime" SG_ 648 HUT_OD_Obj5_Confidence 100;
BA_ "GenSigCycleTime" SG_ 648 HUT_OD_Obj5_width 100;
BA_ "GenSigCycleTime" SG_ 648 HUT_OD_Obj5_Ground_Pos_X 100;
BA_ "GenSigCycleTime" SG_ 648 HUT_OD_Obj5_Ground_Pos_Y 100;
BA_ "GenSigCycleTime" SG_ 648 HUT_OD_Obj6_ID 100;
BA_ "GenSigCycleTime" SG_ 648 HUT_OD_Obj6_type 100;
BA_ "GenSigCycleTime" SG_ 648 HUT_OD_Obj6_Confidence 100;
BA_ "GenSigCycleTime" SG_ 648 HUT_OD_Obj6_width 100;
BA_ "GenSigCycleTime" SG_ 648 HUT_OD_Obj6_Ground_Pos_X 100;
BA_ "GenSigCycleTime" SG_ 648 HUT_OD_Obj6_Ground_Pos_Y 100;
BA_ "TransparentInitValue" SG_ 648 HUT_FD2_0x288 "0 0 0 0 0 0 0 0 0 0 0 0 0 0 0 0 0 0 0 0 0 0 0 0 0 0 0 0 0 0 0 0 0 0 0 0 0 0 0 0 0 0 0 0 0 0 0 0 0 0 0 0 0 0 0 0 0 0 0 0 0 0 0 0 ";
BA_ "GenSigCycleTime" SG_ 648 HUT_FD2_0x288 100;
BA_ "GenSigCycleTime" SG_ 745 HUT_OD_Obj7_ID 100;
BA_ "GenSigCycleTime" SG_ 745 HUT_OD_Obj7_type 100;
BA_ "GenSigCycleTime" SG_ 745 HUT_OD_Obj7_Confidence 100;
BA_ "GenSigCycleTime" SG_ 745 HUT_OD_Obj7_width 100;
BA_ "GenSigCycleTime" SG_ 745 HUT_OD_Obj7_Ground_Pos_X 100;
BA_ "GenSigCycleTime" SG_ 745 HUT_OD_Obj7_Ground_Pos_Y 100;
BA_ "GenSigCycleTime" SG_ 745 HUT_OD_WorkSts 100;
BA_ "GenSigCycleTime" SG_ 745 HUT_OD_Obj_Timestamp 100;
BA_ "GenSigCycleTime" SG_ 745 HUT_FSD1_distance 100;
BA_ "GenSigCycleTime" SG_ 745 HUT_FSD2_distance 100;
BA_ "GenSigCycleTime" SG_ 745 HUT_FSD3_distance 100;
BA_ "GenSigCycleTime" SG_ 745 HUT_FSD4_distance 100;
BA_ "GenSigCycleTime" SG_ 745 HUT_FSD5_distance 100;
BA_ "GenSigCycleTime" SG_ 745 HUT_FSD6_distance 100;
BA_ "GenSigCycleTime" SG_ 745 HUT_FSD7_distance 100;
BA_ "GenSigCycleTime" SG_ 745 HUT_FSD8_distance 100;
BA_ "GenSigCycleTime" SG_ 745 HUT_FSD9_distance 100;
BA_ "GenSigCycleTime" SG_ 745 HUT_FSD10_distance 100;
BA_ "GenSigCycleTime" SG_ 745 HUT_FSD11_distance 100;
BA_ "GenSigCycleTime" SG_ 745 HUT_FSD12_distance 100;
BA_ "GenSigCycleTime" SG_ 745 HUT_FSD13_distance 100;
BA_ "GenSigCycleTime" SG_ 745 HUT_FSD14_distance 100;
BA_ "GenSigCycleTime" SG_ 745 HUT_FSD15_distance 100;
BA_ "GenSigCycleTime" SG_ 745 HUT_FSD16_distance 100;
BA_ "GenSigCycleTime" SG_ 745 HUT_FSD17_distance 100;
BA_ "GenSigCycleTime" SG_ 745 HUT_FSD18_distance 100;
BA_ "TransparentInitValue" SG_ 745 HUT_FD3_0x2E9 "0 0 0 0 0 0 0 0 0 0 0 0 0 0 0 0 0 0 0 0 0 0 0 0 0 0 0 0 0 0 0 0 0 0 0 0 0 0 0 0 0 0 0 0 0 0 0 0 0 0 0 0 0 0 0 0 0 0 0 0 0 0 0 0 ";
BA_ "GenSigCycleTime" SG_ 745 HUT_FD3_0x2E9 100;
BA_ "GenSigCycleTime" SG_ 1045 ADAS_Meta_MsgTyp 5000;
BA_ "GenSigCycleTime" SG_ 1045 ADAS_Meta_MapProvider 5000;
BA_ "GenSigCycleTime" SG_ 1045 ADAS_Meta_CountryCode 5000;
BA_ "GenSigCycleTime" SG_ 1045 ADAS_Meta_CycCnt 5000;
BA_ "GenSigCycleTime" SG_ 1045 ADAS_Meta_ProtVer_Major 5000;
BA_ "GenSigCycleTime" SG_ 1045 ADAS_Meta_ProtVer_MinorSub 5000;
BA_ "GenSigCycleTime" SG_ 1045 ADAS_Meta_HwVer 5000;
BA_ "GenSigStartValue" SG_ 1045 ADAS_Meta_DrvSide 1;
BA_ "GenSigCycleTime" SG_ 1045 ADAS_Meta_DrvSide 5000;
BA_ "GenSigCycleTime" SG_ 1045 ADAS_Meta_RegionCode 5000;
BA_ "GenSigCycleTime" SG_ 1045 ADAS_Meta_MapVerQtr 5000;
BA_ "GenSigCycleTime" SG_ 1045 ADAS_Meta_MapVerYear 5000;
BA_ "GenSigCycleTime" SG_ 1045 ADAS_Meta_SpdUnits 5000;
BA_ "GenSigCycleTime" SG_ 1045 ADAS_Meta_ProtVer_Minor 5000;
BA_ "TransparentInitValue" SG_ 1045 HUT19_0x415 "0 0 0 0 128 0 0 0 ";
BA_ "GenSigCycleTime" SG_ 1045 HUT19_0x415 5000;
BA_ "GenSigStartValue" SG_ 840 PowerSet 1;
BA_ "GenSigCycleTime" SG_ 840 PowerSet 500;
BA_ "TransparentInitValue" SG_ 840 HUT16_0x348 "0 0 0 0 128 0 0 0 ";
BA_ "GenSigCycleTime" SG_ 840 HUT16_0x348 500;
BA_ "GenSigCycleTime" SG_ 796 AudioMuteSts 100;
BA_ "GenSigCycleTime" SG_ 796 OrvmPosnEnaSts 100;
BA_ "GenSigStartValue" SG_ 796 VSGSwtSet 1;
BA_ "GenSigCycleTime" SG_ 796 VSGSwtSet 100;
BA_ "TransparentInitValue" SG_ 796 HUT13_0x31C "0 1 0 0 0 0 0 0 ";
BA_ "GenSigCycleTime" SG_ 796 HUT13_0x31C 100;
BA_ "GenSigStartValue" SG_ 871 DomeLmpDlyTimSet 1;
BA_ "GenSigSendType" SG_ 871 DomeLmpDlyTimSet 2;
BA_ "GenSigStartValue" SG_ 871 FolwMeHomeDlyTimSet 1;
BA_ "GenSigSendType" SG_ 871 FolwMeHomeDlyTimSet 2;
BA_ "GenSigSendType" SG_ 871 TranPMode_Req 2;
BA_ "GenSigStartValue" SG_ 871 RearviewFoldModSet 1;
BA_ "GenSigSendType" SG_ 871 RearviewFoldModSet 2;
BA_ "GenSigStartValue" SG_ 871 BattSaveDelayTimeSet 1;
BA_ "GenSigSendType" SG_ 871 BattSaveDelayTimeSet 2;
BA_ "GenSigSendType" SG_ 871 ACDualReq_TC 2;
BA_ "GenSigSendType" SG_ 871 ACAutoModReq_TC 2;
BA_ "GenSigSendType" SG_ 871 ACAirInletReq_TC 2;
BA_ "GenSigSendType" SG_ 871 ACAQSReq_TC 2;
BA_ "GenSigSendType" SG_ 871 ACCmprReq_TC 2;
BA_ "GenSigSendType" SG_ 871 ACFrntDefrstReq_TC 2;
BA_ "GenSigSendType" SG_ 871 ACFrntBlwrSpdDecReq_TC 2;
BA_ "GenSigStartValue" SG_ 871 DrvDrowsnsDetnSet 1;
BA_ "GenSigSendType" SG_ 871 DrvDrowsnsDetnSet 2;
BA_ "GenSigSendType" SG_ 871 ACFrntBlwrSpdIncReq_TC 2;
BA_ "GenSigSendType" SG_ 871 ACDrvAirDistribModReq_TC 2;
BA_ "GenSigSendType" SG_ 871 ACDrvTempDecReq_TC 2;
BA_ "GenSigStartValue" SG_ 871 ChairMemPosnEna 1;
BA_ "GenSigSendType" SG_ 871 ChairMemPosnEna 2;
BA_ "GenSigSendType" SG_ 871 ACDrvTempIncReq_TC 2;
BA_ "GenSigSendType" SG_ 871 ACFrntPassTempDecReq_TC 2;
BA_ "GenSigSendType" SG_ 871 ACFrntPassTempIncReq_TC 2;
BA_ "GenSigSendType" SG_ 871 ACAIUReq_TC 2;
BA_ "GenSigSendType" SG_ 871 ACOffReq_TC 2;
BA_ "GenSigSendType" SG_ 871 ACBlwrsteplsSpdReq_TC 2;
BA_ "TransparentInitValue" SG_ 871 HUT1_0x367 "34 80 0 0 16 1 0 0 ";
BA_ "GenSigSendType" SG_ 871 HUT1_0x367 2;
BA_ "GenSigSendType" SG_ 873 AMP_MediaCallSourceSet 2;
BA_ "GenSigSendType" SG_ 873 AMP_NaviSourceSet 2;
BA_ "GenSigSendType" SG_ 873 AMP_BeepSourceSet 2;
BA_ "GenSigStartValue" SG_ 873 AMP_LRAudioBalanceSet 10;
BA_ "GenSigSendType" SG_ 873 AMP_LRAudioBalanceSet 2;
BA_ "GenSigStartValue" SG_ 873 AMP_AudioVolVSCModReq 2;
BA_ "GenSigSendType" SG_ 873 AMP_AudioVolVSCModReq 2;
BA_ "GenSigStartValue" SG_ 873 AMP_FRAudioFaderSet 10;
BA_ "GenSigSendType" SG_ 873 AMP_FRAudioFaderSet 2;
BA_ "GenSigSendType" SG_ 873 AMP_LRDrvSideSet 2;
BA_ "GenSigStartValue" SG_ 873 AMP_LowFrqAudioSet 10;
BA_ "GenSigSendType" SG_ 873 AMP_LowFrqAudioSet 2;
BA_ "GenSigStartValue" SG_ 873 AMP_MuteSet 1;
BA_ "GenSigSendType" SG_ 873 AMP_MuteSet 2;
BA_ "GenSigStartValue" SG_ 873 AMP_MidFrqAudioSet 10;
BA_ "GenSigSendType" SG_ 873 AMP_MidFrqAudioSet 2;
BA_ "GenSigStartValue" SG_ 873 AMP_HighFrqAudioSet 10;
BA_ "GenSigSendType" SG_ 873 AMP_HighFrqAudioSet 2;
BA_ "GenSigSendType" SG_ 873 T_box_ECallSet 2;
BA_ "GenSigStartValue" SG_ 873 QLISurroundSet 1;
BA_ "GenSigSendType" SG_ 873 QLISurroundSet 2;
BA_ "GenSigStartValue" SG_ 873 ANCSwtSet 1;
BA_ "GenSigSendType" SG_ 873 ANCSwtSet 2;
BA_ "GenSigSendType" SG_ 873 RearWinHeatCmd_TC 2;
BA_ "GenSigSendType" SG_ 873 FrntWinHeatSwt 2;
BA_ "TransparentInitValue" SG_ 873 HUT2_0x369 "0 82 80 82 16 80 82 0 ";
BA_ "GenSigSendType" SG_ 873 HUT2_0x369 2;
BA_ "GenSigStartValue" SG_ 875 AMP_HFMVolSet 10;
BA_ "GenSigSendType" SG_ 875 AMP_HFMVolSet 2;
BA_ "GenSigStartValue" SG_ 875 AMP_TTSVolSet_VR 10;
BA_ "GenSigSendType" SG_ 875 AMP_TTSVolSet_VR 2;
BA_ "GenSigStartValue" SG_ 875 AMP_NaviVolSet 10;
BA_ "GenSigSendType" SG_ 875 AMP_NaviVolSet 2;
BA_ "GenSigStartValue" SG_ 875 AMP_MainVolSet 10;
BA_ "GenSigSendType" SG_ 875 AMP_MainVolSet 2;
BA_ "GenSigSendType" SG_ 875 AMP_GetSWInfoReq 2;
BA_ "GenSigSendType" SG_ 875 AMP_GetHWInfoReq 2;
BA_ "GenSigSendType" SG_ 875 AMP_GetTempInfoReq 2;
BA_ "GenSigSendType" SG_ 875 AMP_GetIntVoltInfoReq 2;
BA_ "GenSigSendType" SG_ 875 AMP_GetDTCInfoReq 2;
BA_ "GenSigSendType" SG_ 875 IESS_MdlSwtReq 2;
BA_ "GenSigSendType" SG_ 875 IESS_MdlInfoReq 2;
BA_ "GenSigSendType" SG_ 875 AMP_BestListegPosnReq 2;
BA_ "GenSigStartValue" SG_ 875 AMP_Clari_FiReq 1;
BA_ "GenSigSendType" SG_ 875 AMP_Clari_FiReq 2;
BA_ "TransparentInitValue" SG_ 875 HUT3_0x36B "40 40 40 40 0 8 0 0 ";
BA_ "GenSigSendType" SG_ 875 HUT3_0x36B 2;
BA_ "GenSigSendType" SG_ 877 DrvSeatHeatgLvlSet 2;
BA_ "GenSigSendType" SG_ 877 PassSeatHeatgLvlSet 2;
BA_ "GenSigSendType" SG_ 877 DrvSeatVentnLvlSet 2;
BA_ "GenSigSendType" SG_ 877 PassSeatVentnLvlSet 2;
BA_ "GenSigSendType" SG_ 877 ACAutoModReq_VR 2;
BA_ "GenSigSendType" SG_ 877 ACCmprReq_VR 2;
BA_ "GenSigSendType" SG_ 877 ACPowerReq_VR 2;
BA_ "GenSigSendType" SG_ 877 ACBlwrSpdReq_VR 2;
BA_ "GenSigSendType" SG_ 877 ACDrvTempReq_VR 2;
BA_ "GenSigSendType" SG_ 877 ACFrntDefrostReq_VR 2;
BA_ "GenSigSendType" SG_ 877 ACDrvAirDistribModReq_VR 2;
BA_ "GenSigSendType" SG_ 877 ACAirInletReq_VR 2;
BA_ "GenSigStartValue" SG_ 877 ACModReq_HUT 1;
BA_ "GenSigSendType" SG_ 877 ACModReq_HUT 2;
BA_ "GenSigStartValue" SG_ 877 ElecSideSteppingSysSet 1;
BA_ "GenSigSendType" SG_ 877 ElecSideSteppingSysSet 2;
BA_ "GenSigSendType" SG_ 877 RoofModSet 2;
BA_ "GenSigSendType" SG_ 877 AllTerrainDislSet 2;
BA_ "GenSigSendType" SG_ 877 RemUpgrdSts 2;
BA_ "TransparentInitValue" SG_ 877 HUT4_0x36D "0 0 32 0 0 0 0 64 ";
BA_ "GenSigSendType" SG_ 877 HUT4_0x36D 2;
BA_ "GenSigSendType" SG_ 74 AUTODefrost_TC 2;
BA_ "GenSigSendType" SG_ 74 AUTODefrost_VR 2;
BA_ "GenSigSendType" SG_ 74 LaneCalActvtCmd 2;
BA_ "GenSigSendType" SG_ 74 MODChgReq 2;
BA_ "GenSigSendType" SG_ 74 Radar_DispCmd 2;
BA_ "GenSigSendType" SG_ 74 Guid_Ovl_Display_Cmd 2;
BA_ "GenSigSendType" SG_ 74 Sgl_View_Sel 2;
BA_ "GenSigSendType" SG_ 74 SwToFieldCalRstCmd 2;
BA_ "GenSigSendType" SG_ 74 AutoViewChgCmd 2;
BA_ "GenSigSendType" SG_ 74 MdlColrChgCmd 2;
BA_ "GenSigSendType" SG_ 74 CarMdlTrsprcySwtCmd 2;
BA_ "GenSigSendType" SG_ 74 CarMdlDispCmd 2;
BA_ "GenSigSendType" SG_ 74 AutoAVMSwSet_Cmd 2;
BA_ "GenSigSendType" SG_ 74 FPAS_AutoModSwt 2;
BA_ "GenSigSendType" SG_ 74 MEBSwtSet 2;
BA_ "GenSigSendType" SG_ 74 WshSoftSwt 2;
BA_ "GenSigSendType" SG_ 74 View_SoftswitchCmd 2;
BA_ "TransparentInitValue" SG_ 74 HUT6_0x4A "0 0 0 0 0 0 0 0 ";
BA_ "GenSigSendType" SG_ 74 HUT6_0x4A 2;
BA_ "GenSigCycleTime" SG_ 880 TimeMod 1000;
BA_ "GenSigCycleTime" SG_ 880 TimeIndcn 1000;
BA_ "GenSigStartValue" SG_ 880 Time_Hour 31;
BA_ "GenSigCycleTime" SG_ 880 Time_Hour 1000;
BA_ "GenSigStartValue" SG_ 880 Time_Minutes 63;
BA_ "GenSigCycleTime" SG_ 880 Time_Minutes 1000;
BA_ "GenSigStartValue" SG_ 880 Time_Second 63;
BA_ "GenSigCycleTime" SG_ 880 Time_Second 1000;
BA_ "GenSigStartValue" SG_ 880 Time_Year_Left 15;
BA_ "GenSigCycleTime" SG_ 880 Time_Year_Left 1000;
BA_ "GenSigStartValue" SG_ 880 Time_Year_Right 15;
BA_ "GenSigCycleTime" SG_ 880 Time_Year_Right 1000;
BA_ "GenSigCycleTime" SG_ 880 Time_Month 1000;
BA_ "GenSigCycleTime" SG_ 880 Time_Day 1000;
BA_ "TransparentInitValue" SG_ 880 HUT34_0x370 "0 248 252 252 255 0 0 0 ";
BA_ "GenSigCycleTime" SG_ 880 HUT34_0x370 1000;
BA_ "GenSigSendType" SG_ 817 HUT_EgyRecvrySet 2;
BA_ "GenSigSendType" SG_ 817 ACDualReq_VR 2;
BA_ "GenSigSendType" SG_ 817 ACAQSReq_VR 2;
BA_ "GenSigSendType" SG_ 817 ACRearDefrstReq_VR 2;
BA_ "GenSigSendType" SG_ 817 ACPassTempReq_VR 2;
BA_ "GenSigSendType" SG_ 817 ACAIUReq_VR 2;
BA_ "GenSigStartValue" SG_ 817 IPVolSet 15;
BA_ "GenSigSendType" SG_ 817 IPVolSet 2;
BA_ "GenSigSendType" SG_ 817 ALCMStatSwt 2;
BA_ "GenSigSendType" SG_ 817 ALCMDynSwt 2;
BA_ "GenSigSendType" SG_ 817 ALCMClrSet 2;
BA_ "GenSigStartValue" SG_ 817 ALCMRhmSwt 1;
BA_ "GenSigSendType" SG_ 817 ALCMRhmSwt 2;
BA_ "GenSigSendType" SG_ 817 PASSwtReq_VR 2;
BA_ "TransparentInitValue" SG_ 817 HUT10_0x331 "0 0 0 1 0 0 0 60 ";
BA_ "GenSigSendType" SG_ 817 HUT10_0x331 2;
BA_ "GenSigSendType" SG_ 494 ACOperMod_TC 2;
BA_ "GenSigSendType" SG_ 494 ACOperMod_VR 2;
BA_ "GenSigStartValue" SG_ 494 SteerWheelHeatSwtReq 1;
BA_ "GenSigSendType" SG_ 494 SteerWheelHeatSwtReq 2;
BA_ "GenSigSendType" SG_ 494 ACDrvSetTempSteplsReq_TC 2;
BA_ "GenSigSendType" SG_ 494 ACPassSetTempSteplsReq_TC 2;
BA_ "GenSigSendType" SG_ 494 SDWSwtSet 2;
BA_ "GenSigSendType" SG_ 494 APSSwtReq_VR 2;
BA_ "GenSigSendType" SG_ 494 PASExitSpdSwt 2;
BA_ "GenSigSendType" SG_ 494 APSPrkgTypSeln 2;
BA_ "GenSigSendType" SG_ 494 SunShadeSwtReq_VR 2;
BA_ "GenSigSendType" SG_ 494 SunRoofSwtReq_VR 2;
BA_ "GenSigStartValue" SG_ 494 SportModLightSet 1;
BA_ "GenSigSendType" SG_ 494 SportModLightSet 2;
BA_ "GenSigStartValue" SG_ 494 ABSLmpSet 1;
BA_ "GenSigSendType" SG_ 494 ABSLmpSet 2;
BA_ "GenSigStartValue" SG_ 494 AutoWshWipSet 2;
BA_ "GenSigSendType" SG_ 494 AutoWshWipSet 2;
BA_ "GenSigSendType" SG_ 494 SeekVehSet 2;
BA_ "GenSigStartValue" SG_ 494 SpdAutoLockModSet 2;
BA_ "GenSigSendType" SG_ 494 SpdAutoLockModSet 2;
BA_ "GenSigStartValue" SG_ 494 ParkLmpSet 1;
BA_ "GenSigSendType" SG_ 494 ParkLmpSet 2;
BA_ "GenSigSendType" SG_ 494 DoorUnlockModSet 2;
BA_ "GenSigSendType" SG_ 494 ACEAHReq_TC 2;
BA_ "GenSigSendType" SG_ 494 ACEAHReq_VR 2;
BA_ "GenSigSendType" SG_ 494 FreshnessValue_HUT15 2;
BA_ "GenSigSendType" SG_ 494 MAC_Check_HUT15 2;
BA_ "TransparentInitValue" SG_ 494 HUT15_0x1EE "5 81 0 2 0 0 0 0 0 0 0 0 0 0 0 0 ";
BA_ "GenSigSendType" SG_ 494 HUT15_0x1EE 2;
BA_ "GenSigSendType" SG_ 827 AVMSwtReq 2;
BA_ "GenSigStartValue" SG_ 827 NaviMediaVolLvlReq 3;
BA_ "GenSigSendType" SG_ 827 NaviMediaVolLvlReq 2;
BA_ "GenSigStartValue" SG_ 827 AVMMediaVolLvlReq 3;
BA_ "GenSigSendType" SG_ 827 AVMMediaVolLvlReq 2;
BA_ "GenSigSendType" SG_ 827 FPASChanSwtReq 2;
BA_ "GenSigSendType" SG_ 827 RPASChanSwtReq 2;
BA_ "GenSigStartValue" SG_ 827 BackgroundLightLvlSet 4;
BA_ "GenSigSendType" SG_ 827 BackgroundLightLvlSet 2;
BA_ "GenSigStartValue" SG_ 827 ManCmpSet 5;
BA_ "GenSigSendType" SG_ 827 ManCmpSet 2;
BA_ "GenSigSendType" SG_ 827 DispModSet 2;
BA_ "GenSigStartValue" SG_ 827 OPDSwtSts 1;
BA_ "GenSigSendType" SG_ 827 OPDSwtSts 2;
BA_ "GenSigSendType" SG_ 827 PLGReq_VR 2;
BA_ "GenSigStartValue" SG_ 827 WPC_SwtReq 1;
BA_ "GenSigSendType" SG_ 827 WPC_SwtReq 2;
BA_ "TransparentInitValue" SG_ 827 HUT17_0x33B "0 0 64 51 69 0 16 0 ";
BA_ "GenSigSendType" SG_ 827 HUT17_0x33B 2;
BA_ "GenSigSendType" SG_ 734 ADAS_ProfLong_MsgTyp 2;
BA_ "GenSigSendType" SG_ 734 ADAS_ProfLong_Offset 2;
BA_ "GenSigSendType" SG_ 734 ADAS_ProfLong_CycCnt 2;
BA_ "GenSigSendType" SG_ 734 ADAS_ProfLong_PathIdx 2;
BA_ "GenSigSendType" SG_ 734 ADAS_ProfLong_ProfTyp 2;
BA_ "GenSigSendType" SG_ 734 ADAS_ProfLong_CtrlPoint 2;
BA_ "GenSigSendType" SG_ 734 ADAS_ProfLong_Retr 2;
BA_ "GenSigSendType" SG_ 734 ADAS_ProfLong_Update 2;
BA_ "GenSigSendType" SG_ 734 ADAS_ProfLong_Value 2;
BA_ "TransparentInitValue" SG_ 734 HUT20_0x2DE "0 0 0 0 0 0 0 0 ";
BA_ "GenSigSendType" SG_ 734 HUT20_0x2DE 2;
BA_ "GenSigSendType" SG_ 733 ADAS_ProfShort_MsgTyp 2;
BA_ "GenSigSendType" SG_ 733 ADAS_ProfShort_Offset 2;
BA_ "GenSigSendType" SG_ 733 ADAS_ProfShort_CycCnt 2;
BA_ "GenSigSendType" SG_ 733 ADAS_ProfShort_PathIdx 2;
BA_ "GenSigSendType" SG_ 733 ADAS_ProfShort_ProfTyp 2;
BA_ "GenSigSendType" SG_ 733 ADAS_ProfShort_CtrlPoint 2;
BA_ "GenSigSendType" SG_ 733 ADAS_ProfShort_Retr 2;
BA_ "GenSigSendType" SG_ 733 ADAS_ProfShort_Update 2;
BA_ "GenSigStartValue" SG_ 733 ADAS_ProfShort_AccurClass 3;
BA_ "GenSigSendType" SG_ 733 ADAS_ProfShort_AccurClass 2;
BA_ "GenSigSendType" SG_ 733 ADAS_ProfShort_Dist1 2;
BA_ "GenSigSendType" SG_ 733 ADAS_ProfShort_Value0 2;
BA_ "GenSigSendType" SG_ 733 ADAS_ProfShort_Value1 2;
BA_ "TransparentInitValue" SG_ 733 HUT21_0x2DD "0 0 0 0 192 0 0 0 ";
BA_ "GenSigSendType" SG_ 733 HUT21_0x2DD 2;
BA_ "GenSigSendType" SG_ 730 ADAS_Seg_MsgTyp 2;
BA_ "GenSigSendType" SG_ 730 ADAS_Seg_Offset 2;
BA_ "GenSigSendType" SG_ 730 ADAS_Seg_CycCnt 2;
BA_ "GenSigSendType" SG_ 730 ADAS_Seg_PathIdx 2;
BA_ "GenSigSendType" SG_ 730 ADAS_Seg_Tunnel 2;
BA_ "GenSigSendType" SG_ 730 ADAS_Seg_Brdg 2;
BA_ "GenSigSendType" SG_ 730 ADAS_Seg_BuildUpArea 2;
BA_ "GenSigSendType" SG_ 730 ADAS_Seg_Retr 2;
BA_ "GenSigSendType" SG_ 730 ADAS_Seg_Update 2;
BA_ "GenSigSendType" SG_ 730 ADAS_Seg_RelProbb 2;
BA_ "GenSigSendType" SG_ 730 ADAS_Seg_FuncRoadClass 2;
BA_ "GenSigSendType" SG_ 730 ADAS_Seg_PartOfCalcRoute 2;
BA_ "GenSigSendType" SG_ 730 ADAS_Seg_CmplxInsct 2;
BA_ "GenSigSendType" SG_ 730 ADAS_Seg_FormOfWay 2;
BA_ "GenSigSendType" SG_ 730 ADAS_Seg_EffSpdLmt 2;
BA_ "GenSigSendType" SG_ 730 ADAS_Seg_EffSpdLmtTyp 2;
BA_ "GenSigSendType" SG_ 730 ADAS_Seg_DivideRoad 2;
BA_ "GenSigSendType" SG_ 730 ADAS_Seg_NumOfLaneOppDir 2;
BA_ "GenSigSendType" SG_ 730 ADAS_Seg_NumOfLaneDrvDir 2;
BA_ "TransparentInitValue" SG_ 730 HUT22_0x2DA "0 0 0 0 0 0 0 0 ";
BA_ "GenSigSendType" SG_ 730 HUT22_0x2DA 2;
BA_ "GenSigSendType" SG_ 728 ADAS_Stub_MsgTyp 2;
BA_ "GenSigSendType" SG_ 728 ADAS_Stub_Offset 2;
BA_ "GenSigSendType" SG_ 728 ADAS_Stub_CycCnt 2;
BA_ "GenSigSendType" SG_ 728 ADAS_Stub_PathIdx 2;
BA_ "GenSigSendType" SG_ 728 ADAS_Stub_StubPathIdx 2;
BA_ "GenSigSendType" SG_ 728 ADAS_Stub_Retr 2;
BA_ "GenSigSendType" SG_ 728 ADAS_Stub_Update 2;
BA_ "GenSigSendType" SG_ 728 ADAS_Stub_RelProbb 2;
BA_ "GenSigSendType" SG_ 728 ADAS_Stub_FuncRoadClass 2;
BA_ "GenSigSendType" SG_ 728 ADAS_Stub_PartOfCalcRoute 2;
BA_ "GenSigSendType" SG_ 728 ADAS_Stub_CmplxInsct 2;
BA_ "GenSigSendType" SG_ 728 ADAS_Stub_FormOfWay 2;
BA_ "GenSigSendType" SG_ 728 ADAS_Stub_TurnAngl 2;
BA_ "GenSigSendType" SG_ 728 ADAS_Stub_LastStub 2;
BA_ "GenSigSendType" SG_ 728 ADAS_Stub_RtOfWay 2;
BA_ "GenSigSendType" SG_ 728 ADAS_Stub_NumOfLaneOppDir 2;
BA_ "GenSigSendType" SG_ 728 ADAS_Stub_NumOfLaneDrvDir 2;
BA_ "TransparentInitValue" SG_ 728 HUT23_0x2D8 "0 0 0 0 0 0 0 0 ";
BA_ "GenSigSendType" SG_ 728 HUT23_0x2D8 2;
BA_ "GenSigSendType" SG_ 489 IdnResultReq_HUT 2;
BA_ "GenSigSendType" SG_ 489 BackReq_AVM 2;
BA_ "GenSigSendType" SG_ 489 HUD_HeightLvlSwt 2;
BA_ "GenSigSendType" SG_ 489 HUD_BrightnessLvlSwt 2;
BA_ "GenSigSendType" SG_ 489 HUD_SwtReq 2;
BA_ "GenSigStartValue" SG_ 489 ExprsnSetUp 1;
BA_ "GenSigSendType" SG_ 489 ExprsnSetUp 2;
BA_ "GenSigStartValue" SG_ 489 DistrctnDetnSet 1;
BA_ "GenSigSendType" SG_ 489 DistrctnDetnSet 2;
BA_ "GenSigStartValue" SG_ 489 DrowsnsDetnSet 1;
BA_ "GenSigSendType" SG_ 489 DrowsnsDetnSet 2;
BA_ "GenSigStartValue" SG_ 489 FaceIdnSet 1;
BA_ "GenSigSendType" SG_ 489 FaceIdnSet 2;
BA_ "GenSigStartValue" SG_ 489 VoiceIdnSet 1;
BA_ "GenSigSendType" SG_ 489 VoiceIdnSet 2;
BA_ "GenSigStartValue" SG_ 489 EraseAllFaceUsersReq 1;
BA_ "GenSigSendType" SG_ 489 EraseAllFaceUsersReq 2;
BA_ "GenSigStartValue" SG_ 489 EraseAllVoiceUsersReq 1;
BA_ "GenSigSendType" SG_ 489 EraseAllVoiceUsersReq 2;
BA_ "GenSigStartValue" SG_ 489 CancelVoiceIdn 1;
BA_ "GenSigSendType" SG_ 489 CancelVoiceIdn 2;
BA_ "GenSigStartValue" SG_ 489 EnrollFaceReq 2;
BA_ "GenSigSendType" SG_ 489 EnrollFaceReq 2;
BA_ "GenSigStartValue" SG_ 489 EnrollUserIDResult 15;
BA_ "GenSigSendType" SG_ 489 EnrollUserIDResult 2;
BA_ "GenSigStartValue" SG_ 489 DeleteUserIDFaceData 15;
BA_ "GenSigSendType" SG_ 489 DeleteUserIDFaceData 2;
BA_ "GenSigStartValue" SG_ 489 DeleteUserIDVoiceData 15;
BA_ "GenSigSendType" SG_ 489 DeleteUserIDVoiceData 2;
BA_ "TransparentInitValue" SG_ 489 HUT30_0x1E9 "0 0 0 0 21 85 111 255 ";
BA_ "GenSigSendType" SG_ 489 HUT30_0x1E9 2;
BA_ "GenSigCycleTime" SG_ 623 CheckSum_HUT32 50;
BA_ "GenSigCycleTime" SG_ 623 ScrnOpSts 50;
BA_ "GenSigStartValue" SG_ 623 XLvl 2047;
BA_ "GenSigCycleTime" SG_ 623 XLvl 50;
BA_ "GenSigStartValue" SG_ 623 YLvl 2047;
BA_ "GenSigCycleTime" SG_ 623 YLvl 50;
BA_ "GenSigCycleTime" SG_ 623 DetVideoLost 50;
BA_ "GenSigCycleTime" SG_ 623 PrkgCtrlModReqValid 50;
BA_ "GenSigCycleTime" SG_ 623 PrkgCtrlModReq 50;
BA_ "GenSigCycleTime" SG_ 623 ContnPrkgReqValid 50;
BA_ "GenSigCycleTime" SG_ 623 ContnPrkgReq 50;
BA_ "GenSigCycleTime" SG_ 623 VolLampDispSts 50;
BA_ "GenSigCycleTime" SG_ 623 PrkStraightSwtReq_HUT 50;
BA_ "GenSigCycleTime" SG_ 623 PrkStraightSuspendOrFinishReq_HU 50;
BA_ "SystemSignalLongSymbol" SG_ 623 PrkStraightSuspendOrFinishReq_HU "PrkStraightSuspendOrFinishReq_HUT";
BA_ "GenSigCycleTime" SG_ 623 PrkStraightModSel_HUT 50;
BA_ "GenSigCycleTime" SG_ 623 PrkStraightSts_HUT 50;
BA_ "GenSigCycleTime" SG_ 623 PrkStraightStrtReq_HUT 50;
BA_ "GenSigCycleTime" SG_ 623 PrkStraightVehStrtReq_HUT_Valid 50;
BA_ "GenSigCycleTime" SG_ 623 PrkStraightContinueReq_HUT 50;
BA_ "GenSigCycleTime" SG_ 623 RollingCounter_HUT32 50;
BA_ "TransparentInitValue" SG_ 623 HUT32_0x26F "0 0 255 231 255 0 0 0 ";
BA_ "GenSigCycleTime" SG_ 623 HUT32_0x26F 50;
BA_ "GenSigSendType" SG_ 493 MbrMonrEnReq_TC 2;
BA_ "GenSigSendType" SG_ 493 ChairMemPosnSetSwt 2;
BA_ "GenSigStartValue" SG_ 493 ApproachLampSet 2;
BA_ "GenSigSendType" SG_ 493 ApproachLampSet 2;
BA_ "GenSigStartValue" SG_ 493 FlaoutUnlockSet 2;
BA_ "GenSigSendType" SG_ 493 FlaoutUnlockSet 2;
BA_ "GenSigStartValue" SG_ 493 SuperLockSet 2;
BA_ "GenSigSendType" SG_ 493 SuperLockSet 2;
BA_ "GenSigSendType" SG_ 493 PrkInDirChoice 2;
BA_ "GenSigSendType" SG_ 493 PathLrngFinshCmd 2;
BA_ "GenSigSendType" SG_ 493 PathLrngStartCmd 2;
BA_ "GenSigSendType" SG_ 493 SelPrkOutDirReq 2;
BA_ "GenSigSendType" SG_ 493 ParkMdlCmd 2;
BA_ "GenSigSendType" SG_ 493 BackReq_APS 2;
BA_ "GenSigSendType" SG_ 493 StartPrkgPath2Cmd 2;
BA_ "GenSigSendType" SG_ 493 DeletePath2Cmd 2;
BA_ "GenSigSendType" SG_ 493 StartPrkgPath1Cmd 2;
BA_ "GenSigSendType" SG_ 493 DeletePath1Cmd 2;
BA_ "GenSigSendType" SG_ 493 SelPrkgFctnCmd 2;
BA_ "GenSigSendType" SG_ 493 RLWinSwtReq_VR 2;
BA_ "GenSigSendType" SG_ 493 RRWinSwtReq_VR 2;
BA_ "GenSigSendType" SG_ 493 DrvWinSwtReq_VR 2;
BA_ "GenSigSendType" SG_ 493 PassWinSwtReq_VR 2;
BA_ "GenSigSendType" SG_ 493 ALCMDynModSet 2;
BA_ "TransparentInitValue" SG_ 493 HUT33_0x1ED "168 0 0 0 0 0 0 0 ";
BA_ "GenSigSendType" SG_ 493 HUT33_0x1ED 2;
BA_ "GenSigSendType" SG_ 825 CarWashMode_Req 2;
BA_ "GenSigSendType" SG_ 825 HUT_ChrgnMode 2;
BA_ "GenSigSendType" SG_ 825 HUT_RemtEngCtrl 2;
BA_ "GenSigSendType" SG_ 825 HUT_BattKeepTemp 2;
BA_ "GenSigSendType" SG_ 825 HUT_IntelEngIdlChrgnSet 2;
BA_ "GenSigSendType" SG_ 825 HUT_BattSOCLim 2;
BA_ "GenSigSendType" SG_ 825 HUT_IntelBattTempMagSet 2;
BA_ "TransparentInitValue" SG_ 825 HUT25_0x339 "0 0 0 0 0 0 0 0 ";
BA_ "GenSigSendType" SG_ 825 HUT25_0x339 2;
BA_ "GenSigStartValue" SG_ 589 DrowsnsLvl 7;
BA_ "GenSigCycleTime" SG_ 589 DrowsnsLvl 50;
BA_ "GenSigStartValue" SG_ 589 DrowsnsLvlQlty 127;
BA_ "GenSigCycleTime" SG_ 589 DrowsnsLvlQlty 50;
BA_ "GenSigStartValue" SG_ 589 DMSProc 7;
BA_ "GenSigCycleTime" SG_ 589 DMSProc 50;
BA_ "GenSigStartValue" SG_ 589 DMSProcResult 15;
BA_ "GenSigCycleTime" SG_ 589 DMSProcResult 50;
BA_ "GenSigStartValue" SG_ 589 DMSProcSts 15;
BA_ "GenSigCycleTime" SG_ 589 DMSProcSts 50;
BA_ "GenSigStartValue" SG_ 589 DMSIdnResult 15;
BA_ "GenSigCycleTime" SG_ 589 DMSIdnResult 50;
BA_ "GenSigStartValue" SG_ 589 GenderSts 3;
BA_ "GenSigCycleTime" SG_ 589 GenderSts 50;
BA_ "GenSigStartValue" SG_ 589 ExprsnSts 7;
BA_ "GenSigCycleTime" SG_ 589 ExprsnSts 50;
BA_ "GenSigStartValue" SG_ 589 GenderStsQlty 127;
BA_ "GenSigCycleTime" SG_ 589 GenderStsQlty 50;
BA_ "GenSigStartValue" SG_ 589 ExprsnStsQlty 127;
BA_ "GenSigCycleTime" SG_ 589 ExprsnStsQlty 50;
BA_ "GenSigCycleTime" SG_ 589 Checksum_DMS2 50;
BA_ "GenSigStartValue" SG_ 589 DistrctnLvl_ACC 7;
BA_ "GenSigCycleTime" SG_ 589 DistrctnLvl_ACC 50;
BA_ "GenSigStartValue" SG_ 589 DistrctnLvlQlty_ACC 127;
BA_ "GenSigCycleTime" SG_ 589 DistrctnLvlQlty_ACC 50;
BA_ "GenSigStartValue" SG_ 589 DrowsnsLvl_ACC 7;
BA_ "GenSigCycleTime" SG_ 589 DrowsnsLvl_ACC 50;
BA_ "GenSigStartValue" SG_ 589 DrowsnsLvlQlty_ACC 127;
BA_ "GenSigCycleTime" SG_ 589 DrowsnsLvlQlty_ACC 50;
BA_ "GenSigStartValue" SG_ 589 DistrctnLvl 7;
BA_ "GenSigCycleTime" SG_ 589 DistrctnLvl 50;
BA_ "GenSigStartValue" SG_ 589 DistrctnLvlQlty 127;
BA_ "GenSigCycleTime" SG_ 589 DistrctnLvlQlty 50;
BA_ "GenSigCycleTime" SG_ 589 RollingCounter_DMS2 50;
BA_ "GenSigCycleTime" SG_ 589 Checksum_DMS3 50;
BA_ "GenSigStartValue" SG_ 589 HeadPosnX 2047;
BA_ "GenSigCycleTime" SG_ 589 HeadPosnX 50;
BA_ "GenSigStartValue" SG_ 589 HeadPosnY 2047;
BA_ "GenSigCycleTime" SG_ 589 HeadPosnY 50;
BA_ "GenSigStartValue" SG_ 589 HeadPosnZ 2047;
BA_ "GenSigCycleTime" SG_ 589 HeadPosnZ 50;
BA_ "GenSigStartValue" SG_ 589 HeadPosQlty 127;
BA_ "GenSigCycleTime" SG_ 589 HeadPosQlty 50;
BA_ "GenSigStartValue" SG_ 589 DrvBehvSts 7;
BA_ "GenSigCycleTime" SG_ 589 DrvBehvSts 50;
BA_ "GenSigCycleTime" SG_ 589 RollingCounter_DMS3 50;
BA_ "GenSigStartValue" SG_ 589 GazePosnX 2047;
BA_ "GenSigCycleTime" SG_ 589 GazePosnX 50;
BA_ "GenSigStartValue" SG_ 589 GazePosnY 2047;
BA_ "GenSigCycleTime" SG_ 589 GazePosnY 50;
BA_ "GenSigStartValue" SG_ 589 GazePosnZ 2047;
BA_ "GenSigCycleTime" SG_ 589 GazePosnZ 50;
BA_ "GenSigStartValue" SG_ 589 DrvGazeAreaSts 7;
BA_ "GenSigCycleTime" SG_ 589 DrvGazeAreaSts 50;
BA_ "GenSigCycleTime" SG_ 589 Checksum_DMS5 50;
BA_ "GenSigStartValue" SG_ 589 DMSSts 7;
BA_ "GenSigCycleTime" SG_ 589 DMSSts 50;
BA_ "GenSigCycleTime" SG_ 589 HeadDetn 50;
BA_ "GenSigStartValue" SG_ 589 HeadYawAng 255;
BA_ "GenSigCycleTime" SG_ 589 HeadYawAng 50;
BA_ "GenSigStartValue" SG_ 589 HeadPitchAng 255;
BA_ "GenSigCycleTime" SG_ 589 HeadPitchAng 50;
BA_ "GenSigStartValue" SG_ 589 HeadRollAng 255;
BA_ "GenSigCycleTime" SG_ 589 HeadRollAng 50;
BA_ "GenSigStartValue" SG_ 589 HeadRotAngQlty 127;
BA_ "GenSigCycleTime" SG_ 589 HeadRotAngQlty 50;
BA_ "GenSigCycleTime" SG_ 589 RollingCounter_DMS5 50;
BA_ "GenSigCycleTime" SG_ 589 Checksum_DMS6 50;
BA_ "GenSigStartValue" SG_ 589 LEyeOpenSts 2;
BA_ "GenSigCycleTime" SG_ 589 LEyeOpenSts 50;
BA_ "GenSigStartValue" SG_ 589 LEyeOpenStsQlty 100;
BA_ "GenSigCycleTime" SG_ 589 LEyeOpenStsQlty 50;
BA_ "GenSigStartValue" SG_ 589 REyeOpenSts 2;
BA_ "GenSigCycleTime" SG_ 589 REyeOpenSts 50;
BA_ "GenSigStartValue" SG_ 589 REyeOpenStsQlty 100;
BA_ "GenSigCycleTime" SG_ 589 REyeOpenStsQlty 50;
BA_ "GenSigStartValue" SG_ 589 RobustGazeYawAng 255;
BA_ "GenSigCycleTime" SG_ 589 RobustGazeYawAng 50;
BA_ "GenSigStartValue" SG_ 589 RobustGazePitchAng 255;
BA_ "GenSigCycleTime" SG_ 589 RobustGazePitchAng 50;
BA_ "GenSigStartValue" SG_ 589 RobustGazeAngQlty 127;
BA_ "GenSigCycleTime" SG_ 589 RobustGazeAngQlty 50;
BA_ "GenSigCycleTime" SG_ 589 RollingCounter_DMS6 50;
BA_ "TransparentInitValue" SG_ 589 DMS_FD1_0x24D "0 63 255 255 255 254 254 0 0 254 254 252 224 254 0 0 0 255 255 255 255 255 0 112 0 255 255 255 255 128 0 112 0 255 255 255 254 224 0 0 0 255 255 200 200 254 160 0 0 0 0 0 0 0 0 0 0 0 0 0 0 0 0 0 ";
BA_ "GenSigCycleTime" SG_ 589 DMS_FD1_0x24D 50;
VAL_ 659 IP_CurrTheme 0 "Valid Value" 3 "Valid Value" 4 "Initial value" 5 "Reserved" 7 "Reserved" ;
VAL_ 659 IP_VehSpdDisp 0 "Valid" 510 "Valid" 511 "Invalid" ;
VAL_ 659 IP_FuelMainTankR 0 "Invalid value" 1 "Reserved" 9 "Reserved" 10 "Valid value" 1000 "Valid value" 1001 "Reserved" 1022 "Reserved" 1023 "Invalid value" ;
VAL_ 659 IP_FuelAuxTankR 0 "Invalid value" 1 "Reserved" 9 "Reserved" 10 "Valid value" 1000 "Valid value" 1001 "Reserved" 1022 "Reserved" 1023 "Invalid value" ;
VAL_ 659 IP_VelSpdDisp_Mile 0 "Valid" 254 "Valid" 255 "Invalid" ;
VAL_ 659 IP_LagueSet 0 "Chinese" 1 "English" 2 "Russian" 3 "Spaish" 4 "Portuguese" 5 "German" 6 "French" 7 "Italian" 8 "Arabic" 9 "Thai" 10 "Ukrainian" 11 "Indonesian" 12 "Reserve" 14 "Reserve" 15 "Invalid value" ;
VAL_ 639 CheckSum_IP2 0 "Valid values" 255 "Valid values" ;
VAL_ 639 IP_DrvSeatBeltWarnLmpFailSts 0 "No failure" 1 "Failure" 2 "Signal not available" 3 "Reserved" ;
VAL_ 639 IP_PassSeatBeltWarnLmpFailSts 0 "No failure" 1 "Failure" 2 "Signal not available" 3 "Reserved" ;
VAL_ 639 IP_VehTotDistance 0 "0-9999999-km" 9999999 "0-9999999-km" 10000000 "Reserved" 16777214 "Reserved" 16777215 "Invalid" ;
VAL_ 639 IP_FuelLvlInfo 0 "Valid Value" 200 "Valid Value" 201 "Reserved" 254 "Reserved" 255 "Invalid Value" ;
VAL_ 639 IP_FuelLvlLowLmpSts 0 "OFF" 1 "ON" 2 "Internal Error" 3 "Reserved" ;
VAL_ 639 IP_BattChrgLmpSts 0 "OFF" 1 "ON" 2 "Internal Error" 3 "Reserved" ;
VAL_ 639 IP_EngOilPressLowLmpSts 0 "OFF" 1 "ON" 2 "Internal Error" 3 "Reserved" ;
VAL_ 639 IP_ABMWarnLmpFailrSts 0 "No failure" 1 "Failure" 2 "Signal not available" 3 "Reserved" ;
VAL_ 639 IP_Err 0 "No error" 1 "Error" ;
VAL_ 639 IP_ACCErr 0 "No error" 1 "Error" ;
VAL_ 639 IP_VehTotDistanceValid 0 "Invalid" 1 "Valid" ;
VAL_ 639 IP_VehSpdUnit 0 "kph" 1 "mph" ;
VAL_ 639 IP_VINcompr 0 "equality" 1 "inequality" ;
VAL_ 639 RollingCounter_IP2 0 "Valid value" 14 "Valid value" 15 "Invalid value" ;
VAL_ 842 IP_RemainDistance 0 "0~2000" 2000 "0~2000" 2001 "Reserved" 4094 "Reserved" 4095 "Invalid" ;
VAL_ 842 IP_InstFuelConsUnit 0 "L100km" 1 "Lh" ;
VAL_ 842 IP_EBDFailSts 0 "No failure" 1 "Failure" ;
VAL_ 842 IP_AvgFuelCons 0 "Valid" 2999 "Valid" 3000 "Reserved" 4094 "Reserved" 4095 "Invalid" ;
VAL_ 842 IP_InstFuelCons 0 "Valid" 9999 "Valid" 10000 "Reserved" 16382 "Reserved" 16383 "Invalid" ;
VAL_ 707 SSSSet_HUT 0 "OFF" 1 "ON" ;
VAL_ 707 IFC_SnvtySet 0 "Normal" 1 "High sensitivity" 2 "Low sensitivity" 3 "Reserved" ;
VAL_ 707 DOWSwtReq 0 "OFF" 1 "ON" ;
VAL_ 707 AEB_PedSwtReq 0 "OFF" 1 "ON" ;
VAL_ 707 ALCMLightLvlSet 0 "Reserved" 1 "10" 2 "20" 3 "30" 4 "40" 5 "50" 6 "60" 7 "70" 8 "80" 9 "90" 10 "100" 11 "Reserved" 15 "Reserved" ;
VAL_ 707 FlashLmpSwtReq 0 "OFF" 1 "ON" ;
VAL_ 707 LCASwtReq 0 "OFF" 1 "ON" ;
VAL_ 707 RCTASwtReq 0 "OFF" 1 "ON" ;
VAL_ 707 RCTABrkSwtReq 0 "OFF" 1 "ON" ;
VAL_ 707 RCWSwtReq 0 "OFF" 1 "ON" ;
VAL_ 707 FCW_SnvtySet 0 "Normal" 1 "High sensitivity" 2 "Low sensitivity" 3 "Reserved" ;
VAL_ 707 AEB_VehSwtReq 0 "OFF" 1 "ON" ;
VAL_ 707 LKASwtReq 0 "OFF" 1 "ON" ;
VAL_ 707 LCKSwtReq 0 "OFF" 1 "ON" ;
VAL_ 707 ELKSwtReq 0 "OFF" 1 "ON" ;
VAL_ 707 ESS_PedSwtReq 0 "OFF" 1 "ON" ;
VAL_ 707 ESS_VehSwtReq 0 "OFF" 1 "ON" ;
VAL_ 707 LDWSwtReq 0 "OFF" 1 "ON" ;
VAL_ 707 TSRSwtReq 0 "OFF" 1 "ON" ;
VAL_ 707 TSRWarnSwtReq 0 "OFF" 1 "ON" ;
VAL_ 707 ICA_HandsOffSwtReq 0 "OFF" 1 "ON" ;
VAL_ 707 ISLSwtReq 0 "OFF" 1 "ON" ;
VAL_ 707 TSR_SnvtySet 0 "valid" 30 "valid" 31 "Invalid" ;
VAL_ 707 BrkPedalFeelReq 0 "Comfort" 1 "Sport" 2 "Reserved" 3 "Reserved" ;
VAL_ 707 HFASwtSts 0 "OFF" 1 "ON" ;
VAL_ 707 EPSSteerModSwtReq 0 "Comfort Mode" 1 "SportÂ mode" 2 "Handiness Mode" 3 "NO Hut Control" ;
VAL_ 707 DSTSwtReq 0 "OFF" 1 "ON" ;
VAL_ 707 HUT_ESPFuncOffSwtSts 0 "Not Pressed" 1 "Pressed" ;
VAL_ 707 DrivingModReq_HUT 0 "StandardNormal Mode" 1 "Snow_Nex" 2 "Off Road" 3 "Economic" 4 "Sport" 5 "Reserved" 8 "Reserved" 9 "Auto" 10 "4L" 11 "Mud" 12 "Reserved" 13 "Sand" 14 "Reserved" 15 "Invalid Value" ;
VAL_ 707 LSSSwtReq 0 "OFF" 1 "ON" ;
VAL_ 707 LSSWarnFormSwtReq 0 "Voice" 1 "Haptic" 2 "Voice+Haptic" 3 "Reserved" ;
VAL_ 707 IntelligentEvaSwtReq 0 "OFF" 1 "ON" ;
VAL_ 707 HUT_BattSOCLimSaveMod 0 "30%" 1 "35%" 2 "40%" 3 "45%" 4 "50%" 5 "55%" 6 "60%" 7 "65%" 8 "70%" 9 "75%" 10 "80%" 11 "85%" 12 "90%" 13 "95%" 14 "100%" 15 "Reserved" 30 "Reserved" 31 "Invalid" ;
VAL_ 707 DrvgModeMemReq 0 "OFF" 1 "ON" ;
VAL_ 707 HUTRadioFrq 0 "Radio frequency value" 4094 "Radio frequency value" 4095 "Invalid value" ;
VAL_ 707 MediaPlaySrc 0 "unknown" 1 "USB Audio" 2 "USB Video" 3 "BT Audio" 4 "iPod" 5 "AM" 6 "FM" 7 "Applink" 8 "QQ Music" 9 "Kaola FM" 10 "Online News" 11 "TOD" 12 "Reversed" 15 "Reversed" ;
VAL_ 707 HUT_DrvModReq 0 "AutoNormal Mode started" 1 "EV Mode started" 2 "Save Mode started" 3 "SPORT Mode started" 4 "AWD Normal Mode started" 5 "Snow Mode started" 6 "Muddy Mode started" 7 "Sand Mode started" 8 "ECO Mode started" 9 "SPORT Plus Mode started" 10 "Reserved" 15 "Reserved" ;
VAL_ 707 HUT_WadeModeSet 0 "OFF" 1 "ON" ;
VAL_ 707 USB_AudioSts 0 "Invalid" 1 "Play" 2 "Pause" 3 "Reserved" ;
VAL_ 707 USB_VideoSts 0 "Invalid" 1 "Play" 2 "Pause" 3 "Reserved" ;
VAL_ 707 BT_AudioSts 0 "Invalid" 1 "Play" 2 "Pause" 3 "Reserved" ;
VAL_ 707 IPod_Sts 0 "Invalid" 1 "Play" 2 "Pause" 3 "Reserved" ;
VAL_ 707 AM_Sts 0 "Invalid" 1 "Play" 2 "Pause" 3 "Reserved" ;
VAL_ 707 FM_Sts 0 "Invalid" 1 "Play" 2 "Pause" 3 "Reserved" ;
VAL_ 707 APPLink_Sts 0 "Invalid" 1 "Play" 2 "Pause" 3 "Reserved" ;
VAL_ 707 QQMusic_Sts 0 "Invalid" 1 "Play" 2 "Pause" 3 "Reserved" ;
VAL_ 707 KaolaFM_Sts 0 "Invalid" 1 "Play" 2 "Pause" 3 "Reserved" ;
VAL_ 707 OnlineNews_Sts 0 "Invalid" 1 "Play" 2 "Pause" 3 "Reserved" ;
VAL_ 707 ChairMemPosnSet 0 "No Command" 1 "Binding Account" 2 "Bring Up The Account" 3 "Unbinding Account" ;
VAL_ 707 CCOSwtReq_HUT 0 "No request" 1 "Request" ;
VAL_ 707 ChairMemPosnSetResult 0 "Factory Default" 1 "User ID1" 2 "User ID2" 3 "User ID3" 4 "User ID4" 5 "User ID5" 6 "User ID6" 7 "User ID7" 8 "User ID8" 9 "User ID9" 10 "User ID10" 11 "Reserved" 15 "Reserved" ;
VAL_ 707 TABSwtReq_HUT 0 "Not activate" 1 "Activate" ;
VAL_ 707 NavVehToTrafEyeDist 0 "Valid value" 1023 "Valid value" ;
VAL_ 707 NavRoadType 0 "Unknown" 1 "Expressway" 2 "City expressway" 3 "National rode" 4 "Provincial rode" 5 "County rode" 6 "City or Village rode" 7 "ramp" 8 "Tunnel" 9 "Side rode" 10 "Channel" 11 "Reserved" 15 "Reserved" ;
VAL_ 707 NavSpdLimType 0 "Unknown" 1 "Traffic sign" 2 "Electronic eye" 3 "Rode Default" ;
VAL_ 707 NavSpdLimValue 0 "No Display" 1 "SPL 5" 2 "SPL 10" 3 "SPL 15" 4 "SPL 20" 5 "SPL 25" 6 "SPL 30" 7 "SPL 35" 8 "SPL 40" 9 "SPL 45" 10 "SPL 50" 11 "SPL 55" 12 "SPL 60" 13 "SPL 65" 14 "SPL 70" 15 "SPL 75" 16 "SPL 80" 17 "SPL 85" 18 "SPL 90" 19 "SPL 95" 20 "SPL 100" 21 "SPL 105" 22 "SPL 110" 23 "SPL 115" 24 "SPL 120" 25 "SPL 125" 26 "SPL 130" 27 "SPL 135" 28 "SPL 140" 29 "SPL 145" 30 "SPL 150" 31 "Reserved" 62 "Reserved" 63 "Invalid" ;
VAL_ 707 NavSpdLimUnit_HUT 0 "Unknown" 1 "KMH" 2 "MPH" 3 "Reserved" ;
VAL_ 707 NavCtryType 0 "Reserved" 155 "Reserved" 156 "China" 157 "Reserved" 1023 "Reserved" ;
VAL_ 707 HWA_SwtReq 0 "OFF" 1 "ON" ;
VAL_ 707 HWA_SnvtySet 0 "Normal" 1 "High sensitivity" 2 "Low sensitivity" 3 "Reserved" ;
VAL_ 707 ALC_SwtReq 0 "OFF" 1 "ON" ;
VAL_ 707 NavSpdLimSignSts 0 "Unknow" 1 "Exist SPL sign" 2 "Exist Traffic sign" 3 "Exist SPL and Traffic sign" 4 "None" 5 "Plural" 6 "Reserved" 7 "Reserved" ;
VAL_ 707 NavTSRTrafSign 0 "None" 1 "Snow" 2 "Fog" 3 "ThunderStorm" 4 "Rain" 5 "FWay" 6 "EFWay" 7 "Straight" 8 "FrontageLeft" 9 "TurnLeftRight" 10 "FrontageRight" 11 "Right" 12 "TurnRight" 13 "Left" 14 "TurnLeft" 15 "RelieveNoOvertake" 16 "NoOvertake" 17 "StopGiveWay" 18 "GiveWay" 19 "NoPass" 20 "NoEntry" 21 "NoCar" 22 "NoTruck" 23 "NoBus" 24 "NoTurnaround" 25 "NoStraightLeftTurn" 26 "NoStraightRightTurn" 27 "NoLeftRightTurn" 28 "NoLeftTurn" 29 "NoRightTurn" 30 "NoStraight" 31 "WarnKids" 32 "WarnPed" 33 "WarnBike" 34 "WarnWorks" 35 "WarnWildanimal" 36 "WarnCattle" 37 "AccidentProneSection" 38 "Town" 39 "Slow" 40 "SharpTurnR" 41 "SharpTurnL" 42 "ReverseCurveL" 43 "ReverseCurveR" 44 "ContinuousBend" 45 "Crossroads" 46 "ConfluenceR" 47 "ConfluenceL" 48 "Reserved" 254 "Reserved" 255 "Invalid" ;
VAL_ 707 FCTASwtReq 0 "OFF" 1 "ON" ;
VAL_ 707 FCTABrkSwtReq 0 "OFF" 1 "ON" ;
VAL_ 707 AEB_JASwtReq 0 "OFF" 1 "ON" ;
VAL_ 707 AESSwtReq 0 "OFF" 1 "ON" ;
VAL_ 707 ADAS_Posn_MsgTye 0 "System Specific" 1 "Position" 2 "Segment" 3 "Stub" 4 "Profile Short" 5 "Profile Long" 6 "Meta-data" 7 "Reserved" ;
VAL_ 707 ADAS_Posn_Offset 0 "Valid value" 8190 "Valid value" 8191 "Invalid data" ;
VAL_ 707 ADAS_Posn_CycCnt 0 "Valid value" 3 "Valid value" ;
VAL_ 707 ADAS_Posn_Pathldx 0 "Valid value" 63 "Valid value" ;
VAL_ 707 ADAS_Posn_Idx 0 "Valid value" 3 "Valid value" ;
VAL_ 707 ADAS_Posn_PosProbb 0 "Unknown" 1 "Valid data" 30 "Valid data" 31 "Invalid" ;
VAL_ 707 ADAS_Posn_Age 0 "0~2545ms" 509 "0~2545ms" 510 ">2545ms" 511 "Invalid data" ;
VAL_ 707 ADAS_Posn_PosConfdc 0 "Valid value" 6 "Valid value" 7 "Invalid value" ;
VAL_ 707 ADAS_Posn_CurLane 0 "Unknown" 1 "Emergency lane" 2 "Single-lane road" 3 "Left-most lane" 4 "Right-most lane" 5 "One of middle lanes on road with three or more lanes" 6 "Reserved" 7 "Invalid data" ;
VAL_ 707 ADAS_Posn_Spd 0 "â‰¤ -12.8 ms" 1 "(-12.6)~(-0.2)ms" 63 "(-12.6)~(-0.2)ms" 64 "Standing still" 65 "(+0.2)~(+89.0)ms" 509 "(+0.2)~(+89.0)ms" 510 "â‰¥ +89.2 ms" 511 "Invalid data" ;
VAL_ 707 ADAS_Posn_Rehead 0 "In path direction" 1 "1.417 degrees right" 2 "Right from path direction" 125 "Right from path direction" 126 "178.583 degrees right" 127 "Opposite direction" 128 "178.583 degrees left (181.417 degrees right)" 129 "Left from path direction" 252 "Left from path direction" 253 "1.417 degrees left (358.583 degrees right)" 254 "Unknown" 255 "Invalid" ;
VAL_ 648 HUT_OD_Obj0_ID 0 "Valid values" 9 "Valid values" 10 "Invalid values" 15 "Invalid values" ;
VAL_ 648 HUT_OD_Obj0_type 0 "No target" 1 "Pedestrian or Biker" 2 "Vehicle" 3 "Ground Locker or Barrier" 4 "Unknown type" 5 "Invalid values" 7 "Invalid values" ;
VAL_ 648 HUT_OD_Obj0_Confidence 0 "0-1" 10 "0-1" 11 "Invalid values" 15 "Invalid values" ;
VAL_ 648 HUT_OD_Obj0_width 0 "Valid values" 126 "Valid values" 127 "Invalid values" ;
VAL_ 648 HUT_OD_Obj0_Ground_Pos_X 0 "Valid values" 4000 "Valid values" 4001 "Reserved" 4094 "Reserved" 4095 "Invalid values" ;
VAL_ 648 HUT_OD_Obj0_Ground_Pos_Y 0 "Valid values" 4000 "Valid values" 4001 "Reserved" 4094 "Reserved" 4095 "Invalid values" ;
VAL_ 648 HTU_OD_Obj1_ID 0 "Valid values" 9 "Valid values" 10 "Invalid values" 15 "Invalid values" ;
VAL_ 648 HUT_OD_Obj1_type 0 "No target" 1 "Pedestrian or Biker" 2 "Vehicle" 3 "Ground Locker or Barrier" 4 "Unknown type" 5 "Invalid values" 7 "Invalid values" ;
VAL_ 648 HUT_OD_Obj1_Confidence 0 "0-1" 10 "0-1" 11 "Invalid values" 15 "Invalid values" ;
VAL_ 648 HUT_OD_Obj1_width 0 "Valid values" 126 "Valid values" 127 "Invalid values" ;
VAL_ 648 HUT_OD_Obj1_Ground_Pos_X 0 "Valid values" 4000 "Valid values" 4001 "Reserved" 4094 "Reserved" 4095 "Invalid values" ;
VAL_ 648 HUT_OD_Obj1_Ground_Pos_Y 0 "Valid values" 4000 "Valid values" 4001 "Reserved" 4094 "Reserved" 4095 "Invalid values" ;
VAL_ 648 HUT_OD_Obj2_ID 0 "Valid values" 9 "Valid values" 10 "Invalid values" 15 "Invalid values" ;
VAL_ 648 HUT_OD_Obj2_type 0 "No target" 1 "Pedestrian or Biker" 2 "Vehicle" 3 "Ground Locker or Barrier" 4 "Unknown type" 5 "Invalid values" 7 "Invalid values" ;
VAL_ 648 HUT_OD_Obj2_Confidence 0 "0-1" 10 "0-1" 11 "Invalid values" 15 "Invalid values" ;
VAL_ 648 HUT_OD_Obj2_width 0 "Valid values" 126 "Valid values" 127 "Invalid values" ;
VAL_ 648 HUT_OD_Obj2_Ground_Pos_X 0 "Valid values" 4000 "Valid values" 4001 "Reserved" 4094 "Reserved" 4095 "Invalid values" ;
VAL_ 648 HUT_OD_Obj2_Ground_Pos_Y 0 "Valid values" 4000 "Valid values" 4001 "Reserved" 4094 "Reserved" 4095 "Invalid values" ;
VAL_ 648 HUT_OD_Obj3_ID 0 "Valid values" 9 "Valid values" 10 "Invalid values" 15 "Invalid values" ;
VAL_ 648 HUT_OD_Obj3_type 0 "No target" 1 "Pedestrian or Biker" 2 "Vehicle" 3 "Ground Locker or Barrier" 4 "Unknown type" 5 "Invalid values" 7 "Invalid values" ;
VAL_ 648 HUT_OD_Obj3_Confidence 0 "0-1" 10 "0-1" 11 "Invalid values" 15 "Invalid values" ;
VAL_ 648 HUT_OD_Obj3_width 0 "Valid values" 126 "Valid values" 127 "Invalid values" ;
VAL_ 648 HUT_OD_Obj3_Ground_Pos_X 0 "Valid values" 4000 "Valid values" 4001 "Reserved" 4094 "Reserved" 4095 "Invalid values" ;
VAL_ 648 HUT_OD_Obj3_Ground_Pos_Y 0 "Valid values" 4000 "Valid values" 4001 "Reserved" 4094 "Reserved" 4095 "Invalid values" ;
VAL_ 648 HUT_OD_Obj4_ID 0 "Valid values" 9 "Valid values" 10 "Invalid values" 15 "Invalid values" ;
VAL_ 648 HUT_OD_Obj4_type 0 "No target" 1 "Pedestrian or Biker" 2 "Vehicle" 3 "Ground Locker or Barrier" 4 "Unknown type" 5 "Invalid values" 7 "Invalid values" ;
VAL_ 648 HUT_OD_Obj4_Confidence 0 "0-1" 10 "0-1" 11 "Invalid values" 15 "Invalid values" ;
VAL_ 648 HUT_OD_Obj4_width 0 "Valid values" 126 "Valid values" 127 "Invalid values" ;
VAL_ 648 HUT_OD_Obj4_Ground_Pos_X 0 "Valid values" 4000 "Valid values" 4001 "Reserved" 4094 "Reserved" 4095 "Invalid values" ;
VAL_ 648 HUT_OD_Obj4_Ground_Pos_Y 0 "Valid values" 4000 "Valid values" 4001 "Reserved" 4094 "Reserved" 4095 "Invalid values" ;
VAL_ 648 HUT_OD_Obj5_ID 0 "Valid values" 9 "Valid values" 10 "Invalid values" 15 "Invalid values" ;
VAL_ 648 HUT_OD_Obj5_type 0 "No target" 1 "Pedestrian or Biker" 2 "Vehicle" 3 "Ground Locker or Barrier" 4 "Unknown type" 5 "Invalid values" 7 "Invalid values" ;
VAL_ 648 HUT_OD_Obj5_Confidence 0 "0-1" 10 "0-1" 11 "Invalid values" 15 "Invalid values" ;
VAL_ 648 HUT_OD_Obj5_width 0 "Valid values" 126 "Valid values" 127 "Invalid values" ;
VAL_ 648 HUT_OD_Obj5_Ground_Pos_X 0 "Valid values" 4000 "Valid values" 4001 "Reserved" 4094 "Reserved" 4095 "Invalid values" ;
VAL_ 648 HUT_OD_Obj5_Ground_Pos_Y 0 "Valid values" 4000 "Valid values" 4001 "Reserved" 4094 "Reserved" 4095 "Invalid values" ;
VAL_ 648 HUT_OD_Obj6_ID 0 "Valid values" 9 "Valid values" 10 "Invalid values" 15 "Invalid values" ;
VAL_ 648 HUT_OD_Obj6_type 0 "No target" 1 "Pedestrian or Biker" 2 "Vehicle" 3 "Ground Locker or Barrier" 4 "Unknown type" 5 "Invalid values" 7 "Invalid values" ;
VAL_ 648 HUT_OD_Obj6_Confidence 0 "0-1" 10 "0-1" 11 "Invalid values" 15 "Invalid values" ;
VAL_ 648 HUT_OD_Obj6_width 0 "Valid values" 126 "Valid values" 127 "Invalid values" ;
VAL_ 648 HUT_OD_Obj6_Ground_Pos_X 0 "Valid values" 4000 "Valid values" 4001 "Reserved" 4094 "Reserved" 4095 "Invalid values" ;
VAL_ 648 HUT_OD_Obj6_Ground_Pos_Y 0 "Valid values" 4000 "Valid values" 4001 "Reserved" 4094 "Reserved" 4095 "Invalid values" ;
VAL_ 745 HUT_OD_Obj7_ID 0 "Valid values" 9 "Valid values" 10 "Invalid values" 15 "Invalid values" ;
VAL_ 745 HUT_OD_Obj7_type 0 "No target" 1 "Pedestrian or Biker" 2 "Vehicle" 3 "Ground Locker or Barrier" 4 "Unknown type" 5 "Invalid values" 7 "Invalid values" ;
VAL_ 745 HUT_OD_Obj7_Confidence 0 "0-1" 10 "0-1" 11 "Invalid values" 15 "Invalid values" ;
VAL_ 745 HUT_OD_Obj7_width 0 "Valid values" 126 "Valid values" 127 "Invalid values" ;
VAL_ 745 HUT_OD_Obj7_Ground_Pos_X 0 "Valid values" 4000 "Valid values" 4001 "Reserved" 4094 "Reserved" 4095 "Invalid values" ;
VAL_ 745 HUT_OD_Obj7_Ground_Pos_Y 0 "Valid values" 4000 "Valid values" 4001 "Reserved" 4094 "Reserved" 4095 "Invalid values" ;
VAL_ 745 HUT_OD_WorkSts 0 "OFF" 1 "FOD Active" 2 "ROD Active" 3 "Reserved" ;
VAL_ 745 HUT_OD_Obj_Timestamp 0 "Valid values" 65535 "Valid values" ;
VAL_ 745 HUT_FSD1_distance 0 "Valid values" 60 "Valid values" 61 "Invalid values" 63 "Invalid values" ;
VAL_ 745 HUT_FSD2_distance 0 "Valid values" 60 "Valid values" 61 "Invalid values" 63 "Invalid values" ;
VAL_ 745 HUT_FSD3_distance 0 "Valid values" 60 "Valid values" 61 "Invalid values" 63 "Invalid values" ;
VAL_ 745 HUT_FSD4_distance 0 "Valid values" 60 "Valid values" 61 "Invalid values" 63 "Invalid values" ;
VAL_ 745 HUT_FSD5_distance 0 "Valid values" 60 "Valid values" 61 "Invalid values" 63 "Invalid values" ;
VAL_ 745 HUT_FSD6_distance 0 "Valid values" 60 "Valid values" 61 "Invalid values" 63 "Invalid values" ;
VAL_ 745 HUT_FSD7_distance 0 "Valid values" 60 "Valid values" 61 "Invalid values" 63 "Invalid values" ;
VAL_ 745 HUT_FSD8_distance 0 "Valid values" 60 "Valid values" 61 "Invalid values" 63 "Invalid values" ;
VAL_ 745 HUT_FSD9_distance 0 "Valid values" 60 "Valid values" 61 "Invalid values" 63 "Invalid values" ;
VAL_ 745 HUT_FSD10_distance 0 "Valid values" 60 "Valid values" 61 "Invalid values" 63 "Invalid values" ;
VAL_ 745 HUT_FSD11_distance 0 "Valid values" 60 "Valid values" 61 "Invalid values" 63 "Invalid values" ;
VAL_ 745 HUT_FSD12_distance 0 "Valid values" 60 "Valid values" 61 "Invalid values" 63 "Invalid values" ;
VAL_ 745 HUT_FSD13_distance 0 "Valid values" 60 "Valid values" 61 "Invalid values" 63 "Invalid values" ;
VAL_ 745 HUT_FSD14_distance 0 "Valid values" 60 "Valid values" 61 "Invalid values" 63 "Invalid values" ;
VAL_ 745 HUT_FSD15_distance 0 "Valid values" 60 "Valid values" 61 "Invalid values" 63 "Invalid values" ;
VAL_ 745 HUT_FSD16_distance 0 "Valid values" 60 "Valid values" 61 "Invalid values" 63 "Invalid values" ;
VAL_ 745 HUT_FSD17_distance 0 "Valid values" 60 "Valid values" 61 "Invalid values" 63 "Invalid values" ;
VAL_ 745 HUT_FSD18_distance 0 "Valid values" 60 "Valid values" 61 "Invalid values" 63 "Invalid values" ;
VAL_ 1045 ADAS_Meta_MsgTyp 0 "System Specific" 1 "Position" 2 "Segment" 3 "Stub" 4 "Profile Short" 5 "Profile Long" 6 "Meta-data" 7 "Reserved" ;
VAL_ 1045 ADAS_Meta_MapProvider 0 "Unknown" 1 "Nokia HERE (NAVTEQ)" 2 "TomTom (Tele Atlas)" 3 "Zenrin" 4 "IPC" 5 "NavInfo" 6 "Other" 7 "NA" ;
VAL_ 1045 ADAS_Meta_CountryCode 0 "Unknown" 1 "Valid values" 1023 "Valid values" ;
VAL_ 1045 ADAS_Meta_CycCnt 0 "Valid values" 3 "Valid values" ;
VAL_ 1045 ADAS_Meta_ProtVer_Major 0 "Valid values" 3 "Valid values" ;
VAL_ 1045 ADAS_Meta_ProtVer_MinorSub 0 "Valid values" 7 "Valid values" ;
VAL_ 1045 ADAS_Meta_HwVer 0 "Unknown" 1 "Valid values" 511 "Valid values" ;
VAL_ 1045 ADAS_Meta_DrvSide 0 "Drvg Side Left" 1 "Drvg Side Right" ;
VAL_ 1045 ADAS_Meta_RegionCode 0 "Unknow" 1 "Valid values" 32766 "Valid values" 32767 "Invalid" ;
VAL_ 1045 ADAS_Meta_MapVerQtr 0 "Valid values" 3 "Valid values" ;
VAL_ 1045 ADAS_Meta_MapVerYear 0 "Valid values" 62 "Valid values" 63 "invalid" ;
VAL_ 1045 ADAS_Meta_SpdUnits 0 "KMH" 1 "MPH" ;
VAL_ 1045 ADAS_Meta_ProtVer_Minor 0 "Valid values" 15 "Valid values" ;
VAL_ 840 PowerSet 0 "OFF" 1 "ON" ;
VAL_ 796 AudioMuteSts 0 "Not used" 1 "not producing audio" 2 "producing audio" 3 "Reserved" ;
VAL_ 796 OrvmPosnEnaSts 0 "No command" 1 "Both side disable" 2 "Both side enable" 3 "Only driver enable" 4 "Only passager enable" 5 "Reserved" 7 "Reserved" ;
VAL_ 796 VSGSwtSet 0 "VSG OFF" 1 "VSG ON" ;
VAL_ 871 DomeLmpDlyTimSet 0 "3seconds" 1 "10seconds" 2 "20seconds" 3 "30seconds" 4 "Reserved" 7 "Reserved" ;
VAL_ 871 FolwMeHomeDlyTimSet 0 "0seconds" 1 "30seconds" 2 "60seconds" 3 "90seconds" 4 "Reserved" 7 "Reserved" ;
VAL_ 871 TranPMode_Req 0 "Transport Mode OFF" 1 "Transport Mode ON" ;
VAL_ 871 RearviewFoldModSet 0 "Automatical" 1 "Manual" ;
VAL_ 871 BattSaveDelayTimeSet 0 "2minutes" 1 "5minutes" 2 "8minutes" 3 "Reserved" ;
VAL_ 871 ACDualReq_TC 0 "No action" 1 "Pressed" 2 "Reserved" 3 "Reserved" ;
VAL_ 871 ACAutoModReq_TC 0 "No action" 1 "Pressed" 2 "Reserved" 3 "Reserved" ;
VAL_ 871 ACAirInletReq_TC 0 "No action" 1 "Pressed" 2 "OneButtonCloseWindows" 3 "Reserved" ;
VAL_ 871 ACAQSReq_TC 0 "No action" 1 "Pressed" 2 "Reserved" 3 "Reserved" ;
VAL_ 871 ACCmprReq_TC 0 "No action" 1 "Pressed" 2 "Reserved" 3 "Reserved" ;
VAL_ 871 ACFrntDefrstReq_TC 0 "No action" 1 "Pressed" 2 "Reserved" 3 "Reserved" ;
VAL_ 871 ACFrntBlwrSpdDecReq_TC 0 "No action" 1 "Pressed" 2 "Reserved" 3 "Reserved" ;
VAL_ 871 DrvDrowsnsDetnSet 0 "OFF" 1 "ON" ;
VAL_ 871 ACFrntBlwrSpdIncReq_TC 0 "No action" 1 "Pressed" 2 "Reserved" 3 "Reserved" ;
VAL_ 871 ACDrvAirDistribModReq_TC 0 "No action" 1 "Face" 2 "Face & Foot" 3 "Foot" 4 "Foot & Defrost" 5 "Reserved" 7 "Reserved" ;
VAL_ 871 ACDrvTempDecReq_TC 0 "No action" 1 "Pressed" 2 "Reserved" 3 "Reserved" ;
VAL_ 871 ChairMemPosnEna 0 "Disable" 1 "Enable" ;
VAL_ 871 ACDrvTempIncReq_TC 0 "No action" 1 "Pressed" 2 "Reserved" 3 "Reserved" ;
VAL_ 871 ACFrntPassTempDecReq_TC 0 "No action" 1 "Pressed" 2 "Reserved" 3 "Reserved" ;
VAL_ 871 ACFrntPassTempIncReq_TC 0 "No action" 1 "Pressed" 2 "Reserved" 3 "Reserved" ;
VAL_ 871 ACAIUReq_TC 0 "No action" 1 "Pressed" ;
VAL_ 871 ACOffReq_TC 0 "No action" 1 "Pressed" 2 "Reserved" 3 "Reserved" ;
VAL_ 871 ACBlwrsteplsSpdReq_TC 0 "No Command" 1 "Stepless Speed1_Low" 2 "Stepless Speed2" 3 "Stepless Speed3" 4 "Stepless Speed4" 5 "Stepless Speed5" 6 "Stepless Speed6" 7 "Stepless Speed7_High" 8 "Reserved" 15 "Reserved" ;
VAL_ 873 AMP_MediaCallSourceSet 0 "Media Source on" 1 "Call Source on" 2 "Reserved" 15 "Reserved" ;
VAL_ 873 AMP_NaviSourceSet 0 "None" 1 "Navi on" 2 "VR & TTS on" 3 "Reserved" 7 "Reserved" ;
VAL_ 873 AMP_BeepSourceSet 0 "None" 1 "Beep on" 2 "IP on" 3 "IP turn light on" 4 "Radar alarm on" 5 "Reserved" 7 "Reserved" ;
VAL_ 873 AMP_LRAudioBalanceSet 0 "Lch+10-Lch+1" 9 "Lch+10-Lch+1" 10 "Center" 11 "Rch+1-Rch+10" 20 "Rch+1-Rch+10" 21 "Reserved" 31 "Reserved" ;
VAL_ 873 AMP_AudioVolVSCModReq 0 "OFF" 1 "Low" 2 "Middle" 3 "High" ;
VAL_ 873 AMP_FRAudioFaderSet 0 "Rear+10-Rear+1" 9 "Rear+10-Rear+1" 10 "Center" 11 "Front+1-Front+10" 20 "Front+1-Front+10" 21 "Reserved" 31 "Reserved" ;
VAL_ 873 AMP_LRDrvSideSet 0 "Left" 1 "Right" ;
VAL_ 873 AMP_LowFrqAudioSet 0 "-10" 1 "-9" 2 "-8" 3 "-7" 4 "-6" 5 "-5" 6 "-4" 7 "-3" 8 "-2" 9 "-1" 10 "0" 11 "1" 12 "2" 13 "3" 14 "4" 15 "5" 16 "6" 17 "7" 18 "8" 19 "9" 20 "10" 21 "Reserved" 31 "Reserved" ;
VAL_ 873 AMP_MuteSet 0 "Unmute" 1 "Mute" ;
VAL_ 873 AMP_MidFrqAudioSet 0 "-10" 1 "-9" 2 "-8" 3 "-7" 4 "-6" 5 "-5" 6 "-4" 7 "-3" 8 "-2" 9 "-1" 10 "0" 11 "1" 12 "2" 13 "3" 14 "4" 15 "5" 16 "6" 17 "7" 18 "8" 19 "9" 20 "10" 21 "Reserved" 31 "Reserved" ;
VAL_ 873 AMP_HighFrqAudioSet 0 "-10" 1 "-9" 2 "-8" 3 "-7" 4 "-6" 5 "-5" 6 "-4" 7 "-3" 8 "-2" 9 "-1" 10 "0" 11 "1" 12 "2" 13 "3" 14 "4" 15 "5" 16 "6" 17 "7" 18 "8" 19 "9" 20 "10" 21 "Reserved" 31 "Reserved" ;
VAL_ 873 T_box_ECallSet 0 "OFF" 1 "ON" ;
VAL_ 873 QLISurroundSet 0 "Stereo" 1 "QLI Surround" ;
VAL_ 873 ANCSwtSet 0 "OFF" 1 "ON" ;
VAL_ 873 RearWinHeatCmd_TC 0 "No action" 1 "Pressed" 2 "Reserved" 3 "Reserved" ;
VAL_ 873 FrntWinHeatSwt 0 "No action" 1 "Pressed" ;
VAL_ 875 AMP_HFMVolSet 0 "HFM volume step 0-39" 39 "HFM volume step 0-39" 40 "Reserved" 62 "Reserved" 63 "Invalid Value" ;
VAL_ 875 AMP_TTSVolSet_VR 0 "VR_TTS volume step 0-39" 39 "VR_TTS volume step 0-39" 40 "Reserved" 62 "Reserved" 63 "Invalid Value" ;
VAL_ 875 AMP_NaviVolSet 0 "Navi volume step 0-39" 39 "Navi volume step 0-39" 40 "Reserved" 62 "Reserved" 63 "Invalid Value" ;
VAL_ 875 AMP_MainVolSet 0 "Main volume step 0-39" 39 "Main volume step 0-39" 40 "Reserved" 62 "Reserved" 63 "Invalid Value" ;
VAL_ 875 AMP_GetSWInfoReq 0 "No action" 1 "Get information" ;
VAL_ 875 AMP_GetHWInfoReq 0 "No action" 1 "Get information" ;
VAL_ 875 AMP_GetTempInfoReq 0 "No action" 1 "Get information" ;
VAL_ 875 AMP_GetIntVoltInfoReq 0 "No action" 1 "Get information" ;
VAL_ 875 AMP_GetDTCInfoReq 0 "No action" 1 "Get information" ;
VAL_ 875 IESS_MdlSwtReq 0 "OFF" 1 "Model 1" 2 "Model 2" 3 "Model 3" ;
VAL_ 875 IESS_MdlInfoReq 0 "No action" 1 "Get information" ;
VAL_ 875 AMP_BestListegPosnReq 0 "All Seat" 1 "Front Seat" 2 "Rear Seat" 3 "Driver Seat" 4 "Boss Seat" 5 "Children sleep Seat" 6 "reserved" 7 "reserved" ;
VAL_ 875 AMP_Clari_FiReq 0 "OFF" 1 "ON" ;
VAL_ 877 DrvSeatHeatgLvlSet 0 "OFF" 1 "Level 1_Low" 2 "Level 2_Middle" 3 "Level 3_High" ;
VAL_ 877 PassSeatHeatgLvlSet 0 "OFF" 1 "Level 1_Low" 2 "Level 2_Middle" 3 "Level 3_High" ;
VAL_ 877 DrvSeatVentnLvlSet 0 "OFF" 1 "Level 1_Low" 2 "Level 2_Middle" 3 "Level 3_High" ;
VAL_ 877 PassSeatVentnLvlSet 0 "OFF" 1 "Level 1_Low" 2 "Level 2_Middle" 3 "Level 3_High" ;
VAL_ 877 ACAutoModReq_VR 0 "No action" 1 "Not active_reserved" 2 "Active" 3 "Reserved" ;
VAL_ 877 ACCmprReq_VR 0 "No action" 1 "Not active" 2 "Active" 3 "Reserved" ;
VAL_ 877 ACPowerReq_VR 0 "No action" 1 "Power off" 2 "Power on" 3 "Reserved" ;
VAL_ 877 ACBlwrSpdReq_VR 0 "No Command" 1 "Stepless Speed1_Low" 2 "Stepless Speed2" 3 "Stepless Speed3" 4 "Stepless Speed4" 5 "Stepless Speed5" 6 "Stepless Speed6" 7 "Stepless Speed7_High" 8 "Reserved" 15 "Reserved" ;
VAL_ 877 ACDrvTempReq_VR 0 "No action" 1 "Low" 2 "valid value(phys=0.5 * raw + 15.5)" 32 "valid value(phys=0.5 * raw + 15.5)" 33 "High" 34 "Reserved" 63 "Reserved" ;
VAL_ 877 ACFrntDefrostReq_VR 0 "No action" 1 "Not active" 2 "Active" 3 "Reserved" ;
VAL_ 877 ACDrvAirDistribModReq_VR 0 "No action" 1 "Face" 2 "Face & Foot" 3 "Foot" 4 "Foot & Defrost" 5 "Reserved" 7 "Reserved" ;
VAL_ 877 ACAirInletReq_VR 0 "no action" 1 "Fresh" 2 "Recirculation" 3 "Reserved" ;
VAL_ 877 ACModReq_HUT 0 "no action" 1 "comfort" 2 "economy" 3 "reserved" ;
VAL_ 877 ElecSideSteppingSysSet 0 "OFF" 1 "ON" ;
VAL_ 877 RoofModSet 0 "OFF" 1 "ON" ;
VAL_ 877 AllTerrainDislSet 0 "OFF" 1 "ON" ;
VAL_ 877 RemUpgrdSts 0 "NO action" 1 "End the Remote upgrade mode" ;
VAL_ 74 AUTODefrost_TC 0 "No action" 1 "Pressed" 2 "Reserved" 3 "Reserved" ;
VAL_ 74 AUTODefrost_VR 0 "No action" 1 "Not active" 2 "Active" 3 "Reserved" ;
VAL_ 74 LaneCalActvtCmd 0 "Off" 1 "On" ;
VAL_ 74 MODChgReq 0 "No request" 1 "Request" ;
VAL_ 74 Radar_DispCmd 0 "No Request" 1 "Request" ;
VAL_ 74 Guid_Ovl_Display_Cmd 0 "No Request" 1 "Request" ;
VAL_ 74 Sgl_View_Sel 0 "No Commands" 1 "Touch 2D Front Button" 2 "Touch 2D Rear Button" 3 "Touch 2D Left Button" 4 "Touch 2D Right Button" 5 "Touch 2D Left Front  Button" 6 "Touch 2D Right Front Button" 7 "Touch 2D Left Back Button" 8 "Touch 2D Right Back Button" 9 "Touch return Button" 10 "Touch Engine Room Button" 11 "Reserved" 15 "Reserved" ;
VAL_ 74 SwToFieldCalRstCmd 0 "Off" 1 "On" ;
VAL_ 74 AutoViewChgCmd 0 "No Request" 1 "Request" ;
VAL_ 74 MdlColrChgCmd 0 "No Request" 1 "Request" ;
VAL_ 74 CarMdlTrsprcySwtCmd 0 "No Request" 1 "Request" ;
VAL_ 74 CarMdlDispCmd 0 "No Request" 1 "Request" ;
VAL_ 74 AutoAVMSwSet_Cmd 0 "No Request" 1 "Request" ;
VAL_ 74 FPAS_AutoModSwt 0 "No Request" 1 "Request" ;
VAL_ 74 MEBSwtSet 0 "No Request" 1 "Request" ;
VAL_ 74 WshSoftSwt 0 "No request" 1 "Request" ;
VAL_ 74 View_SoftswitchCmd 0 "No request" 1 "Request" ;
VAL_ 880 TimeMod 0 "24" 1 "12" ;
VAL_ 880 TimeIndcn 0 "am" 1 "pm" ;
VAL_ 880 Time_Hour 0 "Valid hour" 23 "Valid hour" 24 "Reserved" 30 "Reserved" 31 "Invalid" ;
VAL_ 880 Time_Minutes 0 "Valid minute" 59 "Valid minute" 60 "Reserved" 62 "Reserved" 63 "Invalid" ;
VAL_ 880 Time_Second 0 "Valid second" 59 "Valid second" 60 "Reserved" 62 "Reserved" 63 "Invalid" ;
VAL_ 880 Time_Year_Left 0 "Valid year" 9 "Valid year" 10 "Reserved" 14 "Reserved" 15 "Invalid" ;
VAL_ 880 Time_Year_Right 0 "Valid year" 9 "Valid year" 10 "Reserved" 14 "Reserved" 15 "Invalid" ;
VAL_ 880 Time_Month 0 "Invalid" 1 "Valid month" 12 "Valid month" 13 "Reserved" 15 "Reserved" ;
VAL_ 880 Time_Day 0 "Invalid" 1 "Valid day" 31 "Valid day" ;
VAL_ 817 HUT_EgyRecvrySet 0 "Strong" 1 "Normal" 2 "Weak" 3 "No action" ;
VAL_ 817 ACDualReq_VR 0 "No action" 1 "Close" 2 "Open" 3 "Reserved" ;
VAL_ 817 ACAQSReq_VR 0 "No action" 1 "Close" 2 "Open" 3 "Reserved" ;
VAL_ 817 ACRearDefrstReq_VR 0 "No action" 1 "Close" 2 "Open" 3 "Reserved" ;
VAL_ 817 ACPassTempReq_VR 0 "No action" 1 "Low" 2 "Valid value(phys = 0.5 * raw + 15.5)" 32 "Valid value(phys = 0.5 * raw + 15.5)" 33 "High" 34 "Reserved" 63 "Reserved" ;
VAL_ 817 ACAIUReq_VR 0 "No action" 1 "Close" 2 "Open" 3 "Reserved" ;
VAL_ 817 IPVolSet 0 "Reserved" 9 "Reserved" 10 "IP volume step 10-20" 20 "IP volume step 10-20" 21 "Reserved" 62 "Reserved" 63 "Invalid Value" ;
VAL_ 817 ALCMStatSwt 0 "Off" 1 "On" ;
VAL_ 817 ALCMDynSwt 0 "Off" 1 "On" ;
VAL_ 817 ALCMClrSet 0 "Colour set 0-63" 63 "Colour set 0-63" ;
VAL_ 817 ALCMRhmSwt 0 "Off" 1 "On" ;
VAL_ 817 PASSwtReq_VR 0 "No action" 1 "off" 2 "on" 3 "Reserved" ;
VAL_ 494 ACOperMod_TC 0 "No action" 1 "Standard Mode" 2 "Comfort Mode" 3 "Strong Mode" ;
VAL_ 494 ACOperMod_VR 0 "No action" 1 "Standard Mode" 2 "Comfort Mode" 3 "Strong Mode" ;
VAL_ 494 SteerWheelHeatSwtReq 0 "No action" 1 "No request" 2 "Request" 3 "Reserved" ;
VAL_ 494 ACDrvSetTempSteplsReq_TC 0 "No action" 1 "Low" 2 "Valid value" 32 "Valid value" 33 "High" 34 "Reserved" 63 "Reserved" ;
VAL_ 494 ACPassSetTempSteplsReq_TC 0 "No action" 1 "Low" 2 "Valid value" 32 "Valid value" 33 "High" 34 "Reserved" 63 "Reserved" ;
VAL_ 494 SDWSwtSet 0 "No Request" 1 "Request" ;
VAL_ 494 APSSwtReq_VR 0 "No action" 1 "off" 2 "on" 3 "Reserved" ;
VAL_ 494 PASExitSpdSwt 0 "No command" 1 "15kmh" 2 "30kmh" 3 "Reserved" ;
VAL_ 494 APSPrkgTypSeln 0 "No Select" 1 "Select parallel parking" 2 "Select vertical parking" 3 "Reserved" ;
VAL_ 494 SunShadeSwtReq_VR 0 "No action" 1 "Full closed" 2 "10%" 3 "20%" 4 "30%" 5 "40%" 6 "50%" 7 "60%" 8 "70%" 9 "80%" 10 "90%" 11 "full open" 12 "stop" 13 "reserved" 15 "reserved" ;
VAL_ 494 SunRoofSwtReq_VR 0 "No action" 1 "Full closed" 2 "Tilt Up" 3 "10%" 4 "20%" 5 "30%" 6 "40%" 7 "50%" 8 "60%" 9 "70%" 10 "80%" 11 "90%" 12 "full open" 13 "stop" 14 "reserved" 15 "reserved" ;
VAL_ 494 SportModLightSet 0 "OFF" 1 "Flashing&Light" 2 "Reserved" 3 "Reserved" ;
VAL_ 494 ABSLmpSet 0 "OFF" 1 "ON" ;
VAL_ 494 AutoWshWipSet 0 "short time 300ms" 1 "middle time 500ms" 2 "long time 800ms" 3 "Reserved" ;
VAL_ 494 SeekVehSet 0 "Horn&Light" 1 "HornOnly" 2 "LightOnly" 3 "Reserved" ;
VAL_ 494 SpdAutoLockModSet 0 "OFF" 1 "8kmh" 2 "15kmh" 3 "Reserved" ;
VAL_ 494 ParkLmpSet 0 "OFF" 1 "ON" ;
VAL_ 494 DoorUnlockModSet 0 "All Door" 1 "Driver Door" ;
VAL_ 494 ACEAHReq_TC 0 "No action" 1 "Pressed" ;
VAL_ 494 ACEAHReq_VR 0 "No action" 1 "Not active" 2 "Active" 3 "Reserved" ;
VAL_ 827 AVMSwtReq 0 "OFF" 1 "ON" ;
VAL_ 827 NaviMediaVolLvlReq 0 "Level 0" 1 "Level 1" 2 "Level 2" 3 "Level 3" 4 "Level 4" 5 "Level 5" 6 "Level 6" 7 "Level 7" 8 "Level 8" 9 "Level 9" 10 "Level 10" 11 "Invalid" 15 "Invalid" ;
VAL_ 827 AVMMediaVolLvlReq 0 "Level 0" 1 "Level 1" 2 "Level 2" 3 "Level 3" 4 "Level 4" 5 "Level 5" 6 "Level 6" 7 "Level 7" 8 "Level 8" 9 "Level 9" 10 "Level 10" 11 "Invalid" 15 "Invalid" ;
VAL_ 827 FPASChanSwtReq 0 "OFF" 1 "ON" ;
VAL_ 827 RPASChanSwtReq 0 "OFF" 1 "ON" ;
VAL_ 827 BackgroundLightLvlSet 0 "1" 1 "2" 2 "3" 3 "4" 4 "5" 5 "6" 6 "7" 7 "8" 8 "9" 9 "10" 10 "No action" 11 "Reserved" 15 "Reserved" ;
VAL_ 827 ManCmpSet 0 "0" 1 "1" 2 "2" 3 "3" 4 "4" 5 "5" 6 "6" 7 "7" 8 "8" 9 "9" 10 "10" 11 "Reserved" 15 "Reserved" ;
VAL_ 827 DispModSet 0 "Automode" 1 "Day mode" 2 "Night mode" 3 "Reserved" ;
VAL_ 827 OPDSwtSts 0 "ON" 1 "OFF" 2 "Unselect able" 3 "No action" ;
VAL_ 827 PLGReq_VR 0 "No action" 1 "Close" 2 "Open" 3 "Reserved" ;
VAL_ 827 WPC_SwtReq 0 "No action" 1 "Initial value" 2 "Close" 3 "Open" ;
VAL_ 734 ADAS_ProfLong_MsgTyp 0 "System Specific" 1 "Position" 2 "Segment" 3 "Stub" 4 "Profile Short" 5 "Profile Long" 6 "Meta-data" 7 "Reserved" ;
VAL_ 734 ADAS_ProfLong_Offset 0 "Valid value" 8190 "Valid value" 8191 "Invalid" ;
VAL_ 734 ADAS_ProfLong_CycCnt 0 "Valid value" 3 "Valid value" ;
VAL_ 734 ADAS_ProfLong_PathIdx 0 "Valid value" 63 "Valid value" ;
VAL_ 734 ADAS_ProfLong_ProfTyp 0 "unkown" 1 "Longitude" 2 "Latitude" 3 "Altitude" 4 "Control Point Longitude" 5 "Control Point Latitude" 6 "Control Point Altitude" 7 "Link Identifier" 8 "Traffic Sign" 9 "Truck Speed Limits" 10 "Extended Lane" 11 "Reserved for standard types" 15 "Reserved for standard types" 16 "Reserved for system specific types" 18 "Reserved for system specific types" 19 "Traffic Event" 20 "weather" 21 "Reserved for system specific types" 31 "Reserved for system specific types" ;
VAL_ 734 ADAS_ProfLong_CtrlPoint 0 "false" 1 "true" ;
VAL_ 734 ADAS_ProfLong_Retr 0 "false" 1 "true" ;
VAL_ 734 ADAS_ProfLong_Update 0 "false" 1 "true" ;
VAL_ 734 ADAS_ProfLong_Value -2147483648 "invalid" 0 "Valid value" ;
VAL_ 733 ADAS_ProfShort_MsgTyp 0 "System Specific" 1 "Position" 2 "Segment" 3 "Stub" 4 "Profile Short" 5 "Profile Long" 6 "Meta-data" 7 "Reserved" ;
VAL_ 733 ADAS_ProfShort_Offset 0 "0-8190m" 8190 "0-8190m" 8191 "Invalid" ;
VAL_ 733 ADAS_ProfShort_CycCnt 0 "Valid value" 3 "Valid value" ;
VAL_ 733 ADAS_ProfShort_PathIdx 0 "Valid value" 63 "Valid value" ;
VAL_ 733 ADAS_ProfShort_ProfTyp 0 "Unknow" 1 "Curvature" 2 "Route Number Types" 3 "Slopeï¼ˆstepï¼‰" 4 "Slopeï¼ˆlinerï¼‰" 5 "Road ACCessibility" 6 "Road condition" 7 "Variable Speed Sign Position" 8 "Heading Change" 9 "Reserved for standard types" 15 "Reserved for standard types" 16 "Reserved for system specific types" 17 "Reserved for system specific types" 18 "History average speed" 19 "Traffic Flow" 20 "Reserved for system specific types" 31 "Reserved for system specific types" ;
VAL_ 733 ADAS_ProfShort_CtrlPoint 0 "false" 1 "true" ;
VAL_ 733 ADAS_ProfShort_Retr 0 "false" 1 "true" ;
VAL_ 733 ADAS_ProfShort_Update 0 "false" 1 "true" ;
VAL_ 733 ADAS_ProfShort_AccurClass 0 "Hiest accuracy" 1 "Medium accuracy" 2 "Lowest accuracy" 3 "Unknown" ;
VAL_ 733 ADAS_ProfShort_Dist1 0 "no other profile values are defined in this message" 1 "Valid value" 1022 "Valid value" 1023 "Invalid" ;
VAL_ 733 ADAS_ProfShort_Value0 0 "Valid data" 1022 "Valid data" 1023 "Unknow" ;
VAL_ 733 ADAS_ProfShort_Value1 0 "Valid data" 1022 "Valid data" 1023 "Unknow" ;
VAL_ 730 ADAS_Seg_MsgTyp 0 "System Specific" 1 "Position" 2 "Segment" 3 "Stub" 4 "Profile Short" 5 "Profile Long" 6 "Meta-data" 7 "Reserved" ;
VAL_ 730 ADAS_Seg_Offset 0 "Valid data" 8190 "Valid data" 8191 "Invalid data" ;
VAL_ 730 ADAS_Seg_CycCnt 0 "Valid value" 3 "Valid value" ;
VAL_ 730 ADAS_Seg_PathIdx 0 "Valid value" 63 "Valid value" ;
VAL_ 730 ADAS_Seg_Tunnel 0 "Segment is not part of a tunnel" 1 "Segment is part of a tunnel" 2 "Unknown" 3 "Invalid" ;
VAL_ 730 ADAS_Seg_Brdg 0 "Segment is not part of a bridge" 1 "Segment is part of a bridge" 2 "Unknown" 3 "Invalid" ;
VAL_ 730 ADAS_Seg_BuildUpArea 0 "Segment is not part of a built-up area" 1 "Segment is part of a built-up area" 2 "Unknown" 3 "Invalid" ;
VAL_ 730 ADAS_Seg_Retr 0 "False" 1 "True" ;
VAL_ 730 ADAS_Seg_Update 0 "False" 1 "True" ;
VAL_ 730 ADAS_Seg_RelProbb 0 "Unknown" 1 "Valid data" 30 "Valid data" 31 "Invalid" ;
VAL_ 730 ADAS_Seg_FuncRoadClass 0 "Unkown" 1 "Expressway" 2 "City expressway" 3 "National road" 4 "Provincial rode or County road" 5 "City or Village road" 6 "Other road" 7 "Invalid" ;
VAL_ 730 ADAS_Seg_PartOfCalcRoute 0 "Segment is not part of Calculated Route" 1 "Segment is part of Calculated Route" 2 "Unknown" 3 "Invalid" ;
VAL_ 730 ADAS_Seg_CmplxInsct 0 "Segment is not part of complex intersection" 1 "Segment is part of a complex intersection" 2 "Unknown" 3 "Invalid" ;
VAL_ 730 ADAS_Seg_FormOfWay 0 "Unkown" 1 "Freeway or Controlled Access road that is not a slip roadramp" 2 "Multiple Carriageway or Multiply Digitized Road" 3 "Single Carriageway (default)" 4 "Roundabout Circle" 5 "Traffic SquareSpecial Traffic Figure" 6 "Reserved" 7 "Reserved" 8 "Parallel Road (as special type of a slip roadramp)" 9 "Slip RoadRamp on a Freeway or Controlled Access road" 10 "Slip RoadRamp (not on a Freeway or Controlled Access road)" 11 "Service Road or Frontage Road" 12 "Entrance to or exit of a Car Park" 13 "Entrance to or exit to Service" 14 "Pedestrian Zone" 15 "Unknow" ;
VAL_ 730 ADAS_Seg_EffSpdLmt 0 "Unknown (including variable speed sign controlled)" 1 "value â‰¤ 5 kmh [mph]" 2 "5 < value â‰¤ 7 kmh [mph]" 3 "7 < value â‰¤ 10 kmh [mph]" 4 "10 < value â‰¤ 15 kmh [mph]" 5 "15 < value â‰¤ 20 kmh [mph]" 6 "20 < value â‰¤ 25 kmh [mph]" 7 "25 < value â‰¤ 30 kmh [mph]" 8 "30 < value â‰¤ 35 kmh [mph]" 9 "35 < value â‰¤ 40 kmh [mph]" 10 "40 < value â‰¤ 45 kmh [mph]" 11 "45 < value â‰¤ 50 kmh [mph]" 12 "50 < value â‰¤ 55 kmh [mph]" 13 "55 < value â‰¤ 60 kmh [mph]" 14 "60 < value â‰¤ 65 kmh [mph]" 15 "65 < value â‰¤ 70 kmh [mph]" 16 "70 < value â‰¤ 75 kmh [mph]" 17 "75 < value â‰¤ 80 kmh [mph]" 18 "80 < value â‰¤ 85 kmh [mph]" 19 "85 < value â‰¤ 90 kmh [mph]" 20 "90 < value â‰¤ 95 kmh [mph]" 21 "95 < value â‰¤ 100 kmh [mph]" 22 "100 < value â‰¤ 105 kmh [mph]" 23 "105 < value â‰¤ 110 kmh [mph]" 24 "110 < value â‰¤ 115 kmh [mph]" 25 "115 < value â‰¤ 120 kmh [mph]" 26 "120 < value â‰¤ 130 kmh [mph]" 27 "130 < value â‰¤ 140 kmh [mph]" 28 "140 < value â‰¤ 150 kmh [mph]" 29 "150 < value < unlimited" 30 "Unlimited" 31 "NA" ;
VAL_ 730 ADAS_Seg_EffSpdLmtTyp 0 "Implicit (for instance, default speed limit in the cities)" 1 "Explicit â€“ on traffic sign" 2 "Explicit â€“ by night" 3 "Explicit â€“ by day" 4 "Explicit â€“ time of day" 5 "Explicit â€“ Electronic eye" 6 "Explicit â€“ snow" 7 "Unknown" ;
VAL_ 730 ADAS_Seg_DivideRoad 0 "Segment is not part of a divided roaddual carriageway" 1 "Segment is part of a divided roaddual carriageway" 2 "Unknown" 3 "NA" ;
VAL_ 730 ADAS_Seg_NumOfLaneOppDir 0 "One-direction road" 1 "One lane only" 2 "Indicates 2 or more lanes" 3 "Invalid" ;
VAL_ 730 ADAS_Seg_NumOfLaneDrvDir 0 "One-direction road driven in wrong direction" 1 "Verbatim values" 5 "Verbatim values" 6 "Six or more lanes" 7 "invalid" ;
VAL_ 728 ADAS_Stub_MsgTyp 0 "System Specific" 1 "Position" 2 "Segment" 3 "Stub" 4 "Profile Short" 5 "Profile Long" 6 "Meta-data" 7 "Reserved" ;
VAL_ 728 ADAS_Stub_Offset 0 "Valid data" 8190 "Valid data" 8191 "Invalid data" ;
VAL_ 728 ADAS_Stub_CycCnt 0 "Valid value" 3 "Valid value" ;
VAL_ 728 ADAS_Stub_PathIdx 0 "Valid value" 63 "Valid value" ;
VAL_ 728 ADAS_Stub_StubPathIdx 0 "Valid value" 63 "Valid value" ;
VAL_ 728 ADAS_Stub_Retr 0 "False" 1 "True" ;
VAL_ 728 ADAS_Stub_Update 0 "False" 1 "True" ;
VAL_ 728 ADAS_Stub_RelProbb 0 "unknown" 1 "Valid data" 30 "Valid data" 31 "Invalid" ;
VAL_ 728 ADAS_Stub_FuncRoadClass 0 "Unkown" 1 "Expressway" 2 "City expressway" 3 "National road" 4 "Provincial rode or County road" 5 "City or Village road" 6 "Other road" 7 "Invalid" ;
VAL_ 728 ADAS_Stub_PartOfCalcRoute 0 "New path from this point on is not part of Calculated Route" 1 "New path from this point on is part of Calculated Route" 2 "Unknown" 3 "invalid" ;
VAL_ 728 ADAS_Stub_CmplxInsct 0 "New path is not part of complex intersection" 1 "New path is part of a complex intersection" 2 "Unknown" 3 "invalid" ;
VAL_ 728 ADAS_Stub_FormOfWay 0 "Unkown" 1 "Freeway or Controlled Access road that is not a slip roadramp" 2 "Multiple Carriageway or Multiply Digitized Road" 3 "Single Carriageway (default)" 4 "Roundabout Circle" 5 "Traffic SquareSpecial Traffic Figure" 6 "Reserved" 7 "Reserved" 8 "Parallel Road (as special type of a slip roadramp)" 9 "Slip RoadRamp on a Freeway or Controlled Access road" 10 "Slip RoadRamp (not on a Freeway or Controlled Access road)" 11 "Service Road or Frontage Road" 12 "Entrance to or exit of a Car Park" 13 "Entrance to or exit to Service" 14 "Pedestrian Zone" 15 "Unknow" ;
VAL_ 728 ADAS_Stub_TurnAngl 0 "In path direction" 1 "1.417 degrees right" 2 "Right from path direction" 126 "178.583 degrees right" 127 "Opposite direction" 128 "178.583 degrees left (181.417 degrees right)" 129 "Left from path direction" 252 "Left from path direction" 253 "1.417 degrees left (358.583 degrees right)" 254 "Unknown" 255 "Invalid" ;
VAL_ 728 ADAS_Stub_LastStub 0 "False" 1 "True" ;
VAL_ 728 ADAS_Stub_RtOfWay 0 "Drvg towards this stub has priority over all conflicting vehicle movements" 1 "Drvg towards this stub might require yielding to conflicting vehicle movements" 2 "Unknown" 3 "Invalid" ;
VAL_ 728 ADAS_Stub_NumOfLaneOppDir 0 "one-direction road" 1 "one lane only" 2 "indicates 2 or more lanes" 3 "invalid" ;
VAL_ 728 ADAS_Stub_NumOfLaneDrvDir 0 "One-direction road driven in wrong direction" 1 "Verbatim values" 5 "Verbatim values" 6 "6 or more lanes" 7 "invalid" ;
VAL_ 489 IdnResultReq_HUT 0 "No request" 1 "Request" 2 "Request cancel recognition result" 3 "Reserve" ;
VAL_ 489 BackReq_AVM 0 "No request" 1 "Request" ;
VAL_ 489 HUD_HeightLvlSwt 0 "No action" 1 "Level 1_Low" 2 "Level 2" 3 "Level 3" 4 "Level 4" 5 "Level 5" 6 "Level 6" 7 "Level 7" 8 "Level 8" 9 "Level 9" 10 "Level 10" 11 "Level 11_Middle" 12 "Level 12" 13 "Level 13" 14 "Level 14" 15 "Level 15" 16 "Level 16" 17 "Level 17" 18 "Level 18" 19 "Level 19" 20 "Level 20" 21 "Level 21_High" 22 "Reserved" 31 "Reserved" ;
VAL_ 489 HUD_BrightnessLvlSwt 0 "No action" 1 "Level 1_Low" 2 "Level 2" 3 "Level 3" 4 "Level 4" 5 "Level 5_Middle" 6 "Level 6" 7 "Level 7" 8 "Level 8" 9 "Level 9_High" 10 "Reserved" 15 "Reserved" ;
VAL_ 489 HUD_SwtReq 0 "No action" 1 "OFF" 2 "ON" 3 "Reserved" ;
VAL_ 489 ExprsnSetUp 0 "No action" 1 "Disable" 2 "Enable" 3 "Reserved" ;
VAL_ 489 DistrctnDetnSet 0 "No action" 1 "Disable" 2 "Enable" 3 "Reserved" ;
VAL_ 489 DrowsnsDetnSet 0 "No action" 1 "Disable" 2 "Enable" 3 "Reserved" ;
VAL_ 489 FaceIdnSet 0 "No action" 1 "Disable" 2 "Enable" 3 "Reserved" ;
VAL_ 489 VoiceIdnSet 0 "No action" 1 "Disable" 2 "Enable" 3 "Reserved" ;
VAL_ 489 EraseAllFaceUsersReq 0 "No action" 1 "Disable" 2 "Enable" 3 "Reserved" ;
VAL_ 489 EraseAllVoiceUsersReq 0 "No action" 1 "Disable" 2 "Enable" 3 "Reserved" ;
VAL_ 489 CancelVoiceIdn 0 "No action" 1 "No" 2 "Yes" 3 "Reserved" ;
VAL_ 489 EnrollFaceReq 0 "No action" 1 "Request enrolling face" 2 "Request cancel enrolling face" 3 "Reserved" ;
VAL_ 489 EnrollUserIDResult 0 "Reserved" 1 "Enroll user ID face sucessflly" 6 "Enroll user ID face sucessflly" 7 "Reserved" 14 "Reserved" 15 "Invalid" ;
VAL_ 489 DeleteUserIDFaceData 0 "Reserved" 1 "User ID" 6 "User ID" 7 "Reserved" 14 "Reserved" 15 "Invalid" ;
VAL_ 489 DeleteUserIDVoiceData 0 "Reserved" 1 "User ID" 6 "User ID" 7 "Reserved" 14 "Reserved" 15 "Invalid" ;
VAL_ 623 CheckSum_HUT32 0 "Valid value" 255 "Valid value" ;
VAL_ 623 ScrnOpSts 0 "Release" 1 "Pressed" 2 "Hold" 3 "Reserved" ;
VAL_ 623 XLvl 0 "Valid value" 1960 "Valid value" 1961 "Invalid" 2047 "Invalid" ;
VAL_ 623 YLvl 0 "Valid value" 720 "Valid value" 721 "Invalid" 2047 "Invalid" ;
VAL_ 623 DetVideoLost 0 "Nomal" 1 "Video lost" ;
VAL_ 623 PrkgCtrlModReqValid 0 "valid" 1 "invalid" ;
VAL_ 623 PrkgCtrlModReq 0 "No action" 1 "Parking in car" 2 "Remote parking" 3 "Reserved" ;
VAL_ 623 ContnPrkgReqValid 0 "valid" 1 "invalid" ;
VAL_ 623 ContnPrkgReq 2 "cancle parking" 3 "invalid" ;
VAL_ 623 VolLampDispSts 0 "Segment_0" 1 "Segment_1" 2 "Segment_2" 3 "Segment_3" 4 "Segment_4" 5 "Segment_5" 6 "Segment_6" 7 "Segment_7" 8 "Segment_8" 9 "Error" 10 "Reserved" 15 "Reserved" ;
VAL_ 623 PrkStraightSwtReq_HUT 0 "No request" 1 "Request" ;
VAL_ 623 PrkStraightSuspendOrFinishReq_HU 0 "No request" 1 "Request suspend" 2 "Request finish" 3 "Reserved" ;
VAL_ 623 PrkStraightModSel_HUT 0 "No select" 1 "Front vertical head park straight" 2 "Rear vertical tail park straight" 3 "Reserved" ;
VAL_ 623 PrkStraightSts_HUT 0 "No error" 1 "Error" ;
VAL_ 623 PrkStraightStrtReq_HUT 0 "No request" 1 "Request" ;
VAL_ 623 PrkStraightVehStrtReq_HUT_Valid 0 "Invalid" 1 "Valid" ;
VAL_ 623 PrkStraightContinueReq_HUT 0 "User not continue request" 1 "User continue request" ;
VAL_ 623 RollingCounter_HUT32 0 "Valid value" 14 "Valid value" 15 "Invalid value" ;
VAL_ 493 MbrMonrEnReq_TC 0 "No action" 1 "Disable" 2 "Enable" 3 "Reserved" ;
VAL_ 493 ChairMemPosnSetSwt 0 "no action" 1 "set memory button 1" 2 "set memory button 2" 3 "set memory button 3" 4 "recall  memory button 1" 5 "recall  memory button 2" 6 "recall  memory button 3" 7 "Reserved" ;
VAL_ 493 ApproachLampSet 0 "No action" 1 "OFF" 2 "ON" 3 "Reserved" ;
VAL_ 493 FlaoutUnlockSet 0 "No action" 1 "OFF" 2 "ON" 3 "Reserved" ;
VAL_ 493 SuperLockSet 0 "No action" 1 "OFF" 2 "ON" 3 "Reserved" ;
VAL_ 493 PrkInDirChoice 0 "None" 1 "Tail in" 2 "Head in" 3 "Reserved" ;
VAL_ 493 PathLrngFinshCmd 0 "No request" 1 "Request" ;
VAL_ 493 PathLrngStartCmd 0 "No request" 1 "Request" ;
VAL_ 493 SelPrkOutDirReq 0 "No selection" 1 "Park out frontvertical head out" 2 "Park out rearvertical tail out" 3 "Park out leftparallel left out" 4 "Park out rightparallel right out" 5 "Reserved" 7 "Reserved" ;
VAL_ 493 ParkMdlCmd 0 "No request" 1 "Request" ;
VAL_ 493 BackReq_APS 0 "No request" 1 "Request" ;
VAL_ 493 StartPrkgPath2Cmd 0 "No request" 1 "Request" ;
VAL_ 493 DeletePath2Cmd 0 "No request" 1 "Request" ;
VAL_ 493 StartPrkgPath1Cmd 0 "No request" 1 "Request" ;
VAL_ 493 DeletePath1Cmd 0 "No request" 1 "Request" ;
VAL_ 493 SelPrkgFctnCmd 0 "No selection" 1 "Select APA parking" 2 "Select P2P parking" 3 "Select Explore Forward" 4 "Select drive back" 5 "Reserved" 7 "Reserved" ;
VAL_ 493 RLWinSwtReq_VR 0 "No action" 1 "Close" 2 "Open" 3 "Half_Open" 4 "5%_Up" 5 "5%_Down" 6 "13_Open" 7 "Reserved" ;
VAL_ 493 RRWinSwtReq_VR 0 "No action" 1 "Close" 2 "Open" 3 "Half_Open" 4 "5%_Up" 5 "5%_Down" 6 "13_Open" 7 "Reserved" ;
VAL_ 493 DrvWinSwtReq_VR 0 "No action" 1 "Close" 2 "Open" 3 "Half_Open" 4 "5%_Up" 5 "5%_Down" 6 "13_Open" 7 "Reserved" ;
VAL_ 493 PassWinSwtReq_VR 0 "No action" 1 "Close" 2 "Open" 3 "Half_Open" 4 "5%_Up" 5 "5%_Down" 6 "13_Open" 7 "Reserved" ;
VAL_ 493 ALCMDynModSet 0 "DynModOFF" 1 "DynMod1" 2 "DynMod2" 3 "DynMod3" 4 "DynMod4" 5 "DynMod5" 6 "DynMod6" 7 "DynMod7" ;
VAL_ 825 CarWashMode_Req 0 "Car Wash Mode OFF" 1 "Car Wash Mode ON" 2 "No action" 3 "Reserved" ;
VAL_ 825 HUT_ChrgnMode 0 "Immediate Charging" 1 "Delay Charging" 2 "Invalid value" 3 "No action" ;
VAL_ 825 HUT_RemtEngCtrl 0 "No action" 1 "Start" 2 "Stop" 3 "Invalid" ;
VAL_ 825 HUT_BattKeepTemp 0 "Default" 1 "ON" 2 "OFF" 3 "Reserved" ;
VAL_ 825 HUT_IntelEngIdlChrgnSet 0 "Default" 1 "ON" 2 "OFF" 3 "Reserved" ;
VAL_ 825 HUT_BattSOCLim 0 "100%" 1 "50%" 2 "60%" 3 "70%" 4 "80%" 5 "90%" 6 "No action" 7 "Reserved" ;
VAL_ 825 HUT_IntelBattTempMagSet 0 "Default" 1 "ON" 2 "OFF" 3 "Reserved" ;
VAL_ 589 DrowsnsLvl 0 "No Drowsiness" 1 "Low level Drowsiness" 2 "Middle level Drowsiness" 3 "High level Drowsiness" 4 "Reserved" 6 "Reserved" 7 "Invalid" ;
VAL_ 589 DrowsnsLvlQlty 0 "Valid value" 100 "Valid value" 101 "Reserved" 126 "Reserved" 127 "Invalid" ;
VAL_ 589 DMSProc 0 "FaceIdentification" 1 "FaceEnrollment" 2 "VoiceIdentification" 3 "VoiceEnrollment" 4 "DeleteFaceData" 5 "DeleteVoiceDate" 6 "Reserved" 7 "Invalid" ;
VAL_ 589 DMSProcResult 0 "Unknow" 1 "User ID1" 2 "User ID2" 3 "User ID3" 4 "User ID4" 5 "User ID5" 6 "User ID6" 7 "Reserved" 10 "Reserved" 11 "Failed" 12 "Reserved" 14 "Reserved" 15 "Invalid" ;
VAL_ 589 DMSProcSts 0 "OK" 1 "InProgress" 2 "NOK" 3 "Start" 4 "End" 5 "Moving head left and right" 6 "Reserved" 14 "Reserved" 15 "Invalid" ;
VAL_ 589 DMSIdnResult 0 "Unknow" 1 "User ID1" 2 "User ID2" 3 "User ID3" 4 "User ID4" 5 "User ID5" 6 "User ID6" 7 "Reserved" 10 "Reserved" 11 "Failed" 12 "Reserved" 14 "Reserved" 15 "Invalid" ;
VAL_ 589 GenderSts 0 "Male" 1 "Female" 2 "Reserved" 3 "Invalid" ;
VAL_ 589 ExprsnSts 0 "No expression" 1 "Smile" 2 "Angry" 3 "Surprise" 4 "Sad" 5 "Reserved" 6 "Reserved" 7 "Invalid" ;
VAL_ 589 GenderStsQlty 0 "Valid value" 100 "Valid value" 101 "Reserved" 126 "Reserved" 127 "Invalid" ;
VAL_ 589 ExprsnStsQlty 0 "Valid value" 100 "Valid value" 101 "Reserved" 126 "Reserved" 127 "Invalid" ;
VAL_ 589 Checksum_DMS2 0 "Valid values" 255 "Valid values" ;
VAL_ 589 DistrctnLvl_ACC 0 "No distraction" 1 "Low level distraction" 2 "Middle level distraction" 3 "Hi level distraction" 4 "Reserved" 6 "Reserved" 7 "Invalid" ;
VAL_ 589 DistrctnLvlQlty_ACC 0 "Valid value" 100 "Valid value" 101 "Reserved" 126 "Reserved" 127 "Invalid" ;
VAL_ 589 DrowsnsLvl_ACC 0 "No Drowsiness" 1 "Low level Drowsiness" 2 "Middle level Drowsiness" 3 "Hi level Drowsiness" 4 "Reserved" 6 "Reserved" 7 "Invalid" ;
VAL_ 589 DrowsnsLvlQlty_ACC 0 "Valid value" 100 "Valid value" 101 "Reserved" 126 "Reserved" 127 "Invalid" ;
VAL_ 589 DistrctnLvl 0 "No distraction" 1 "Low level distraction" 2 "Middle level distraction" 3 "High level distraction" 4 "Reserved" 6 "Reserved" 7 "Invalid" ;
VAL_ 589 DistrctnLvlQlty 0 "Valid value" 100 "Valid value" 101 "Reserved" 126 "Reserved" 127 "Invalid" ;
VAL_ 589 RollingCounter_DMS2 0 "Valid value" 14 "Valid value" 15 "Invalid value" ;
VAL_ 589 Checksum_DMS3 0 "Valid values" 255 "Valid values" ;
VAL_ 589 HeadPosnX 0 "Valid value" 1500 "Valid value" 1501 "Reserved" 2046 "Reserved" 2047 "Invalid" ;
VAL_ 589 HeadPosnY 0 "Valid value" 1000 "Valid value" 1001 "Reserved" 2046 "Reserved" 2047 "Invalid" ;
VAL_ 589 HeadPosnZ 0 "Valid value" 1000 "Valid value" 1001 "Reserved" 2046 "Reserved" 2047 "Invalid" ;
VAL_ 589 HeadPosQlty 0 "Valid value" 100 "Valid value" 101 "Reserved" 126 "Reserved" 127 "Invalid" ;
VAL_ 589 DrvBehvSts 0 "No actiong" 1 "Smoking" 2 "on the phone" 3 "Reserved" 6 "Reserved" 7 "Invalid" ;
VAL_ 589 RollingCounter_DMS3 0 "Valid value" 14 "Valid value" 15 "Invalid value" ;
VAL_ 589 GazePosnX 0 "Valid value" 1500 "Valid value" 1501 "Reserved" 2046 "Reserved" 2047 "Invalid" ;
VAL_ 589 GazePosnY 0 "Valid value" 1000 "Valid value" 1001 "Reserved" 2046 "Reserved" 2047 "Invalid" ;
VAL_ 589 GazePosnZ 0 "Valid value" 1000 "Valid value" 1001 "Reserved" 2046 "Reserved" 2047 "Invalid" ;
VAL_ 589 DrvGazeAreaSts 0 "No area" 1 "Area 1" 2 "Area 2" 3 "Area 3" 4 "Area 4" 5 "Area 5" 6 "Area 6" 7 "Invalid" ;
VAL_ 589 Checksum_DMS5 0 "Valid values" 255 "Valid values" ;
VAL_ 589 DMSSts 0 "Blindness" 1 "Error" 2 "Active" 3 "Not active" 4 "Reserved" 6 "Reserved" 7 "Invalid" ;
VAL_ 589 HeadDetn 0 "No" 1 "Yes" ;
VAL_ 589 HeadYawAng 0 "Valid value" 150 "Valid value" 151 "Reserved" 254 "Reserved" 255 "Invalid" ;
VAL_ 589 HeadPitchAng 0 "Valid value" 70 "Valid value" 71 "Reserved" 254 "Reserved" 255 "Invalid" ;
VAL_ 589 HeadRollAng 0 "Valid value" 90 "Valid value" 91 "Reserved" 254 "Reserved" 255 "Invalid" ;
VAL_ 589 HeadRotAngQlty 0 "Valid value" 100 "Valid value" 101 "Reserved" 126 "Reserved" 127 "Invalid" ;
VAL_ 589 RollingCounter_DMS5 0 "Valid value" 14 "Valid value" 15 "Invalid value" ;
VAL_ 589 Checksum_DMS6 0 "Valid values" 255 "Valid values" ;
VAL_ 589 LEyeOpenSts 0 "No" 1 "Yes" 2 "Loss left eye" 3 "Invalid" ;
VAL_ 589 LEyeOpenStsQlty 0 "Valid value" 100 "Valid value" 101 "Reserved" 126 "Reserved" 127 "Invalid" ;
VAL_ 589 REyeOpenSts 0 "No" 1 "Yes" 2 "Loss right eye" 3 "Invalid" ;
VAL_ 589 REyeOpenStsQlty 0 "Valid value" 100 "Valid value" 101 "Reserved" 126 "Reserved" 127 "Invalid" ;
VAL_ 589 RobustGazeYawAng 0 "Valid value" 180 "Valid value" 181 "Reserved" 254 "Reserved" 255 "Invalid" ;
VAL_ 589 RobustGazePitchAng 0 "Valid value" 180 "Valid value" 181 "Reserved" 254 "Reserved" 255 "Invalid" ;
VAL_ 589 RobustGazeAngQlty 0 "Valid value" 100 "Valid value" 101 "Reserved" 126 "Reserved" 127 "Invalid" ;
VAL_ 589 RollingCounter_DMS6 0 "Valid value" 14 "Valid value" 15 "Invalid value" ;
SIG_GROUP_ 639 HUT_IP2 1 : CheckSum_IP2 IP_VehTotDistance IP_FuelLvlInfo IP_ACCErr IP_VehTotDistanceValid IP_FuelLvlLowLmpSts IP_BattChrgLmpSts IP_EngOilPressLowLmpSts IP_ABMWarnLmpFailrSts IP_VehSpdUnit IP_Err IP_DrvSeatBeltWarnLmpFailSts IP_PassSeatBeltWarnLmpFailSts IP_VINcompr RollingCounter_IP2;
SIG_GROUP_ 623 HUT32 1 : CheckSum_HUT32 ContnPrkgReq PrkgCtrlModReq PrkStraightSwtReq_HUT PrkgCtrlModReqValid DetVideoLost ContnPrkgReqValid XLvl PrkStraightSuspendOrFinishReq_HU YLvl ScrnOpSts PrkStraightStrtReq_HUT PrkStraightVehStrtReq_HUT_Valid VolLampDispSts PrkStraightContinueReq_HUT PrkStraightModSel_HUT PrkStraightSts_HUT RollingCounter_HUT32;
SIG_GROUP_ 589 DMS2_DMS_FD1 1 : Checksum_DMS2 DistrctnLvlQlty_ACC dummy_DMS_FD1_5 DrowsnsLvlQlty_ACC dummy_DMS_FD1_6 DistrctnLvl_ACC DrowsnsLvl_ACC dummy_DMS_FD1_7 DistrctnLvl dummy_DMS_FD1_8 DistrctnLvlQlty dummy_DMS_FD1_9 dummy_DMS_FD1_10 dummy_DMS_FD1_11 RollingCounter_DMS2;
SIG_GROUP_ 589 DMS3_DMS_FD1 1 : Checksum_DMS3 HeadPosnX HeadPosnY HeadPosnZ HeadPosQlty dummy_DMS_FD1_12 dummy_DMS_FD1_13 DrvBehvSts RollingCounter_DMS3;
SIG_GROUP_ 589 DMS5_DMS_FD1 1 : Checksum_DMS5 HeadYawAng HeadPitchAng HeadRollAng HeadRotAngQlty HeadDetn DMSSts dummy_DMS_FD1_19 dummy_DMS_FD1_20 dummy_DMS_FD1_21 RollingCounter_DMS5;
SIG_GROUP_ 589 DMS6_DMS_FD1 1 : Checksum_DMS6 RobustGazeYawAng RobustGazePitchAng LEyeOpenStsQlty dummy_DMS_FD1_22 REyeOpenStsQlty dummy_DMS_FD1_23 RobustGazeAngQlty dummy_DMS_FD1_24 LEyeOpenSts REyeOpenSts dummy_DMS_FD1_25 dummy_DMS_FD1_26 RollingCounter_DMS6;
