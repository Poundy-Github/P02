AUTOSAR XML (schema 00046)
package /Renesas/Port_ib_bswmd/BswModuleDescriptions
  bsw module description Port
    bsw internal behavior PortBehavior
      9 x exclusive area:
        PORT_SET_PIN_DIR_PROTECTION
        PORT_SET_PIN_MODE_PROTECTION
        PORT_SET_TO_DIO_ALT_PROTECTION
        PORT_INIT_CONFIG_PROTECTION
        PORT_REFRESH_PORT_INTERNAL_PROTECTION
        PORT_SET_PIN_DEFAULT_MODE_PROTECTION
        PORT_SET_PIN_DEFAULT_DIR_PROTECTION
        PORT_CHECK_HW_CONSISTENCY_PROTECTION
        PORT_REGISTER_PROTECTION
