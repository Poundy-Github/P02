AUTOSAR XML (schema 00046)
package /Renesas/CorTst_ib_bswmd/BswModuleDescriptions
  bsw module description CorTst: provided-entrys=CorTst_MainFunction
    bsw internal behavior CorTstBehavior
      exclusive area CORTST_TESTMODULE_DATA_PROTECTION
      bsw schedulable entity CorTst_MainFunction: implemented-entry=CorTst_MainFunction
      bsw timing event CorTst_MainFunctionTimingEvent0: starts-on-event=CorTst_MainFunction, period=0.005
  bsw module entry CorTst_MainFunction: call-type=SCHEDULED, execution-context=TASK
