AUTOSAR XML (schema 00046)
package /Renesas/Gpt_ib_bswmd/BswModuleDescriptions
  bsw module description Gpt
    bsw internal behavior GptBehavior
      exclusive area GPT_TIMERREG_PROTECTION
      exclusive area GPT_TIMERINT_PROTECTION
