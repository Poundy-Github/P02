AUTOSAR XML (schema 00046)
package /MICROSAR/SecOC_ib_bswmd/BswModuleDescriptions
  bsw module description SecOC: provided-entrys=[SecOC_MainFunctionRx, SecOC_MainFunctionTx]
    bsw internal behavior SecOCBehavior
      exclusive area SECOC_EXCLUSIVE_AREA_RXSTATE
      exclusive area SECOC_EXCLUSIVE_AREA_TXSTATE
      bsw schedulable entity SecOC_MainFunctionRx: implemented-entry=SecOC_MainFunctionRx
      bsw schedulable entity SecOC_MainFunctionTx: implemented-entry=SecOC_MainFunctionTx
      bsw timing event SecOC_MainFunctionRxTimingEvent0: starts-on-event=SecOC_MainFunctionRx, period=0.002
      bsw timing event SecOC_MainFunctionTxTimingEvent0: starts-on-event=SecOC_MainFunctionTx, period=0.002
  bsw module entry SecOC_MainFunctionRx: call-type=SCHEDULED, execution-context=TASK
  bsw module entry SecOC_MainFunctionTx: call-type=SCHEDULED, execution-context=TASK
