AUTOSAR XML (schema 00046)
package /MICROSAR/Fee_30_SmallSector_ib_bswmd/BswModuleDescriptions
  bsw module description Fee: provided-entrys=Fee_30_SmallSector_MainFunction
    bsw internal behavior Fee_30_SmallSectorBehavior
      bsw schedulable entity Fee_30_SmallSector_MainFunction: implemented-entry=Fee_30_SmallSector_MainFunction
      bsw timing event Fee_30_SmallSector_MainFunctionTimingEvent0: starts-on-event=Fee_30_SmallSector_MainFunction, period=0.005
  bsw module entry Fee_30_SmallSector_MainFunction: call-type=SCHEDULED, execution-context=TASK
