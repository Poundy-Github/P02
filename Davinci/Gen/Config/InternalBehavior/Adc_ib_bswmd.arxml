AUTOSAR XML (schema 00046)
package /Renesas/Adc_ib_bswmd/BswModuleDescriptions
  bsw module description Adc
    bsw internal behavior AdcBehavior
      exclusive area ADC_RAMDATA_PROTECTION
      exclusive area ADC_INT_PROTECTION
