AUTOSAR XML (schema 00046)
package /MICROSAR
  bsw implementation LinIf_Impl: programming-language=C, sw-version=8.00.00, used-code-generator=DaVinci Configurator, vendor-id=30, ar-release-version=4.00.03
