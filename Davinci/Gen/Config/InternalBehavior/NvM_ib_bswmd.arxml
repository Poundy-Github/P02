AUTOSAR XML (schema 00046)
package /MICROSAR
  bsw implementation NvM_Impl: programming-language=C, sw-version=6.02.03, used-code-generator=DaVinci Configurator, vendor-id=30, ar-release-version=4.00.03
package /MICROSAR/NvM_ib_bswmd/BswModuleDescriptions
  bsw module description NvM: provided-entrys=NvM_MainFunction
    bsw internal behavior NvMBehavior
      exclusive area NVM_EXCLUSIVE_AREA_0
      bsw schedulable entity NvM_MainFunction: implemented-entry=NvM_MainFunction
      bsw timing event NvM_MainFunctionTimingEvent0: starts-on-event=NvM_MainFunction, period=0.005
  bsw module entry NvM_MainFunction: call-type=SCHEDULED, execution-context=TASK
