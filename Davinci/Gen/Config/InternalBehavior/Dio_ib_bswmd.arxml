AUTOSAR XML (schema 00046)
package /Renesas/Dio_ib_bswmd/BswModuleDescriptions
  bsw module description Dio
    bsw internal behavior DioBehavior
      exclusive area DIO_REGISTER_PROTECTION
