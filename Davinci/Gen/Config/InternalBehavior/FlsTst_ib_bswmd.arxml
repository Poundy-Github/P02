AUTOSAR XML (schema 00046)
package /Renesas/FlsTst_ib_bswmd/BswModuleDescriptions
  bsw module description FlsTst: provided-entrys=FlsTst_MainFunction
    bsw internal behavior FlsTstBehavior
      exclusive area FLSTST_DRIVERSTATE_DATA_PROTECTION
      bsw schedulable entity FlsTst_MainFunction: implemented-entry=FlsTst_MainFunction
      bsw timing event FlsTst_MainFunctionTimingEvent0: starts-on-event=FlsTst_MainFunction, period=0.005
  bsw module entry FlsTst_MainFunction: call-type=SCHEDULED, execution-context=TASK
