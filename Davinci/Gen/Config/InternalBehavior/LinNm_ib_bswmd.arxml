AUTOSAR XML (schema 00046)
package /MICROSAR
  bsw implementation LinNm_Impl: programming-language=C, sw-version=2.03.00, used-code-generator=DaVinci Configurator, vendor-id=30, ar-release-version=4.00.03
