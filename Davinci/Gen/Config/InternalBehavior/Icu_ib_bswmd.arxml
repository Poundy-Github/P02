AUTOSAR XML (schema 00046)
package /Renesas/Icu_ib_bswmd/BswModuleDescriptions
  bsw module description Icu
    bsw internal behavior IcuBehavior
      4 x exclusive area:
        ICU_CHANNEL_DATA_PROTECTION
        ICU_TIMESTAMP_DATA_PROTECTION
        ICU_SIGNALMEASURE_DATA_PROTECTION
        ICU_EDGECOUNT_DATA_PROTECTION
