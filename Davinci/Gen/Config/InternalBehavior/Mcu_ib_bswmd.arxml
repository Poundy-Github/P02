AUTOSAR XML (schema 00046)
package /Renesas/Mcu_ib_bswmd/BswModuleDescriptions
  bsw module description Mcu
    bsw internal behavior McuBehavior
      exclusive area MCU_PWR_MODE_PSC_PROTECTION
      exclusive area MCU_REGISTER_PROTECTION
      exclusive area MCU_VARIABLE_PROTECTION
