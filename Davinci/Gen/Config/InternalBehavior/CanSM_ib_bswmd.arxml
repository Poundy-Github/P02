AUTOSAR XML (schema 00046)
package /MICROSAR
  bsw implementation CanSM_Impl: programming-language=C, sw-version=3.00.01, used-code-generator=DaVinci Configurator, vendor-id=30, ar-release-version=4.00.03
package /MICROSAR/CanSM_ib_bswmd/BswModuleDescriptions
  bsw module description CanSM: provided-entrys=CanSM_MainFunction
    bsw internal behavior CanSMBehavior
      6 x exclusive area:
        CANSM_EXCLUSIVE_AREA_{1..6}
      bsw schedulable entity CanSM_MainFunction: implemented-entry=CanSM_MainFunction
      bsw timing event CanSM_MainFunctionTimingEvent0: starts-on-event=CanSM_MainFunction, period=0.005
  bsw module entry CanSM_MainFunction: call-type=SCHEDULED, execution-context=TASK
