AUTOSAR XML (schema 00046)
package /Renesas/RamTst_ib_bswmd/BswModuleDescriptions
  bsw module description RamTst: provided-entrys=RamTst_MainFunction
    bsw internal behavior RamTstBehavior
      exclusive area RAMTST_RAM_DATA_PROTECTION
      bsw schedulable entity RamTst_MainFunction: implemented-entry=RamTst_MainFunction
      bsw timing event RamTst_MainFunctionTimingEvent0: starts-on-event=RamTst_MainFunction, period=0.005
  bsw module entry RamTst_MainFunction: call-type=SCHEDULED, execution-context=TASK
