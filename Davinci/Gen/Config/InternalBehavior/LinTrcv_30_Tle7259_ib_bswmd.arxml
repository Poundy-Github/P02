AUTOSAR XML (schema 00046)
package /MICROSAR/LinTrcv_30_Tle7259_ib_bsmwd/BswModuleDescriptions
  bsw module description LinTrcv
    bsw internal behavior LinTrcv_30_Tle7259Behavior
      exclusive area LINTRCV_30_TLE7259_EXCLUSIVE_AREA_0  # Using to secure atomic Hardware access. this Area should be protected with global interrupt locks.
