AUTOSAR XML (schema 00046)
package /Renesas/Pwm_ib_bswmd/BswModuleDescriptions
  bsw module description Pwm
    bsw internal behavior PwmBehavior
      exclusive area PWM_REGISTERS_PROTECTION
