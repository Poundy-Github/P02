AUTOSAR XML (schema 00046)
package /Renesas/Spi_ib_bswmd/BswModuleDescriptions
  bsw module description Spi: provided-entrys=Spi_MainFunction_Handling
    bsw internal behavior SpiBehavior
      5 x exclusive area:
        SPI_RAM_DATA_PROTECTION
        SPI_CHIP_SELECT_PROTECTION
        SPI_REG_PROTECTION
        SPI_DMA_PROTECTION
        SPI_INTERRUPT_CONTROL_PROTECTION
      bsw schedulable entity Spi_MainFunction_Handling: implemented-entry=Spi_MainFunction_Handling
      bsw timing event Spi_MainFunction_HandlingTimingEvent0: starts-on-event=Spi_MainFunction_Handling, period=0.005
  bsw module entry Spi_MainFunction_Handling: call-type=SCHEDULED, execution-context=TASK
