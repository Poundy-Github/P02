AUTOSAR XML (schema 00046)
package /MICROSAR/FvM_ib_bswmd/BswModuleDescriptions
  bsw module description FvM: provided-entrys=FvM_MainFunction
    bsw internal behavior FvMBehavior
      4 x exclusive area:
        FVM_EXCLUSIVE_AREA_RX_FRESHNESS
        FVM_EXCLUSIVE_AREA_TX_FRESHNESS
        FVM_EXCLUSIVE_AREA_SYNC_STATE
        FVM_EXCLUSIVE_AREA_BOTH_FRESHNESS
      bsw schedulable entity FvM_MainFunction: implemented-entry=FvM_MainFunction
      bsw timing event FvM_MainFunctionTimingEvent0: starts-on-event=FvM_MainFunction, period=0.1
  bsw module entry FvM_MainFunction: call-type=SCHEDULED, execution-context=TASK
