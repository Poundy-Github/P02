AUTOSAR XML (schema 00046)
package /ActiveEcuC
  module config WdgM: implementation-config-variant=VARIANT-PRE-COMPILE, module-description=WdgM_Impl
    WdgMConfigSet: WdgMInitialMode=WdgMMode
      WdgMMode:
        WdgMExpiredSupervisionCycleTol = 0
        WdgMModeId = 0
        WdgMSupervisionCycle = 0.01
        WdgMInitialTriggerModeId = 0
        WdgMModeCoreAssignment = 0
        WdgMTicksPerSecond = 100
        WdgMReportStatusViaRte = true
        WdgMGlobalMemoryAppTaskRef = SystemApplication_OsCore0
        WdgMTrigger: WdgMWatchdogMode=WDGIF_FAST_MODE, WdgMTriggerConditionValue=512, WdgMTriggerModeId=0, WdgMTriggerWatchdogRef=WdgMWatchdog
        WdgMLocalStatusParams:
          WdgMFailedAliveSupervisionRefCycleTol = 50
          WdgMSupervisedEntityInitialMode = WDGM_LOCAL_STATUS_OK
          WdgMFailedDeadlineRefCycleTol = 0
          WdgMDeadlineReferenceCycle = 0
          WdgMFailedProgramFlowRefCycleTol = 0
          WdgMProgramFlowReferenceCycle = 3
          WdgMLocalStatusSupervisedEntityRef = WdgMSupervisedEntity_test
        WdgMAliveSupervision:
          WdgMExpectedAliveIndications = 20
          WdgMMaxMargin = 19
          WdgMMinMargin = 19
          WdgMSupervisionReferenceCycle = 10
          WdgMAliveSupervisionCheckpointRef = WdgMCheckpoint_test
        WdgMLocalStatusParams_GEAR (WdgMLocalStatusParams):
          WdgMFailedAliveSupervisionRefCycleTol = 50
          WdgMSupervisedEntityInitialMode = WDGM_LOCAL_STATUS_OK
          WdgMFailedDeadlineRefCycleTol = 0
          WdgMDeadlineReferenceCycle = 0
          WdgMFailedProgramFlowRefCycleTol = 0
          WdgMProgramFlowReferenceCycle = 0
          WdgMLocalStatusSupervisedEntityRef = WdgMSupervisedEntity_GEAR
        WdgMLocalStatusParams_TT (WdgMLocalStatusParams):
          WdgMFailedAliveSupervisionRefCycleTol = 50
          WdgMSupervisedEntityInitialMode = WDGM_LOCAL_STATUS_OK
          WdgMFailedDeadlineRefCycleTol = 0
          WdgMDeadlineReferenceCycle = 0
          WdgMFailedProgramFlowRefCycleTol = 0
          WdgMProgramFlowReferenceCycle = 0
          WdgMLocalStatusSupervisedEntityRef = WdgMSupervisedEntity_TT
        WdgMAliveSupervision_GEAR (WdgMAliveSupervision):
          WdgMExpectedAliveIndications = 10
          WdgMMaxMargin = 9
          WdgMMinMargin = 9
          WdgMSupervisionReferenceCycle = 50
          WdgMAliveSupervisionCheckpointRef = WdgMSupervisedEntity_GEAR/WdgMCheckpoint
        WdgMAliveSupervision_TT (WdgMAliveSupervision):
          WdgMExpectedAliveIndications = 10
          WdgMMaxMargin = 9
          WdgMMinMargin = 9
          WdgMSupervisionReferenceCycle = 10
          WdgMAliveSupervisionCheckpointRef = WdgMSupervisedEntity_TT/WdgMCheckpoint
    WdgMGeneral:
      WdgMDevErrorDetect = true
      WdgMDemReport = false
      WdgMImmediateReset = true
      WdgMOffModeEnabled = true
      WdgMVersionInfoApi = false
      WdgMDefensiveBehavior = false
      WdgMUseRte = true
      WdgMDemSupervisionReport = false
      WdgMFirstCycleAliveCounterReset = false
      WdgMAutosarDebugging = false
      WdgMUseOsSuspendInterrupt = true
      WdgMTimebaseSource = WDGM_INTERNAL_SOFTWARE_TICK
      WdgMSecondResetPath = true
      WdgMTickOverrunCorrection = false
      WdgMEntityDeactivationEnabled = false
      WdgMGenerateCPIdAsPortDefinedArgument = false
      WdgMStatusReportingMechanism = WDGM_USE_NOTIFICATIONS
      WdgMCallerIds: WdgMCallerId=0
      WdgMWatchdog: WdgMWatchdogName=, WdgMWatchdogDeviceRef=WdgIfDevice
      3 x WdgMSupervisedEntity, all with WdgMEnableEntityDeactivation=false, WdgMReportStatusViaRte=true, WdgMAppTaskRef=SystemApplication_OsCore0:
        WdgMSupervisedEntity_test: WdgMSupervisedEntityId=0, WdgMInternalCheckpointInitialRef=WdgMCheckpoint_test
          WdgMCheckpoint_test (WdgMCheckpoint): WdgMCheckpointId=0
        WdgMSupervisedEntity_GEAR: WdgMSupervisedEntityId=1, WdgMInternalCheckpointInitialRef=WdgMSupervisedEntity_GEAR/WdgMCheckpoint
          WdgMCheckpoint: WdgMCheckpointId=0
        WdgMSupervisedEntity_TT: WdgMSupervisedEntityId=2, WdgMInternalCheckpointInitialRef=WdgMSupervisedEntity_TT/WdgMCheckpoint
          WdgMCheckpoint: WdgMCheckpointId=0
