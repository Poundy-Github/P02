AUTOSAR XML (schema 00046)
package /ActiveEcuC
  module config CanIf: implementation-config-variant=VARIANT-PRE-COMPILE, module-description=CanIf_Impl
    CanIfCtrlDrvCfg_7d254554 (CanIfCtrlDrvCfg): CanIfCtrlDrvTxCancellation=true, CanIfCtrlDrvInitHohConfigRef=CanIfInitHohCfg, CanIfCtrlDrvNameRef=CanGeneral
      3 x CanIfCtrlCfg, all with CanIfCtrlJ1939DynAddrSupport=DISABLED:
        CT_B30_for_SC_CAN_V3_2_4a04dc9c: CanIfCtrlId=0, CanIfCtrlWakeupSupport=true, CanIfDoubleHashRandom1=6677, CanIfDoubleHashRandom2=22996, CanIfCtrlCanCtrlRef=CT_B30_for_SC_CAN_V3_2_4a04dc9c, CanIfCtrlTrcvCfgRef=CanIfTrcvCfg_CAN3
        CT_B30_for_SC_CAN_V3_2_4a04dc9c_001: CanIfCtrlId=1, CanIfCtrlWakeupSupport=false, CanIfDoubleHashRandom1=0, CanIfDoubleHashRandom2=0, CanIfCtrlCanCtrlRef=CT_B30_for_SC_CAN_V3_2_4a04dc9c_001, CanIfCtrlTrcvCfgRef=CanIfTrcvCfg_CAN0
        CT_B30_for_SC_CAN_V3_2_4a04dc9c_002: CanIfCtrlId=2, CanIfCtrlWakeupSupport=false, CanIfDoubleHashRandom1=0, CanIfDoubleHashRandom2=0, CanIfCtrlCanCtrlRef=CT_B30_for_SC_CAN_V3_2_4a04dc9c_002, CanIfCtrlTrcvCfgRef=CanIfTrcvCfg_CAN1
    CanIfDispatchCfg:
      CanIfDispatchUserCtrlBusOffName = CanSM_ControllerBusOff
      CanIfDispatchUserCtrlBusOffUL = CAN_SM
      CanIfDispatchUserCtrlModeIndicationName = CanSM_ControllerModeIndication
      CanIfDispatchUserCtrlModeIndicationUL = CAN_SM
      CanIfDispatchUserTrcvModeIndicationUL = CAN_SM
      CanIfDispatchUserTrcvModeIndicationName = CanSM_TransceiverModeIndication
      CanIfDispatchUserValidateWakeupEventName = EcuM_ValidateWakeupEvent
      CanIfDispatchUserValidateWakeupEventUL = ECUM
      CanIfDispatchDataChecksumRxErrorIndicationName = NULL_PTR
      CanIfDispatchDataChecksumRxErrorIndicationUL = NONE
    CanIfInitCfg
      6 x CanIfRxPduCfg, all with CanIfRxPduCanIdType=STANDARD_FD_CAN, CanIfRxPduUserRxIndicationName=PduR_CanIfRxIndication, CanIfRxPduUserRxIndicationUL=PDUR, CanIfRxPduReadData=false, CanIfRxPduReadNotifyStatus=false, CanIfRxPduDlcCheck=true, CanIfRxPduDataChecksumPdu=true, CanIfRxPduHrhIdRef=CN_B30_for_SC_CAN_V3_2_efc035d8_Rx:
        AEB_FD1_oB30_for_SC_CAN_V3_2_0e351c33_Rx: CanIfRxPduCanId=395, CanIfRxPduDlc=64, CanIfRxPduId=113, CanIfRxPduRef=AEB_FD1_oB30_for_SC_CAN_V3_2_c284a95c_Rx
        PDCM1_oB30_for_SC_CAN_V3_2_39eaea1a_Rx: CanIfRxPduCanId=717, CanIfRxPduDlc=8, CanIfRxPduId=57, CanIfRxPduRef=PDCM1_oB30_for_SC_CAN_V3_2_76a5c7ab_Rx
        ECM7_oB30_for_SC_CAN_V3_2_80d4d71c_Rx: CanIfRxPduCanId=132, CanIfRxPduDlc=8, CanIfRxPduId=141, CanIfRxPduRef=ECM7_oB30_for_SC_CAN_V3_2_743820e8_Rx
        HCU_PT4_oB30_for_SC_CAN_V3_2_f04552bd_Rx: CanIfRxPduCanId=762, CanIfRxPduDlc=8, CanIfRxPduId=46, CanIfRxPduRef=HCU_PT4_oB30_for_SC_CAN_V3_2_d214f642_Rx
        HCU_PT7_oB30_for_SC_CAN_V3_2_25ff29ae_Rx: CanIfRxPduCanId=584, CanIfRxPduDlc=8, CanIfRxPduId=88, CanIfRxPduRef=HCU_PT7_oB30_for_SC_CAN_V3_2_5726e4b6_Rx
        HAP_FD1_oB30_for_SC_CAN_V3_2_4a3d5566_Rx: CanIfRxPduCanId=347, CanIfRxPduDlc=64, CanIfRxPduId=119, CanIfRxPduRef=HAP_FD1_oB30_for_SC_CAN_V3_2_6083faa7_Rx
      HUT19_oB30_for_SC_CAN_V3_2_1a2bdd42_Tx (CanIfTxPduCfg):
        CanIfTxPduCanId = 1045
        CanIfTxPduCanIdType = STANDARD_FD_CAN
        CanIfTxPduDlc = 8
        CanIfTxPduUserTxConfirmationName = PduR_CanIfTxConfirmation
        CanIfTxPduUserTxConfirmationUL = PDUR
        CanIfTxPduId = 38
        CanIfTxPduReadNotifyStatus = false
        CanIfTxPduType = STATIC
        CanIfTxPduTruncation = true
        CanIfTxPduBufferRef = CanIfBufferCfg_HUT19_oB30_for_SC_CAN_V3_2_1a2bdd42_Tx
        CanIfTxPduRef = HUT19_oB30_for_SC_CAN_V3_2_7c4add44_Tx
      RSDS_FD1_oB30_for_SC_CAN_V3_2_5521fc93_Rx (CanIfRxPduCfg):
        CanIfRxPduCanId = 367
        CanIfRxPduCanIdType = STANDARD_FD_CAN
        CanIfRxPduDlc = 64
        CanIfRxPduUserRxIndicationName = PduR_CanIfRxIndication
        CanIfRxPduUserRxIndicationUL = PDUR
        CanIfRxPduId = 115
        CanIfRxPduReadData = false
        CanIfRxPduReadNotifyStatus = false
        CanIfRxPduDlcCheck = true
        CanIfRxPduDataChecksumPdu = true
        CanIfRxPduHrhIdRef = CN_B30_for_SC_CAN_V3_2_efc035d8_Rx
        CanIfRxPduRef = RSDS_FD1_oB30_for_SC_CAN_V3_2_b597372e_Rx
      6 x CanIfTxPduCfg, all with CanIfTxPduCanIdType=STANDARD_FD_CAN, CanIfTxPduDlc=8, CanIfTxPduUserTxConfirmationName=PduR_CanIfTxConfirmation, CanIfTxPduUserTxConfirmationUL=PDUR, CanIfTxPduReadNotifyStatus=false, CanIfTxPduType=STATIC, CanIfTxPduTruncation=true:
        HUT2_oB30_for_SC_CAN_V3_2_2e4fab23_Tx: CanIfTxPduCanId=873, CanIfTxPduId=11, CanIfTxPduBufferRef=CHNL_b4130143, CanIfTxPduRef=HUT2_oB30_for_SC_CAN_V3_2_ccdf26ca_Tx
        HUT13_oB30_for_SC_CAN_V3_2_fc2f1567_Tx: CanIfTxPduCanId=796, CanIfTxPduId=43, CanIfTxPduBufferRef=CanIfBufferCfg_HUT13_oB30_for_SC_CAN_V3_2_fc2f1567_Tx, CanIfTxPduRef=HUT13_oB30_for_SC_CAN_V3_2_d404bffe_Tx
        HUT6_oB30_for_SC_CAN_V3_2_7865d3ad_Tx: CanIfTxPduCanId=74, CanIfTxPduId=36, CanIfTxPduBufferRef=CHNL_b4130143, CanIfTxPduRef=HUT6_oB30_for_SC_CAN_V3_2_52c6e404_Tx
        HUT21_oB30_for_SC_CAN_V3_2_39937324_Tx: CanIfTxPduCanId=733, CanIfTxPduId=17, CanIfTxPduBufferRef=CHNL_b4130143, CanIfTxPduRef=HUT21_oB30_for_SC_CAN_V3_2_215d5a8e_Tx
        HUT23_oB30_for_SC_CAN_V3_2_0d38b185_Tx: CanIfTxPduCanId=728, CanIfTxPduId=19, CanIfTxPduBufferRef=CHNL_b4130143, CanIfTxPduRef=HUT23_oB30_for_SC_CAN_V3_2_6e51bbe9_Tx
        HUT25_oB30_for_SC_CAN_V3_2_50c4f666_Tx: CanIfTxPduCanId=825, CanIfTxPduId=14, CanIfTxPduBufferRef=CHNL_b4130143, CanIfTxPduRef=HUT25_oB30_for_SC_CAN_V3_2_bf449840_Tx
      9 x CanIfRxPduCfg, all with CanIfRxPduCanIdType=STANDARD_FD_CAN, CanIfRxPduUserRxIndicationName=PduR_CanIfRxIndication, CanIfRxPduUserRxIndicationUL=PDUR, CanIfRxPduReadData=false, CanIfRxPduReadNotifyStatus=false, CanIfRxPduDlcCheck=true, CanIfRxPduDataChecksumPdu=true, CanIfRxPduHrhIdRef=CN_B30_for_SC_CAN_V3_2_efc035d8_Rx:
        AMP3_oB30_for_SC_CAN_V3_2_e81cfa6e_Rx: CanIfRxPduCanId=997, CanIfRxPduDlc=8, CanIfRxPduId=8, CanIfRxPduRef=AMP3_oB30_for_SC_CAN_V3_2_b64354b4_Rx
        IFC_FD3_oB30_for_SC_CAN_V3_2_892173f6_Rx: CanIfRxPduCanId=719, CanIfRxPduDlc=64, CanIfRxPduId=55, CanIfRxPduRef=IFC_FD3_oB30_for_SC_CAN_V3_2_4c625c72_Rx
        ECM11_oB30_for_SC_CAN_V3_2_9a268e5b_Rx: CanIfRxPduCanId=723, CanIfRxPduDlc=8, CanIfRxPduId=51, CanIfRxPduRef=ECM11_oB30_for_SC_CAN_V3_2_5b5ef203_Rx
        HAP_FD3_oB30_for_SC_CAN_V3_2_65c1fabb_Rx: CanIfRxPduCanId=664, CanIfRxPduDlc=64, CanIfRxPduId=74, CanIfRxPduRef=HAP_FD3_oB30_for_SC_CAN_V3_2_2f8f1bc0_Rx
        AC1_oB30_for_SC_CAN_V3_2_a5757e7b_Rx: CanIfRxPduCanId=669, CanIfRxPduDlc=8, CanIfRxPduId=71, CanIfRxPduRef=AC1_oB30_for_SC_CAN_V3_2_3243b46e_Rx
        HAP_FD2_oB30_for_SC_CAN_V3_2_9f872e75_Rx: CanIfRxPduCanId=628, CanIfRxPduDlc=64, CanIfRxPduId=82, CanIfRxPduRef=HAP_FD2_oB30_for_SC_CAN_V3_2_e5b1e853_Rx
        GW_FD1_oB30_for_SC_CAN_V3_2_002aed10_Rx: CanIfRxPduCanId=699, CanIfRxPduDlc=64, CanIfRxPduId=62, CanIfRxPduRef=GW_FD1_oB30_for_SC_CAN_V3_2_7270e594_Rx
        EPB1_oB30_for_SC_CAN_V3_2_139493e2_Rx: CanIfRxPduCanId=363, CanIfRxPduDlc=8, CanIfRxPduId=116, CanIfRxPduRef=EPB1_oB30_for_SC_CAN_V3_2_9899d01e_Rx
        DCT5_oB30_for_SC_CAN_V3_2_3a3a1203_Rx: CanIfRxPduCanId=545, CanIfRxPduDlc=8, CanIfRxPduId=98, CanIfRxPduRef=DCT5_oB30_for_SC_CAN_V3_2_81a2a74b_Rx
      HUT32_oB30_for_SC_CAN_V3_2_aa274fab_Tx (CanIfTxPduCfg):
        CanIfTxPduCanId = 623
        CanIfTxPduCanIdType = STANDARD_FD_CAN
        CanIfTxPduDlc = 8
        CanIfTxPduUserTxConfirmationName = PduR_CanIfTxConfirmation
        CanIfTxPduUserTxConfirmationUL = PDUR
        CanIfTxPduId = 51
        CanIfTxPduReadNotifyStatus = false
        CanIfTxPduType = STATIC
        CanIfTxPduTruncation = true
        CanIfTxPduBufferRef = CanIfBufferCfg_HUT32_oB30_for_SC_CAN_V3_2_aa274fab_Tx
        CanIfTxPduRef = HUT32_oB30_for_SC_CAN_V3_2_cda3b477_Tx
      HUT34_oB30_for_SC_CAN_V3_2_f7db0848_Tx (CanIfTxPduCfg):
        CanIfTxPduCanId = 880
        CanIfTxPduCanIdType = STANDARD_FD_CAN
        CanIfTxPduDlc = 8
        CanIfTxPduUserTxConfirmationName = PduR_CanIfTxConfirmation
        CanIfTxPduUserTxConfirmationUL = PDUR
        CanIfTxPduId = 40
        CanIfTxPduReadNotifyStatus = false
        CanIfTxPduType = STATIC
        CanIfTxPduTruncation = true
        CanIfTxPduBufferRef = CanIfBufferCfg_HUT34_oB30_for_SC_CAN_V3_2_f7db0848_Tx
        CanIfTxPduRef = HUT34_oB30_for_SC_CAN_V3_2_1cb697de_Tx
      AMP4_ANC1_oB30_for_SC_CAN_V3_2_778038f3_Rx (CanIfRxPduCfg):
        CanIfRxPduCanId = 722
        CanIfRxPduCanIdType = STANDARD_FD_CAN
        CanIfRxPduDlc = 8
        CanIfRxPduUserRxIndicationName = PduR_CanIfRxIndication
        CanIfRxPduUserRxIndicationUL = PDUR
        CanIfRxPduId = 52
        CanIfRxPduReadData = false
        CanIfRxPduReadNotifyStatus = false
        CanIfRxPduDlcCheck = true
        CanIfRxPduDataChecksumPdu = true
        CanIfRxPduHrhIdRef = CN_B30_for_SC_CAN_V3_2_efc035d8_Rx
        CanIfRxPduRef = AMP4_ANC1_oB30_for_SC_CAN_V3_2_e4b31b97_Rx
      HUT3_oB30_for_SC_CAN_V3_2_d67db620_Tx (CanIfTxPduCfg):
        CanIfTxPduCanId = 875
        CanIfTxPduCanIdType = STANDARD_FD_CAN
        CanIfTxPduDlc = 8
        CanIfTxPduUserTxConfirmationName = PduR_CanIfTxConfirmation
        CanIfTxPduUserTxConfirmationUL = PDUR
        CanIfTxPduId = 10
        CanIfTxPduReadNotifyStatus = false
        CanIfTxPduType = STATIC
        CanIfTxPduTruncation = true
        CanIfTxPduBufferRef = CHNL_b4130143
        CanIfTxPduRef = HUT3_oB30_for_SC_CAN_V3_2_06e1d559_Tx
      9 x CanIfRxPduCfg, all with CanIfRxPduCanIdType=STANDARD_FD_CAN, CanIfRxPduDlc=8, CanIfRxPduUserRxIndicationName=PduR_CanIfRxIndication, CanIfRxPduUserRxIndicationUL=PDUR, CanIfRxPduReadData=false, CanIfRxPduReadNotifyStatus=false, CanIfRxPduDlcCheck=true, CanIfRxPduDataChecksumPdu=true, CanIfRxPduHrhIdRef=CN_B30_for_SC_CAN_V3_2_efc035d8_Rx:
        BMS4_oB30_for_SC_CAN_V3_2_4275844b_Rx: CanIfRxPduCanId=241, CanIfRxPduId=133, CanIfRxPduRef=BMS4_oB30_for_SC_CAN_V3_2_15d37a43_Rx
        CSA2_oB30_for_SC_CAN_V3_2_d5a053f8_Rx: CanIfRxPduCanId=161, CanIfRxPduId=138, CanIfRxPduRef=CSA2_oB30_for_SC_CAN_V3_2_214ae38a_Rx
        ECM19_oB30_for_SC_CAN_V3_2_488984df_Rx: CanIfRxPduCanId=949, CanIfRxPduId=14, CanIfRxPduRef=ECM19_oB30_for_SC_CAN_V3_2_bc1c71de_Rx
        DDCM1_oB30_for_SC_CAN_V3_2_7340df60_Rx: CanIfRxPduCanId=714, CanIfRxPduId=59, CanIfRxPduRef=DDCM1_oB30_for_SC_CAN_V3_2_b3033028_Rx
        CSA3_oB30_for_SC_CAN_V3_2_2d924efb_Rx: CanIfRxPduCanId=580, CanIfRxPduId=91, CanIfRxPduRef=CSA3_oB30_for_SC_CAN_V3_2_eb741019_Rx
        WPC1_oB30_for_SC_CAN_V3_2_08a4c96d_Rx: CanIfRxPduCanId=698, CanIfRxPduId=63, CanIfRxPduRef=WPC1_oB30_for_SC_CAN_V3_2_e844e41f_Rx
        AMP1_oB30_for_SC_CAN_V3_2_c309c629_Rx: CanIfRxPduCanId=993, CanIfRxPduId=10, CanIfRxPduRef=AMP1_oB30_for_SC_CAN_V3_2_f94fb5d3_Rx
        ECM9_oB30_for_SC_CAN_V3_2_51bf62c9_Rx: CanIfRxPduCanId=258, CanIfRxPduId=131, CanIfRxPduRef=ECM9_oB30_for_SC_CAN_V3_2_426f809c_Rx
        ABM2_oB30_for_SC_CAN_V3_2_b111794d_Rx: CanIfRxPduCanId=581, CanIfRxPduId=90, CanIfRxPduRef=ABM2_oB30_for_SC_CAN_V3_2_5851072c_Rx
      HUT17_oB30_for_SC_CAN_V3_2_95789025_Tx (CanIfTxPduCfg):
        CanIfTxPduCanId = 827
        CanIfTxPduCanIdType = STANDARD_FD_CAN
        CanIfTxPduDlc = 8
        CanIfTxPduUserTxConfirmationName = PduR_CanIfTxConfirmation
        CanIfTxPduUserTxConfirmationUL = PDUR
        CanIfTxPduId = 13
        CanIfTxPduReadNotifyStatus = false
        CanIfTxPduType = STATIC
        CanIfTxPduTruncation = true
        CanIfTxPduBufferRef = CHNL_b4130143
        CanIfTxPduRef = HUT17_oB30_for_SC_CAN_V3_2_4a1d7d30_Tx
      HCU_HC7_oB30_for_SC_CAN_V3_2_144709d5_Rx (CanIfRxPduCfg):
        CanIfRxPduCanId = 962
        CanIfRxPduCanIdType = STANDARD_FD_CAN
        CanIfRxPduDlc = 8
        CanIfRxPduUserRxIndicationName = PduR_CanIfRxIndication
        CanIfRxPduUserRxIndicationUL = PDUR
        CanIfRxPduId = 11
        CanIfRxPduReadData = false
        CanIfRxPduReadNotifyStatus = false
        CanIfRxPduDlcCheck = true
        CanIfRxPduDataChecksumPdu = true
        CanIfRxPduHrhIdRef = CN_B30_for_SC_CAN_V3_2_efc035d8_Rx
        CanIfRxPduRef = HCU_HC7_oB30_for_SC_CAN_V3_2_7b235adf_Rx
      CHNL_b4130143 (CanIfBufferCfg):
        CanIfBufferSize = 38
        CanIfTxBufferHandlingType = PRIO_BY_CANID
        CanIfTxBufferMappedTxPdus = 38
        CanIfTxBufferMaxPduLength = 64
        CanIfBufferHthRef = CN_B30_for_SC_CAN_V3_2_c0d6c67b_Tx
      HUT10_oB30_for_SC_CAN_V3_2_3f69b5b6_Tx (CanIfTxPduCfg):
        CanIfTxPduCanId = 817
        CanIfTxPduCanIdType = STANDARD_FD_CAN
        CanIfTxPduDlc = 8
        CanIfTxPduUserTxConfirmationName = PduR_CanIfTxConfirmation
        CanIfTxPduUserTxConfirmationUL = PDUR
        CanIfTxPduId = 15
        CanIfTxPduReadNotifyStatus = false
        CanIfTxPduType = STATIC
        CanIfTxPduTruncation = true
        CanIfTxPduBufferRef = CHNL_b4130143
        CanIfTxPduRef = HUT10_oB30_for_SC_CAN_V3_2_5136ad0a_Tx
      CanIfInitHohCfg: CanIfInitRefCfgSet=CanConfigSet
        CN_B30_for_SC_CAN_V3_2_c0d6c67b_Tx (CanIfHthCfg): CanIfHthCanCtrlIdRef=CT_B30_for_SC_CAN_V3_2_4a04dc9c, CanIfHthIdSymRef=CN_B30_for_SC_CAN_V3_2_c0d6c67b_Tx
        3 x CanIfHrhCfg, all with CanIfHrhSoftwareFilter=true:
          CN_B30_for_SC_CAN_V3_2_efc035d8_Rx: CanIfHrhCanCtrlIdRef=CT_B30_for_SC_CAN_V3_2_4a04dc9c, CanIfHrhIdSymRef=CN_B30_for_SC_CAN_V3_2_efc035d8_Rx
          CN_B30_for_SC_CAN_V3_2_efc035d8_Rx_001: CanIfHrhCanCtrlIdRef=CT_B30_for_SC_CAN_V3_2_4a04dc9c_001, CanIfHrhIdSymRef=CN_B30_for_SC_CAN_V3_2_efc035d8_Rx_001
          CN_B30_for_SC_CAN_V3_2_efc035d8_Rx_002: CanIfHrhCanCtrlIdRef=CT_B30_for_SC_CAN_V3_2_4a04dc9c_002, CanIfHrhIdSymRef=CN_B30_for_SC_CAN_V3_2_efc035d8_Rx_002
        18 x CanIfHthCfg, all with CanIfHthCanCtrlIdRef=CT_B30_for_SC_CAN_V3_2_4a04dc9c:
          CanIfHthCfg_IP3_oB30_for_SC_CAN_V3_2_8dd4dc90_Tx: CanIfHthIdSymRef=CanHardwareObject_IP3_oB30_for_SC_CAN_V3_2_8dd4dc90_Tx
          CanIfHthCfg_IP2_Sc_oB30_for_SC_CAN_V3_2_fb13b195_Tx: CanIfHthIdSymRef=CanHardwareObject_IP2_Sc_oB30_for_SC_CAN_V3_2_fb13b195_Tx
          CanIfHthCfg_IP1_oB30_for_SC_CAN_V3_2_c2bc6804_Tx: CanIfHthIdSymRef=CanHardwareObject_IP1_oB30_for_SC_CAN_V3_2_c2bc6804_Tx
          CanIfHthCfg_HUT_FD1_Sc_oB30_for_SC_CAN_V3_2_ad4f6083_Tx: CanIfHthIdSymRef=CanHardwareObject_HUT_FD1_Sc_oB30_for_SC_CAN_V3_2_ad4f6083_Tx
          CanIfHthCfg_HUT_FD2_oB30_for_SC_CAN_V3_2_19e0e547_Tx: CanIfHthIdSymRef=CanHardwareObject_HUT_FD2_oB30_for_SC_CAN_V3_2_19e0e547_Tx
          CanIfHthCfg_HUT_FD3_oB30_for_SC_CAN_V3_2_e3a63189_Tx: CanIfHthIdSymRef=CanHardwareObject_HUT_FD3_oB30_for_SC_CAN_V3_2_e3a63189_Tx
          CanIfHthCfg_HUT40_oB30_for_SC_CAN_V3_2_f7205ed1_Tx: CanIfHthIdSymRef=CanHardwareObject_HUT40_oB30_for_SC_CAN_V3_2_f7205ed1_Tx
          CanIfHthCfg_HUT34_oB30_for_SC_CAN_V3_2_f7db0848_Tx: CanIfHthIdSymRef=CanHardwareObject_HUT34_oB30_for_SC_CAN_V3_2_f7db0848_Tx
          CanIfHthCfg_HUT32_oB30_for_SC_CAN_V3_2_aa274fab_Tx: CanIfHthIdSymRef=CanHardwareObject_HUT32_oB30_for_SC_CAN_V3_2_aa274fab_Tx
          CanIfHthCfg_HUT31_oB30_for_SC_CAN_V3_2_6961ef7a_Tx: CanIfHthIdSymRef=CanHardwareObject_HUT31_oB30_for_SC_CAN_V3_2_6961ef7a_Tx
          CanIfHthCfg_HUT26_oB30_for_SC_CAN_V3_2_938256b7_Tx: CanIfHthIdSymRef=CanHardwareObject_HUT26_oB30_for_SC_CAN_V3_2_938256b7_Tx
          CanIfHthCfg_HUT19_oB30_for_SC_CAN_V3_2_1a2bdd42_Tx: CanIfHthIdSymRef=CanHardwareObject_HUT19_oB30_for_SC_CAN_V3_2_1a2bdd42_Tx
          CanIfHthCfg_HUT16_oB30_for_SC_CAN_V3_2_6295f255_Tx: CanIfHthIdSymRef=CanHardwareObject_HUT16_oB30_for_SC_CAN_V3_2_6295f255_Tx
          CanIfHthCfg_HUT13_oB30_for_SC_CAN_V3_2_fc2f1567_Tx: CanIfHthIdSymRef=CanHardwareObject_HUT13_oB30_for_SC_CAN_V3_2_fc2f1567_Tx
          CanIfHthCfg_HUT12_oB30_for_SC_CAN_V3_2_0bc27717_Tx: CanIfHthIdSymRef=CanHardwareObject_HUT12_oB30_for_SC_CAN_V3_2_0bc27717_Tx
          CanIfHthCfg_DMS_FD1_oB30_for_SC_CAN_V3_2_1702aefa_Tx: CanIfHthIdSymRef=CanHardwareObject_DMS_FD1_oB30_for_SC_CAN_V3_2_1702aefa_Tx
          CanIfHthCfg_DVR_FD1_oB30_for_SC_CAN_V3_2_2030c8ae_Tx: CanIfHthIdSymRef=CanHardwareObject_DVR_FD1_oB30_for_SC_CAN_V3_2_2030c8ae_Tx
          CanIfHthCfg_HUT27_oB30_for_SC_CAN_V3_2_646f34c7_Tx: CanIfHthIdSymRef=CanHardwareObject_HUT27_oB30_for_SC_CAN_V3_2_646f34c7_Tx
      HUT22_oB30_for_SC_CAN_V3_2_fad5d3f5_Tx (CanIfTxPduCfg):
        CanIfTxPduCanId = 730
        CanIfTxPduCanIdType = STANDARD_FD_CAN
        CanIfTxPduDlc = 8
        CanIfTxPduUserTxConfirmationName = PduR_CanIfTxConfirmation
        CanIfTxPduUserTxConfirmationUL = PDUR
        CanIfTxPduId = 18
        CanIfTxPduReadNotifyStatus = false
        CanIfTxPduType = STATIC
        CanIfTxPduTruncation = true
        CanIfTxPduBufferRef = CHNL_b4130143
        CanIfTxPduRef = HUT22_oB30_for_SC_CAN_V3_2_a46f487a_Tx
      AC2_oB30_for_SC_CAN_V3_2_cda990a5_Rx (CanIfRxPduCfg):
        CanIfRxPduCanId = 901
        CanIfRxPduCanIdType = STANDARD_FD_CAN
        CanIfRxPduDlc = 8
        CanIfRxPduUserRxIndicationName = PduR_CanIfRxIndication
        CanIfRxPduUserRxIndicationUL = PDUR
        CanIfRxPduId = 17
        CanIfRxPduReadData = false
        CanIfRxPduReadNotifyStatus = false
        CanIfRxPduDlcCheck = true
        CanIfRxPduDataChecksumPdu = true
        CanIfRxPduHrhIdRef = CN_B30_for_SC_CAN_V3_2_efc035d8_Rx
        CanIfRxPduRef = AC2_oB30_for_SC_CAN_V3_2_b771a69a_Rx
      PEPS2_oB30_for_SC_CAN_V3_2_10fa9b50_Rx (CanIfRxPduCfg):
        CanIfRxPduCanId = 661
        CanIfRxPduCanIdType = STANDARD_FD_CAN
        CanIfRxPduDlc = 8
        CanIfRxPduUserRxIndicationName = PduR_CanIfRxIndication
        CanIfRxPduUserRxIndicationUL = PDUR
        CanIfRxPduId = 75
        CanIfRxPduReadData = false
        CanIfRxPduReadNotifyStatus = false
        CanIfRxPduDlcCheck = true
        CanIfRxPduDataChecksumPdu = true
        CanIfRxPduHrhIdRef = CN_B30_for_SC_CAN_V3_2_efc035d8_Rx
        CanIfRxPduRef = PEPS2_oB30_for_SC_CAN_V3_2_8c308c2e_Rx
      HUT30_oB30_for_SC_CAN_V3_2_9e8c8d0a_Tx (CanIfTxPduCfg):
        CanIfTxPduCanId = 489
        CanIfTxPduCanIdType = STANDARD_FD_CAN
        CanIfTxPduDlc = 8
        CanIfTxPduUserTxConfirmationName = PduR_CanIfTxConfirmation
        CanIfTxPduUserTxConfirmationUL = PDUR
        CanIfTxPduId = 27
        CanIfTxPduReadNotifyStatus = false
        CanIfTxPduType = STATIC
        CanIfTxPduTruncation = true
        CanIfTxPduBufferRef = CHNL_b4130143
        CanIfTxPduRef = HUT30_oB30_for_SC_CAN_V3_2_82af5510_Tx
      ECM1_oB30_for_SC_CAN_V3_2_fdeb93d5_Rx (CanIfRxPduCfg):
        CanIfRxPduCanId = 273
        CanIfRxPduCanIdType = STANDARD_FD_CAN
        CanIfRxPduDlc = 8
        CanIfRxPduUserRxIndicationName = PduR_CanIfRxIndication
        CanIfRxPduUserRxIndicationUL = PDUR
        CanIfRxPduId = 129
        CanIfRxPduReadData = false
        CanIfRxPduReadNotifyStatus = false
        CanIfRxPduDlcCheck = true
        CanIfRxPduDataChecksumPdu = true
        CanIfRxPduHrhIdRef = CN_B30_for_SC_CAN_V3_2_efc035d8_Rx
        CanIfRxPduRef = ECM1_oB30_for_SC_CAN_V3_2_a52d0341_Rx
      HUT20_oB30_for_SC_CAN_V3_2_ce7e1154_Tx (CanIfTxPduCfg):
        CanIfTxPduCanId = 734
        CanIfTxPduCanIdType = STANDARD_FD_CAN
        CanIfTxPduDlc = 8
        CanIfTxPduUserTxConfirmationName = PduR_CanIfTxConfirmation
        CanIfTxPduUserTxConfirmationUL = PDUR
        CanIfTxPduId = 16
        CanIfTxPduReadNotifyStatus = false
        CanIfTxPduType = STATIC
        CanIfTxPduTruncation = true
        CanIfTxPduBufferRef = CHNL_b4130143
        CanIfTxPduRef = HUT20_oB30_for_SC_CAN_V3_2_eb63a91d_Tx
      BCM12_oB30_for_SC_CAN_V3_2_adc98d2d_Rx (CanIfRxPduCfg):
        CanIfRxPduCanId = 568
        CanIfRxPduCanIdType = STANDARD_FD_CAN
        CanIfRxPduDlc = 8
        CanIfRxPduUserRxIndicationName = PduR_CanIfRxIndication
        CanIfRxPduUserRxIndicationUL = PDUR
        CanIfRxPduId = 93
        CanIfRxPduReadData = false
        CanIfRxPduReadNotifyStatus = false
        CanIfRxPduDlcCheck = true
        CanIfRxPduDataChecksumPdu = true
        CanIfRxPduHrhIdRef = CN_B30_for_SC_CAN_V3_2_efc035d8_Rx
        CanIfRxPduRef = BCM12_oB30_for_SC_CAN_V3_2_3066f987_Rx
      HUT1_oB30_for_SC_CAN_V3_2_fd688a67_Tx (CanIfTxPduCfg):
        CanIfTxPduCanId = 871
        CanIfTxPduCanIdType = STANDARD_FD_CAN
        CanIfTxPduDlc = 8
        CanIfTxPduUserTxConfirmationName = PduR_CanIfTxConfirmation
        CanIfTxPduUserTxConfirmationUL = PDUR
        CanIfTxPduId = 12
        CanIfTxPduReadNotifyStatus = false
        CanIfTxPduType = STATIC
        CanIfTxPduTruncation = true
        CanIfTxPduBufferRef = CHNL_b4130143
        CanIfTxPduRef = HUT1_oB30_for_SC_CAN_V3_2_49ed343e_Tx
      8 x CanIfRxPduCfg, all with CanIfRxPduCanIdType=STANDARD_FD_CAN, CanIfRxPduDlc=8, CanIfRxPduUserRxIndicationName=PduR_CanIfRxIndication, CanIfRxPduUserRxIndicationUL=PDUR, CanIfRxPduReadData=false, CanIfRxPduReadNotifyStatus=false, CanIfRxPduDlcCheck=true, CanIfRxPduDataChecksumPdu=true, CanIfRxPduHrhIdRef=CN_B30_for_SC_CAN_V3_2_efc035d8_Rx:
        PEPS4_oB30_for_SC_CAN_V3_2_4d06dcb3_Rx: CanIfRxPduCanId=770, CanIfRxPduId=43, CanIfRxPduRef=PEPS4_oB30_for_SC_CAN_V3_2_5d25af87_Rx
        HUD1_oB30_for_SC_CAN_V3_2_d4329b1b_Rx: CanIfRxPduCanId=805, CanIfRxPduId=30, CanIfRxPduRef=HUD1_oB30_for_SC_CAN_V3_2_6397ebab_Rx
        BCM8_oB30_for_SC_CAN_V3_2_207df679_Rx: CanIfRxPduCanId=671, CanIfRxPduId=70, CanIfRxPduRef=BCM8_oB30_for_SC_CAN_V3_2_8c292f0d_Rx
        ABS1_oB30_for_SC_CAN_V3_2_bd04049b_Rx: CanIfRxPduCanId=561, CanIfRxPduId=95, CanIfRxPduRef=ABS1_oB30_for_SC_CAN_V3_2_a04728c8_Rx
        EEM1_oB30_for_SC_CAN_V3_2_96620764_Rx: CanIfRxPduCanId=680, CanIfRxPduId=68, CanIfRxPduRef=EEM1_oB30_for_SC_CAN_V3_2_788fa486_Rx
        DCT3_oB30_for_SC_CAN_V3_2_470556ca_Rx: CanIfRxPduCanId=166, CanIfRxPduId=137, CanIfRxPduRef=DCT3_oB30_for_SC_CAN_V3_2_50b784e2_Rx
        DSM1_oB30_for_SC_CAN_V3_2_918c77ee_Rx: CanIfRxPduCanId=705, CanIfRxPduId=61, CanIfRxPduRef=DSM1_oB30_for_SC_CAN_V3_2_24c7b7e3_Rx
        ECM4_oB30_for_SC_CAN_V3_2_53f3f658_Rx: CanIfRxPduCanId=130, CanIfRxPduId=142, CanIfRxPduRef=ECM4_oB30_for_SC_CAN_V3_2_f10a321c_Rx
      HUT16_oB30_for_SC_CAN_V3_2_6295f255_Tx (CanIfTxPduCfg):
        CanIfTxPduCanId = 840
        CanIfTxPduCanIdType = STANDARD_FD_CAN
        CanIfTxPduDlc = 8
        CanIfTxPduUserTxConfirmationName = PduR_CanIfTxConfirmation
        CanIfTxPduUserTxConfirmationUL = PDUR
        CanIfTxPduId = 42
        CanIfTxPduReadNotifyStatus = false
        CanIfTxPduType = STATIC
        CanIfTxPduTruncation = true
        CanIfTxPduBufferRef = CanIfBufferCfg_HUT16_oB30_for_SC_CAN_V3_2_6295f255_Tx
        CanIfTxPduRef = HUT16_oB30_for_SC_CAN_V3_2_80238ea3_Tx
      3 x CanIfRxPduCfg, all with CanIfRxPduCanIdType=STANDARD_FD_CAN, CanIfRxPduDlc=8, CanIfRxPduUserRxIndicationName=PduR_CanIfRxIndication, CanIfRxPduUserRxIndicationUL=PDUR, CanIfRxPduReadData=false, CanIfRxPduReadNotifyStatus=false, CanIfRxPduDlcCheck=true, CanIfRxPduDataChecksumPdu=true, CanIfRxPduHrhIdRef=CN_B30_for_SC_CAN_V3_2_efc035d8_Rx:
        CSA1_oB30_for_SC_CAN_V3_2_068772bc_Rx: CanIfRxPduCanId=357, CanIfRxPduId=117, CanIfRxPduRef=CSA1_oB30_for_SC_CAN_V3_2_a478f17e_Rx
        ESP8_oB30_for_SC_CAN_V3_2_5e47e6f6_Rx: CanIfRxPduCanId=368, CanIfRxPduId=114, CanIfRxPduRef=ESP8_oB30_for_SC_CAN_V3_2_cf6f571c_Rx
        ESP11_oB30_for_SC_CAN_V3_2_e67254f2_Rx: CanIfRxPduCanId=200, CanIfRxPduId=134, CanIfRxPduRef=ESP11_oB30_for_SC_CAN_V3_2_dfa78df9_Rx
      HUT33_oB30_for_SC_CAN_V3_2_5dca2ddb_Tx (CanIfTxPduCfg):
        CanIfTxPduCanId = 493
        CanIfTxPduCanIdType = STANDARD_FD_CAN
        CanIfTxPduDlc = 8
        CanIfTxPduUserTxConfirmationName = PduR_CanIfTxConfirmation
        CanIfTxPduUserTxConfirmationUL = PDUR
        CanIfTxPduId = 24
        CanIfTxPduReadNotifyStatus = false
        CanIfTxPduType = STATIC
        CanIfTxPduTruncation = true
        CanIfTxPduBufferRef = CHNL_b4130143
        CanIfTxPduRef = HUT33_oB30_for_SC_CAN_V3_2_079d47e4_Tx
      4 x CanIfRxPduCfg, all with CanIfRxPduCanIdType=STANDARD_FD_CAN, CanIfRxPduDlc=8, CanIfRxPduUserRxIndicationName=PduR_CanIfRxIndication, CanIfRxPduUserRxIndicationUL=PDUR, CanIfRxPduReadData=false, CanIfRxPduReadNotifyStatus=false, CanIfRxPduDlcCheck=true, CanIfRxPduDataChecksumPdu=true, CanIfRxPduHrhIdRef=CN_B30_for_SC_CAN_V3_2_efc035d8_Rx:
        ECM2_oB30_for_SC_CAN_V3_2_2eccb291_Rx: CanIfRxPduCanId=625, CanIfRxPduId=84, CanIfRxPduRef=ECM2_oB30_for_SC_CAN_V3_2_201f11b5_Rx
        ABS2_oB30_for_SC_CAN_V3_2_6e2325df_Rx: CanIfRxPduCanId=582, CanIfRxPduId=89, CanIfRxPduRef=ABS2_oB30_for_SC_CAN_V3_2_25753a3c_Rx
        ECM3_oB30_for_SC_CAN_V3_2_d6feaf92_Rx: CanIfRxPduCanId=881, CanIfRxPduId=18, CanIfRxPduRef=ECM3_oB30_for_SC_CAN_V3_2_ea21e226_Rx
        ECM20_oB30_for_SC_CAN_V3_2_9cdc48c9_Rx: CanIfRxPduCanId=951, CanIfRxPduId=13, CanIfRxPduRef=ECM20_oB30_for_SC_CAN_V3_2_2b350587_Rx
      HUT4_oB30_for_SC_CAN_V3_2_5370efea_Tx (CanIfTxPduCfg):
        CanIfTxPduCanId = 877
        CanIfTxPduCanIdType = STANDARD_FD_CAN
        CanIfTxPduDlc = 8
        CanIfTxPduUserTxConfirmationName = PduR_CanIfTxConfirmation
        CanIfTxPduUserTxConfirmationUL = PDUR
        CanIfTxPduId = 9
        CanIfTxPduReadNotifyStatus = false
        CanIfTxPduType = STATIC
        CanIfTxPduTruncation = true
        CanIfTxPduBufferRef = CHNL_b4130143
        CanIfTxPduRef = HUT4_oB30_for_SC_CAN_V3_2_1dca0563_Tx
      6 x CanIfRxPduCfg, all with CanIfRxPduCanIdType=STANDARD_FD_CAN, CanIfRxPduUserRxIndicationName=PduR_CanIfRxIndication, CanIfRxPduUserRxIndicationUL=PDUR, CanIfRxPduReadData=false, CanIfRxPduReadNotifyStatus=false, CanIfRxPduDlcCheck=true, CanIfRxPduDataChecksumPdu=true, CanIfRxPduHrhIdRef=CN_B30_for_SC_CAN_V3_2_efc035d8_Rx:
        IFC_FD6_oB30_for_SC_CAN_V3_2_2c9ef882_Rx: CanIfRxPduCanId=546, CanIfRxPduDlc=64, CanIfRxPduId=97, CanIfRxPduRef=IFC_FD6_oB30_for_SC_CAN_V3_2_18456d2f_Rx
        RSDS_FD2_oB30_for_SC_CAN_V3_2_636e054f_Rx: CanIfRxPduCanId=778, CanIfRxPduDlc=64, CanIfRxPduId=38, CanIfRxPduRef=RSDS_FD2_oB30_for_SC_CAN_V3_2_30a525da_Rx
        IFC_FD5_oB30_for_SC_CAN_V3_2_f9248391_Rx: CanIfRxPduCanId=415, CanIfRxPduDlc=64, CanIfRxPduId=110, CanIfRxPduRef=IFC_FD5_oB30_for_SC_CAN_V3_2_9d777fdb_Rx
        ACC_FD3_oB30_for_SC_CAN_V3_2_42104251_Rx: CanIfRxPduCanId=692, CanIfRxPduDlc=64, CanIfRxPduId=66, CanIfRxPduRef=ACC_FD3_oB30_for_SC_CAN_V3_2_e2f593d9_Rx
        ACC_FD4_oB30_for_SC_CAN_V3_2_c85366f8_Rx: CanIfRxPduCanId=696, CanIfRxPduDlc=64, CanIfRxPduId=65, CanIfRxPduRef=ACC_FD4_oB30_for_SC_CAN_V3_2_f9de43e3_Rx
        IFC1_oB30_for_SC_CAN_V3_2_1b1d10af_Rx: CanIfRxPduCanId=265, CanIfRxPduDlc=8, CanIfRxPduId=130, CanIfRxPduRef=IFC1_oB30_for_SC_CAN_V3_2_a7037da8_Rx
      HUT39_oB30_for_SC_CAN_V3_2_bbcee5fe_Tx (CanIfTxPduCfg):
        CanIfTxPduCanId = 491
        CanIfTxPduCanIdType = STANDARD_FD_CAN
        CanIfTxPduDlc = 8
        CanIfTxPduUserTxConfirmationName = PduR_CanIfTxConfirmation
        CanIfTxPduUserTxConfirmationUL = PDUR
        CanIfTxPduId = 26
        CanIfTxPduReadNotifyStatus = false
        CanIfTxPduType = STATIC
        CanIfTxPduTruncation = true
        CanIfTxPduBufferRef = CHNL_b4130143
        CanIfTxPduRef = HUT39_oB30_for_SC_CAN_V3_2_afd3255e_Tx
      DVR_FD1_oB30_for_SC_CAN_V3_2_2030c8ae_Tx (CanIfTxPduCfg):
        CanIfTxPduCanId = 748
        CanIfTxPduCanIdType = STANDARD_FD_CAN
        CanIfTxPduDlc = 64
        CanIfTxPduUserTxConfirmationName = PduR_CanIfTxConfirmation
        CanIfTxPduUserTxConfirmationUL = PDUR
        CanIfTxPduId = 45
        CanIfTxPduReadNotifyStatus = false
        CanIfTxPduType = STATIC
        CanIfTxPduTruncation = true
        CanIfTxPduBufferRef = CanIfBufferCfg_DVR_FD1_oB30_for_SC_CAN_V3_2_2030c8ae_Tx
        CanIfTxPduRef = DVR_FD1_oB30_for_SC_CAN_V3_2_d1b20623_Tx
      CR_FD1_oB30_for_SC_CAN_V3_2_6ad188d2_Rx (CanIfRxPduCfg):
        CanIfRxPduCanId = 350
        CanIfRxPduCanIdType = STANDARD_FD_CAN
        CanIfRxPduDlc = 64
        CanIfRxPduUserRxIndicationName = PduR_CanIfRxIndication
        CanIfRxPduUserRxIndicationUL = PDUR
        CanIfRxPduId = 118
        CanIfRxPduReadData = false
        CanIfRxPduReadNotifyStatus = false
        CanIfRxPduDlcCheck = true
        CanIfRxPduDataChecksumPdu = true
        CanIfRxPduHrhIdRef = CN_B30_for_SC_CAN_V3_2_efc035d8_Rx
        CanIfRxPduRef = CR_FD1_oB30_for_SC_CAN_V3_2_ae29d598_Rx
      NMRange_oB30_for_SC_CAN_V3_2_bdc4688d_Rx (CanIfRxPduCfg):
        CanIfRxPduCanIdType = STANDARD_NO_FD_CAN
        CanIfRxPduDlc = 8
        CanIfRxPduId = 0
        CanIfRxPduReadData = false
        CanIfRxPduReadNotifyStatus = false
        CanIfRxPduUserRxIndicationName = CanNm_RxIndication
        CanIfRxPduUserRxIndicationUL = CAN_NM
        CanIfRxPduDlcCheck = true
        CanIfRxPduDataChecksumPdu = true
        CanIfRxPduHrhIdRef = CN_B30_for_SC_CAN_V3_2_efc035d8_Rx
        CanIfRxPduRef = NMRange_oB30_for_SC_CAN_V3_2_ac4231d8_Rx
        CanIfRxPduCanIdRange: CanIfRxPduCanIdRangeLowerCanId=1280, CanIfRxPduCanIdRangeUpperCanId=1407
      HUT_FD3_oB30_for_SC_CAN_V3_2_e3a63189_Tx (CanIfTxPduCfg):
        CanIfTxPduCanId = 579
        CanIfTxPduCanIdType = STANDARD_FD_CAN
        CanIfTxPduDlc = 64
        CanIfTxPduUserTxConfirmationName = PduR_CanIfTxConfirmation
        CanIfTxPduUserTxConfirmationUL = PDUR
        CanIfTxPduId = 53
        CanIfTxPduReadNotifyStatus = false
        CanIfTxPduType = STATIC
        CanIfTxPduTruncation = true
        CanIfTxPduBufferRef = CanIfBufferCfg_HUT_FD3_oB30_for_SC_CAN_V3_2_e3a63189_Tx
        CanIfTxPduRef = HUT_FD3_oB30_for_SC_CAN_V3_2_d3f5a3ed_Tx
      HUT_FD2_oB30_for_SC_CAN_V3_2_19e0e547_Tx (CanIfTxPduCfg):
        CanIfTxPduCanId = 515
        CanIfTxPduCanIdType = STANDARD_FD_CAN
        CanIfTxPduDlc = 64
        CanIfTxPduUserTxConfirmationName = PduR_CanIfTxConfirmation
        CanIfTxPduUserTxConfirmationUL = PDUR
        CanIfTxPduId = 55
        CanIfTxPduReadNotifyStatus = false
        CanIfTxPduType = STATIC
        CanIfTxPduTruncation = true
        CanIfTxPduBufferRef = CanIfBufferCfg_HUT_FD2_oB30_for_SC_CAN_V3_2_19e0e547_Tx
        CanIfTxPduRef = HUT_FD2_oB30_for_SC_CAN_V3_2_19cb507e_Tx
      4 x CanIfRxPduCfg, all with CanIfRxPduCanIdType=STANDARD_FD_CAN, CanIfRxPduUserRxIndicationName=PduR_CanIfRxIndication, CanIfRxPduUserRxIndicationUL=PDUR, CanIfRxPduReadData=false, CanIfRxPduReadNotifyStatus=false, CanIfRxPduDlcCheck=true, CanIfRxPduDataChecksumPdu=true, CanIfRxPduHrhIdRef=CN_B30_for_SC_CAN_V3_2_efc035d8_Rx:
        HAP_FD6_oB30_for_SC_CAN_V3_2_c07e71cf_Rx: CanIfRxPduCanId=649, CanIfRxPduDlc=64, CanIfRxPduId=78, CanIfRxPduRef=HAP_FD6_oB30_for_SC_CAN_V3_2_7ba82a9d_Rx
        BCM3_Sc_oB30_for_SC_CAN_V3_2_ae909a55_Rx: CanIfRxPduCanId=837, CanIfRxPduDlc=16, CanIfRxPduId=24, CanIfRxPduRef=BCM3_Sc_oB30_for_SC_CAN_V3_2_8af269c3_Rx
        BCM1_Sc_oB30_for_SC_CAN_V3_2_816c3588_Rx: CanIfRxPduCanId=793, CanIfRxPduDlc=16, CanIfRxPduId=31, CanIfRxPduRef=BCM1_Sc_oB30_for_SC_CAN_V3_2_89b93aaf_Rx
        TPMS1_Sc_oB30_for_SC_CAN_V3_2_2ac39b2c_Rx: CanIfRxPduCanId=833, CanIfRxPduDlc=16, CanIfRxPduId=26, CanIfRxPduRef=TPMS1_Sc_oB30_for_SC_CAN_V3_2_026ce1da_Rx
      HUT_FD1_Sc_oB30_for_SC_CAN_V3_2_ad4f6083_Tx (CanIfTxPduCfg):
        CanIfTxPduCanId = 707
        CanIfTxPduCanIdType = STANDARD_FD_CAN
        CanIfTxPduDlc = 64
        CanIfTxPduUserTxConfirmationName = PduR_CanIfTxConfirmation
        CanIfTxPduUserTxConfirmationUL = PDUR
        CanIfTxPduId = 46
        CanIfTxPduReadNotifyStatus = false
        CanIfTxPduType = STATIC
        CanIfTxPduTruncation = true
        CanIfTxPduBufferRef = CanIfBufferCfg_HUT_FD1_Sc_oB30_for_SC_CAN_V3_2_ad4f6083_Tx
        CanIfTxPduRef = HUT_FD1_Sc_oB30_for_SC_CAN_V3_2_37cb1482_Tx
      HUT15_Sc_oB30_for_SC_CAN_V3_2_6348d3e5_Tx (CanIfTxPduCfg):
        CanIfTxPduCanId = 494
        CanIfTxPduCanIdType = STANDARD_FD_CAN
        CanIfTxPduDlc = 16
        CanIfTxPduUserTxConfirmationName = PduR_CanIfTxConfirmation
        CanIfTxPduUserTxConfirmationUL = PDUR
        CanIfTxPduId = 23
        CanIfTxPduReadNotifyStatus = false
        CanIfTxPduType = STATIC
        CanIfTxPduTruncation = true
        CanIfTxPduBufferRef = CHNL_b4130143
        CanIfTxPduRef = HUT15_Sc_oB30_for_SC_CAN_V3_2_03f030a3_Tx
      6 x CanIfRxPduCfg, all with CanIfRxPduCanIdType=STANDARD_FD_CAN, CanIfRxPduUserRxIndicationName=PduR_CanIfRxIndication, CanIfRxPduUserRxIndicationUL=PDUR, CanIfRxPduReadData=false, CanIfRxPduReadNotifyStatus=false, CanIfRxPduDlcCheck=true, CanIfRxPduDataChecksumPdu=true, CanIfRxPduHrhIdRef=CN_B30_for_SC_CAN_V3_2_efc035d8_Rx:
        ABM1_Sc_oB30_for_SC_CAN_V3_2_acb4c490_Rx: CanIfRxPduCanId=849, CanIfRxPduDlc=16, CanIfRxPduId=21, CanIfRxPduRef=ABM1_Sc_oB30_for_SC_CAN_V3_2_bdd35fd4_Rx
        AEB_FD2_Sc_oB30_for_SC_CAN_V3_2_d523569e_Rx: CanIfRxPduCanId=551, CanIfRxPduDlc=64, CanIfRxPduId=96, CanIfRxPduRef=AEB_FD2_Sc_oB30_for_SC_CAN_V3_2_2f1f8022_Rx
        TPMS2_Sc_oB30_for_SC_CAN_V3_2_1c8c62f0_Rx: CanIfRxPduCanId=917, CanIfRxPduDlc=16, CanIfRxPduId=16, CanIfRxPduRef=TPMS2_Sc_oB30_for_SC_CAN_V3_2_00821b00_Rx
        AMP2_Sc_oB30_for_SC_CAN_V3_2_85f1b9ac_Rx: CanIfRxPduCanId=995, CanIfRxPduDlc=16, CanIfRxPduId=9, CanIfRxPduRef=AMP2_Sc_oB30_for_SC_CAN_V3_2_2fb79ac1_Rx
        ACC_FD2_Sc_oB30_for_SC_CAN_V3_2_bd00e6e5_Rx: CanIfRxPduCanId=683, CanIfRxPduDlc=64, CanIfRxPduId=67, CanIfRxPduRef=ACC_FD2_Sc_oB30_for_SC_CAN_V3_2_c90195d6_Rx
        IFC_FD2_Sc_oB30_for_SC_CAN_V3_2_ccd6702c_Rx: CanIfRxPduCanId=573, CanIfRxPduDlc=64, CanIfRxPduId=92, CanIfRxPduRef=IFC_FD2_Sc_oB30_for_SC_CAN_V3_2_3e25ea9f_Rx
      4 x CanIfTxPduCfg, all with CanIfTxPduCanIdType=STANDARD_FD_CAN, CanIfTxPduUserTxConfirmationName=PduR_CanIfTxConfirmation, CanIfTxPduUserTxConfirmationUL=PDUR, CanIfTxPduReadNotifyStatus=false, CanIfTxPduType=STATIC, CanIfTxPduTruncation=true:
        HUT35_oB30_for_SC_CAN_V3_2_00366a38_Tx: CanIfTxPduCanId=485, CanIfTxPduDlc=8, CanIfTxPduId=30, CanIfTxPduBufferRef=CHNL_b4130143, CanIfTxPduRef=HUT35_oB30_for_SC_CAN_V3_2_d688644d_Tx
        IP2_Sc_oB30_for_SC_CAN_V3_2_fb13b195_Tx: CanIfTxPduCanId=639, CanIfTxPduDlc=16, CanIfTxPduId=50, CanIfTxPduBufferRef=CanIfBufferCfg_IP2_Sc_oB30_for_SC_CAN_V3_2_fb13b195_Tx, CanIfTxPduRef=IP2_Sc_oB30_for_SC_CAN_V3_2_3598fa68_Tx
        IP3_oB30_for_SC_CAN_V3_2_8dd4dc90_Tx: CanIfTxPduCanId=842, CanIfTxPduDlc=16, CanIfTxPduId=41, CanIfTxPduBufferRef=CanIfBufferCfg_IP3_oB30_for_SC_CAN_V3_2_8dd4dc90_Tx, CanIfTxPduRef=IP3_oB30_for_SC_CAN_V3_2_ad470001_Tx
        DMS_FD1_oB30_for_SC_CAN_V3_2_1702aefa_Tx: CanIfTxPduCanId=589, CanIfTxPduDlc=64, CanIfTxPduId=52, CanIfTxPduBufferRef=CanIfBufferCfg_DMS_FD1_oB30_for_SC_CAN_V3_2_1702aefa_Tx, CanIfTxPduRef=DMS_FD1_oB30_for_SC_CAN_V3_2_3b8624c3_Tx
      DDCM3_oB30_for_SC_CAN_V3_2_47eb1dc1_Rx (CanIfRxPduCfg):
        CanIfRxPduCanId = 759
        CanIfRxPduCanIdType = STANDARD_FD_CAN
        CanIfRxPduDlc = 8
        CanIfRxPduUserRxIndicationName = PduR_CanIfRxIndication
        CanIfRxPduUserRxIndicationUL = PDUR
        CanIfRxPduId = 48
        CanIfRxPduReadData = false
        CanIfRxPduReadNotifyStatus = false
        CanIfRxPduDlcCheck = true
        CanIfRxPduDataChecksumPdu = true
        CanIfRxPduHrhIdRef = CN_B30_for_SC_CAN_V3_2_efc035d8_Rx
        CanIfRxPduRef = DDCM3_oB30_for_SC_CAN_V3_2_fc0fd14f_Rx
      IP1_oB30_for_SC_CAN_V3_2_c2bc6804_Tx (CanIfTxPduCfg):
        CanIfTxPduCanId = 659
        CanIfTxPduCanIdType = STANDARD_FD_CAN
        CanIfTxPduDlc = 8
        CanIfTxPduUserTxConfirmationName = PduR_CanIfTxConfirmation
        CanIfTxPduUserTxConfirmationUL = PDUR
        CanIfTxPduId = 49
        CanIfTxPduReadNotifyStatus = false
        CanIfTxPduType = STATIC
        CanIfTxPduTruncation = true
        CanIfTxPduBufferRef = CanIfBufferCfg_IP1_oB30_for_SC_CAN_V3_2_c2bc6804_Tx
        CanIfTxPduRef = IP1_oB30_for_SC_CAN_V3_2_e24be166_Tx
      GW_Sync_Req_Sc_oB30_for_SC_CAN_V3_2_9379f94a_Rx (CanIfRxPduCfg):
        CanIfRxPduCanId = 1121
        CanIfRxPduCanIdType = STANDARD_FD_CAN
        CanIfRxPduDlc = 16
        CanIfRxPduUserRxIndicationName = PduR_CanIfRxIndication
        CanIfRxPduUserRxIndicationUL = PDUR
        CanIfRxPduId = 5
        CanIfRxPduReadData = false
        CanIfRxPduReadNotifyStatus = false
        CanIfRxPduDlcCheck = true
        CanIfRxPduDataChecksumPdu = true
        CanIfRxPduHrhIdRef = CN_B30_for_SC_CAN_V3_2_efc035d8_Rx
        CanIfRxPduRef = GW_Sync_Req_Sc_oB30_for_SC_CAN_V3_2_21657c6a_Rx
      HUT_Phy_Resp_Tp_oB30_for_SC_CAN_V3_2_20_228bf6a1_Tx (CanIfTxPduCfg):
        CanIfTxPduCanId = 1971
        CanIfTxPduCanIdType = STANDARD_CAN
        CanIfTxPduDlc = 8
        CanIfTxPduUserTxConfirmationName = CanTp_TxConfirmation
        CanIfTxPduUserTxConfirmationUL = CAN_TP
        CanIfTxPduId = 0
        CanIfTxPduReadNotifyStatus = false
        CanIfTxPduType = STATIC
        CanIfTxPduTruncation = true
        CanIfTxPduBufferRef = CHNL_b4130143
        CanIfTxPduRef = HUT_Phy_Resp_Tp_oB30_for_SC_CAN_V3_2_20_4bbb4ddf_Tx
      4 x CanIfRxPduCfg, all with CanIfRxPduDlc=8, CanIfRxPduUserRxIndicationName=CanTp_RxIndication, CanIfRxPduUserRxIndicationType=PDUID_PDUINFOPTR, CanIfRxPduUserRxIndicationUL=CAN_TP, CanIfRxPduReadData=false, CanIfRxPduReadNotifyStatus=false, CanIfRxPduDlcCheck=true, CanIfRxPduDataChecksumPdu=true, CanIfRxPduHrhIdRef=CN_B30_for_SC_CAN_V3_2_efc035d8_Rx:
        DiagFuncReq_Tp_oB30_for_SC_CAN_V3_2_9e7c1619_Rx: CanIfRxPduCanId=1888, CanIfRxPduCanIdType=STANDARD_FD_CAN, CanIfRxPduId=3, CanIfRxPduRef=DiagFuncReq_Tp_oB30_for_SC_CAN_V3_2_16517e6b_Rx
        DiagFuncReq_Tp_oB30_for_SC_CAN_V3_2_20_05fdfda7_Rx: CanIfRxPduCanId=1888, CanIfRxPduCanIdType=STANDARD_NO_FD_CAN, CanIfRxPduId=4, CanIfRxPduRef=DiagFuncReq_Tp_oB30_for_SC_CAN_V3_2_20_391e823e_Rx
        HUT_Phy_Req_Tp_oB30_for_SC_CAN_V3_2_030a1f56_Rx: CanIfRxPduCanId=1907, CanIfRxPduCanIdType=STANDARD_FD_CAN, CanIfRxPduId=1, CanIfRxPduRef=HUT_Phy_Req_Tp_oB30_for_SC_CAN_V3_2_c33a46c1_Rx
        HUT_Phy_Req_Tp_oB30_for_SC_CAN_V3_2_20_5d31e3ec_Rx: CanIfRxPduCanId=1907, CanIfRxPduCanIdType=STANDARD_NO_FD_CAN, CanIfRxPduId=2, CanIfRxPduRef=HUT_Phy_Req_Tp_oB30_for_SC_CAN_V3_2_20_200e5e76_Rx
      HUT_Phy_Resp_Tp_oB30_for_SC_CAN_V3_2_36a91054_Tx (CanIfTxPduCfg):
        CanIfTxPduCanId = 1971
        CanIfTxPduCanIdType = STANDARD_FD_CAN
        CanIfTxPduDlc = 8
        CanIfTxPduUserTxConfirmationName = CanTp_TxConfirmation
        CanIfTxPduUserTxConfirmationUL = CAN_TP
        CanIfTxPduId = 1
        CanIfTxPduReadNotifyStatus = false
        CanIfTxPduType = STATIC
        CanIfTxPduTruncation = true
        CanIfTxPduBufferRef = CHNL_b4130143
        CanIfTxPduRef = HUT_Phy_Resp_Tp_oB30_for_SC_CAN_V3_2_b970c45d_Tx
      HUT_NM_oB30_for_SC_CAN_V3_2_5ab58849_Tx (CanIfTxPduCfg):
        CanIfTxPduCanId = 1289
        CanIfTxPduCanIdType = STANDARD_CAN
        CanIfTxPduDlc = 8
        CanIfTxPduUserTxConfirmationName = CanNm_TxConfirmation
        CanIfTxPduUserTxConfirmationUL = CAN_NM
        CanIfTxPduId = 7
        CanIfTxPduReadNotifyStatus = false
        CanIfTxPduType = STATIC
        CanIfTxPduTruncation = true
        CanIfTxPduBufferRef = CHNL_b4130143
        CanIfTxPduRef = HUT_NM_oB30_for_SC_CAN_V3_2_00cca29e_Tx
      AC4_oB30_for_SC_CAN_V3_2_1c104d19_Rx (CanIfRxPduCfg):
        CanIfRxPduCanId = 716
        CanIfRxPduCanIdType = STANDARD_FD_CAN
        CanIfRxPduDlc = 8
        CanIfRxPduUserRxIndicationName = PduR_CanIfRxIndication
        CanIfRxPduUserRxIndicationUL = PDUR
        CanIfRxPduId = 58
        CanIfRxPduReadData = false
        CanIfRxPduReadNotifyStatus = false
        CanIfRxPduDlcCheck = true
        CanIfRxPduDataChecksumPdu = true
        CanIfRxPduHrhIdRef = CN_B30_for_SC_CAN_V3_2_efc035d8_Rx
        CanIfRxPduRef = AC4_oB30_for_SC_CAN_V3_2_66648533_Rx
      HUT26_oB30_for_SC_CAN_V3_2_938256b7_Tx (CanIfTxPduCfg):
        CanIfTxPduCanId = 694
        CanIfTxPduCanIdType = STANDARD_FD_CAN
        CanIfTxPduDlc = 8
        CanIfTxPduUserTxConfirmationName = PduR_CanIfTxConfirmation
        CanIfTxPduUserTxConfirmationUL = PDUR
        CanIfTxPduId = 47
        CanIfTxPduReadNotifyStatus = false
        CanIfTxPduType = STATIC
        CanIfTxPduTruncation = true
        CanIfTxPduBufferRef = CanIfBufferCfg_HUT26_oB30_for_SC_CAN_V3_2_938256b7_Tx
        CanIfTxPduRef = HUT26_oB30_for_SC_CAN_V3_2_3a768ab4_Tx
      ELD1_oB30_for_SC_CAN_V3_2_7fd898d6_Rx (CanIfRxPduCfg):
        CanIfRxPduCanId = 338
        CanIfRxPduCanIdType = STANDARD_FD_CAN
        CanIfRxPduDlc = 8
        CanIfRxPduUserRxIndicationName = PduR_CanIfRxIndication
        CanIfRxPduUserRxIndicationUL = PDUR
        CanIfRxPduId = 120
        CanIfRxPduReadData = false
        CanIfRxPduReadNotifyStatus = false
        CanIfRxPduDlcCheck = true
        CanIfRxPduDataChecksumPdu = true
        CanIfRxPduHrhIdRef = CN_B30_for_SC_CAN_V3_2_efc035d8_Rx
        CanIfRxPduRef = ELD1_oB30_for_SC_CAN_V3_2_d7398aaa_Rx
      4 x CanIfTxPduCfg, all with CanIfTxPduCanIdType=STANDARD_FD_CAN, CanIfTxPduDlc=8, CanIfTxPduUserTxConfirmationName=PduR_CanIfTxConfirmation, CanIfTxPduUserTxConfirmationUL=PDUR, CanIfTxPduReadNotifyStatus=false, CanIfTxPduType=STATIC, CanIfTxPduTruncation=true:
        HUT31_oB30_for_SC_CAN_V3_2_6961ef7a_Tx: CanIfTxPduCanId=780, CanIfTxPduId=44, CanIfTxPduBufferRef=CanIfBufferCfg_HUT31_oB30_for_SC_CAN_V3_2_6961ef7a_Tx, CanIfTxPduRef=HUT31_oB30_for_SC_CAN_V3_2_4891a683_Tx
        HUT45_oB30_for_SC_CAN_V3_2_699ab9e3_Tx: CanIfTxPduCanId=476, CanIfTxPduId=32, CanIfTxPduBufferRef=CHNL_b4130143, CanIfTxPduRef=HUT45_oB30_for_SC_CAN_V3_2_109f962f_Tx
        HUT12_oB30_for_SC_CAN_V3_2_0bc27717_Tx: CanIfTxPduCanId=943, CanIfTxPduId=39, CanIfTxPduBufferRef=CanIfBufferCfg_HUT12_oB30_for_SC_CAN_V3_2_0bc27717_Tx, CanIfTxPduRef=HUT12_oB30_for_SC_CAN_V3_2_1e3a4c6d_Tx
        HUT42_oB30_for_SC_CAN_V3_2_c38b9c70_Tx: CanIfTxPduCanId=505, CanIfTxPduId=22, CanIfTxPduBufferRef=CHNL_b4130143, CanIfTxPduRef=HUT42_oB30_for_SC_CAN_V3_2_0bb44615_Tx
      13 x CanIfRxPduCfg, all with CanIfRxPduCanIdType=STANDARD_FD_CAN, CanIfRxPduUserRxIndicationName=PduR_CanIfRxIndication, CanIfRxPduUserRxIndicationUL=PDUR, CanIfRxPduReadData=false, CanIfRxPduReadNotifyStatus=false, CanIfRxPduDlcCheck=true, CanIfRxPduDataChecksumPdu=true, CanIfRxPduHrhIdRef=CN_B30_for_SC_CAN_V3_2_efc035d8_Rx:
        Ibooster_FD2_oB30_for_SC_CAN_V3_2_5cce1132_Rx: CanIfRxPduCanId=288, CanIfRxPduDlc=64, CanIfRxPduId=126, CanIfRxPduRef=Ibooster_FD2_oB30_for_SC_CAN_V3_2_055eeaf7_Rx
        ESCL2_oB30_for_SC_CAN_V3_2_c0f28acf_Rx: CanIfRxPduCanId=771, CanIfRxPduDlc=8, CanIfRxPduId=42, CanIfRxPduRef=ESCL2_oB30_for_SC_CAN_V3_2_63dcaaa3_Rx
        AC7_oB30_for_SC_CAN_V3_2_74cca3c7_Rx: CanIfRxPduCanId=720, CanIfRxPduDlc=8, CanIfRxPduId=54, CanIfRxPduRef=AC7_oB30_for_SC_CAN_V3_2_e35697c7_Rx
        AC8_oB30_for_SC_CAN_V3_2_6412f020_Rx: CanIfRxPduCanId=636, CanIfRxPduDlc=8, CanIfRxPduId=81, CanIfRxPduRef=AC8_oB30_for_SC_CAN_V3_2_1f3fc420_Rx
        BCM11_oB30_for_SC_CAN_V3_2_6e8f2dfc_Rx: CanIfRxPduCanId=773, CanIfRxPduDlc=8, CanIfRxPduId=40, CanIfRxPduRef=BCM11_oB30_for_SC_CAN_V3_2_b554eb73_Rx
        BMS65_oB30_for_SC_CAN_V3_2_138d13ea_Rx: CanIfRxPduCanId=335, CanIfRxPduDlc=8, CanIfRxPduId=121, CanIfRxPduRef=BMS65_oB30_for_SC_CAN_V3_2_f8605782_Rx
        AC3_oB30_for_SC_CAN_V3_2_ea1dcaef_Rx: CanIfRxPduCanId=765, CanIfRxPduDlc=8, CanIfRxPduId=44, CanIfRxPduRef=AC3_oB30_for_SC_CAN_V3_2_7d4f5509_Rx
        ECM16_oB30_for_SC_CAN_V3_2_3037abc8_Rx: CanIfRxPduCanId=724, CanIfRxPduDlc=8, CanIfRxPduId=50, CanIfRxPduRef=ECM16_oB30_for_SC_CAN_V3_2_40752239_Rx
        HCU_HC16_oB30_for_SC_CAN_V3_2_1bcddd39_Rx: CanIfRxPduCanId=158, CanIfRxPduDlc=8, CanIfRxPduId=139, CanIfRxPduRef=HCU_HC16_oB30_for_SC_CAN_V3_2_f8c79c4c_Rx
        CP1_oB30_for_SC_CAN_V3_2_c9facce9_Rx: CanIfRxPduCanId=862, CanIfRxPduDlc=8, CanIfRxPduId=19, CanIfRxPduRef=CP1_oB30_for_SC_CAN_V3_2_5fdd0f6e_Rx
        Trailer1_oB30_for_SC_CAN_V3_2_8e004320_Rx: CanIfRxPduCanId=627, CanIfRxPduDlc=8, CanIfRxPduId=83, CanIfRxPduRef=Trailer1_oB30_for_SC_CAN_V3_2_f8a7c92e_Rx
        T_BOX_FD4_oB30_for_SC_CAN_V3_2_4f1f2ee0_Rx: CanIfRxPduCanId=481, CanIfRxPduDlc=16, CanIfRxPduId=106, CanIfRxPduRef=T_BOX_FD4_oB30_for_SC_CAN_V3_2_b9da4418_Rx
        AC6_oB30_for_SC_CAN_V3_2_5378f98d_Rx: CanIfRxPduCanId=760, CanIfRxPduDlc=8, CanIfRxPduId=47, CanIfRxPduRef=AC6_oB30_for_SC_CAN_V3_2_29686454_Rx
      HUT38_oB30_for_SC_CAN_V3_2_4c23878e_Tx (CanIfTxPduCfg):
        CanIfTxPduCanId = 487
        CanIfTxPduCanIdType = STANDARD_FD_CAN
        CanIfTxPduDlc = 8
        CanIfTxPduUserTxConfirmationName = PduR_CanIfTxConfirmation
        CanIfTxPduUserTxConfirmationUL = PDUR
        CanIfTxPduId = 28
        CanIfTxPduReadNotifyStatus = false
        CanIfTxPduType = STATIC
        CanIfTxPduTruncation = true
        CanIfTxPduBufferRef = CHNL_b4130143
        CanIfTxPduRef = HUT38_oB30_for_SC_CAN_V3_2_65edd6cd_Tx
      HUT43_oB30_for_SC_CAN_V3_2_3466fe00_Tx (CanIfTxPduCfg):
        CanIfTxPduCanId = 509
        CanIfTxPduCanIdType = STANDARD_FD_CAN
        CanIfTxPduDlc = 8
        CanIfTxPduUserTxConfirmationName = PduR_CanIfTxConfirmation
        CanIfTxPduUserTxConfirmationUL = PDUR
        CanIfTxPduId = 20
        CanIfTxPduReadNotifyStatus = false
        CanIfTxPduType = STATIC
        CanIfTxPduTruncation = true
        CanIfTxPduBufferRef = CHNL_b4130143
        CanIfTxPduRef = HUT43_oB30_for_SC_CAN_V3_2_c18ab586_Tx
      3 x CanIfRxPduCfg, all with CanIfRxPduCanIdType=STANDARD_FD_CAN, CanIfRxPduUserRxIndicationName=PduR_CanIfRxIndication, CanIfRxPduUserRxIndicationUL=PDUR, CanIfRxPduReadData=false, CanIfRxPduReadNotifyStatus=false, CanIfRxPduDlcCheck=true, CanIfRxPduDataChecksumPdu=true, CanIfRxPduHrhIdRef=CN_B30_for_SC_CAN_V3_2_efc035d8_Rx:
        BCM14_oB30_for_SC_CAN_V3_2_f035cace_Rx: CanIfRxPduCanId=675, CanIfRxPduDlc=8, CanIfRxPduId=69, CanIfRxPduRef=BCM14_oB30_for_SC_CAN_V3_2_e173da2e_Rx
        ESP_FD2_Sc_oB30_for_SC_CAN_V3_2_a182ac89_Rx: CanIfRxPduCanId=311, CanIfRxPduDlc=64, CanIfRxPduId=124, CanIfRxPduRef=ESP_FD2_Sc_oB30_for_SC_CAN_V3_2_dec71f3e_Rx
        TOD1_oB30_for_SC_CAN_V3_2_7b636dc1_Rx: CanIfRxPduCanId=593, CanIfRxPduDlc=8, CanIfRxPduId=87, CanIfRxPduRef=TOD1_oB30_for_SC_CAN_V3_2_4faf68bf_Rx
      HUT_Sync_Req_oB30_for_SC_CAN_V3_2_67456da2_Tx (CanIfTxPduCfg):
        CanIfTxPduCanId = 1122
        CanIfTxPduCanIdType = STANDARD_FD_CAN
        CanIfTxPduDlc = 16
        CanIfTxPduUserTxConfirmationName = PduR_CanIfTxConfirmation
        CanIfTxPduUserTxConfirmationUL = PDUR
        CanIfTxPduId = 8
        CanIfTxPduReadNotifyStatus = false
        CanIfTxPduType = STATIC
        CanIfTxPduTruncation = true
        CanIfTxPduBufferRef = CHNL_b4130143
        CanIfTxPduRef = HUT_Sync_Req_oB30_for_SC_CAN_V3_2_850087bd_Tx
      3 x CanIfRxPduCfg, all with CanIfRxPduCanIdType=STANDARD_FD_CAN, CanIfRxPduUserRxIndicationName=PduR_CanIfRxIndication, CanIfRxPduUserRxIndicationUL=PDUR, CanIfRxPduReadData=false, CanIfRxPduReadNotifyStatus=false, CanIfRxPduDlcCheck=true, CanIfRxPduDataChecksumPdu=true, CanIfRxPduHrhIdRef=CN_B30_for_SC_CAN_V3_2_efc035d8_Rx:
        T_BOX_FD1_Sc_oB30_for_SC_CAN_V3_2_52ff33bb_Rx: CanIfRxPduCanId=51, CanIfRxPduDlc=16, CanIfRxPduId=145, CanIfRxPduRef=T_BOX_FD1_Sc_oB30_for_SC_CAN_V3_2_3a52a1a3_Rx
        T_BOX_FD3_Sc_oB30_for_SC_CAN_V3_2_3b96f3fe_Rx: CanIfRxPduCanId=1001, CanIfRxPduDlc=16, CanIfRxPduId=7, CanIfRxPduRef=T_BOX_FD3_Sc_oB30_for_SC_CAN_V3_2_3919f2cf_Rx
        EPS_FD1_oB30_for_SC_CAN_V3_2_12526eab_Rx: CanIfRxPduCanId=327, CanIfRxPduDlc=64, CanIfRxPduId=123, CanIfRxPduRef=EPS_FD1_oB30_for_SC_CAN_V3_2_a6650fa5_Rx
      4 x CanIfTxPduCfg, all with CanIfTxPduCanIdType=STANDARD_FD_CAN, CanIfTxPduDlc=8, CanIfTxPduUserTxConfirmationName=PduR_CanIfTxConfirmation, CanIfTxPduUserTxConfirmationUL=PDUR, CanIfTxPduReadNotifyStatus=false, CanIfTxPduType=STATIC, CanIfTxPduTruncation=true:
        HUT36_oB30_for_SC_CAN_V3_2_c370cae9_Tx: CanIfTxPduCanId=486, CanIfTxPduId=29, CanIfTxPduBufferRef=CHNL_b4130143, CanIfTxPduRef=HUT36_oB30_for_SC_CAN_V3_2_53ba76b9_Tx
        HUT46_oB30_for_SC_CAN_V3_2_aadc1932_Tx: CanIfTxPduCanId=477, CanIfTxPduId=31, CanIfTxPduBufferRef=CHNL_b4130143, CanIfTxPduRef=HUT46_oB30_for_SC_CAN_V3_2_95ad84db_Tx
        HUT40_oB30_for_SC_CAN_V3_2_f7205ed1_Tx: CanIfTxPduCanId=548, CanIfTxPduId=54, CanIfTxPduBufferRef=CanIfBufferCfg_HUT40_oB30_for_SC_CAN_V3_2_f7205ed1_Tx, CanIfTxPduRef=HUT40_oB30_for_SC_CAN_V3_2_44b8a772_Tx
        HUT7_oB30_for_SC_CAN_V3_2_8057ceae_Tx: CanIfTxPduCanId=68, CanIfTxPduId=37, CanIfTxPduBufferRef=CHNL_b4130143, CanIfTxPduRef=HUT7_oB30_for_SC_CAN_V3_2_98f81797_Tx
      DOCK1_oB30_for_SC_CAN_V3_2_ad577210_Rx (CanIfRxPduCfg):
        CanIfRxPduCanId = 785
        CanIfRxPduCanIdType = STANDARD_FD_CAN
        CanIfRxPduDlc = 64
        CanIfRxPduUserRxIndicationName = PduR_CanIfRxIndication
        CanIfRxPduUserRxIndicationUL = PDUR
        CanIfRxPduId = 35
        CanIfRxPduReadData = false
        CanIfRxPduReadNotifyStatus = false
        CanIfRxPduDlcCheck = true
        CanIfRxPduDataChecksumPdu = true
        CanIfRxPduHrhIdRef = CN_B30_for_SC_CAN_V3_2_efc035d8_Rx
        CanIfRxPduRef = DOCK1_oB30_for_SC_CAN_V3_2_131b892d_Rx
      DWD1_oB30_for_SC_CAN_V3_2_e70e0616_Rx (CanIfRxPduCfg):
        CanIfRxPduCanId = 697
        CanIfRxPduCanIdType = STANDARD_FD_CAN
        CanIfRxPduDlc = 8
        CanIfRxPduUserRxIndicationName = PduR_CanIfRxIndication
        CanIfRxPduUserRxIndicationUL = PDUR
        CanIfRxPduId = 64
        CanIfRxPduReadData = false
        CanIfRxPduReadNotifyStatus = false
        CanIfRxPduDlcCheck = true
        CanIfRxPduDataChecksumPdu = true
        CanIfRxPduHrhIdRef = CN_B30_for_SC_CAN_V3_2_efc035d8_Rx
        CanIfRxPduRef = DWD1_oB30_for_SC_CAN_V3_2_959d6041_Rx
      HUT37_oB30_for_SC_CAN_V3_2_349da899_Tx (CanIfTxPduCfg):
        CanIfTxPduCanId = 492
        CanIfTxPduCanIdType = STANDARD_FD_CAN
        CanIfTxPduDlc = 8
        CanIfTxPduUserTxConfirmationName = PduR_CanIfTxConfirmation
        CanIfTxPduUserTxConfirmationUL = PDUR
        CanIfTxPduId = 25
        CanIfTxPduReadNotifyStatus = false
        CanIfTxPduType = STATIC
        CanIfTxPduTruncation = true
        CanIfTxPduBufferRef = CHNL_b4130143
        CanIfTxPduRef = HUT37_oB30_for_SC_CAN_V3_2_9984852a_Tx
      HUT41_oB30_for_SC_CAN_V3_2_00cd3ca1_Tx (CanIfTxPduCfg):
        CanIfTxPduCanId = 507
        CanIfTxPduCanIdType = STANDARD_FD_CAN
        CanIfTxPduDlc = 8
        CanIfTxPduUserTxConfirmationName = PduR_CanIfTxConfirmation
        CanIfTxPduUserTxConfirmationUL = PDUR
        CanIfTxPduId = 21
        CanIfTxPduReadNotifyStatus = false
        CanIfTxPduType = STATIC
        CanIfTxPduTruncation = true
        CanIfTxPduBufferRef = CHNL_b4130143
        CanIfTxPduRef = HUT41_oB30_for_SC_CAN_V3_2_8e8654e1_Tx
      DSC4_oB30_for_SC_CAN_V3_2_c9fc5f8d_Rx (CanIfRxPduCfg):
        CanIfRxPduCanId = 718
        CanIfRxPduCanIdType = STANDARD_FD_CAN
        CanIfRxPduDlc = 8
        CanIfRxPduUserRxIndicationName = PduR_CanIfRxIndication
        CanIfRxPduUserRxIndicationUL = PDUR
        CanIfRxPduId = 56
        CanIfRxPduReadData = false
        CanIfRxPduReadNotifyStatus = false
        CanIfRxPduDlcCheck = true
        CanIfRxPduDataChecksumPdu = true
        CanIfRxPduHrhIdRef = CN_B30_for_SC_CAN_V3_2_efc035d8_Rx
        CanIfRxPduRef = DSC4_oB30_for_SC_CAN_V3_2_27be643b_Rx
      HUT_FD5_oB30_for_SC_CAN_V3_2_93a3c1ee_Tx (CanIfTxPduCfg):
        CanIfTxPduCanId = 475
        CanIfTxPduCanIdType = STANDARD_FD_CAN
        CanIfTxPduDlc = 64
        CanIfTxPduUserTxConfirmationName = PduR_CanIfTxConfirmation
        CanIfTxPduUserTxConfirmationUL = PDUR
        CanIfTxPduId = 33
        CanIfTxPduReadNotifyStatus = false
        CanIfTxPduType = STATIC
        CanIfTxPduTruncation = true
        CanIfTxPduBufferRef = CHNL_b4130143
        CanIfTxPduRef = HUT_FD5_oB30_for_SC_CAN_V3_2_02e08044_Tx
      27 x CanIfRxPduCfg, all with CanIfRxPduCanIdType=STANDARD_FD_CAN, CanIfRxPduUserRxIndicationName=PduR_CanIfRxIndication, CanIfRxPduUserRxIndicationUL=PDUR, CanIfRxPduReadData=false, CanIfRxPduReadNotifyStatus=false, CanIfRxPduDlcCheck=true, CanIfRxPduDataChecksumPdu=true, CanIfRxPduHrhIdRef=CN_B30_for_SC_CAN_V3_2_efc035d8_Rx:
        DOCK2_oB30_for_SC_CAN_V3_2_6e11d2c1_Rx: CanIfRxPduCanId=479, CanIfRxPduDlc=64, CanIfRxPduId=107, CanIfRxPduRef=DOCK2_oB30_for_SC_CAN_V3_2_96299bd9_Rx
        P2M1_oB30_for_SC_CAN_V3_2_e947d735_Rx: CanIfRxPduCanId=172, CanIfRxPduDlc=8, CanIfRxPduId=136, CanIfRxPduRef=P2M1_oB30_for_SC_CAN_V3_2_f19378e0_Rx
        BMS66_oB30_for_SC_CAN_V3_2_d0cbb33b_Rx: CanIfRxPduCanId=942, CanIfRxPduDlc=8, CanIfRxPduId=15, CanIfRxPduRef=BMS66_oB30_for_SC_CAN_V3_2_7d524576_Rx
        ECM_PT7_oB30_for_SC_CAN_V3_2_f08d75e2_Rx: CanIfRxPduCanId=279, CanIfRxPduDlc=8, CanIfRxPduId=128, CanIfRxPduRef=ECM_PT7_oB30_for_SC_CAN_V3_2_6eb54960_Rx
        T_BOX_FD9_oB30_for_SC_CAN_V3_2_18c22ff6_Rx: CanIfRxPduCanId=510, CanIfRxPduDlc=8, CanIfRxPduId=100, CanIfRxPduRef=T_BOX_FD9_oB30_for_SC_CAN_V3_2_0abff698_Rx
        BMS19_oB30_for_SC_CAN_V3_2_c1d94ff7_Rx: CanIfRxPduCanId=850, CanIfRxPduDlc=8, CanIfRxPduId=20, CanIfRxPduRef=BMS19_oB30_for_SC_CAN_V3_2_472ce4f3_Rx
        EBOOSTER_FD1_oB30_for_SC_CAN_V3_2_3b0df78d_Rx: CanIfRxPduCanId=301, CanIfRxPduDlc=64, CanIfRxPduId=125, CanIfRxPduRef=EBOOSTER_FD1_oB30_for_SC_CAN_V3_2_9ce048b8_Rx
        HCU_HC6_oB30_for_SC_CAN_V3_2_ee01dd1b_Rx: CanIfRxPduCanId=788, CanIfRxPduDlc=8, CanIfRxPduId=34, CanIfRxPduRef=HCU_HC6_oB30_for_SC_CAN_V3_2_b11da94c_Rx
        BMS22_oB30_for_SC_CAN_V3_2_21274140_Rx: CanIfRxPduCanId=959, CanIfRxPduDlc=8, CanIfRxPduId=12, CanIfRxPduRef=BMS22_oB30_for_SC_CAN_V3_2_9f0971cd_Rx
        BMS_FD14_oB30_for_SC_CAN_V3_2_d6fdd23c_Rx: CanIfRxPduCanId=483, CanIfRxPduDlc=8, CanIfRxPduId=104, CanIfRxPduRef=BMS_FD14_oB30_for_SC_CAN_V3_2_69b2ad5e_Rx
        HCU_HC8_oB30_for_SC_CAN_V3_2_21f69208_Rx: CanIfRxPduCanId=482, CanIfRxPduDlc=8, CanIfRxPduId=105, CanIfRxPduRef=HCU_HC8_oB30_for_SC_CAN_V3_2_874a0938_Rx
        ECM_PT6_oB30_for_SC_CAN_V3_2_0acba12c_Rx: CanIfRxPduCanId=656, CanIfRxPduDlc=8, CanIfRxPduId=76, CanIfRxPduRef=ECM_PT6_oB30_for_SC_CAN_V3_2_a48bbaf3_Rx
        P2M3_oB30_for_SC_CAN_V3_2_c252eb72_Rx: CanIfRxPduCanId=190, CanIfRxPduDlc=8, CanIfRxPduId=135, CanIfRxPduRef=P2M3_oB30_for_SC_CAN_V3_2_be9f9987_Rx
        HCU_HC3_oB30_for_SC_CAN_V3_2_4bbe566f_Rx: CanIfRxPduCanId=616, CanIfRxPduDlc=8, CanIfRxPduId=85, CanIfRxPduRef=HCU_HC3_oB30_for_SC_CAN_V3_2_e53a9811_Rx
        HCU_PT8_oB30_for_SC_CAN_V3_2_104eb273_Rx: CanIfRxPduCanId=448, CanIfRxPduDlc=8, CanIfRxPduId=109, CanIfRxPduRef=HCU_PT8_oB30_for_SC_CAN_V3_2_ab4fb751_Rx
        HCU_HP8_oB30_for_SC_CAN_V3_2_0a33e699_Rx: CanIfRxPduCanId=249, CanIfRxPduDlc=8, CanIfRxPduId=132, CanIfRxPduRef=HCU_HP8_oB30_for_SC_CAN_V3_2_1765d2ba_Rx
        BMS8_oB30_for_SC_CAN_V3_2_b80b0dd9_Rx: CanIfRxPduCanId=645, CanIfRxPduDlc=8, CanIfRxPduId=80, CanIfRxPduRef=BMS8_oB30_for_SC_CAN_V3_2_6c883b50_Rx
        BMS30_oB30_for_SC_CAN_V3_2_457e1fbf_Rx: CanIfRxPduCanId=1009, CanIfRxPduDlc=8, CanIfRxPduId=6, CanIfRxPduRef=BMS30_oB30_for_SC_CAN_V3_2_b9c96ca7_Rx
        HCU_FD1_oB30_for_SC_CAN_V3_2_4c4e73be_Rx: CanIfRxPduCanId=96, CanIfRxPduDlc=64, CanIfRxPduId=143, CanIfRxPduRef=HCU_FD1_oB30_for_SC_CAN_V3_2_f1a4a259_Rx
        HCU_PT5_oB30_for_SC_CAN_V3_2_0a038673_Rx: CanIfRxPduCanId=330, CanIfRxPduDlc=8, CanIfRxPduId=122, CanIfRxPduRef=HCU_PT5_oB30_for_SC_CAN_V3_2_182a05d1_Rx
        ECM_PT5_oB30_for_SC_CAN_V3_2_df71da3f_Rx: CanIfRxPduCanId=142, CanIfRxPduDlc=8, CanIfRxPduId=140, CanIfRxPduRef=ECM_PT5_oB30_for_SC_CAN_V3_2_21b9a807_Rx
        BCM18_oB30_for_SC_CAN_V3_2_4bcd4508_Rx: CanIfRxPduCanId=845, CanIfRxPduDlc=8, CanIfRxPduId=23, CanIfRxPduRef=BCM18_oB30_for_SC_CAN_V3_2_98289b3d_Rx
        ECM24_oB30_for_SC_CAN_V3_2_f58bcd8b_Rx: CanIfRxPduCanId=848, CanIfRxPduDlc=8, CanIfRxPduId=22, CanIfRxPduRef=ECM24_oB30_for_SC_CAN_V3_2_b52cc749_Rx
        HCU_HP6_oB30_for_SC_CAN_V3_2_c5c4a98a_Rx: CanIfRxPduCanId=282, CanIfRxPduDlc=8, CanIfRxPduId=127, CanIfRxPduRef=HCU_HP6_oB30_for_SC_CAN_V3_2_213272ce_Rx
        T_BOX_FD10_oB30_for_SC_CAN_V3_2_1bbcf88b_Rx: CanIfRxPduCanId=752, CanIfRxPduDlc=64, CanIfRxPduId=49, CanIfRxPduRef=T_BOX_FD10_oB30_for_SC_CAN_V3_2_964515ff_Rx
        GW_OTA_oB30_for_SC_CAN_V3_2_556bd38c_Rx: CanIfRxPduCanId=473, CanIfRxPduDlc=8, CanIfRxPduId=108, CanIfRxPduRef=GW_OTA_oB30_for_SC_CAN_V3_2_0f39012b_Rx
        HAP_FD7_oB30_for_SC_CAN_V3_2_3a38a501_Rx: CanIfRxPduCanId=667, CanIfRxPduDlc=64, CanIfRxPduId=72, CanIfRxPduRef=HAP_FD7_oB30_for_SC_CAN_V3_2_b196d90e_Rx
      HUT_FD4_oB30_for_SC_CAN_V3_2_69e51520_Tx (CanIfTxPduCfg):
        CanIfTxPduCanId = 474
        CanIfTxPduCanIdType = STANDARD_FD_CAN
        CanIfTxPduDlc = 64
        CanIfTxPduUserTxConfirmationName = PduR_CanIfTxConfirmation
        CanIfTxPduUserTxConfirmationUL = PDUR
        CanIfTxPduId = 34
        CanIfTxPduReadNotifyStatus = false
        CanIfTxPduType = STATIC
        CanIfTxPduTruncation = true
        CanIfTxPduBufferRef = CHNL_b4130143
        CanIfTxPduRef = HUT_FD4_oB30_for_SC_CAN_V3_2_c8de73d7_Tx
      6 x CanIfRxPduCfg, all with CanIfRxPduCanIdType=STANDARD_FD_CAN, CanIfRxPduDlc=8, CanIfRxPduUserRxIndicationName=PduR_CanIfRxIndication, CanIfRxPduUserRxIndicationUL=PDUR, CanIfRxPduReadData=false, CanIfRxPduReadNotifyStatus=false, CanIfRxPduDlcCheck=true, CanIfRxPduDataChecksumPdu=true, CanIfRxPduHrhIdRef=CN_B30_for_SC_CAN_V3_2_efc035d8_Rx:
        AC14_oB30_for_SC_CAN_V3_2_44780039_Rx: CanIfRxPduCanId=665, CanIfRxPduId=73, CanIfRxPduRef=AC14_oB30_for_SC_CAN_V3_2_a43f90b0_Rx
        SCM1_oB30_for_SC_CAN_V3_2_a8dca609_Rx: CanIfRxPduCanId=721, CanIfRxPduId=53, CanIfRxPduRef=SCM1_oB30_for_SC_CAN_V3_2_baaa6d95_Rx
        BCM7_oB30_for_SC_CAN_V3_2_09245eaf_Rx: CanIfRxPduCanId=653, CanIfRxPduId=77, CanIfRxPduRef=BCM7_oB30_for_SC_CAN_V3_2_70407cea_Rx
        HCU_HP5_oB30_for_SC_CAN_V3_2_107ed299_Rx: CanIfRxPduCanId=513, CanIfRxPduId=99, CanIfRxPduRef=HCU_HP5_oB30_for_SC_CAN_V3_2_a400603a_Rx
        BLE5_oB30_for_SC_CAN_V3_2_39f30a4c_Rx: CanIfRxPduCanId=506, CanIfRxPduId=101, CanIfRxPduRef=BLE5_oB30_for_SC_CAN_V3_2_2494e86b_Rx
        BLE1_oB30_for_SC_CAN_V3_2_6fd972c2_Rx: CanIfRxPduCanId=604, CanIfRxPduId=86, CanIfRxPduRef=BLE1_oB30_for_SC_CAN_V3_2_ba8d2aa5_Rx
      17 x CanIfBufferCfg, all with CanIfBufferSize=0, CanIfTxBufferHandlingType=NONE, CanIfTxBufferMappedTxPdus=1:
        CanIfBufferCfg_IP3_oB30_for_SC_CAN_V3_2_8dd4dc90_Tx: CanIfTxBufferMaxPduLength=16, CanIfBufferHthRef=CanIfHthCfg_IP3_oB30_for_SC_CAN_V3_2_8dd4dc90_Tx
        CanIfBufferCfg_IP2_Sc_oB30_for_SC_CAN_V3_2_fb13b195_Tx: CanIfTxBufferMaxPduLength=16, CanIfBufferHthRef=CanIfHthCfg_IP2_Sc_oB30_for_SC_CAN_V3_2_fb13b195_Tx
        CanIfBufferCfg_IP1_oB30_for_SC_CAN_V3_2_c2bc6804_Tx: CanIfTxBufferMaxPduLength=8, CanIfBufferHthRef=CanIfHthCfg_IP1_oB30_for_SC_CAN_V3_2_c2bc6804_Tx
        CanIfBufferCfg_HUT_FD1_Sc_oB30_for_SC_CAN_V3_2_ad4f6083_Tx: CanIfTxBufferMaxPduLength=64, CanIfBufferHthRef=CanIfHthCfg_HUT_FD1_Sc_oB30_for_SC_CAN_V3_2_ad4f6083_Tx
        CanIfBufferCfg_HUT_FD2_oB30_for_SC_CAN_V3_2_19e0e547_Tx: CanIfTxBufferMaxPduLength=64, CanIfBufferHthRef=CanIfHthCfg_HUT_FD2_oB30_for_SC_CAN_V3_2_19e0e547_Tx
        CanIfBufferCfg_HUT_FD3_oB30_for_SC_CAN_V3_2_e3a63189_Tx: CanIfTxBufferMaxPduLength=64, CanIfBufferHthRef=CanIfHthCfg_HUT_FD3_oB30_for_SC_CAN_V3_2_e3a63189_Tx
        CanIfBufferCfg_HUT40_oB30_for_SC_CAN_V3_2_f7205ed1_Tx: CanIfTxBufferMaxPduLength=8, CanIfBufferHthRef=CanIfHthCfg_HUT40_oB30_for_SC_CAN_V3_2_f7205ed1_Tx
        CanIfBufferCfg_HUT34_oB30_for_SC_CAN_V3_2_f7db0848_Tx: CanIfTxBufferMaxPduLength=8, CanIfBufferHthRef=CanIfHthCfg_HUT34_oB30_for_SC_CAN_V3_2_f7db0848_Tx
        CanIfBufferCfg_HUT32_oB30_for_SC_CAN_V3_2_aa274fab_Tx: CanIfTxBufferMaxPduLength=8, CanIfBufferHthRef=CanIfHthCfg_HUT32_oB30_for_SC_CAN_V3_2_aa274fab_Tx
        CanIfBufferCfg_HUT31_oB30_for_SC_CAN_V3_2_6961ef7a_Tx: CanIfTxBufferMaxPduLength=8, CanIfBufferHthRef=CanIfHthCfg_HUT31_oB30_for_SC_CAN_V3_2_6961ef7a_Tx
        CanIfBufferCfg_HUT26_oB30_for_SC_CAN_V3_2_938256b7_Tx: CanIfTxBufferMaxPduLength=8, CanIfBufferHthRef=CanIfHthCfg_HUT26_oB30_for_SC_CAN_V3_2_938256b7_Tx
        CanIfBufferCfg_HUT19_oB30_for_SC_CAN_V3_2_1a2bdd42_Tx: CanIfTxBufferMaxPduLength=8, CanIfBufferHthRef=CanIfHthCfg_HUT19_oB30_for_SC_CAN_V3_2_1a2bdd42_Tx
        CanIfBufferCfg_HUT16_oB30_for_SC_CAN_V3_2_6295f255_Tx: CanIfTxBufferMaxPduLength=8, CanIfBufferHthRef=CanIfHthCfg_HUT16_oB30_for_SC_CAN_V3_2_6295f255_Tx
        CanIfBufferCfg_HUT13_oB30_for_SC_CAN_V3_2_fc2f1567_Tx: CanIfTxBufferMaxPduLength=8, CanIfBufferHthRef=CanIfHthCfg_HUT13_oB30_for_SC_CAN_V3_2_fc2f1567_Tx
        CanIfBufferCfg_HUT12_oB30_for_SC_CAN_V3_2_0bc27717_Tx: CanIfTxBufferMaxPduLength=8, CanIfBufferHthRef=CanIfHthCfg_HUT12_oB30_for_SC_CAN_V3_2_0bc27717_Tx
        CanIfBufferCfg_DMS_FD1_oB30_for_SC_CAN_V3_2_1702aefa_Tx: CanIfTxBufferMaxPduLength=64, CanIfBufferHthRef=CanIfHthCfg_DMS_FD1_oB30_for_SC_CAN_V3_2_1702aefa_Tx
        CanIfBufferCfg_DVR_FD1_oB30_for_SC_CAN_V3_2_2030c8ae_Tx: CanIfTxBufferMaxPduLength=64, CanIfBufferHthRef=CanIfHthCfg_DVR_FD1_oB30_for_SC_CAN_V3_2_2030c8ae_Tx
      5 x CanIfRxPduCfg, all with CanIfRxPduCanIdType=STANDARD_FD_CAN, CanIfRxPduDlc=8, CanIfRxPduUserRxIndicationName=PduR_CanIfRxIndication, CanIfRxPduUserRxIndicationUL=PDUR, CanIfRxPduReadData=false, CanIfRxPduReadNotifyStatus=false, CanIfRxPduDlcCheck=true, CanIfRxPduDataChecksumPdu=true, CanIfRxPduHrhIdRef=CN_B30_for_SC_CAN_V3_2_efc035d8_Rx:
        HCM_R1_oB30_for_SC_CAN_V3_2_c6a7a6c6_Rx: CanIfRxPduCanId=781, CanIfRxPduId=37, CanIfRxPduRef=HCM_R1_oB30_for_SC_CAN_V3_2_2995cda3_Rx
        OBC1_oB30_for_SC_CAN_V3_2_5cce00c0_Rx: CanIfRxPduCanId=790, CanIfRxPduId=33, CanIfRxPduRef=OBC1_oB30_for_SC_CAN_V3_2_82cd4f59_Rx
        ETC4_oB30_for_SC_CAN_V3_2_dfa38f29_Rx: CanIfRxPduCanId=498, CanIfRxPduId=102, CanIfRxPduRef=ETC4_oB30_for_SC_CAN_V3_2_8561da0b_Rx
        HCM_L1_oB30_for_SC_CAN_V3_2_838a93c0_Rx: CanIfRxPduCanId=776, CanIfRxPduId=39, CanIfRxPduRef=HCM_L1_oB30_for_SC_CAN_V3_2_54b1f0b3_Rx
        BMS35_oB30_for_SC_CAN_V3_2_dbc4f88d_Rx: CanIfRxPduCanId=708, CanIfRxPduId=60, CanIfRxPduRef=BMS35_oB30_for_SC_CAN_V3_2_edee5dfa_Rx
      HUT27_oB30_for_SC_CAN_V3_2_646f34c7_Tx (CanIfTxPduCfg):
        CanIfTxPduCanId = 690
        CanIfTxPduCanIdType = STANDARD_FD_CAN
        CanIfTxPduDlc = 8
        CanIfTxPduUserTxConfirmationName = PduR_CanIfTxConfirmation
        CanIfTxPduUserTxConfirmationUL = PDUR
        CanIfTxPduId = 48
        CanIfTxPduReadNotifyStatus = false
        CanIfTxPduType = STATIC
        CanIfTxPduTruncation = true
        CanIfTxPduBufferRef = CanIfBufferCfg_HUT27_oB30_for_SC_CAN_V3_2_646f34c7_Tx
        CanIfTxPduRef = HUT27_oB30_for_SC_CAN_V3_2_f0487927_Tx
      10 x CanIfRxPduCfg, all with CanIfRxPduCanIdType=STANDARD_FD_CAN, CanIfRxPduUserRxIndicationName=PduR_CanIfRxIndication, CanIfRxPduUserRxIndicationUL=PDUR, CanIfRxPduReadData=false, CanIfRxPduReadNotifyStatus=false, CanIfRxPduDlcCheck=true, CanIfRxPduDataChecksumPdu=true, CanIfRxPduHrhIdRef=CN_B30_for_SC_CAN_V3_2_efc035d8_Rx:
        HCM_R2_oB30_for_SC_CAN_V3_2_8594005d_Rx: CanIfRxPduCanId=816, CanIfRxPduDlc=8, CanIfRxPduId=29, CanIfRxPduRef=HCM_R2_oB30_for_SC_CAN_V3_2_aca7df57_Rx
        DCT_FD4_oB30_for_SC_CAN_V3_2_737de028_Rx: CanIfRxPduCanId=566, CanIfRxPduDlc=64, CanIfRxPduId=94, CanIfRxPduRef=DCT_FD4_oB30_for_SC_CAN_V3_2_207dfaa4_Rx
        RFCM_R1_oB30_for_SC_CAN_V3_2_e80a1e77_Rx: CanIfRxPduCanId=819, CanIfRxPduDlc=8, CanIfRxPduId=27, CanIfRxPduRef=RFCM_R1_oB30_for_SC_CAN_V3_2_9c1b42b1_Rx
        F_PBOX1_oB30_for_SC_CAN_V3_2_0d3fde0d_Rx: CanIfRxPduCanId=411, CanIfRxPduDlc=8, CanIfRxPduId=112, CanIfRxPduRef=F_PBOX1_oB30_for_SC_CAN_V3_2_d5db6bdb_Rx
        ETC2_oB30_for_SC_CAN_V3_2_a29ccbe0_Rx: CanIfRxPduCanId=497, CanIfRxPduDlc=8, CanIfRxPduId=103, CanIfRxPduRef=ETC2_oB30_for_SC_CAN_V3_2_5474f9a2_Rx
        HCM_L2_oB30_for_SC_CAN_V3_2_c0b9355b_Rx: CanIfRxPduCanId=772, CanIfRxPduDlc=8, CanIfRxPduId=41, CanIfRxPduRef=HCM_L2_oB30_for_SC_CAN_V3_2_d183e247_Rx
        R_PBOX1_Sc_oB30_for_SC_CAN_V3_2_89d7921d_Rx: CanIfRxPduCanId=412, CanIfRxPduDlc=16, CanIfRxPduId=111, CanIfRxPduRef=R_PBOX1_Sc_oB30_for_SC_CAN_V3_2_4d1c68c6_Rx
        RFCM_L1_oB30_for_SC_CAN_V3_2_c3d527d2_Rx: CanIfRxPduCanId=818, CanIfRxPduDlc=8, CanIfRxPduId=28, CanIfRxPduRef=RFCM_L1_oB30_for_SC_CAN_V3_2_e13f7fa1_Rx
        ALS1_oB30_for_SC_CAN_V3_2_fa40a3a9_Rx: CanIfRxPduCanId=647, CanIfRxPduDlc=16, CanIfRxPduId=79, CanIfRxPduRef=ALS1_oB30_for_SC_CAN_V3_2_3dc20185_Rx
        OBC2_oB30_for_SC_CAN_V3_2_8fe92184_Rx: CanIfRxPduCanId=791, CanIfRxPduDlc=8, CanIfRxPduId=32, CanIfRxPduRef=OBC2_oB30_for_SC_CAN_V3_2_07ff5dad_Rx
      HUT49_oB30_for_SC_CAN_V3_2_d2623625_Tx (CanIfTxPduCfg):
        CanIfTxPduCanId = 465
        CanIfTxPduCanIdType = STANDARD_FD_CAN
        CanIfTxPduDlc = 8
        CanIfTxPduUserTxConfirmationName = PduR_CanIfTxConfirmation
        CanIfTxPduUserTxConfirmationUL = PDUR
        CanIfTxPduId = 35
        CanIfTxPduReadNotifyStatus = false
        CanIfTxPduType = STATIC
        CanIfTxPduTruncation = true
        CanIfTxPduBufferRef = CHNL_b4130143
        CanIfTxPduRef = HUT49_oB30_for_SC_CAN_V3_2_69c4d73c_Tx
      ETC3_oB30_for_SC_CAN_V3_2_5aaed6e3_Rx (CanIfRxPduCfg):
        CanIfRxPduCanId = 836
        CanIfRxPduCanIdType = STANDARD_FD_CAN
        CanIfRxPduDlc = 8
        CanIfRxPduUserRxIndicationName = PduR_CanIfRxIndication
        CanIfRxPduUserRxIndicationUL = PDUR
        CanIfRxPduId = 25
        CanIfRxPduReadData = false
        CanIfRxPduReadNotifyStatus = false
        CanIfRxPduDlcCheck = true
        CanIfRxPduDataChecksumPdu = true
        CanIfRxPduHrhIdRef = CN_B30_for_SC_CAN_V3_2_efc035d8_Rx
        CanIfRxPduRef = ETC3_oB30_for_SC_CAN_V3_2_9e4a0a31_Rx
      CanIfBufferCfg_HUT27_oB30_for_SC_CAN_V3_2_646f34c7_Tx (CanIfBufferCfg):
        CanIfBufferSize = 0
        CanIfTxBufferHandlingType = NONE
        CanIfTxBufferMappedTxPdus = 1
        CanIfTxBufferMaxPduLength = 8
        CanIfBufferHthRef = CanIfHthCfg_HUT27_oB30_for_SC_CAN_V3_2_646f34c7_Tx
      5 x CanIfTxPduCfg, all with CanIfTxPduCanIdType=STANDARD_FD_CAN, CanIfTxPduDlc=64, CanIfTxPduReadNotifyStatus=false, CanIfTxPduType=STATIC, CanIfTxPduUserTxConfirmationUL=PDUR, CanIfTxPduTruncation=true, CanIfTxPduUserTxConfirmationName=PduR_CanIfTxConfirmation, CanIfTxPduBufferRef=CHNL_b4130143:
        ZCluster_Debug_Msg_0x7AB_Tx: CanIfTxPduCanId=1963, CanIfTxPduId=6, CanIfTxPduRef=ZCluster_Debug_Msg_0x7AB_Tx
        ZCluster_Debug_Msg_0x7AF_Tx: CanIfTxPduCanId=1967, CanIfTxPduId=2, CanIfTxPduRef=ZCluster_Debug_Msg_0x7AF_Tx
        ZCluster_Debug_Msg_0x7AE_Tx: CanIfTxPduCanId=1966, CanIfTxPduId=3, CanIfTxPduRef=ZCluster_Debug_Msg_0x7AE_Tx
        ZCluster_Debug_Msg_0x7AD_Tx: CanIfTxPduCanId=1965, CanIfTxPduId=4, CanIfTxPduRef=ZCluster_Debug_Msg_0x7AD_Tx
        ZCluster_Debug_Msg_0x7AC_Tx: CanIfTxPduCanId=1964, CanIfTxPduId=5, CanIfTxPduRef=ZCluster_Debug_Msg_0x7AC_Tx
      3 x CanIfRxPduCfg, all with CanIfRxPduCanIdType=STANDARD_FD_CAN, CanIfRxPduDlc=8, CanIfRxPduUserRxIndicationName=PduR_CanIfRxIndication, CanIfRxPduUserRxIndicationUL=PDUR, CanIfRxPduReadData=false, CanIfRxPduReadNotifyStatus=false, CanIfRxPduDlcCheck=true, CanIfRxPduDataChecksumPdu=true, CanIfRxPduHrhIdRef=CN_B30_for_SC_CAN_V3_2_efc035d8_Rx:
        GLO_NASS1_oB30_for_SC_CAN_V3_2_cd0fc4aa_Rx: CanIfRxPduCanId=86, CanIfRxPduId=144, CanIfRxPduRef=GLO_NASS1_oB30_for_SC_CAN_V3_2_c0d601c5_Rx
        VMDR1_oB30_for_SC_CAN_V3_2_3fa04c0b_Rx: CanIfRxPduCanId=763, CanIfRxPduId=45, CanIfRxPduRef=VMDR1_oB30_for_SC_CAN_V3_2_01b65f56_Rx
        BCM19_oB30_for_SC_CAN_V3_2_bc202778_Rx: CanIfRxPduCanId=783, CanIfRxPduId=36, CanIfRxPduRef=BCM19_oB30_for_SC_CAN_V3_2_521668ae_Rx
    CanIfPrivateCfg:
      CanIfPrivateSoftwareFilterType = DOUBLEHASH
      CanIfPrivateDlcCheck = true
      CanIfSupportTTCAN = false
      CanIfTransceiverMapping = false
      CanIfTransceiverHandling = true
      CanIfSupportExtendedIds = false
      CanIfSupportNmOsek = false
      CanIfTxBufferType = BYTE_QUEUE
      CanIfOptimizeOneController = false
      CanIfWakeupSupport = true
      CanIfStaticFdTxBufferSupport = true
      CanIfRxSearchConsiderMsgType = true
      CanIfTxBufferFifoSupport = false
      CanIfSetPduReceptionModeSupport = false
      CanIfCheckWakeupCanRetType = false
      CanIfDataChecksumRxSupport = true
      CanIfDoubleHashAdditionalMemory = 418
      CanIfDoubleHashAdjustCount = 197
      CanIfDataChecksumTxSupport = false
    CanIfPublicCfg:
      CanIfPublicPnSupport = false
      CanIfPublicCancelTransmitSupport = false
      CanIfPublicDevErrorDetect = true
      CanIfPublicHandleTypeEnum = UINT8
      CanIfPublicMultipleDrvSupport = false
      CanIfPublicNumberOfCanHwUnits = 1
      CanIfPublicReadRxPduDataApi = false
      CanIfPublicReadRxPduNotifyStatusApi = false
      CanIfPublicReadTxPduNotifyStatusApi = false
      CanIfPublicSetDynamicTxIdApi = false
      CanIfPublicTxBuffering = true
      CanIfPublicTxConfirmPollingSupport = false
      CanIfPublicVersionInfoApi = false
      CanIfPublicWakeupCheckValidSupport = true
      CanIfPnWakeupTxPduFilterSupport = false
      CanIfPnTrcvHandlingSupport = false
      CanIfJ1939DynAddrSupport = DISABLED
      CanIfSafeBswChecks = false
      CanIfBusMirroringSupport = false
      CanIfSetBaudrateApi = false
      CanIfPublicWakeupCheckValidByNM = true
    CanIfTrcvDrvCfg
      3 x CanIfTrcvCfg:
        CanIfTrcvCfg_CAN3: CanIfTrcvId=2, CanIfTrcvWakeupSupport=true, CanIfTrcvCanTrcvRef=CanTrcvChannel_CAN3
        CanIfTrcvCfg_CAN1: CanIfTrcvId=1, CanIfTrcvWakeupSupport=false, CanIfTrcvCanTrcvRef=CanTrcvChannel_CAN1
        CanIfTrcvCfg_CAN0: CanIfTrcvId=0, CanIfTrcvWakeupSupport=false, CanIfTrcvCanTrcvRef=CanTrcvChannel_CAN0
