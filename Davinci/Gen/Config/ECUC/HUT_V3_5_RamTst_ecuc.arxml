AUTOSAR XML (schema 00046)
package /ActiveEcuC
  module config RamTst: implementation-config-variant=VARIANT-PRE-COMPILE, module-description=RamTst_Impl
    RamTstCommon:
      RamTstVersionCheckExternalModules = false
      RamTstAllowApi = true
      RamTstChangeNumOfTestedCellsApi = true
      RamTstCriticalSectionProtection = true
      RamTstDevErrorDetect = true
      RamTstDeviceName = R7F701651
      RamTstEccCheck = true
      RamTstGetAlgParamsApi = true
      RamTstGetExecutionStatusApi = true
      RamTstGetNumberOfTestedCellsApi = true
      RamTstGetTestAlgorithmApi = true
      RamTstGetTestResultApi = true
      RamTstGetTestResultPerBlockApi = true
      RamTstGetVersionInfoApi = true
      RamTstResumeApi = true
      RamTstRunFullTestApi = true
      RamTstRunPartialTestApi = true
      RamTstSelectAlgParamsApi = true
      RamTstStopApi = true
      RamTstSuspendApi = true
      RamTstAlgorithms:
        RamTstAbrahamTestSelected = false
        RamTstCheckerboardTestSelected = true
        RamTstGalpatTestSelected = false
        RamTstMarchTestSelected = false
        RamTstMarchYTestSelected = false
        RamTstTranspGalpatTestSelected = false
        RamTstWalkPathTestSelected = false
      RamTstConfigParams:
        RamTstDefaultAlgParamsId = 1
        RamTstMinNumberOfTestedCells = 1
        RamTstNumberOfAlgParamSets = 1
        RamTstTestCompletedNotification = RamTst_CompletedNotification
        RamTstTestErrorNotification = NULL_PTR
        RamTstAlgParams_CHECKERBOARD (RamTstAlgParams):
          RamTstAlgorithm = RAMTST_CHECKERBOARD_TEST
          RamTstAlgParamsId = 1
          RamTstExtNumberOfTestedCells = 262144
          RamTstMaxNumberOfTestedCells = 4100
          RamTstNumberOfBlocks = 40
          RamTstNumberOfTestedCells = 8
          40 x RamTstBlockParams, all with RamTstFillPattern=0, RamTstTestPolicy=RAMTST_NON_DESTRUCTIVE:
            RamTstBlockParams: RamTstBlockId=1, RamTstEndAddress=4273737727, RamTstStartAddress=4273733632
            RamTstBlockParams_001: RamTstBlockId=2, RamTstEndAddress=4273741823, RamTstStartAddress=4273737728
            RamTstBlockParams_002: RamTstBlockId=3, RamTstEndAddress=4273745919, RamTstStartAddress=4273741824
            RamTstBlockParams_003: RamTstBlockId=4, RamTstEndAddress=4273750015, RamTstStartAddress=4273745920
            RamTstBlockParams_004: RamTstBlockId=5, RamTstEndAddress=4273754111, RamTstStartAddress=4273750016
            RamTstBlockParams_005: RamTstBlockId=6, RamTstEndAddress=4273758207, RamTstStartAddress=4273754112
            RamTstBlockParams_006: RamTstBlockId=7, RamTstEndAddress=4273762303, RamTstStartAddress=4273758208
            RamTstBlockParams_007: RamTstBlockId=8, RamTstEndAddress=4273766399, RamTstStartAddress=4273762304
            RamTstBlockParams_008: RamTstBlockId=9, RamTstEndAddress=4273770495, RamTstStartAddress=4273766400
            RamTstBlockParams_009: RamTstBlockId=10, RamTstEndAddress=4273774591, RamTstStartAddress=4273770496
            RamTstBlockParams_010: RamTstBlockId=11, RamTstEndAddress=4273778687, RamTstStartAddress=4273774592
            RamTstBlockParams_011: RamTstBlockId=12, RamTstEndAddress=4273782783, RamTstStartAddress=4273778688
            RamTstBlockParams_012: RamTstBlockId=13, RamTstEndAddress=4273786879, RamTstStartAddress=4273782784
            RamTstBlockParams_013: RamTstBlockId=14, RamTstEndAddress=4273790975, RamTstStartAddress=4273786880
            RamTstBlockParams_014: RamTstBlockId=15, RamTstEndAddress=4273795071, RamTstStartAddress=4273790976
            RamTstBlockParams_015: RamTstBlockId=16, RamTstEndAddress=4273799167, RamTstStartAddress=4273795072
            RamTstBlockParams_016: RamTstBlockId=17, RamTstEndAddress=4273803263, RamTstStartAddress=4273799168
            RamTstBlockParams_017: RamTstBlockId=18, RamTstEndAddress=4273807359, RamTstStartAddress=4273803264
            RamTstBlockParams_018: RamTstBlockId=19, RamTstEndAddress=4273811455, RamTstStartAddress=4273807360
            RamTstBlockParams_019: RamTstBlockId=20, RamTstEndAddress=4273815551, RamTstStartAddress=4273811456
            RamTstBlockParams_020: RamTstBlockId=21, RamTstEndAddress=4273819647, RamTstStartAddress=4273815552
            RamTstBlockParams_021: RamTstBlockId=22, RamTstEndAddress=4273823743, RamTstStartAddress=4273819648
            RamTstBlockParams_022: RamTstBlockId=23, RamTstEndAddress=4273827839, RamTstStartAddress=4273823744
            RamTstBlockParams_023: RamTstBlockId=24, RamTstEndAddress=4273831935, RamTstStartAddress=4273827840
            RamTstBlockParams_024: RamTstBlockId=25, RamTstEndAddress=4273836031, RamTstStartAddress=4273831936
            RamTstBlockParams_025: RamTstBlockId=26, RamTstEndAddress=4273840127, RamTstStartAddress=4273836032
            RamTstBlockParams_026: RamTstBlockId=27, RamTstEndAddress=4273844223, RamTstStartAddress=4273840128
            RamTstBlockParams_027: RamTstBlockId=28, RamTstEndAddress=4273848319, RamTstStartAddress=4273844224
            RamTstBlockParams_028: RamTstBlockId=29, RamTstEndAddress=4273852415, RamTstStartAddress=4273848320
            RamTstBlockParams_029: RamTstBlockId=30, RamTstEndAddress=4273856511, RamTstStartAddress=4273852416
            RamTstBlockParams_030: RamTstBlockId=31, RamTstEndAddress=4273860607, RamTstStartAddress=4273856512
            RamTstBlockParams_031: RamTstBlockId=32, RamTstEndAddress=4273864703, RamTstStartAddress=4273860608
            RamTstBlockParams_032: RamTstBlockId=33, RamTstEndAddress=4273868799, RamTstStartAddress=4273864704
            RamTstBlockParams_033: RamTstBlockId=34, RamTstEndAddress=4273872895, RamTstStartAddress=4273868800
            RamTstBlockParams_034: RamTstBlockId=35, RamTstEndAddress=4273876991, RamTstStartAddress=4273872896
            RamTstBlockParams_035: RamTstBlockId=36, RamTstEndAddress=4273881087, RamTstStartAddress=4273876992
            RamTstBlockParams_036: RamTstBlockId=37, RamTstEndAddress=4273885183, RamTstStartAddress=4273881088
            RamTstBlockParams_037: RamTstBlockId=38, RamTstEndAddress=4273889279, RamTstStartAddress=4273885184
            RamTstBlockParams_038: RamTstBlockId=39, RamTstEndAddress=4273893375, RamTstStartAddress=4273889280
            RamTstBlockParams_039: RamTstBlockId=40, RamTstEndAddress=4273897471, RamTstStartAddress=4273893376
    RamTstPublishedInformation: RamTstCellSize=32
    RamTstDemEventParameterRefs:
      RAMTST_MAIN_RAM_FAILURE = AutoCreatedDemEvent_RamtstDemEventParameterRefs_RAMTST_E_MIAN_RAM_FAILURE
      RAMTST_E_ECC_FAILED = AutoCreatedDemEvent_RamtstDemEventParameterRefs_RAMTST_E_ECC_FAILED
      RAMTST_E_RAM_FAILURE = AutoCreatedDemEvent_RamtstDemEventParameterRefs_RAMTST_E_RAM_FAILURE
      RAMTST_PART_RAM_FAILURE = AutoCreatedDemEvent_RamtstDemEventParameterRefs_RAMTST_E_PART_RAM_FAILURE
      RAMTST_RUNFL_RAM_FAILURE = AutoCreatedDemEvent_RamtstDemEventParameterRefs_RAMTST_E_RUNFL_RAM_FAILURE
