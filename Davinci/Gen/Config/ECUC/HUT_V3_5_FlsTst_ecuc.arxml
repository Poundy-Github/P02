AUTOSAR XML (schema 00046)
package /ActiveEcuC
  module config FlsTst: implementation-config-variant=VARIANT-POST-BUILD, module-description=FlsTst_Impl
    FlsTstGeneral:
      FlsTstAlreadyInitDetCheck = true
      FlsTstCFECCTestStartAddress = 16982016
      FlsTstCrcBgndDcranUnit = FLSTST_DCRA0
      FlsTstCrcFgndDcranUnit = FLSTST_DCRA1
      FlsTstCriticalSectionProtection = true
      FlsTstDevErrorDetect = false
      FlsTstDeviceName = R7F701651
      FlsTstNumberOfTestedCellsAtomic = 1
      FlsTstRAMMirror = DISABLE
      FlsTstTestCompletedNotificationSupported = true
      FlsTstTestIntervalIdEndValue = 1
      FlsTstTestResultSignature = false
      FlsTstUseWriteVerifyErrorInterface = false
      FlsTstVerCheckExtrModules = false
      FlsTstWriteVerify = WV_DISABLE
    FlsTstConfigSet: FlsTstBlockNumberBgnd=0, FlsTstBlockNumberFgnd=0, FlsTstTestCompletedNotification=NULL_PTR
    FlsTstConfigurationOfOptApiServices:
      FlsTstGetCurrentStateApi = false
      FlsTstGetErrorDetailsApi = false
      FlsTstGetTestResultBgndApi = false
      FlsTstGetTestResultFgndApi = true
      FlsTstGetTestSignatureBgndApi = false
      FlsTstGetTestSignatureFgndApi = true
      FlsTstStartFgndApi = true
      FlsTstSuspendResumeApi = false
      FlsTstTestEccApi = true
      FlsTstVersionInfoApi = false
    FlsTstDemEventParameterRefs:
      FLSTST_E_ECC_FAILED = AutoCreatedDemEvent_FlststDemEventParameterRefs_FLSTST_E_ECC_FAILED
      FLSTST_E_FLSTST_FAILURE = AutoCreatedDemEvent_FlststDemEventParameterRefs_FLSTST_E_FLSTEST_FAILURE
      FLSTST_E_REG_WRITE_VERIFY = AutoCreatedDemEvent_FlststDemEventParameterRefs_FLSTST_E_REG_WRITE_VERIFY
