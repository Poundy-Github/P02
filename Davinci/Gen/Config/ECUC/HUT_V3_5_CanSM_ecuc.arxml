AUTOSAR XML (schema 00046)
package /ActiveEcuC
  module config CanSM: implementation-config-variant=VARIANT-PRE-COMPILE, module-description=CanSM_Impl
    CanSMConfiguration: CanSMModeRequestRepetitionMax=10, CanSMModeRequestRepetitionTime=0.1
      CHNL_b4130143 (CanSMManagerNetwork):
        CanSMBorCounterL1ToL2 = 6
        CanSMBorTimeL1 = 0.09
        CanSMBorTimeL2 = 1
        CanSMBorTimeTxEnsured = 0.1
        CanSMBorTxConfirmationPolling = false
        CanSMComMNetworkHandleRef = CN_B30_for_SC_CAN_V3_2_c0d6c67b
        CanSMTransceiverId = CanIfTrcvCfg_CAN3
        CT_B30_for_SC_CAN_V3_2_51247d91 (CanSMController): CanSMControllerId=CT_B30_for_SC_CAN_V3_2_4a04dc9c
    CanSMGeneral:
      CanSMDevErrorDetect = true
      CanSMMainFunctionTimePeriod = 0.005
      CanSMVersionInfoApi = false
      CanSMBorCheckLevel = true
      CanSMSetBaudrateApi = false
      CanSMBusOffBegin = CanServer_BusOffBegin
      CanSMBusOffEnd = CanServer_BusOffEnd
      CanSMGeneration: CanSMOutOfBoundsWriteSanitizer=false, CanSMOutOfBoundsReadSanitizer=false
