AUTOSAR XML (schema 00046)
package /ActiveEcuC
  module config Fee: implementation-config-variant=VARIANT-PRE-COMPILE, module-description=Fee_Impl
    FeeGeneral:
      FeeDevErrorDetect = true
      FeeIndex = 0
      FeeNvmJobEndNotification = NvM_JobEndNotification
      FeeNvmJobErrorNotification = NvM_JobErrorNotification
      FeePollingMode = true
      FeeSetModeSupported = true
      FeeVersionInfoApi = false
      FeeVirtualPageSize = 8
      FeeMainFunctionPeriod = 0.005
      FeeMainFunctionTriggering = FixedCycleTime
      FeeCorrectSingleBitFlips = false
      FeeSafeBswChecks = false
    FeePublishedInformation: FeeBlockOverhead=2, FeeMaximumBlockingTime=1, FeePageOverhead=0
    FeePartitionConfiguration:
      FeePartitionStartAddress = 0
      FeePartitionAddressAlignment = 64
      FeePartitionWriteAlignment = 4
      FeePartitionReadAlignment = 1
      FeeFlsBlankCheckApi = true
      FeePartitionSize = 8192
      FeePartitionDevice = FlsConfigSet
    12 x FeeBlockConfiguration, all with FeeImmediateData=false, FeeNumberOfDatasets=2, FeeVerifyWrittenData=false, FeeDeviceIndex=FlsGeneral:
      FeeDemAdminDataBlock: FeeBlockNumber=16, FeeBlockSize=32, FeeNumberOfWriteCycles=10000, FeeNumberOfInstances=1, FeeBlockId=0, FeePartition=FeePartitionConfiguration_DEM
      FeeDemStatusDataBlock: FeeBlockNumber=32, FeeBlockSize=406, FeeNumberOfWriteCycles=10000, FeeNumberOfInstances=1, FeeBlockId=1, FeePartition=FeePartitionConfiguration_DEM
      FeeDemPrimaryDataBlock0: FeeBlockNumber=48, FeeBlockSize=32, FeeNumberOfWriteCycles=100000, FeeNumberOfInstances=1, FeeBlockId=3, FeePartition=FeePartitionConfiguration_DEM
      FeeDemPrimaryDataBlock1: FeeBlockNumber=64, FeeBlockSize=32, FeeNumberOfWriteCycles=10000, FeeNumberOfInstances=1, FeeBlockId=4, FeePartition=FeePartitionConfiguration_DEM
      FeeDemPrimaryDataBlock2: FeeBlockNumber=80, FeeBlockSize=32, FeeNumberOfWriteCycles=10000, FeeNumberOfInstances=1, FeeBlockId=6, FeePartition=FeePartitionConfiguration_DEM
      FeeDemPrimaryDataBlock3: FeeBlockNumber=96, FeeBlockSize=32, FeeNumberOfWriteCycles=10000, FeeNumberOfInstances=1, FeeBlockId=7, FeePartition=FeePartitionConfiguration_DEM
      FeeDemPrimaryDataBlock4: FeeBlockNumber=112, FeeBlockSize=32, FeeNumberOfWriteCycles=10000, FeeNumberOfInstances=1, FeeBlockId=9, FeePartition=FeePartitionConfiguration_DEM
      FeeDemPrimaryDataBlock5: FeeBlockNumber=128, FeeBlockSize=32, FeeNumberOfWriteCycles=10000, FeeNumberOfInstances=1, FeeBlockId=10, FeePartition=FeePartitionConfiguration_DEM
      FeeDemPrimaryDataBlock6: FeeBlockNumber=144, FeeBlockSize=32, FeeNumberOfWriteCycles=10000, FeeNumberOfInstances=1, FeeBlockId=12, FeePartition=FeePartitionConfiguration_DEM
      FeeDemPrimaryDataBlock7: FeeBlockNumber=160, FeeBlockSize=32, FeeNumberOfWriteCycles=10000, FeeNumberOfInstances=1, FeeBlockId=13, FeePartition=FeePartitionConfiguration_DEM
      FeeStartApplication_NvMBlock1: FeeBlockNumber=176, FeeBlockSize=4, FeeNumberOfWriteCycles=10000, FeeNumberOfInstances=1, FeeBlockId=0, FeePartition=FeePartitionConfiguration
      FeeNvBlockNeed_Block_ODO_1: FeeBlockNumber=192, FeeBlockSize=18, FeeNumberOfWriteCycles=300000, FeeNumberOfInstances=3, FeeBlockId=1, FeePartition=FeePartitionConfiguration
    FeePartitionConfiguration_boot (FeePartitionConfiguration):
      FeePartitionStartAddress = 32640
      FeePartitionSize = 128
      FeePartitionAddressAlignment = 64
      FeePartitionWriteAlignment = 4
      FeePartitionReadAlignment = 1
      FeeFlsBlankCheckApi = true
      FeePartitionDevice = FlsConfigSet
    46 x FeeBlockConfiguration, all with FeeImmediateData=false, FeeNumberOfDatasets=2, FeeVerifyWrittenData=false, FeeDeviceIndex=FlsGeneral:
      FeeNvBlockNeed_Block_ODO_2: FeeBlockNumber=208, FeeBlockSize=18, FeeNumberOfWriteCycles=300000, FeeNumberOfInstances=3, FeeBlockId=2, FeePartition=FeePartitionConfiguration
      FeeNvBlockNeed_Block_ODO_3: FeeBlockNumber=224, FeeBlockSize=18, FeeNumberOfWriteCycles=300000, FeeNumberOfInstances=3, FeeBlockId=3, FeePartition=FeePartitionConfiguration
      FeeNvBlockNeed_Block_ODO_4: FeeBlockNumber=240, FeeBlockSize=18, FeeNumberOfWriteCycles=300000, FeeNumberOfInstances=3, FeeBlockId=4, FeePartition=FeePartitionConfiguration
      FeeNvBlockNeed_Block_ODO_5: FeeBlockNumber=256, FeeBlockSize=18, FeeNumberOfWriteCycles=300000, FeeNumberOfInstances=3, FeeBlockId=5, FeePartition=FeePartitionConfiguration
      FeeODO_NvBlockNeed_Block_MaintainOdo: FeeBlockNumber=272, FeeBlockSize=82, FeeNumberOfWriteCycles=10000, FeeNumberOfInstances=1, FeeBlockId=6, FeePartition=FeePartitionConfiguration
      FeeODO_NvBlockNeed_Block_Trip: FeeBlockNumber=288, FeeBlockSize=22, FeeNumberOfWriteCycles=10000, FeeNumberOfInstances=1, FeeBlockId=7, FeePartition=FeePartitionConfiguration
      FeeDidDataProcessNvBlockNeed_FactoryMode: FeeBlockNumber=304, FeeBlockSize=3, FeeNumberOfWriteCycles=10000, FeeNumberOfInstances=1, FeeBlockId=1, FeePartition=FeePartitionConfiguration_Diag
      FeeDidDataProcessNvBlockNeed_VIN: FeeBlockNumber=320, FeeBlockSize=19, FeeNumberOfWriteCycles=10000, FeeNumberOfInstances=1, FeeBlockId=0, FeePartition=FeePartitionConfiguration_Diag
      FeeDidDataProcessNvBlockNeed_VehicleMode: FeeBlockNumber=336, FeeBlockSize=22, FeeNumberOfWriteCycles=10000, FeeNumberOfInstances=1, FeeBlockId=2, FeePartition=FeePartitionConfiguration_Diag
      FeeDidDataProcessNvBlockNeed_ECUlevelNetworkConfigurationData: FeeBlockNumber=352, FeeBlockSize=202, FeeNumberOfWriteCycles=10000, FeeNumberOfInstances=1, FeeBlockId=3, FeePartition=FeePartitionConfiguration_Diag
      FeeEOL_NvBlockNeed_0xF18C: FeeBlockNumber=368, FeeBlockSize=22, FeeNumberOfWriteCycles=10000, FeeNumberOfInstances=1, FeeBlockId=4, FeePartition=FeePartitionConfiguration_Diag
      FeeEOL_NvBlockNeed_0xF193: FeeBlockNumber=384, FeeBlockSize=17, FeeNumberOfWriteCycles=10000, FeeNumberOfInstances=1, FeeBlockId=5, FeePartition=FeePartitionConfiguration_Diag
      FeeEOL_NvBlockNeed_0xF195: FeeBlockNumber=400, FeeBlockSize=19, FeeNumberOfWriteCycles=10000, FeeNumberOfInstances=1, FeeBlockId=6, FeePartition=FeePartitionConfiguration_Diag
      FeeEOL_NvBlockNeed_0xFD00: FeeBlockNumber=416, FeeBlockSize=6, FeeNumberOfWriteCycles=10000, FeeNumberOfInstances=1, FeeBlockId=7, FeePartition=FeePartitionConfiguration_Diag
      FeeEOL_NvBlockNeed_0xFD19: FeeBlockNumber=432, FeeBlockSize=3, FeeNumberOfWriteCycles=10000, FeeNumberOfInstances=1, FeeBlockId=8, FeePartition=FeePartitionConfiguration_Diag
      FeeEOL_NvBlockNeed_0xFE20: FeeBlockNumber=448, FeeBlockSize=3, FeeNumberOfWriteCycles=10000, FeeNumberOfInstances=1, FeeBlockId=9, FeePartition=FeePartitionConfiguration_Diag
      FeeEOL_NvBlockNeed_0xFE21: FeeBlockNumber=464, FeeBlockSize=3, FeeNumberOfWriteCycles=10000, FeeNumberOfInstances=1, FeeBlockId=10, FeePartition=FeePartitionConfiguration_Diag
      FeeEOL_NvBlockNeed_0xFE22: FeeBlockNumber=480, FeeBlockSize=3, FeeNumberOfWriteCycles=10000, FeeNumberOfInstances=1, FeeBlockId=12, FeePartition=FeePartitionConfiguration_Diag
      FeeEOL_NvBlockNeed_0xFE23: FeeBlockNumber=496, FeeBlockSize=4, FeeNumberOfWriteCycles=10000, FeeNumberOfInstances=1, FeeBlockId=13, FeePartition=FeePartitionConfiguration_Diag
      FeeEOL_NvBlockNeed_0xFE24: FeeBlockNumber=512, FeeBlockSize=3, FeeNumberOfWriteCycles=10000, FeeNumberOfInstances=1, FeeBlockId=17, FeePartition=FeePartitionConfiguration_Diag
      FeeEOL_NvBlockNeed_0xFE25: FeeBlockNumber=528, FeeBlockSize=4, FeeNumberOfWriteCycles=10000, FeeNumberOfInstances=1, FeeBlockId=19, FeePartition=FeePartitionConfiguration_Diag
      FeeDemPrimaryDataBlock10: FeeBlockNumber=544, FeeBlockSize=32, FeeNumberOfWriteCycles=10000, FeeNumberOfInstances=1, FeeBlockId=8, FeePartition=FeePartitionConfiguration_DEM
      FeeDemPrimaryDataBlock11: FeeBlockNumber=560, FeeBlockSize=32, FeeNumberOfWriteCycles=10000, FeeNumberOfInstances=1, FeeBlockId=11, FeePartition=FeePartitionConfiguration_DEM
      FeeDemPrimaryDataBlock12: FeeBlockNumber=576, FeeBlockSize=32, FeeNumberOfWriteCycles=10000, FeeNumberOfInstances=1, FeeBlockId=14, FeePartition=FeePartitionConfiguration_DEM
      FeeDemPrimaryDataBlock13: FeeBlockNumber=592, FeeBlockSize=32, FeeNumberOfWriteCycles=10000, FeeNumberOfInstances=1, FeeBlockId=15, FeePartition=FeePartitionConfiguration_DEM
      FeeDemPrimaryDataBlock14: FeeBlockNumber=608, FeeBlockSize=32, FeeNumberOfWriteCycles=10000, FeeNumberOfInstances=1, FeeBlockId=16, FeePartition=FeePartitionConfiguration_DEM
      FeeDemPrimaryDataBlock15: FeeBlockNumber=624, FeeBlockSize=32, FeeNumberOfWriteCycles=10000, FeeNumberOfInstances=1, FeeBlockId=17, FeePartition=FeePartitionConfiguration_DEM
      FeeDemPrimaryDataBlock16: FeeBlockNumber=640, FeeBlockSize=32, FeeNumberOfWriteCycles=10000, FeeNumberOfInstances=1, FeeBlockId=18, FeePartition=FeePartitionConfiguration_DEM
      FeeDemPrimaryDataBlock17: FeeBlockNumber=656, FeeBlockSize=32, FeeNumberOfWriteCycles=10000, FeeNumberOfInstances=1, FeeBlockId=21, FeePartition=FeePartitionConfiguration_DEM
      FeeDemPrimaryDataBlock18: FeeBlockNumber=672, FeeBlockSize=32, FeeNumberOfWriteCycles=10000, FeeNumberOfInstances=1, FeeBlockId=20, FeePartition=FeePartitionConfiguration_DEM
      FeeDemPrimaryDataBlock19: FeeBlockNumber=688, FeeBlockSize=32, FeeNumberOfWriteCycles=10000, FeeNumberOfInstances=1, FeeBlockId=19, FeePartition=FeePartitionConfiguration_DEM
      FeeDemPrimaryDataBlock8: FeeBlockNumber=704, FeeBlockSize=32, FeeNumberOfWriteCycles=10000, FeeNumberOfInstances=1, FeeBlockId=2, FeePartition=FeePartitionConfiguration_DEM
      FeeDemPrimaryDataBlock9: FeeBlockNumber=720, FeeBlockSize=32, FeeNumberOfWriteCycles=10000, FeeNumberOfInstances=1, FeeBlockId=5, FeePartition=FeePartitionConfiguration_DEM
      FeeEOL_NvBlockNeed_0xF187: FeeBlockNumber=736, FeeBlockSize=15, FeeNumberOfWriteCycles=10000, FeeNumberOfInstances=1, FeeBlockId=11, FeePartition=FeePartitionConfiguration_Diag
      FeeCommon_GateWayNvBlockNeed_Block_IPC_Config_Data: FeeBlockNumber=752, FeeBlockSize=62, FeeNumberOfWriteCycles=10000, FeeNumberOfInstances=1, FeeBlockId=8, FeePartition=FeePartitionConfiguration
      FeeCommon_GateWayNvBlockNeed_Block_IPC_CAN_Data: FeeBlockNumber=768, FeeBlockSize=122, FeeNumberOfWriteCycles=10000, FeeNumberOfInstances=1, FeeBlockId=9, FeePartition=FeePartitionConfiguration
      FeeMiscNvBlockNeed_ResetInfomation: FeeBlockNumber=784, FeeBlockSize=65, FeeNumberOfWriteCycles=10000, FeeNumberOfInstances=1, FeeBlockId=10, FeePartition=FeePartitionConfiguration
      FeeDCM_ServerNvBlockNeedSecAttemptCount: FeeBlockNumber=800, FeeBlockSize=3, FeeNumberOfWriteCycles=10000, FeeNumberOfInstances=1, FeeBlockId=15, FeePartition=FeePartitionConfiguration_Diag
      FeeDCM_ServerNvBlockNeed_EOLUnlockCnt: FeeBlockNumber=816, FeeBlockSize=3, FeeNumberOfWriteCycles=10000, FeeNumberOfInstances=1, FeeBlockId=18, FeePartition=FeePartitionConfiguration_Diag
      FeeDidDataProcessNvBlockNeed_ClusterInternalConfiguration: FeeBlockNumber=832, FeeBlockSize=302, FeeNumberOfWriteCycles=10000, FeeNumberOfInstances=1, FeeBlockId=20, FeePartition=FeePartitionConfiguration_Diag
      FeeAMP_NvBlockNeed_LC_Calibration: FeeBlockNumber=848, FeeBlockSize=22, FeeNumberOfWriteCycles=10000, FeeNumberOfInstances=1, FeeBlockId=21, FeePartition=FeePartitionConfiguration_Diag
      FeeDidDataProcessNvBlockNeed_E2ESwitch: FeeBlockNumber=864, FeeBlockSize=3, FeeNumberOfWriteCycles=10000, FeeNumberOfInstances=1, FeeBlockId=16, FeePartition=FeePartitionConfiguration_Diag
      FeeDidDataProcessNvBlockNeed_SecOcSwitch: FeeBlockNumber=880, FeeBlockSize=3, FeeNumberOfWriteCycles=10000, FeeNumberOfInstances=1, FeeBlockId=14, FeePartition=FeePartitionConfiguration_Diag
      FeeNvBlockNeed_UpgradeResetFlag: FeeBlockNumber=896, FeeBlockSize=6, FeeNumberOfWriteCycles=10000, FeeNumberOfInstances=1, FeeBlockId=0, FeePartition=FeePartitionConfiguration_boot
      FeeBlockConfiguration_Fvm_TripCount: FeeBlockNumber=912, FeeBlockSize=6, FeeNumberOfWriteCycles=10000, FeeNumberOfInstances=1, FeeBlockId=11, FeePartition=FeePartitionConfiguration
      FeeCommon_NormalNvBlockNeed_Menu: FeeBlockNumber=928, FeeBlockSize=22, FeeNumberOfWriteCycles=10000, FeeNumberOfInstances=1, FeeBlockId=12, FeePartition=FeePartitionConfiguration
    FeePartitionConfiguration_Diag (FeePartitionConfiguration):
      FeePartitionStartAddress = 16384
      FeePartitionSize = 8192
      FeePartitionAddressAlignment = 64
      FeePartitionWriteAlignment = 4
      FeePartitionReadAlignment = 1
      FeeFlsBlankCheckApi = true
      FeePartitionDevice = FlsConfigSet
    FeePartitionConfiguration_DEM (FeePartitionConfiguration):
      FeePartitionStartAddress = 8192
      FeePartitionSize = 8192
      FeePartitionAddressAlignment = 64
      FeePartitionWriteAlignment = 4
      FeePartitionReadAlignment = 1
      FeeFlsBlankCheckApi = true
      FeePartitionDevice = FlsConfigSet
    6 x FeeBlockConfiguration, all with FeeImmediateData=false, FeeNumberOfWriteCycles=10000, FeeNumberOfDatasets=2, FeeNumberOfInstances=1, FeeVerifyWrittenData=false, FeeDeviceIndex=FlsGeneral, FeePartition=FeePartitionConfiguration_Diag:
      FeeDidDataProcessNvBlockNeed_VehicleSoftwareVersion: FeeBlockNumber=944, FeeBlockSize=32, FeeBlockId=22
      FeeAMP_NvBlockNeed_LC_Calibration2: FeeBlockNumber=960, FeeBlockSize=22, FeeBlockId=23
      FeeSOCManagerNvBlockNeed_HealthSwitch: FeeBlockNumber=976, FeeBlockSize=3, FeeBlockId=24
      FeeDidDataProcessNvBlockNeed_ClusterDisplayHMIAdjustmentOffset: FeeBlockNumber=992, FeeBlockSize=10, FeeBlockId=25
      FeeCan_ServerNvBlockNeed_AbnormalWakeupSleepRecords: FeeBlockNumber=1008, FeeBlockSize=82, FeeBlockId=26
      FeeCan_ServerNvBlockNeed_ActiveWUCounter: FeeBlockNumber=1024, FeeBlockSize=3, FeeBlockId=27
