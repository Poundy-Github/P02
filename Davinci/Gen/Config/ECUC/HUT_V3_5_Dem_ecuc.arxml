[part 1 of 2: package /ActiveEcuC]
AUTOSAR XML (schema 00046)
package /ActiveEcuC
  module config Dem: implementation-config-variant=VARIANT-PRE-COMPILE, module-description=Dem_Impl
    DemConfigSet
      DTCClass_DTC_0xd00a46 (DemDTCClass): DemDTCSeverity=DEM_DTC_SEV_NO_SEVERITY, DemUdsDTC=13634118, DemImmediateNvStorage=false
      DTCClass_DTC_0x9a0625 (DemDTCClass): DemDTCSeverity=DEM_DTC_SEV_NO_SEVERITY, DemUdsDTC=10094117, DemImmediateNvStorage=false
      Lost_communication_with_W_HUD_Missing_Message (DemEventParameter):
        DemEventKind = DEM_EVENT_KIND_SWC
        DemMaxNumberFreezeFrameRecords = 1
        DemEventLatchTestFailed = false
        DemEventTimeSeries = DEM_TIMESERIES_SNAPSHOT_NONE
        DemEventAvailable = false
        DemEventId = 46
        DemEventAvailableInVariant = true
        DemEventCreateInfoPort = true
        DemDTCClassRef = DTCClass_DTC_0x908b87
        DemExtendedDataClassRef = ExtendedDataClass_4f5344cd
        DemFreezeFrameClassRef = FreezeFrameClass_80c88891
        DemEventClass:
          DemAgingAllowed = true
          DemAgingCycleCounterThreshold = 40
          DemEventDestination = DEM_DTC_ORIGIN_PRIMARY_MEMORY
          DemEventPriority = 1
          DemEventSignificance = DEM_EVENT_SIGNIFICANCE_FAULT
          DemConsiderPtoStatus = false
          DemFFPrestorageSupported = false
          DemAgingCycleRef = Ignition_on_off
          DemOperationCycleRef = Ignition_on_off
          DemEnableConditionGroupRef = EnableConditionGroup_IgnOn
          DemDebounceAlgorithmClass
            DemDebounceMonitorInternal
              DemCallbackGetFDC
      DTCClass_DTC_0xe00208 (DemDTCClass): DemDTCSeverity=DEM_DTC_SEV_NO_SEVERITY, DemUdsDTC=14680584, DemImmediateNvStorage=false
      Mic_1_open_Circuit_Open (DemEventParameter):
        DemEventKind = DEM_EVENT_KIND_SWC
        DemMaxNumberFreezeFrameRecords = 1
        DemEventLatchTestFailed = false
        DemEventTimeSeries = DEM_TIMESERIES_SNAPSHOT_NONE
        DemEventAvailable = false
        DemEventId = 48
        DemEventAvailableInVariant = true
        DemEventCreateInfoPort = true
        DemDTCClassRef = DTCClass_DTC_0x93f513
        DemExtendedDataClassRef = ExtendedDataClass_4f5344cd
        DemFreezeFrameClassRef = FreezeFrameClass_80c88891
        DemEventClass:
          DemAgingAllowed = true
          DemAgingCycleCounterThreshold = 40
          DemEventDestination = DEM_DTC_ORIGIN_PRIMARY_MEMORY
          DemEventPriority = 1
          DemEventSignificance = DEM_EVENT_SIGNIFICANCE_FAULT
          DemConsiderPtoStatus = false
          DemFFPrestorageSupported = false
          DemAgingCycleRef = Ignition_on_off
          DemEnableConditionGroupRef = EnableConditionGroup_VIPBatteryVoltageAndIgnOn
          DemOperationCycleRef = Ignition_on_off
          DemDebounceAlgorithmClass  # DemDebounceTimeBase
            DemDebounceMonitorInternal
      DTCClass_DTC_0x9a0501 (DemDTCClass): DemDTCSeverity=DEM_DTC_SEV_NO_SEVERITY, DemUdsDTC=10093825, DemImmediateNvStorage=false
      INVALID_SHORTNAME_GW_Ethernet_unexpected_Link_Loss_Bus_Signal_Message_Failure (DemEventParameter):
        DemEventKind = DEM_EVENT_KIND_SWC
        DemMaxNumberFreezeFrameRecords = 1
        DemEventLatchTestFailed = false
        DemEventTimeSeries = DEM_TIMESERIES_SNAPSHOT_NONE
        DemEventAvailable = false
        DemEventId = 12
        DemEventAvailableInVariant = true
        DemEventCreateInfoPort = true
        DemDTCClassRef = DTCClass_DTC_0xe00208
        DemExtendedDataClassRef = ExtendedDataClass_4f5344cd
        DemFreezeFrameClassRef = FreezeFrameClass_80c88891
        DemEventClass:
          DemAgingAllowed = true
          DemAgingCycleCounterThreshold = 40
          DemEventDestination = DEM_DTC_ORIGIN_PRIMARY_MEMORY
          DemEventPriority = 1
          DemEventSignificance = DEM_EVENT_SIGNIFICANCE_FAULT
          DemConsiderPtoStatus = false
          DemFFPrestorageSupported = false
          DemAgingCycleRef = Ignition_on_off
          DemOperationCycleRef = Ignition_on_off
          DemEnableConditionGroupRef = EnableConditionGroup_VIPBatteryVoltageAndIgnOn
          DemDebounceAlgorithmClass
            DemDebounceMonitorInternal
              DemCallbackGetFDC
      Fuel_sensor2_short_to_GND_Circuit_Short_To_Ground (DemEventParameter):
        DemEventKind = DEM_EVENT_KIND_SWC
        DemMaxNumberFreezeFrameRecords = 1
        DemEventLatchTestFailed = false
        DemEventTimeSeries = DEM_TIMESERIES_SNAPSHOT_NONE
        DemEventAvailable = false
        DemEventId = 10
        DemEventAvailableInVariant = true
        DemEventCreateInfoPort = true
        DemDTCClassRef = DTCClass_DTC_0xa13111
        DemExtendedDataClassRef = ExtendedDataClass_4f5344cd
        DemFreezeFrameClassRef = FreezeFrameClass_80c88891
        DemEventClass:
          DemAgingAllowed = true
          DemAgingCycleCounterThreshold = 40
          DemEventDestination = DEM_DTC_ORIGIN_PRIMARY_MEMORY
          DemEventPriority = 1
          DemEventSignificance = DEM_EVENT_SIGNIFICANCE_FAULT
          DemConsiderPtoStatus = false
          DemFFPrestorageSupported = false
          DemAgingCycleRef = Ignition_on_off
          DemEnableConditionGroupRef = EnableConditionGroup_VIPBatteryVoltageAndIgnOn
          DemOperationCycleRef = Ignition_on_off
          DemDebounceAlgorithmClass  # DemDebounceTimeBase
            DemDebounceMonitorInternal
      DTCClass_DTC_0xe00c12 (DemDTCClass): DemDTCSeverity=DEM_DTC_SEV_NO_SEVERITY, DemUdsDTC=14683154, DemImmediateNvStorage=false
      DTCClass_DTC_0xa20149 (DemDTCClass): DemDTCSeverity=DEM_DTC_SEV_NO_SEVERITY, DemUdsDTC=10617161, DemImmediateNvStorage=false
      7 x DemEventParameter, all with DemMaxNumberFreezeFrameRecords=1, DemEventLatchTestFailed=false, DemEventTimeSeries=DEM_TIMESERIES_SNAPSHOT_NONE, DemEventAvailable=false, DemEventAvailableInVariant=true, DemEventCreateInfoPort=true, DemExtendedDataClassRef=ExtendedDataClass_4f5344cd, DemFreezeFrameClassRef=FreezeFrameClass_80c88891:
        SecOC_software_module_running_error_Unexpected_Operation: DemEventKind=DEM_EVENT_KIND_BSW, DemEventId=79, DemDTCClassRef=DTCClass_DTC_0xd00f94
          DemEventClass:
            DemAgingAllowed = true
            DemAgingCycleCounterThreshold = 40
            DemEventDestination = DEM_DTC_ORIGIN_PRIMARY_MEMORY
            DemEventPriority = 1
            DemEventSignificance = DEM_EVENT_SIGNIFICANCE_FAULT
            DemConsiderPtoStatus = false
            DemFFPrestorageSupported = false
            DemAgingCycleRef = Ignition_on_off
            DemOperationCycleRef = Ignition_on_off
            DemEnableConditionGroupRef = EnableConditionGroup_IgnOn
            DemDebounceAlgorithmClass
              DemDebounceMonitorInternal
                DemCallbackGetFDC
        Missing_Gateway_Missing_Message: DemEventKind=DEM_EVENT_KIND_SWC, DemEventId=68, DemDTCClassRef=DTCClass_DTC_0xc14687
          DemEventClass:
            DemAgingAllowed = true
            DemAgingCycleCounterThreshold = 40
            DemEventDestination = DEM_DTC_ORIGIN_PRIMARY_MEMORY
            DemEventPriority = 1
            DemEventSignificance = DEM_EVENT_SIGNIFICANCE_FAULT
            DemEventFailureCycleCounterThreshold = 0
            DemConsiderPtoStatus = false
            DemFFPrestorageSupported = false
            DemAgingCycleRef = Ignition_on_off
            DemEnableConditionGroupRef = EnableConditionGroup_VIPBatteryVoltageAndIgnOn
            DemOperationCycleRef = Ignition_on_off
            DemDebounceAlgorithmClass  # DemDebounceCounterBased
              DemDebounceMonitorInternal
        Speaker_Woofer_resistance_out_of_range_Circuit_Resistance_Out_of_Range: DemEventKind=DEM_EVENT_KIND_SWC, DemEventId=113, DemDTCClassRef=DTCClass_DTC_0x9a061e
          DemEventClass:
            DemAgingAllowed = true
            DemAgingCycleCounterThreshold = 40
            DemEventDestination = DEM_DTC_ORIGIN_PRIMARY_MEMORY
            DemEventPriority = 1
            DemEventSignificance = DEM_EVENT_SIGNIFICANCE_FAULT
            DemConsiderPtoStatus = false
            DemFFPrestorageSupported = false
            DemAgingCycleRef = Ignition_on_off
            DemEnableConditionGroupRef = EnableConditionGroup_BatteryVoltage
            DemOperationCycleRef = Ignition_on_off
            DemDebounceAlgorithmClass  # DemDebounceTimeBase
              DemDebounceMonitorInternal
        Speaker_FL_resistance_out_of_range_Circuit_Resistance_Out_of_Range: DemEventKind=DEM_EVENT_KIND_SWC, DemEventId=89, DemDTCClassRef=DTCClass_DTC_0x9a011e
          DemEventClass:
            DemAgingAllowed = true
            DemAgingCycleCounterThreshold = 40
            DemEventDestination = DEM_DTC_ORIGIN_PRIMARY_MEMORY
            DemEventPriority = 1
            DemEventSignificance = DEM_EVENT_SIGNIFICANCE_FAULT
            DemConsiderPtoStatus = false
            DemFFPrestorageSupported = false
            DemAgingCycleRef = Ignition_on_off
            DemEnableConditionGroupRef = EnableConditionGroup_BatteryVoltage
            DemOperationCycleRef = Ignition_on_off
            DemDebounceAlgorithmClass  # DemDebounceTimeBase
              DemDebounceMonitorInternal
        Speaker_RR_output_waveform_lack_fidelity_Signal_Shape_Waveform_Failure: DemEventKind=DEM_EVENT_KIND_SWC, DemEventId=106, DemDTCClassRef=DTCClass_DTC_0x9a0425
          DemEventClass:
            DemAgingAllowed = true
            DemAgingCycleCounterThreshold = 40
            DemEventDestination = DEM_DTC_ORIGIN_PRIMARY_MEMORY
            DemEventPriority = 1
            DemEventSignificance = DEM_EVENT_SIGNIFICANCE_FAULT
            DemConsiderPtoStatus = false
            DemFFPrestorageSupported = false
            DemAgingCycleRef = Ignition_on_off
            DemEnableConditionGroupRef = EnableConditionGroup_VIPBatteryVoltageAndIgnOn
            DemOperationCycleRef = Ignition_on_off
            DemDebounceAlgorithmClass  # DemDebounceTimeBase
              DemDebounceMonitorInternal
        missing_Trailer_Missing_Message: DemEventKind=DEM_EVENT_KIND_SWC, DemEventId=133, DemDTCClassRef=DTCClass_DTC_0xc14187
          DemEventClass:
            DemAgingAllowed = true
            DemAgingCycleCounterThreshold = 40
            DemEventDestination = DEM_DTC_ORIGIN_PRIMARY_MEMORY
            DemEventPriority = 1
            DemEventSignificance = DEM_EVENT_SIGNIFICANCE_FAULT
            DemEventFailureCycleCounterThreshold = 0
            DemConsiderPtoStatus = false
            DemFFPrestorageSupported = false
            DemAgingCycleRef = Ignition_on_off
            DemEnableConditionGroupRef = EnableConditionGroup_VIPBatteryVoltageAndIgnOn
            DemOperationCycleRef = Ignition_on_off
            DemDebounceAlgorithmClass  # DemDebounceCounterBased
              DemDebounceMonitorInternal
        Speaker_Center_short_across_General_Electrical_Failure: DemEventKind=DEM_EVENT_KIND_SWC, DemEventId=84, DemDTCClassRef=DTCClass_DTC_0x9a0501
          DemEventClass:
            DemAgingAllowed = true
            DemAgingCycleCounterThreshold = 40
            DemEventDestination = DEM_DTC_ORIGIN_PRIMARY_MEMORY
            DemEventPriority = 1
            DemEventSignificance = DEM_EVENT_SIGNIFICANCE_FAULT
            DemConsiderPtoStatus = false
            DemFFPrestorageSupported = false
            DemAgingCycleRef = Ignition_on_off
            DemEnableConditionGroupRef = EnableConditionGroup_BatteryVoltage
            DemOperationCycleRef = Ignition_on_off
            DemDebounceAlgorithmClass  # DemDebounceTimeBase
              DemDebounceMonitorInternal
      DTCClass_DTC_0xc12787 (DemDTCClass): DemDTCSeverity=DEM_DTC_SEV_NO_SEVERITY, DemUdsDTC=12658567, DemImmediateNvStorage=false
      6 x DemEventParameter, all with DemEventKind=DEM_EVENT_KIND_SWC, DemMaxNumberFreezeFrameRecords=1, DemEventLatchTestFailed=false, DemEventTimeSeries=DEM_TIMESERIES_SNAPSHOT_NONE, DemEventAvailable=false, DemEventAvailableInVariant=true, DemEventCreateInfoPort=true, DemExtendedDataClassRef=ExtendedDataClass_4f5344cd, DemFreezeFrameClassRef=FreezeFrameClass_80c88891:
        Missing_Around_View_Monitoring_system_Highly_Automatic_Parking_Integration_Park_Assistant_System_Missing_Message: DemEventId=57, DemDTCClassRef=DTCClass_DTC_0xd00487
          DemEventClass:
            DemAgingAllowed = true
            DemAgingCycleCounterThreshold = 40
            DemEventDestination = DEM_DTC_ORIGIN_PRIMARY_MEMORY
            DemEventPriority = 1
            DemEventSignificance = DEM_EVENT_SIGNIFICANCE_FAULT
            DemEventFailureCycleCounterThreshold = 0
            DemConsiderPtoStatus = false
            DemFFPrestorageSupported = false
            DemAgingCycleRef = Ignition_on_off
            DemEnableConditionGroupRef = EnableConditionGroup_VIPBatteryVoltageAndIgnOn
            DemOperationCycleRef = Ignition_on_off
            DemDebounceAlgorithmClass  # DemDebounceCounterBased
              DemDebounceMonitorInternal
        Speaker_FL_short_to_ground_Circuit_Short_To_Ground: DemEventId=92, DemDTCClassRef=DTCClass_DTC_0x9a0111
          DemEventClass:
            DemAgingAllowed = true
            DemAgingCycleCounterThreshold = 40
            DemEventDestination = DEM_DTC_ORIGIN_PRIMARY_MEMORY
            DemEventPriority = 1
            DemEventSignificance = DEM_EVENT_SIGNIFICANCE_FAULT
            DemConsiderPtoStatus = false
            DemFFPrestorageSupported = false
            DemAgingCycleRef = Ignition_on_off
            DemEnableConditionGroupRef = EnableConditionGroup_VIPBatteryVoltageAndIgnOn
            DemOperationCycleRef = Ignition_on_off
            DemDebounceAlgorithmClass  # DemDebounceTimeBase
              DemDebounceMonitorInternal
        Speaker_Center_short_to_battery_Circuit_Short_To_Battery: DemEventId=85, DemDTCClassRef=DTCClass_DTC_0x9a0512
          DemEventClass:
            DemAgingAllowed = true
            DemAgingCycleCounterThreshold = 40
            DemEventDestination = DEM_DTC_ORIGIN_PRIMARY_MEMORY
            DemEventPriority = 1
            DemEventSignificance = DEM_EVENT_SIGNIFICANCE_FAULT
            DemConsiderPtoStatus = false
            DemFFPrestorageSupported = false
            DemAgingCycleRef = Ignition_on_off
            DemEnableConditionGroupRef = EnableConditionGroup_VIPBatteryVoltageAndIgnOn
            DemOperationCycleRef = Ignition_on_off
            DemDebounceAlgorithmClass  # DemDebounceTimeBase
              DemDebounceMonitorInternal
        Mic_2_open_Circuit_Open: DemEventId=52, DemDTCClassRef=DTCClass_DTC_0x93f613
          DemEventClass:
            DemAgingAllowed = true
            DemAgingCycleCounterThreshold = 40
            DemEventDestination = DEM_DTC_ORIGIN_PRIMARY_MEMORY
            DemEventPriority = 1
            DemEventSignificance = DEM_EVENT_SIGNIFICANCE_FAULT
            DemConsiderPtoStatus = false
            DemFFPrestorageSupported = false
            DemAgingCycleRef = Ignition_on_off
            DemEnableConditionGroupRef = EnableConditionGroup_VIPBatteryVoltageAndIgnOn
            DemOperationCycleRef = Ignition_on_off
            DemDebounceAlgorithmClass  # DemDebounceTimeBase
              DemDebounceMonitorInternal
        Missing_Transmission_Control_Until_PTCAN_Missing_Message: DemEventId=73, DemDTCClassRef=DTCClass_DTC_0xc10187
          DemEventClass:
            DemAgingAllowed = true
            DemAgingCycleCounterThreshold = 40
            DemEventDestination = DEM_DTC_ORIGIN_PRIMARY_MEMORY
            DemEventPriority = 1
            DemEventSignificance = DEM_EVENT_SIGNIFICANCE_FAULT
            DemConsiderPtoStatus = false
            DemFFPrestorageSupported = false
            DemAgingCycleRef = Ignition_on_off
            DemEnableConditionGroupRef = EnableConditionGroup_VIPBatteryVoltageAndIgnOn
            DemOperationCycleRef = Ignition_on_off
            DemDebounceAlgorithmClass  # DemDebounceCounterBased
              DemDebounceMonitorInternal
        TUNER_FM2_short_to_battary_Circuit_Short_To_Battery: DemEventId=124, DemDTCClassRef=DTCClass_DTC_0x9a1112
          DemEventClass:
            DemAgingAllowed = true
            DemAgingCycleCounterThreshold = 40
            DemEventDestination = DEM_DTC_ORIGIN_PRIMARY_MEMORY
            DemEventPriority = 1
            DemEventSignificance = DEM_EVENT_SIGNIFICANCE_FAULT
            DemConsiderPtoStatus = false
            DemFFPrestorageSupported = false
            DemAgingCycleRef = Ignition_on_off
            DemOperationCycleRef = Ignition_on_off
            DemEnableConditionGroupRef = EnableConditionGroup_VIPBatteryVoltage2AndIgnOn
            DemDebounceAlgorithmClass
              DemDebounceMonitorInternal
                DemCallbackGetFDC
      3 x DemDTCClass, all with DemDTCSeverity=DEM_DTC_SEV_NO_SEVERITY, DemImmediateNvStorage=false:
        DTCClass_DTC_0x9a0612: DemUdsDTC=10094098
        DTCClass_DTC_0x9a0613: DemUdsDTC=10094099
        DTCClass_DTC_0x9a0611: DemUdsDTC=10094097
      INVALID_SHORTNAME_HUT_Display_TFT_failure_Internal_Electronic_Failure (DemEventParameter):
        DemEventKind = DEM_EVENT_KIND_SWC
        DemMaxNumberFreezeFrameRecords = 1
        DemEventLatchTestFailed = false
        DemEventTimeSeries = DEM_TIMESERIES_SNAPSHOT_NONE
        DemEventAvailable = false
        DemEventId = 16
        DemEventAvailableInVariant = true
        DemEventCreateInfoPort = true
        DemDTCClassRef = DTCClass_DTC_0xa20249
        DemExtendedDataClassRef = ExtendedDataClass_4f5344cd
        DemFreezeFrameClassRef = FreezeFrameClass_80c88891
        DemEventClass:
          DemAgingAllowed = true
          DemAgingCycleCounterThreshold = 40
          DemEventDestination = DEM_DTC_ORIGIN_PRIMARY_MEMORY
          DemEventPriority = 2
          DemEventSignificance = DEM_EVENT_SIGNIFICANCE_FAULT
          DemConsiderPtoStatus = false
          DemFFPrestorageSupported = false
          DemAgingCycleRef = Ignition_on_off
          DemOperationCycleRef = Ignition_on_off
          DemDebounceAlgorithmClass
            DemDebounceMonitorInternal
              DemCallbackGetFDC
      DTCClass_DTC_0xa20017 (DemDTCClass): DemDTCSeverity=DEM_DTC_SEV_NO_SEVERITY, DemUdsDTC=10616855, DemImmediateNvStorage=false
      DTCClass_DTC_0xc19987 (DemDTCClass): DemDTCSeverity=DEM_DTC_SEV_NO_SEVERITY, DemUdsDTC=12687751, DemImmediateNvStorage=false
      TUNER_FM1_short_to_groud_Circuit_Short_To_Ground (DemEventParameter):
        DemEventKind = DEM_EVENT_KIND_SWC
        DemMaxNumberFreezeFrameRecords = 1
        DemEventLatchTestFailed = false
        DemEventTimeSeries = DEM_TIMESERIES_SNAPSHOT_NONE
        DemEventAvailable = false
        DemEventId = 121
        DemEventAvailableInVariant = true
        DemEventCreateInfoPort = true
        DemDTCClassRef = DTCClass_DTC_0x9a1011
        DemExtendedDataClassRef = ExtendedDataClass_4f5344cd
        DemFreezeFrameClassRef = FreezeFrameClass_80c88891
        DemEventClass:
          DemAgingAllowed = true
          DemAgingCycleCounterThreshold = 40
          DemEventDestination = DEM_DTC_ORIGIN_PRIMARY_MEMORY
          DemEventPriority = 1
          DemEventSignificance = DEM_EVENT_SIGNIFICANCE_FAULT
          DemConsiderPtoStatus = false
          DemFFPrestorageSupported = false
          DemAgingCycleRef = Ignition_on_off
          DemOperationCycleRef = Ignition_on_off
          DemEnableConditionGroupRef = EnableConditionGroup_VIPBatteryVoltageAndIgnOn
          DemDebounceAlgorithmClass
            DemDebounceMonitorInternal
              DemCallbackGetFDC
      DTCClass_DTC_0xd10987 (DemDTCClass): DemDTCSeverity=DEM_DTC_SEV_NO_SEVERITY, DemUdsDTC=13699463, DemImmediateNvStorage=false
      Under_voltage_Circuit_Voltage_Below_Threshold (DemEventParameter):
        DemEventKind = DEM_EVENT_KIND_SWC
        DemMaxNumberFreezeFrameRecords = 1
        DemEventLatchTestFailed = false
        DemEventTimeSeries = DEM_TIMESERIES_SNAPSHOT_NONE
        DemEventAvailable = false
        DemEventId = 126
        DemEventAvailableInVariant = true
        DemEventCreateInfoPort = true
        DemDTCClassRef = DTCClass_DTC_0xd10116
        DemExtendedDataClassRef = ExtendedDataClass_4f5344cd
        DemFreezeFrameClassRef = FreezeFrameClass_80c88891
        DemEventClass:
          DemAgingAllowed = true
          DemAgingCycleCounterThreshold = 40
          DemEventDestination = DEM_DTC_ORIGIN_PRIMARY_MEMORY
          DemEventPriority = 1
          DemEventSignificance = DEM_EVENT_SIGNIFICANCE_FAULT
          DemConsiderPtoStatus = false
          DemFFPrestorageSupported = false
          DemAgingCycleRef = Ignition_on_off
          DemEnableConditionGroupRef = (unset)
          DemOperationCycleRef = Ignition_on_off
          DemDebounceAlgorithmClass  # DemDebounceTimeBase
            DemDebounceMonitorInternal
      3 x DemDTCClass, all with DemDTCSeverity=DEM_DTC_SEV_NO_SEVERITY, DemImmediateNvStorage=false:
        DTCClass_DTC_0xc11587: DemUdsDTC=12653959
        DTCClass_DTC_0x908a87: DemUdsDTC=9472647
        DTCClass_DTC_0xa10349: DemUdsDTC=10552137
      TUNER_FM2_over_current_detection_Circuit_Current_Above_Threshold (DemEventParameter):
        DemEventKind = DEM_EVENT_KIND_SWC
        DemMaxNumberFreezeFrameRecords = 1
        DemEventLatchTestFailed = false
        DemEventTimeSeries = DEM_TIMESERIES_SNAPSHOT_NONE
        DemEventAvailable = false
        DemEventId = 123
        DemEventAvailableInVariant = true
        DemEventCreateInfoPort = true
        DemDTCClassRef = DTCClass_DTC_0x9a1119
        DemExtendedDataClassRef = ExtendedDataClass_4f5344cd
        DemFreezeFrameClassRef = FreezeFrameClass_80c88891
        DemEventClass:
          DemAgingAllowed = true
          DemAgingCycleCounterThreshold = 40
          DemEventDestination = DEM_DTC_ORIGIN_PRIMARY_MEMORY
          DemEventPriority = 1
          DemEventSignificance = DEM_EVENT_SIGNIFICANCE_FAULT
          DemConsiderPtoStatus = false
          DemFFPrestorageSupported = false
          DemAgingCycleRef = Ignition_on_off
          DemOperationCycleRef = Ignition_on_off
          DemEnableConditionGroupRef = EnableConditionGroup_VIPBatteryVoltageAndIgnOn
          DemDebounceAlgorithmClass
            DemDebounceMonitorInternal
              DemCallbackGetFDC
      DTCClass_DTC_0x9a0525 (DemDTCClass): DemDTCSeverity=DEM_DTC_SEV_NO_SEVERITY, DemUdsDTC=10093861, DemImmediateNvStorage=false
      Speaker_RR_short_across_General_Electrical_Failure (DemEventParameter):
        DemEventKind = DEM_EVENT_KIND_SWC
        DemMaxNumberFreezeFrameRecords = 1
        DemEventLatchTestFailed = false
        DemEventTimeSeries = DEM_TIMESERIES_SNAPSHOT_NONE
        DemEventAvailable = false
        DemEventId = 108
        DemEventAvailableInVariant = true
        DemEventCreateInfoPort = true
        DemDTCClassRef = DTCClass_DTC_0x9a0401
        DemExtendedDataClassRef = ExtendedDataClass_4f5344cd
        DemFreezeFrameClassRef = FreezeFrameClass_80c88891
        DemEventClass:
          DemAgingAllowed = true
          DemAgingCycleCounterThreshold = 40
          DemEventDestination = DEM_DTC_ORIGIN_PRIMARY_MEMORY
          DemEventPriority = 1
          DemEventSignificance = DEM_EVENT_SIGNIFICANCE_FAULT
          DemConsiderPtoStatus = false
          DemFFPrestorageSupported = false
          DemAgingCycleRef = Ignition_on_off
          DemEnableConditionGroupRef = EnableConditionGroup_BatteryVoltage
          DemOperationCycleRef = Ignition_on_off
          DemDebounceAlgorithmClass  # DemDebounceTimeBase
            DemDebounceMonitorInternal
      DTCClass_DTC_0x9a0401 (DemDTCClass): DemDTCSeverity=DEM_DTC_SEV_NO_SEVERITY, DemUdsDTC=10093569, DemImmediateNvStorage=false
      Speaker_FL_open_Circuit_Open (DemEventParameter):
        DemEventKind = DEM_EVENT_KIND_SWC
        DemMaxNumberFreezeFrameRecords = 1
        DemEventLatchTestFailed = false
        DemEventTimeSeries = DEM_TIMESERIES_SNAPSHOT_NONE
        DemEventAvailable = false
        DemEventId = 87
        DemEventAvailableInVariant = true
        DemEventCreateInfoPort = true
        DemDTCClassRef = DTCClass_DTC_0x9a0113
        DemExtendedDataClassRef = ExtendedDataClass_4f5344cd
        DemFreezeFrameClassRef = FreezeFrameClass_80c88891
        DemEventClass:
          DemAgingAllowed = true
          DemAgingCycleCounterThreshold = 40
          DemEventDestination = DEM_DTC_ORIGIN_PRIMARY_MEMORY
          DemEventPriority = 1
          DemEventSignificance = DEM_EVENT_SIGNIFICANCE_FAULT
          DemConsiderPtoStatus = false
          DemFFPrestorageSupported = false
          DemAgingCycleRef = Ignition_on_off
          DemEnableConditionGroupRef = EnableConditionGroup_BatteryVoltage
          DemOperationCycleRef = Ignition_on_off
          DemDebounceAlgorithmClass  # DemDebounceTimeBase
            DemDebounceMonitorInternal
      TUNER_FM2_short_to_groud_Circuit_Short_To_Ground (DemEventParameter):
        DemEventKind = DEM_EVENT_KIND_SWC
        DemMaxNumberFreezeFrameRecords = 1
        DemEventLatchTestFailed = false
        DemEventTimeSeries = DEM_TIMESERIES_SNAPSHOT_NONE
        DemEventAvailable = false
        DemEventId = 125
        DemEventAvailableInVariant = true
        DemEventCreateInfoPort = true
        DemDTCClassRef = DTCClass_DTC_0x9a1111
        DemExtendedDataClassRef = ExtendedDataClass_4f5344cd
        DemFreezeFrameClassRef = FreezeFrameClass_80c88891
        DemEventClass:
          DemAgingAllowed = true
          DemAgingCycleCounterThreshold = 40
          DemEventDestination = DEM_DTC_ORIGIN_PRIMARY_MEMORY
          DemEventPriority = 1
          DemEventSignificance = DEM_EVENT_SIGNIFICANCE_FAULT
          DemConsiderPtoStatus = false
          DemFFPrestorageSupported = false
          DemAgingCycleRef = Ignition_on_off
          DemOperationCycleRef = Ignition_on_off
          DemEnableConditionGroupRef = EnableConditionGroup_VIPBatteryVoltageAndIgnOn
          DemDebounceAlgorithmClass
            DemDebounceMonitorInternal
              DemCallbackGetFDC
      DTCClass_DTC_0xa20249 (DemDTCClass): DemDTCSeverity=DEM_DTC_SEV_NO_SEVERITY, DemUdsDTC=10617417, DemImmediateNvStorage=false
      DTCClass_DTC_0xc24187 (DemDTCClass): DemDTCSeverity=DEM_DTC_SEV_NO_SEVERITY, DemUdsDTC=12730759, DemImmediateNvStorage=false
      Speaker_FR_short_to_battery_Circuit_Short_To_Battery (DemEventParameter):
        DemEventKind = DEM_EVENT_KIND_SWC
        DemMaxNumberFreezeFrameRecords = 1
        DemEventLatchTestFailed = false
        DemEventTimeSeries = DEM_TIMESERIES_SNAPSHOT_NONE
        DemEventAvailable = false
        DemEventId = 97
        DemEventAvailableInVariant = true
        DemEventCreateInfoPort = true
        DemDTCClassRef = DTCClass_DTC_0x9a0212
        DemExtendedDataClassRef = ExtendedDataClass_4f5344cd
        DemFreezeFrameClassRef = FreezeFrameClass_80c88891
        DemEventClass:
          DemAgingAllowed = true
          DemAgingCycleCounterThreshold = 40
          DemEventDestination = DEM_DTC_ORIGIN_PRIMARY_MEMORY
          DemEventPriority = 1
          DemEventSignificance = DEM_EVENT_SIGNIFICANCE_FAULT
          DemConsiderPtoStatus = false
          DemFFPrestorageSupported = false
          DemAgingCycleRef = Ignition_on_off
          DemEnableConditionGroupRef = EnableConditionGroup_VIPBatteryVoltageAndIgnOn
          DemOperationCycleRef = Ignition_on_off
          DemDebounceAlgorithmClass  # DemDebounceTimeBase
            DemDebounceMonitorInternal
      A2B_open_Circuit_Open (DemEventParameter):
        DemEventKind = DEM_EVENT_KIND_SWC
        DemMaxNumberFreezeFrameRecords = 1
        DemEventLatchTestFailed = false
        DemEventTimeSeries = DEM_TIMESERIES_SNAPSHOT_NONE
        DemEventAvailable = false
        DemEventId = 1
        DemEventAvailableInVariant = true
        DemEventCreateInfoPort = true
        DemDTCClassRef = DTCClass_DTC_0x95f813
        DemExtendedDataClassRef = ExtendedDataClass_4f5344cd
        DemFreezeFrameClassRef = FreezeFrameClass_80c88891
        DemEventClass:
          DemAgingAllowed = true
          DemAgingCycleCounterThreshold = 40
          DemEventDestination = DEM_DTC_ORIGIN_PRIMARY_MEMORY
          DemEventPriority = 1
          DemEventSignificance = DEM_EVENT_SIGNIFICANCE_FAULT
          DemConsiderPtoStatus = false
          DemFFPrestorageSupported = false
          DemAgingCycleRef = Ignition_on_off
          DemOperationCycleRef = Ignition_on_off
          DemEnableConditionGroupRef = EnableConditionGroup_VIPBatteryVoltageAndIgnOn
          DemDebounceAlgorithmClass
            DemDebounceMonitorInternal
              DemCallbackGetFDC
      DTCClass_DTC_0xa20008 (DemDTCClass): DemDTCSeverity=DEM_DTC_SEV_NO_SEVERITY, DemUdsDTC=10616840, DemImmediateNvStorage=false
      Speaker_RL_resistance_out_of_range_Circuit_Resistance_Out_of_Range (DemEventParameter):
        DemEventKind = DEM_EVENT_KIND_SWC
        DemMaxNumberFreezeFrameRecords = 1
        DemEventLatchTestFailed = false
        DemEventTimeSeries = DEM_TIMESERIES_SNAPSHOT_NONE
        DemEventAvailable = false
        DemEventId = 101
        DemEventAvailableInVariant = true
        DemEventCreateInfoPort = true
        DemDTCClassRef = DTCClass_DTC_0x9a031e
        DemExtendedDataClassRef = ExtendedDataClass_4f5344cd
        DemFreezeFrameClassRef = FreezeFrameClass_80c88891
        DemEventClass:
          DemAgingAllowed = true
          DemAgingCycleCounterThreshold = 40
          DemEventDestination = DEM_DTC_ORIGIN_PRIMARY_MEMORY
          DemEventPriority = 1
          DemEventSignificance = DEM_EVENT_SIGNIFICANCE_FAULT
          DemConsiderPtoStatus = false
          DemFFPrestorageSupported = false
          DemAgingCycleRef = Ignition_on_off
          DemEnableConditionGroupRef = EnableConditionGroup_BatteryVoltage
          DemOperationCycleRef = Ignition_on_off
          DemDebounceAlgorithmClass  # DemDebounceTimeBase
            DemDebounceMonitorInternal
      missing_Passenger_Door_Control_Module_Missing_Message (DemEventParameter):
        DemEventKind = DEM_EVENT_KIND_SWC
        DemMaxNumberFreezeFrameRecords = 1
        DemEventLatchTestFailed = false
        DemEventTimeSeries = DEM_TIMESERIES_SNAPSHOT_NONE
        DemEventAvailable = false
        DemEventId = 130
        DemEventAvailableInVariant = true
        DemEventCreateInfoPort = true
        DemDTCClassRef = DTCClass_DTC_0xc20087
        DemExtendedDataClassRef = ExtendedDataClass_4f5344cd
        DemFreezeFrameClassRef = FreezeFrameClass_80c88891
        DemEventClass:
          DemAgingAllowed = true
          DemAgingCycleCounterThreshold = 40
          DemEventDestination = DEM_DTC_ORIGIN_PRIMARY_MEMORY
          DemEventPriority = 1
          DemEventSignificance = DEM_EVENT_SIGNIFICANCE_FAULT
          DemEventFailureCycleCounterThreshold = 0
          DemConsiderPtoStatus = false
          DemFFPrestorageSupported = false
          DemAgingCycleRef = Ignition_on_off
          DemEnableConditionGroupRef = EnableConditionGroup_VIPBatteryVoltageAndIgnOn
          DemOperationCycleRef = Ignition_on_off
          DemDebounceAlgorithmClass  # DemDebounceCounterBased
            DemDebounceMonitorInternal
      DTCClass_DTC_0xc14387 (DemDTCClass): DemDTCSeverity=DEM_DTC_SEV_NO_SEVERITY, DemUdsDTC=12665735, DemImmediateNvStorage=false
      IP_Display_ASIC_failure_Internal_Electronic_Failure (DemEventParameter):
        DemEventKind = DEM_EVENT_KIND_SWC
        DemMaxNumberFreezeFrameRecords = 1
        DemEventLatchTestFailed = false
        DemEventTimeSeries = DEM_TIMESERIES_SNAPSHOT_NONE
        DemEventAvailable = false
        DemEventId = 22
        DemEventAvailableInVariant = true
        DemEventCreateInfoPort = true
        DemDTCClassRef = DTCClass_DTC_0xa10249
        DemExtendedDataClassRef = ExtendedDataClass_4f5344cd
        DemFreezeFrameClassRef = FreezeFrameClass_80c88891
        DemEventClass:
          DemAgingAllowed = true
          DemAgingCycleCounterThreshold = 40
          DemEventDestination = DEM_DTC_ORIGIN_PRIMARY_MEMORY
          DemEventPriority = 2
          DemEventSignificance = DEM_EVENT_SIGNIFICANCE_FAULT
          DemConsiderPtoStatus = false
          DemFFPrestorageSupported = false
          DemAgingCycleRef = Ignition_on_off
          DemOperationCycleRef = Ignition_on_off
          DemDebounceAlgorithmClass
            DemDebounceMonitorInternal
              DemCallbackGetFDC
      4 x DemDTCClass, all with DemDTCSeverity=DEM_DTC_SEV_NO_SEVERITY, DemImmediateNvStorage=false:
        DTCClass_DTC_0x9a0513: DemUdsDTC=10093843
        DTCClass_DTC_0x9a0511: DemUdsDTC=10093841
        DTCClass_DTC_0x9a0512: DemUdsDTC=10093842
        DTCClass_DTC_0xa20116: DemUdsDTC=10617110
      3 x DemEventParameter, all with DemEventKind=DEM_EVENT_KIND_SWC, DemMaxNumberFreezeFrameRecords=1, DemEventLatchTestFailed=false, DemEventTimeSeries=DEM_TIMESERIES_SNAPSHOT_NONE, DemEventAvailable=false, DemEventAvailableInVariant=true, DemEventCreateInfoPort=true, DemExtendedDataClassRef=ExtendedDataClass_4f5344cd, DemFreezeFrameClassRef=FreezeFrameClass_80c88891:
        IP_Display_ICD_Low_voltage_Circuit_Voltage_Below_Threshold: DemEventId=33, DemDTCClassRef=DTCClass_DTC_0xa10116
          DemEventClass:
            DemAgingAllowed = true
            DemAgingCycleCounterThreshold = 40
            DemEventDestination = DEM_DTC_ORIGIN_PRIMARY_MEMORY
            DemEventPriority = 2
            DemEventSignificance = DEM_EVENT_SIGNIFICANCE_FAULT
            DemConsiderPtoStatus = false
            DemFFPrestorageSupported = false
            DemAgingCycleRef = Ignition_on_off
            DemOperationCycleRef = Ignition_on_off
            DemDebounceAlgorithmClass
              DemDebounceMonitorInternal
                DemCallbackGetFDC
        TUNER_FM1_over_current_detection_Circuit_Current_Above_Threshold: DemEventId=119, DemDTCClassRef=DTCClass_DTC_0x9a1019
          DemEventClass:
            DemAgingAllowed = true
            DemAgingCycleCounterThreshold = 40
            DemEventDestination = DEM_DTC_ORIGIN_PRIMARY_MEMORY
            DemEventPriority = 1
            DemEventSignificance = DEM_EVENT_SIGNIFICANCE_FAULT
            DemConsiderPtoStatus = false
            DemFFPrestorageSupported = false
            DemAgingCycleRef = Ignition_on_off
            DemOperationCycleRef = Ignition_on_off
            DemEnableConditionGroupRef = EnableConditionGroup_VIPBatteryVoltageAndIgnOn
            DemDebounceAlgorithmClass
              DemDebounceMonitorInternal
                DemCallbackGetFDC
        Speaker_Woofer_open_Circuit_Open: DemEventId=111, DemDTCClassRef=DTCClass_DTC_0x9a0613
          DemEventClass:
            DemAgingAllowed = true
            DemAgingCycleCounterThreshold = 40
            DemEventDestination = DEM_DTC_ORIGIN_PRIMARY_MEMORY
            DemEventPriority = 1
            DemEventSignificance = DEM_EVENT_SIGNIFICANCE_FAULT
            DemConsiderPtoStatus = false
            DemFFPrestorageSupported = false
            DemAgingCycleRef = Ignition_on_off
            DemEnableConditionGroupRef = EnableConditionGroup_BatteryVoltage
            DemOperationCycleRef = Ignition_on_off
            DemDebounceAlgorithmClass  # DemDebounceTimeBase
              DemDebounceMonitorInternal
      DTCClass_DTC_0xd01587 (DemDTCClass): DemDTCSeverity=DEM_DTC_SEV_NO_SEVERITY, DemUdsDTC=13636999, DemImmediateNvStorage=false
      DTCClass_DTC_0x9a061e (DemDTCClass): DemDTCSeverity=DEM_DTC_SEV_NO_SEVERITY, DemUdsDTC=10094110, DemImmediateNvStorage=false
      Missing_Front_Power_Box_Missing_Message (DemEventParameter):
        DemEventKind = DEM_EVENT_KIND_SWC
        DemMaxNumberFreezeFrameRecords = 1
        DemEventLatchTestFailed = false
        DemEventTimeSeries = DEM_TIMESERIES_SNAPSHOT_NONE
        DemEventAvailable = false
        DemEventId = 67
        DemEventAvailableInVariant = true
        DemEventCreateInfoPort = true
        DemDTCClassRef = DTCClass_DTC_0xd10887
        DemExtendedDataClassRef = ExtendedDataClass_4f5344cd
        DemFreezeFrameClassRef = FreezeFrameClass_80c88891
        DemEventClass:
          DemAgingAllowed = true
          DemAgingCycleCounterThreshold = 40
          DemEventDestination = DEM_DTC_ORIGIN_PRIMARY_MEMORY
          DemEventPriority = 1
          DemEventSignificance = DEM_EVENT_SIGNIFICANCE_FAULT
          DemConsiderPtoStatus = false
          DemFFPrestorageSupported = false
          DemAgingCycleRef = Ignition_on_off
          DemEnableConditionGroupRef = EnableConditionGroup_VIPBatteryVoltageAndIgnOn
          DemOperationCycleRef = Ignition_on_off
          DemDebounceAlgorithmClass  # DemDebounceCounterBased
            DemDebounceMonitorInternal
      Missing_Rear_Power_Box_Missing_Message (DemEventParameter):
        DemEventKind = DEM_EVENT_KIND_SWC
        DemMaxNumberFreezeFrameRecords = 1
        DemEventLatchTestFailed = false
        DemEventTimeSeries = DEM_TIMESERIES_SNAPSHOT_NONE
        DemEventAvailable = false
        DemEventId = 71
        DemEventAvailableInVariant = true
        DemEventCreateInfoPort = true
        DemDTCClassRef = DTCClass_DTC_0xd10987
        DemExtendedDataClassRef = ExtendedDataClass_4f5344cd
        DemFreezeFrameClassRef = FreezeFrameClass_80c88891
        DemEventClass:
          DemAgingAllowed = true
          DemAgingCycleCounterThreshold = 40
          DemEventDestination = DEM_DTC_ORIGIN_PRIMARY_MEMORY
          DemEventPriority = 1
          DemEventSignificance = DEM_EVENT_SIGNIFICANCE_FAULT
          DemConsiderPtoStatus = false
          DemFFPrestorageSupported = false
          DemAgingCycleRef = Ignition_on_off
          DemEnableConditionGroupRef = EnableConditionGroup_VIPBatteryVoltageAndIgnOn
          DemOperationCycleRef = Ignition_on_off
          DemDebounceAlgorithmClass  # DemDebounceCounterBased
            DemDebounceMonitorInternal
      DTCClass_DTC_0xc13187 (DemDTCClass): DemDTCSeverity=DEM_DTC_SEV_NO_SEVERITY, DemUdsDTC=12661127, DemImmediateNvStorage=false
      DTCClass_DTC_0x9a0425 (DemDTCClass): DemDTCSeverity=DEM_DTC_SEV_NO_SEVERITY, DemUdsDTC=10093605, DemImmediateNvStorage=false
      Speaker_RL_short_across_General_Electrical_Failure (DemEventParameter):
        DemEventKind = DEM_EVENT_KIND_SWC
        DemMaxNumberFreezeFrameRecords = 1
        DemEventLatchTestFailed = false
        DemEventTimeSeries = DEM_TIMESERIES_SNAPSHOT_NONE
        DemEventAvailable = false
        DemEventId = 102
        DemEventAvailableInVariant = true
        DemEventCreateInfoPort = true
        DemDTCClassRef = DTCClass_DTC_0x9a0301
        DemExtendedDataClassRef = ExtendedDataClass_4f5344cd
        DemFreezeFrameClassRef = FreezeFrameClass_80c88891
        DemEventClass:
          DemAgingAllowed = true
          DemAgingCycleCounterThreshold = 40
          DemEventDestination = DEM_DTC_ORIGIN_PRIMARY_MEMORY
          DemEventPriority = 1
          DemEventSignificance = DEM_EVENT_SIGNIFICANCE_FAULT
          DemConsiderPtoStatus = false
          DemFFPrestorageSupported = false
          DemAgingCycleRef = Ignition_on_off
          DemEnableConditionGroupRef = EnableConditionGroup_BatteryVoltage
          DemOperationCycleRef = Ignition_on_off
          DemDebounceAlgorithmClass  # DemDebounceTimeBase
            DemDebounceMonitorInternal
      4 x DemDTCClass, all with DemDTCSeverity=DEM_DTC_SEV_NO_SEVERITY, DemImmediateNvStorage=false:
        DTCClass_DTC_0xa13011: DemUdsDTC=10563601
        DTCClass_DTC_0x9a0301: DemUdsDTC=10093313
        DTCClass_DTC_0xc20087: DemUdsDTC=12714119
        DTCClass_DTC_0x927344: DemUdsDTC=9597764
      3 x DemEventParameter, all with DemEventKind=DEM_EVENT_KIND_SWC, DemMaxNumberFreezeFrameRecords=1, DemEventLatchTestFailed=false, DemEventTimeSeries=DEM_TIMESERIES_SNAPSHOT_NONE, DemEventAvailable=false, DemEventAvailableInVariant=true, DemEventCreateInfoPort=true, DemExtendedDataClassRef=ExtendedDataClass_4f5344cd, DemFreezeFrameClassRef=FreezeFrameClass_80c88891:
        INVALID_SHORTNAME_HUT_Display_Low_voltage_Circuit_Voltage_Below_Threshold: DemEventId=14, DemDTCClassRef=DTCClass_DTC_0xa20116
          DemEventClass:
            DemAgingAllowed = true
            DemAgingCycleCounterThreshold = 40
            DemEventDestination = DEM_DTC_ORIGIN_PRIMARY_MEMORY
            DemEventPriority = 2
            DemEventSignificance = DEM_EVENT_SIGNIFICANCE_FAULT
            DemConsiderPtoStatus = false
            DemFFPrestorageSupported = false
            DemAgingCycleRef = Ignition_on_off
            DemOperationCycleRef = Ignition_on_off
            DemDebounceAlgorithmClass
              DemDebounceMonitorInternal
                DemCallbackGetFDC
        Speaker_FR_resistance_out_of_range_Circuit_Resistance_Out_of_Range: DemEventId=95, DemDTCClassRef=DTCClass_DTC_0x9a021e
          DemEventClass:
            DemAgingAllowed = true
            DemAgingCycleCounterThreshold = 40
            DemEventDestination = DEM_DTC_ORIGIN_PRIMARY_MEMORY
            DemEventPriority = 1
            DemEventSignificance = DEM_EVENT_SIGNIFICANCE_FAULT
            DemConsiderPtoStatus = false
            DemFFPrestorageSupported = false
            DemAgingCycleRef = Ignition_on_off
            DemEnableConditionGroupRef = EnableConditionGroup_BatteryVoltage
            DemOperationCycleRef = Ignition_on_off
            DemDebounceAlgorithmClass  # DemDebounceTimeBase
              DemDebounceMonitorInternal
        INVALID_SHORTNAME_Over_Temperature_Over_Temperature: DemEventId=21, DemDTCClassRef=DTCClass_DTC_0x92764b
          DemEventClass:
            DemAgingAllowed = true
            DemAgingCycleCounterThreshold = 40
            DemEventDestination = DEM_DTC_ORIGIN_PRIMARY_MEMORY
            DemEventPriority = 1
            DemEventSignificance = DEM_EVENT_SIGNIFICANCE_FAULT
            DemConsiderPtoStatus = false
            DemFFPrestorageSupported = false
            DemAgingCycleRef = Ignition_on_off
            DemEnableConditionGroupRef = EnableConditionGroup_IgnOn
            DemOperationCycleRef = Ignition_on_off
            DemDebounceAlgorithmClass  # DemDebounceTimeBase
              DemDebounceMonitorInternal
      3 x DemDTCClass, all with DemDTCSeverity=DEM_DTC_SEV_NO_SEVERITY, DemImmediateNvStorage=false:
        DTCClass_DTC_0xa20349: DemUdsDTC=10617673
        DTCClass_DTC_0xd00487: DemUdsDTC=13632647
        DTCClass_DTC_0x95f811: DemUdsDTC=9828369
      3 x DemEventParameter, all with DemEventKind=DEM_EVENT_KIND_SWC, DemMaxNumberFreezeFrameRecords=1, DemEventLatchTestFailed=false, DemEventTimeSeries=DEM_TIMESERIES_SNAPSHOT_NONE, DemEventAvailable=false, DemEventAvailableInVariant=true, DemEventCreateInfoPort=true, DemExtendedDataClassRef=ExtendedDataClass_4f5344cd, DemFreezeFrameClassRef=FreezeFrameClass_80c88891:
        IP_Display_ICD_Over_voltage_Circuit_Voltage_Above_Threshold: DemEventId=34, DemDTCClassRef=DTCClass_DTC_0xa10017
          DemEventClass:
            DemAgingAllowed = true
            DemAgingCycleCounterThreshold = 40
            DemEventDestination = DEM_DTC_ORIGIN_PRIMARY_MEMORY
            DemEventPriority = 2
            DemEventSignificance = DEM_EVENT_SIGNIFICANCE_FAULT
            DemConsiderPtoStatus = false
            DemFFPrestorageSupported = false
            DemAgingCycleRef = Ignition_on_off
            DemOperationCycleRef = Ignition_on_off
            DemDebounceAlgorithmClass
              DemDebounceMonitorInternal
                DemCallbackGetFDC
        IP_Display_ICD_Dimming_module_status_Internal_Electronic_Failure: DemEventId=32, DemDTCClassRef=DTCClass_DTC_0xa10049
          DemEventClass:
            DemAgingAllowed = true
            DemAgingCycleCounterThreshold = 40
            DemEventDestination = DEM_DTC_ORIGIN_PRIMARY_MEMORY
            DemEventPriority = 2
            DemEventSignificance = DEM_EVENT_SIGNIFICANCE_FAULT
            DemConsiderPtoStatus = false
            DemFFPrestorageSupported = false
            DemAgingCycleRef = Ignition_on_off
            DemOperationCycleRef = Ignition_on_off
            DemDebounceAlgorithmClass
              DemDebounceMonitorInternal
                DemCallbackGetFDC
        missing_Intelligent_Forward_View_Camera_Lane_Detection_Warning_system_Intelligent_Forward_Camera_Missing_Message: DemEventId=128, DemDTCClassRef=DTCClass_DTC_0xc14387
          DemEventClass:
            DemAgingAllowed = true
            DemAgingCycleCounterThreshold = 40
            DemEventDestination = DEM_DTC_ORIGIN_PRIMARY_MEMORY
            DemEventPriority = 1
            DemEventSignificance = DEM_EVENT_SIGNIFICANCE_FAULT
            DemEventFailureCycleCounterThreshold = 0
            DemConsiderPtoStatus = false
            DemFFPrestorageSupported = false
            DemAgingCycleRef = Ignition_on_off
            DemEnableConditionGroupRef = EnableConditionGroup_VIPBatteryVoltageAndIgnOn
            DemOperationCycleRef = Ignition_on_off
            DemDebounceAlgorithmClass  # DemDebounceCounterBased
              DemDebounceMonitorInternal
      DTCClass_DTC_0x95f812 (DemDTCClass): DemDTCSeverity=DEM_DTC_SEV_NO_SEVERITY, DemUdsDTC=9828370, DemImmediateNvStorage=false
      DTCClass_DTC_0x95f813 (DemDTCClass): DemDTCSeverity=DEM_DTC_SEV_NO_SEVERITY, DemUdsDTC=9828371, DemImmediateNvStorage=false
      INVALID_SHORTNAME_HUT_Display_video_signal_connect_failure_Internal_Electronic_Failure (DemEventParameter):
        DemEventKind = DEM_EVENT_KIND_SWC
        DemMaxNumberFreezeFrameRecords = 1
        DemEventLatchTestFailed = false
        DemEventTimeSeries = DEM_TIMESERIES_SNAPSHOT_NONE
        DemEventAvailable = false
        DemEventId = 20
        DemEventAvailableInVariant = true
        DemEventCreateInfoPort = true
        DemDTCClassRef = DTCClass_DTC_0xa20349
        DemExtendedDataClassRef = ExtendedDataClass_4f5344cd
        DemFreezeFrameClassRef = FreezeFrameClass_80c88891
        DemEventClass:
          DemAgingAllowed = true
          DemAgingCycleCounterThreshold = 40
          DemEventDestination = DEM_DTC_ORIGIN_PRIMARY_MEMORY
          DemEventPriority = 2
          DemEventSignificance = DEM_EVENT_SIGNIFICANCE_FAULT
          DemConsiderPtoStatus = false
          DemFFPrestorageSupported = false
          DemAgingCycleRef = Ignition_on_off
          DemOperationCycleRef = Ignition_on_off
          DemDebounceAlgorithmClass
            DemDebounceMonitorInternal
              DemCallbackGetFDC
      Missing_Head_Up_Display_Augmented_Reality_Head_Up_Display_Missing_Message (DemEventParameter):
        DemEventKind = DEM_EVENT_KIND_SWC
        DemMaxNumberFreezeFrameRecords = 1
        DemEventLatchTestFailed = false
        DemEventTimeSeries = DEM_TIMESERIES_SNAPSHOT_NONE
        DemEventAvailable = false
        DemEventId = 69
        DemEventAvailableInVariant = true
        DemEventCreateInfoPort = true
        DemDTCClassRef = DTCClass_DTC_0xc15887
        DemExtendedDataClassRef = ExtendedDataClass_4f5344cd
        DemFreezeFrameClassRef = FreezeFrameClass_80c88891
        DemEventClass:
          DemAgingAllowed = true
          DemAgingCycleCounterThreshold = 40
          DemEventDestination = DEM_DTC_ORIGIN_PRIMARY_MEMORY
          DemEventPriority = 1
          DemEventSignificance = DEM_EVENT_SIGNIFICANCE_FAULT
          DemEventFailureCycleCounterThreshold = 0
          DemConsiderPtoStatus = false
          DemFFPrestorageSupported = false
          DemAgingCycleRef = Ignition_on_off
          DemEnableConditionGroupRef = EnableConditionGroup_VIPBatteryVoltageAndIgnOn
          DemOperationCycleRef = Ignition_on_off
          DemDebounceAlgorithmClass  # DemDebounceCounterBased
            DemDebounceMonitorInternal
      6 x DemDTCClass, all with DemDTCSeverity=DEM_DTC_SEV_NO_SEVERITY, DemImmediateNvStorage=false:
        DTCClass_DTC_0x9a0412: DemUdsDTC=10093586
        DTCClass_DTC_0x9a0413: DemUdsDTC=10093587
        DTCClass_DTC_0xd00f94: DemUdsDTC=13635476
        DTCClass_DTC_0x9a0411: DemUdsDTC=10093585
        DTCClass_DTC_0x9a051e: DemUdsDTC=10093854
        DTCClass_DTC_0xe00083: DemUdsDTC=14680195
      3 x DemEventParameter, all with DemEventKind=DEM_EVENT_KIND_SWC, DemMaxNumberFreezeFrameRecords=1, DemEventLatchTestFailed=false, DemEventTimeSeries=DEM_TIMESERIES_SNAPSHOT_NONE, DemEventAvailable=false, DemEventAvailableInVariant=true, DemEventCreateInfoPort=true, DemExtendedDataClassRef=ExtendedDataClass_4f5344cd, DemFreezeFrameClassRef=FreezeFrameClass_80c88891:
        Missing_Electric_Power_Steering_system_Missing_Message: DemEventId=63, DemDTCClassRef=DTCClass_DTC_0xc13187
          DemEventClass:
            DemAgingAllowed = true
            DemAgingCycleCounterThreshold = 40
            DemEventDestination = DEM_DTC_ORIGIN_PRIMARY_MEMORY
            DemEventPriority = 1
            DemEventSignificance = DEM_EVENT_SIGNIFICANCE_FAULT
            DemEventFailureCycleCounterThreshold = 0
            DemConsiderPtoStatus = false
            DemFFPrestorageSupported = false
            DemAgingCycleRef = Ignition_on_off
            DemEnableConditionGroupRef = EnableConditionGroup_VIPBatteryVoltageAndIgnOn
            DemOperationCycleRef = Ignition_on_off
            DemDebounceAlgorithmClass  # DemDebounceCounterBased
              DemDebounceMonitorInternal
        Fuel_sensor1_short_to_BAT_Circuit_Short_To_Battery: DemEventId=7, DemDTCClassRef=DTCClass_DTC_0x927312
          DemEventClass:
            DemAgingAllowed = true
            DemAgingCycleCounterThreshold = 40
            DemEventDestination = DEM_DTC_ORIGIN_PRIMARY_MEMORY
            DemEventPriority = 1
            DemEventSignificance = DEM_EVENT_SIGNIFICANCE_FAULT
            DemConsiderPtoStatus = false
            DemFFPrestorageSupported = false
            DemAgingCycleRef = Ignition_on_off
            DemEnableConditionGroupRef = EnableConditionGroup_VIPBatteryVoltageAndIgnOn
            DemOperationCycleRef = Ignition_on_off
            DemDebounceAlgorithmClass  # DemDebounceTimeBase
              DemDebounceMonitorInternal
        Mic_2_short_to_GND_Circuit_Short_To_Ground: DemEventId=54, DemDTCClassRef=DTCClass_DTC_0x93f611
          DemEventClass:
            DemAgingAllowed = true
            DemAgingCycleCounterThreshold = 40
            DemEventDestination = DEM_DTC_ORIGIN_PRIMARY_MEMORY
            DemEventPriority = 1
            DemEventSignificance = DEM_EVENT_SIGNIFICANCE_FAULT
            DemConsiderPtoStatus = false
            DemFFPrestorageSupported = false
            DemAgingCycleRef = Ignition_on_off
            DemEnableConditionGroupRef = EnableConditionGroup_VIPBatteryVoltageAndIgnOn
            DemOperationCycleRef = Ignition_on_off
            DemDebounceAlgorithmClass  # DemDebounceTimeBase
              DemDebounceMonitorInternal
      4 x DemDTCClass, all with DemDTCSeverity=DEM_DTC_SEV_NO_SEVERITY, DemImmediateNvStorage=false:
        DTCClass_DTC_0x9a0325: DemUdsDTC=10093349
        DTCClass_DTC_0xc2b387: DemUdsDTC=12759943
        DTCClass_DTC_0xa13111: DemUdsDTC=10563857
        DTCClass_DTC_0x9a0201: DemUdsDTC=10093057
      Speaker_FR_open_Circuit_Open (DemEventParameter):
        DemEventKind = DEM_EVENT_KIND_SWC
        DemMaxNumberFreezeFrameRecords = 1
        DemEventLatchTestFailed = false
        DemEventTimeSeries = DEM_TIMESERIES_SNAPSHOT_NONE
        DemEventAvailable = false
        DemEventId = 93
        DemEventAvailableInVariant = true
        DemEventCreateInfoPort = true
        DemDTCClassRef = DTCClass_DTC_0x9a0213
        DemExtendedDataClassRef = ExtendedDataClass_4f5344cd
        DemFreezeFrameClassRef = FreezeFrameClass_80c88891
        DemEventClass:
          DemAgingAllowed = true
          DemAgingCycleCounterThreshold = 40
          DemEventDestination = DEM_DTC_ORIGIN_PRIMARY_MEMORY
          DemEventPriority = 1
          DemEventSignificance = DEM_EVENT_SIGNIFICANCE_FAULT
          DemConsiderPtoStatus = false
          DemFFPrestorageSupported = false
          DemAgingCycleRef = Ignition_on_off
          DemEnableConditionGroupRef = EnableConditionGroup_BatteryVoltage
          DemOperationCycleRef = Ignition_on_off
          DemDebounceAlgorithmClass  # DemDebounceTimeBase
            DemDebounceMonitorInternal
      DTCClass_DTC_0xa20449 (DemDTCClass): DemDTCSeverity=DEM_DTC_SEV_NO_SEVERITY, DemUdsDTC=10617929, DemImmediateNvStorage=false
      INVALID_SHORTNAME_GW_Ethernet_signal_lines_open_circuit_Circuit_Open (DemEventParameter):
        DemEventKind = DEM_EVENT_KIND_SWC
        DemMaxNumberFreezeFrameRecords = 1
        DemEventLatchTestFailed = false
        DemEventTimeSeries = DEM_TIMESERIES_SNAPSHOT_NONE
        DemEventAvailable = false
        DemEventId = 11
        DemEventAvailableInVariant = true
        DemEventCreateInfoPort = true
        DemDTCClassRef = DTCClass_DTC_0xe01113
        DemExtendedDataClassRef = ExtendedDataClass_4f5344cd
        DemFreezeFrameClassRef = FreezeFrameClass_80c88891
        DemEventClass:
          DemAgingAllowed = true
          DemAgingCycleCounterThreshold = 40
          DemEventDestination = DEM_DTC_ORIGIN_PRIMARY_MEMORY
          DemEventPriority = 1
          DemEventSignificance = DEM_EVENT_SIGNIFICANCE_FAULT
          DemConsiderPtoStatus = false
          DemFFPrestorageSupported = false
          DemAgingCycleRef = Ignition_on_off
          DemOperationCycleRef = Ignition_on_off
          DemEnableConditionGroupRef = EnableConditionGroup_VIPBatteryVoltageAndIgnOn
          DemDebounceAlgorithmClass
            DemDebounceMonitorInternal
              DemCallbackGetFDC
      DTCClass_DTC_0xc16487 (DemDTCClass): DemDTCSeverity=DEM_DTC_SEV_NO_SEVERITY, DemUdsDTC=12674183, DemImmediateNvStorage=false
      DTCClass_DTC_0xc14187 (DemDTCClass): DemDTCSeverity=DEM_DTC_SEV_NO_SEVERITY, DemUdsDTC=12665223, DemImmediateNvStorage=false
      4 x DemEventParameter, all with DemEventKind=DEM_EVENT_KIND_SWC, DemMaxNumberFreezeFrameRecords=1, DemEventLatchTestFailed=false, DemEventTimeSeries=DEM_TIMESERIES_SNAPSHOT_NONE, DemEventAvailable=false, DemEventAvailableInVariant=true, DemEventCreateInfoPort=true, DemExtendedDataClassRef=ExtendedDataClass_4f5344cd, DemFreezeFrameClassRef=FreezeFrameClass_80c88891:
        INVALID_SHORTNAME_GW_Insufficient_SQI_Signal_Below_Allowable_Range: DemEventId=13, DemDTCClassRef=DTCClass_DTC_0xe00784
          DemEventClass:
            DemAgingAllowed = true
            DemAgingCycleCounterThreshold = 40
            DemEventDestination = DEM_DTC_ORIGIN_PRIMARY_MEMORY
            DemEventPriority = 1
            DemEventSignificance = DEM_EVENT_SIGNIFICANCE_FAULT
            DemConsiderPtoStatus = false
            DemFFPrestorageSupported = false
            DemAgingCycleRef = Ignition_on_off
            DemOperationCycleRef = Ignition_on_off
            DemEnableConditionGroupRef = EnableConditionGroup_VIPBatteryVoltageAndIgnOn
            DemDebounceAlgorithmClass
              DemDebounceMonitorInternal
                DemCallbackGetFDC
        Lost_TCP_communication_Missing_Message: DemEventId=38, DemDTCClassRef=DTCClass_DTC_0xe00487
          DemEventClass:
            DemAgingAllowed = true
            DemAgingCycleCounterThreshold = 40
            DemEventDestination = DEM_DTC_ORIGIN_PRIMARY_MEMORY
            DemEventPriority = 2
            DemEventSignificance = DEM_EVENT_SIGNIFICANCE_FAULT
            DemConsiderPtoStatus = false
            DemFFPrestorageSupported = false
            DemAgingCycleRef = Ignition_on_off
            DemOperationCycleRef = Ignition_on_off
            DemEnableConditionGroupRef = EnableConditionGroup_VIPBatteryVoltageAndIgnOn
            DemDebounceAlgorithmClass
              DemDebounceMonitorInternal
                DemCallbackGetFDC
        Speaker_Woofer_short_across_General_Electrical_Failure: DemEventId=114, DemDTCClassRef=DTCClass_DTC_0x9a0601
          DemEventClass:
            DemAgingAllowed = true
            DemAgingCycleCounterThreshold = 40
            DemEventDestination = DEM_DTC_ORIGIN_PRIMARY_MEMORY
            DemEventPriority = 1
            DemEventSignificance = DEM_EVENT_SIGNIFICANCE_FAULT
            DemConsiderPtoStatus = false
            DemFFPrestorageSupported = false
            DemAgingCycleRef = Ignition_on_off
            DemEnableConditionGroupRef = EnableConditionGroup_BatteryVoltage
            DemOperationCycleRef = Ignition_on_off
            DemDebounceAlgorithmClass  # DemDebounceTimeBase
              DemDebounceMonitorInternal
        SecOC_FV_synchronization_authentication_message_failed_ISO_SAE_Reserved: DemEventId=76, DemDTCClassRef=DTCClass_DTC_0xd00e40
          DemEventClass:
            DemAgingAllowed = true
            DemAgingCycleCounterThreshold = 40
            DemEventDestination = DEM_DTC_ORIGIN_PRIMARY_MEMORY
            DemEventPriority = 1
            DemEventSignificance = DEM_EVENT_SIGNIFICANCE_FAULT
            DemConsiderPtoStatus = false
            DemFFPrestorageSupported = false
            DemAgingCycleRef = Ignition_on_off
            DemOperationCycleRef = Ignition_on_off
            DemEnableConditionGroupRef = EnableConditionGroup_IgnOn
            DemDebounceAlgorithmClass
              DemDebounceMonitorInternal
                DemCallbackGetFDC
      DTCClass_DTC_0xd10017 (DemDTCClass): DemDTCSeverity=DEM_DTC_SEV_NO_SEVERITY, DemUdsDTC=13697047, DemImmediateNvStorage=false
      4 x DemEventParameter, all with DemEventKind=DEM_EVENT_KIND_SWC, DemMaxNumberFreezeFrameRecords=1, DemEventLatchTestFailed=false, DemEventTimeSeries=DEM_TIMESERIES_SNAPSHOT_NONE, DemEventAvailable=false, DemEventAvailableInVariant=true, DemEventCreateInfoPort=true, DemExtendedDataClassRef=ExtendedDataClass_4f5344cd, DemFreezeFrameClassRef=FreezeFrameClass_80c88891:
        Speaker_FR_short_to_ground_Circuit_Short_To_Ground: DemEventId=98, DemDTCClassRef=DTCClass_DTC_0x9a0211
          DemEventClass:
            DemAgingAllowed = true
            DemAgingCycleCounterThreshold = 40
            DemEventDestination = DEM_DTC_ORIGIN_PRIMARY_MEMORY
            DemEventPriority = 1
            DemEventSignificance = DEM_EVENT_SIGNIFICANCE_FAULT
            DemConsiderPtoStatus = false
            DemFFPrestorageSupported = false
            DemAgingCycleRef = Ignition_on_off
            DemEnableConditionGroupRef = EnableConditionGroup_VIPBatteryVoltageAndIgnOn
            DemOperationCycleRef = Ignition_on_off
            DemDebounceAlgorithmClass  # DemDebounceTimeBase
              DemDebounceMonitorInternal
        Speaker_Center_resistance_out_of_range_Circuit_Resistance_Out_of_Range: DemEventId=83, DemDTCClassRef=DTCClass_DTC_0x9a051e
          DemEventClass:
            DemAgingAllowed = true
            DemAgingCycleCounterThreshold = 40
            DemEventDestination = DEM_DTC_ORIGIN_PRIMARY_MEMORY
            DemEventPriority = 1
            DemEventSignificance = DEM_EVENT_SIGNIFICANCE_FAULT
            DemConsiderPtoStatus = false
            DemFFPrestorageSupported = false
            DemAgingCycleRef = Ignition_on_off
            DemEnableConditionGroupRef = EnableConditionGroup_BatteryVoltage
            DemOperationCycleRef = Ignition_on_off
            DemDebounceAlgorithmClass  # DemDebounceTimeBase
              DemDebounceMonitorInternal
        Speaker_RL_output_waveform_lack_fidelity_Signal_Shape_Waveform_Failure: DemEventId=100, DemDTCClassRef=DTCClass_DTC_0x9a0325
          DemEventClass:
            DemAgingAllowed = true
            DemAgingCycleCounterThreshold = 40
            DemEventDestination = DEM_DTC_ORIGIN_PRIMARY_MEMORY
            DemEventPriority = 1
            DemEventSignificance = DEM_EVENT_SIGNIFICANCE_FAULT
            DemConsiderPtoStatus = false
            DemFFPrestorageSupported = false
            DemAgingCycleRef = Ignition_on_off
            DemEnableConditionGroupRef = EnableConditionGroup_VIPBatteryVoltageAndIgnOn
            DemOperationCycleRef = Ignition_on_off
            DemDebounceAlgorithmClass  # DemDebounceTimeBase
              DemDebounceMonitorInternal
        Speaker_RR_short_to_battery_Circuit_Short_To_Battery: DemEventId=109, DemDTCClassRef=DTCClass_DTC_0x9a0412
          DemEventClass:
            DemAgingAllowed = true
            DemAgingCycleCounterThreshold = 40
            DemEventDestination = DEM_DTC_ORIGIN_PRIMARY_MEMORY
            DemEventPriority = 1
            DemEventSignificance = DEM_EVENT_SIGNIFICANCE_FAULT
            DemConsiderPtoStatus = false
            DemFFPrestorageSupported = false
            DemAgingCycleRef = Ignition_on_off
            DemEnableConditionGroupRef = EnableConditionGroup_VIPBatteryVoltageAndIgnOn
            DemOperationCycleRef = Ignition_on_off
            DemDebounceAlgorithmClass  # DemDebounceTimeBase
              DemDebounceMonitorInternal
      DTCClass_DTC_0x9a0313 (DemDTCClass): DemDTCSeverity=DEM_DTC_SEV_NO_SEVERITY, DemUdsDTC=10093331, DemImmediateNvStorage=false
      Speaker_RR_open_Circuit_Open (DemEventParameter):
        DemEventKind = DEM_EVENT_KIND_SWC
        DemMaxNumberFreezeFrameRecords = 1
        DemEventLatchTestFailed = false
        DemEventTimeSeries = DEM_TIMESERIES_SNAPSHOT_NONE
        DemEventAvailable = false
        DemEventId = 105
        DemEventAvailableInVariant = true
        DemEventCreateInfoPort = true
        DemDTCClassRef = DTCClass_DTC_0x9a0413
        DemExtendedDataClassRef = ExtendedDataClass_4f5344cd
        DemFreezeFrameClassRef = FreezeFrameClass_80c88891
        DemEventClass:
          DemAgingAllowed = true
          DemAgingCycleCounterThreshold = 40
          DemEventDestination = DEM_DTC_ORIGIN_PRIMARY_MEMORY
          DemEventPriority = 1
          DemEventSignificance = DEM_EVENT_SIGNIFICANCE_FAULT
          DemConsiderPtoStatus = false
          DemFFPrestorageSupported = false
          DemAgingCycleRef = Ignition_on_off
          DemEnableConditionGroupRef = EnableConditionGroup_BatteryVoltage
          DemOperationCycleRef = Ignition_on_off
          DemDebounceAlgorithmClass  # DemDebounceTimeBase
            DemDebounceMonitorInternal
      Speaker_RL_short_to_battery_Circuit_Short_To_Battery (DemEventParameter):
        DemEventKind = DEM_EVENT_KIND_SWC
        DemMaxNumberFreezeFrameRecords = 1
        DemEventLatchTestFailed = false
        DemEventTimeSeries = DEM_TIMESERIES_SNAPSHOT_NONE
        DemEventAvailable = false
        DemEventId = 103
        DemEventAvailableInVariant = true
        DemEventCreateInfoPort = true
        DemDTCClassRef = DTCClass_DTC_0x9a0312
        DemExtendedDataClassRef = ExtendedDataClass_4f5344cd
        DemFreezeFrameClassRef = FreezeFrameClass_80c88891
        DemEventClass:
          DemAgingAllowed = true
          DemAgingCycleCounterThreshold = 40
          DemEventDestination = DEM_DTC_ORIGIN_PRIMARY_MEMORY
          DemEventPriority = 1
          DemEventSignificance = DEM_EVENT_SIGNIFICANCE_FAULT
          DemConsiderPtoStatus = false
          DemFFPrestorageSupported = false
          DemAgingCycleRef = Ignition_on_off
          DemEnableConditionGroupRef = EnableConditionGroup_VIPBatteryVoltageAndIgnOn
          DemOperationCycleRef = Ignition_on_off
          DemDebounceAlgorithmClass  # DemDebounceTimeBase
            DemDebounceMonitorInternal
      DTCClass_DTC_0x9a0311 (DemDTCClass): DemDTCSeverity=DEM_DTC_SEV_NO_SEVERITY, DemUdsDTC=10093329, DemImmediateNvStorage=false
      DTCClass_DTC_0x9a0312 (DemDTCClass): DemDTCSeverity=DEM_DTC_SEV_NO_SEVERITY, DemUdsDTC=10093330, DemImmediateNvStorage=false
      3 x DemEventParameter, all with DemEventKind=DEM_EVENT_KIND_SWC, DemMaxNumberFreezeFrameRecords=1, DemEventLatchTestFailed=false, DemEventTimeSeries=DEM_TIMESERIES_SNAPSHOT_NONE, DemEventAvailable=false, DemEventAvailableInVariant=true, DemEventCreateInfoPort=true, DemExtendedDataClassRef=ExtendedDataClass_4f5344cd, DemFreezeFrameClassRef=FreezeFrameClass_80c88891:
        Speaker_Woofer_short_to_battery_Circuit_Short_To_Battery: DemEventId=115, DemDTCClassRef=DTCClass_DTC_0x9a0612
          DemEventClass:
            DemAgingAllowed = true
            DemAgingCycleCounterThreshold = 40
            DemEventDestination = DEM_DTC_ORIGIN_PRIMARY_MEMORY
            DemEventPriority = 1
            DemEventSignificance = DEM_EVENT_SIGNIFICANCE_FAULT
            DemConsiderPtoStatus = false
            DemFFPrestorageSupported = false
            DemAgingCycleRef = Ignition_on_off
            DemEnableConditionGroupRef = EnableConditionGroup_VIPBatteryVoltageAndIgnOn
            DemOperationCycleRef = Ignition_on_off
            DemDebounceAlgorithmClass  # DemDebounceTimeBase
              DemDebounceMonitorInternal
        TUNER_FM2_open_Circuit_Open: DemEventId=122, DemDTCClassRef=DTCClass_DTC_0x9a1113
          DemEventClass:
            DemAgingAllowed = true
            DemAgingCycleCounterThreshold = 40
            DemEventDestination = DEM_DTC_ORIGIN_PRIMARY_MEMORY
            DemEventPriority = 1
            DemEventSignificance = DEM_EVENT_SIGNIFICANCE_FAULT
            DemConsiderPtoStatus = false
            DemFFPrestorageSupported = false
            DemAgingCycleRef = Ignition_on_off
            DemOperationCycleRef = Ignition_on_off
            DemEnableConditionGroupRef = EnableConditionGroup_VIPBatteryVoltageAndIgnOn
            DemDebounceAlgorithmClass
              DemDebounceMonitorInternal
                DemCallbackGetFDC
        Missing_Airbag_Module_Missing_Message: DemEventId=56, DemDTCClassRef=DTCClass_DTC_0xc15187
          DemEventClass:
            DemAgingAllowed = true
            DemAgingCycleCounterThreshold = 40
            DemEventDestination = DEM_DTC_ORIGIN_PRIMARY_MEMORY
            DemEventPriority = 1
            DemEventSignificance = DEM_EVENT_SIGNIFICANCE_FAULT
            DemEventFailureCycleCounterThreshold = 0
            DemConsiderPtoStatus = false
            DemFFPrestorageSupported = false
            DemAgingCycleRef = Ignition_on_off
            DemEnableConditionGroupRef = EnableConditionGroup_VIPBatteryVoltageAndIgnOn
            DemOperationCycleRef = Ignition_on_off
            DemDebounceAlgorithmClass  # DemDebounceCounterBased
              DemDebounceMonitorInternal
      3 x DemDTCClass, all with DemDTCSeverity=DEM_DTC_SEV_NO_SEVERITY, DemImmediateNvStorage=false:
        DTCClass_DTC_0xc19887: DemUdsDTC=12687495
        DTCClass_DTC_0xa10408: DemUdsDTC=10552328
        DTCClass_DTC_0x9a041e: DemUdsDTC=10093598
      3 x DemEventParameter, all with DemEventKind=DEM_EVENT_KIND_SWC, DemMaxNumberFreezeFrameRecords=1, DemEventLatchTestFailed=false, DemEventTimeSeries=DEM_TIMESERIES_SNAPSHOT_NONE, DemEventAvailable=false, DemEventAvailableInVariant=true, DemEventCreateInfoPort=true, DemExtendedDataClassRef=ExtendedDataClass_4f5344cd, DemFreezeFrameClassRef=FreezeFrameClass_80c88891:
        Fuel_sensor2_short_to_BAT_Circuit_Short_To_Battery: DemEventId=9, DemDTCClassRef=DTCClass_DTC_0x927412
          DemEventClass:
            DemAgingAllowed = true
            DemAgingCycleCounterThreshold = 40
            DemEventDestination = DEM_DTC_ORIGIN_PRIMARY_MEMORY
            DemEventPriority = 1
            DemEventSignificance = DEM_EVENT_SIGNIFICANCE_FAULT
            DemConsiderPtoStatus = false
            DemFFPrestorageSupported = false
            DemAgingCycleRef = Ignition_on_off
            DemEnableConditionGroupRef = EnableConditionGroup_VIPBatteryVoltageAndIgnOn
            DemOperationCycleRef = Ignition_on_off
            DemDebounceAlgorithmClass  # DemDebounceTimeBase
              DemDebounceMonitorInternal
        missing_Driver_Monitoring_System_Missing_Message: DemEventId=127, DemDTCClassRef=DTCClass_DTC_0xc2b387
          DemEventClass:
            DemAgingAllowed = true
            DemAgingCycleCounterThreshold = 40
            DemEventDestination = DEM_DTC_ORIGIN_PRIMARY_MEMORY
            DemEventPriority = 1
            DemEventSignificance = DEM_EVENT_SIGNIFICANCE_FAULT
            DemEventFailureCycleCounterThreshold = 0
            DemConsiderPtoStatus = false
            DemFFPrestorageSupported = false
            DemAgingCycleRef = Ignition_on_off
            DemEnableConditionGroupRef = EnableConditionGroup_VIPBatteryVoltageAndIgnOn
            DemOperationCycleRef = Ignition_on_off
            DemDebounceAlgorithmClass  # DemDebounceCounterBased
              DemDebounceMonitorInternal
        A2B_short_to_ground_Circuit_Short_To_Ground: DemEventId=3, DemDTCClassRef=DTCClass_DTC_0x95f811
          DemEventClass:
            DemAgingAllowed = true
            DemAgingCycleCounterThreshold = 40
            DemEventDestination = DEM_DTC_ORIGIN_PRIMARY_MEMORY
            DemEventPriority = 1
            DemEventSignificance = DEM_EVENT_SIGNIFICANCE_FAULT
            DemConsiderPtoStatus = false
            DemFFPrestorageSupported = false
            DemAgingCycleRef = Ignition_on_off
            DemOperationCycleRef = Ignition_on_off
            DemEnableConditionGroupRef = EnableConditionGroup_VIPBatteryVoltageAndIgnOn
            DemDebounceAlgorithmClass
              DemDebounceMonitorInternal
                DemCallbackGetFDC
      5 x DemDTCClass, all with DemDTCSeverity=DEM_DTC_SEV_NO_SEVERITY, DemImmediateNvStorage=false:
        DTCClass_DTC_0x93f513: DemUdsDTC=9696531
        DTCClass_DTC_0xc11487: DemUdsDTC=12653703
        DTCClass_DTC_0x93f511: DemUdsDTC=9696529
        DTCClass_DTC_0x93f512: DemUdsDTC=9696530
        DTCClass_DTC_0xe00784: DemUdsDTC=14681988
      Ethernet_CRC_Errors_Value_of_Signal_Protection_Calculation_Incorrect (DemEventParameter):
        DemEventKind = DEM_EVENT_KIND_SWC
        DemMaxNumberFreezeFrameRecords = 1
        DemEventLatchTestFailed = false
        DemEventTimeSeries = DEM_TIMESERIES_SNAPSHOT_NONE
        DemEventAvailable = false
        DemEventId = 5
        DemEventAvailableInVariant = true
        DemEventCreateInfoPort = true
        DemDTCClassRef = DTCClass_DTC_0xe00083
        DemExtendedDataClassRef = ExtendedDataClass_4f5344cd
        DemFreezeFrameClassRef = FreezeFrameClass_80c88891
        DemEventClass:
          DemAgingAllowed = true
          DemAgingCycleCounterThreshold = 40
          DemEventDestination = DEM_DTC_ORIGIN_PRIMARY_MEMORY
          DemEventPriority = 2
          DemEventSignificance = DEM_EVENT_SIGNIFICANCE_FAULT
          DemConsiderPtoStatus = false
          DemFFPrestorageSupported = false
          DemAgingCycleRef = Ignition_on_off
          DemOperationCycleRef = Ignition_on_off
          DemEnableConditionGroupRef = EnableConditionGroup_VIPBatteryVoltageAndIgnOn
          DemDebounceAlgorithmClass
            DemDebounceMonitorInternal
              DemCallbackGetFDC
      INVALID_SHORTNAME_HUT_Display_not_received_backlight_value_Bus_Signal_Message_Failure (DemEventParameter):
        DemEventKind = DEM_EVENT_KIND_SWC
        DemMaxNumberFreezeFrameRecords = 1
        DemEventTimeSeries = DEM_TIMESERIES_SNAPSHOT_NONE
        DemEventAvailable = false
        DemEventId = 19
        DemEventAvailableInVariant = true
        DemEventLatchTestFailed = false
        DemEventCreateInfoPort = true
        DemDTCClassRef = DTCClass_DTC_0xa20008
        DemExtendedDataClassRef = ExtendedDataClass_4f5344cd
        DemFreezeFrameClassRef = FreezeFrameClass_80c88891
        DemEventClass:
          DemAgingAllowed = true
          DemAgingCycleCounterThreshold = 40
          DemEventDestination = DEM_DTC_ORIGIN_PRIMARY_MEMORY
          DemEventPriority = 2
          DemEventSignificance = DEM_EVENT_SIGNIFICANCE_FAULT
          DemConsiderPtoStatus = false
          DemFFPrestorageSupported = false
          DemAgingCycleRef = Ignition_on_off
          DemOperationCycleRef = Ignition_on_off
          DemDebounceAlgorithmClass
            DemDebounceMonitorInternal
              DemCallbackGetFDC
      DTCClass_DTC_0x908b87 (DemDTCClass): DemDTCSeverity=DEM_DTC_SEV_NO_SEVERITY, DemUdsDTC=9472903, DemImmediateNvStorage=false
      DTCClass_DTC_0x9a0225 (DemDTCClass): DemDTCSeverity=DEM_DTC_SEV_NO_SEVERITY, DemUdsDTC=10093093, DemImmediateNvStorage=false
      Missing_Screen_touch_button_switch_controller_Missing_Message (DemEventParameter):
        DemEventKind = DEM_EVENT_KIND_SWC
        DemMaxNumberFreezeFrameRecords = 1
        DemEventLatchTestFailed = false
        DemEventTimeSeries = DEM_TIMESERIES_SNAPSHOT_NONE
        DemEventAvailable = false
        DemEventId = 72
        DemEventAvailableInVariant = true
        DemEventCreateInfoPort = true
        DemDTCClassRef = DTCClass_DTC_0xd01587
        DemExtendedDataClassRef = ExtendedDataClass_4f5344cd
        DemFreezeFrameClassRef = FreezeFrameClass_80c88891
        DemEventClass:
          DemAgingAllowed = true
          DemAgingCycleCounterThreshold = 40
          DemEventDestination = DEM_DTC_ORIGIN_PRIMARY_MEMORY
          DemEventPriority = 1
          DemEventSignificance = DEM_EVENT_SIGNIFICANCE_FAULT
          DemEventFailureCycleCounterThreshold = 0
          DemConsiderPtoStatus = false
          DemFFPrestorageSupported = false
          DemAgingCycleRef = Ignition_on_off
          DemEnableConditionGroupRef = EnableConditionGroup_VIPBatteryVoltageAndIgnOn
          DemOperationCycleRef = Ignition_on_off
          DemDebounceAlgorithmClass  # DemDebounceCounterBased
            DemDebounceMonitorInternal
      DTCClass_DTC_0xd00e40 (DemDTCClass): DemDTCSeverity=DEM_DTC_SEV_NO_SEVERITY, DemUdsDTC=13635136, DemImmediateNvStorage=false
      Mic_1_short_to_BAT_Circuit_Short_To_Battery (DemEventParameter):
        DemEventKind = DEM_EVENT_KIND_SWC
        DemMaxNumberFreezeFrameRecords = 1
        DemEventLatchTestFailed = false
        DemEventTimeSeries = DEM_TIMESERIES_SNAPSHOT_NONE
        DemEventAvailable = false
        DemEventId = 50
        DemEventAvailableInVariant = true
        DemEventCreateInfoPort = true
        DemDTCClassRef = DTCClass_DTC_0x93f512
        DemExtendedDataClassRef = ExtendedDataClass_4f5344cd
        DemFreezeFrameClassRef = FreezeFrameClass_80c88891
        DemEventClass:
          DemAgingAllowed = true
          DemAgingCycleCounterThreshold = 40
          DemEventDestination = DEM_DTC_ORIGIN_PRIMARY_MEMORY
          DemEventPriority = 1
          DemEventSignificance = DEM_EVENT_SIGNIFICANCE_FAULT
          DemConsiderPtoStatus = false
          DemFFPrestorageSupported = false
          DemAgingCycleRef = Ignition_on_off
          DemEnableConditionGroupRef = EnableConditionGroup_VIPBatteryVoltage2AndIgnOn
          DemOperationCycleRef = Ignition_on_off
          DemDebounceAlgorithmClass  # DemDebounceTimeBase
            DemDebounceMonitorInternal
      DTCClass_DTC_0x9a0101 (DemDTCClass): DemDTCSeverity=DEM_DTC_SEV_NO_SEVERITY, DemUdsDTC=10092801, DemImmediateNvStorage=false
      Mic_1_short_to_GND_Circuit_Short_To_Ground (DemEventParameter):
        DemEventKind = DEM_EVENT_KIND_SWC
        DemMaxNumberFreezeFrameRecords = 1
        DemEventLatchTestFailed = false
        DemEventTimeSeries = DEM_TIMESERIES_SNAPSHOT_NONE
        DemEventAvailable = false
        DemEventId = 51
        DemEventAvailableInVariant = true
        DemEventCreateInfoPort = true
        DemDTCClassRef = DTCClass_DTC_0x93f511
        DemExtendedDataClassRef = ExtendedDataClass_4f5344cd
        DemFreezeFrameClassRef = FreezeFrameClass_80c88891
        DemEventClass:
          DemAgingAllowed = true
          DemAgingCycleCounterThreshold = 40
          DemEventDestination = DEM_DTC_ORIGIN_PRIMARY_MEMORY
          DemEventPriority = 1
          DemEventSignificance = DEM_EVENT_SIGNIFICANCE_FAULT
          DemConsiderPtoStatus = false
          DemFFPrestorageSupported = false
          DemAgingCycleRef = Ignition_on_off
          DemEnableConditionGroupRef = EnableConditionGroup_VIPBatteryVoltageAndIgnOn
          DemOperationCycleRef = Ignition_on_off
          DemDebounceAlgorithmClass  # DemDebounceTimeBase
            DemDebounceMonitorInternal
      DTCClass_DTC_0xd02987 (DemDTCClass): DemDTCSeverity=DEM_DTC_SEV_NO_SEVERITY, DemUdsDTC=13642119, DemImmediateNvStorage=false
      Speaker_RR_short_to_ground_Circuit_Short_To_Ground (DemEventParameter):
        DemEventKind = DEM_EVENT_KIND_SWC
        DemMaxNumberFreezeFrameRecords = 1
        DemEventLatchTestFailed = false
        DemEventTimeSeries = DEM_TIMESERIES_SNAPSHOT_NONE
        DemEventAvailable = false
        DemEventId = 110
        DemEventAvailableInVariant = true
        DemEventCreateInfoPort = true
        DemDTCClassRef = DTCClass_DTC_0x9a0411
        DemExtendedDataClassRef = ExtendedDataClass_4f5344cd
        DemFreezeFrameClassRef = FreezeFrameClass_80c88891
        DemEventClass:
          DemAgingAllowed = true
          DemAgingCycleCounterThreshold = 40
          DemEventDestination = DEM_DTC_ORIGIN_PRIMARY_MEMORY
          DemEventPriority = 1
          DemEventSignificance = DEM_EVENT_SIGNIFICANCE_FAULT
          DemConsiderPtoStatus = false
          DemFFPrestorageSupported = false
          DemAgingCycleRef = Ignition_on_off
          DemEnableConditionGroupRef = EnableConditionGroup_VIPBatteryVoltageAndIgnOn
          DemOperationCycleRef = Ignition_on_off
          DemDebounceAlgorithmClass  # DemDebounceTimeBase
            DemDebounceMonitorInternal
      DTCClass_DTC_0xd10116 (DemDTCClass): DemDTCSeverity=DEM_DTC_SEV_NO_SEVERITY, DemUdsDTC=13697302, DemImmediateNvStorage=false
      DTCClass_DTC_0xc14687 (DemDTCClass): DemDTCSeverity=DEM_DTC_SEV_NO_SEVERITY, DemUdsDTC=12666503, DemImmediateNvStorage=false
      Lost_communication_with_AVM_Missing_Message (DemEventParameter):
        DemEventKind = DEM_EVENT_KIND_SWC
        DemMaxNumberFreezeFrameRecords = 1
        DemEventLatchTestFailed = false
        DemEventTimeSeries = DEM_TIMESERIES_SNAPSHOT_NONE
        DemEventAvailable = false
        DemEventId = 39
        DemEventAvailableInVariant = true
        DemEventCreateInfoPort = true
        DemDTCClassRef = DTCClass_DTC_0x908a87
        DemExtendedDataClassRef = ExtendedDataClass_4f5344cd
        DemFreezeFrameClassRef = FreezeFrameClass_80c88891
        DemEventClass:
          DemAgingAllowed = true
          DemAgingCycleCounterThreshold = 40
          DemEventDestination = DEM_DTC_ORIGIN_PRIMARY_MEMORY
          DemEventPriority = 1
          DemEventSignificance = DEM_EVENT_SIGNIFICANCE_FAULT
          DemConsiderPtoStatus = false
          DemFFPrestorageSupported = false
          DemAgingCycleRef = Ignition_on_off
          DemOperationCycleRef = Ignition_on_off
          DemEnableConditionGroupRef = (unset)
          DemDebounceAlgorithmClass
            DemDebounceMonitorInternal
              DemCallbackGetFDC
      5 x DemDTCClass, all with DemDTCSeverity=DEM_DTC_SEV_NO_SEVERITY, DemImmediateNvStorage=false:
        DTCClass_DTC_0xc10087: DemUdsDTC=12648583
        DTCClass_DTC_0x908e87: DemUdsDTC=9473671
        DTCClass_DTC_0x9a0212: DemUdsDTC=10093074
        DTCClass_DTC_0x9a0213: DemUdsDTC=10093075
        DTCClass_DTC_0x9a0211: DemUdsDTC=10093073
      Speaker_Center_open_Circuit_Open (DemEventParameter):
        DemEventKind = DEM_EVENT_KIND_SWC
        DemMaxNumberFreezeFrameRecords = 1
        DemEventLatchTestFailed = false
        DemEventTimeSeries = DEM_TIMESERIES_SNAPSHOT_NONE
        DemEventAvailable = false
        DemEventId = 80
        DemEventAvailableInVariant = true
        DemEventCreateInfoPort = true
        DemDTCClassRef = DTCClass_DTC_0x9a0513
        DemExtendedDataClassRef = ExtendedDataClass_4f5344cd
        DemFreezeFrameClassRef = FreezeFrameClass_80c88891
        DemEventClass:
          DemAgingAllowed = true
          DemAgingCycleCounterThreshold = 40
          DemEventDestination = DEM_DTC_ORIGIN_PRIMARY_MEMORY
          DemEventPriority = 1
          DemEventSignificance = DEM_EVENT_SIGNIFICANCE_FAULT
          DemConsiderPtoStatus = false
          DemFFPrestorageSupported = false
          DemAgingCycleRef = Ignition_on_off
          DemEnableConditionGroupRef = EnableConditionGroup_BatteryVoltage
          DemOperationCycleRef = Ignition_on_off
          DemDebounceAlgorithmClass  # DemDebounceTimeBase
            DemDebounceMonitorInternal
      missing_Parking_Assistance_System_Missing_Message (DemEventParameter):
        DemEventKind = DEM_EVENT_KIND_SWC
        DemMaxNumberFreezeFrameRecords = 1
        DemEventLatchTestFailed = false
        DemEventTimeSeries = DEM_TIMESERIES_SNAPSHOT_NONE
        DemEventAvailable = false
        DemEventId = 129
        DemEventAvailableInVariant = true
        DemEventCreateInfoPort = true
        DemDTCClassRef = DTCClass_DTC_0xc24387
        DemExtendedDataClassRef = ExtendedDataClass_4f5344cd
        DemFreezeFrameClassRef = FreezeFrameClass_80c88891
        DemEventClass:
          DemAgingAllowed = true
          DemAgingCycleCounterThreshold = 40
          DemEventDestination = DEM_DTC_ORIGIN_PRIMARY_MEMORY
          DemEventPriority = 1
          DemEventSignificance = DEM_EVENT_SIGNIFICANCE_FAULT
          DemEventFailureCycleCounterThreshold = 0
          DemConsiderPtoStatus = false
          DemFFPrestorageSupported = false
          DemAgingCycleRef = Ignition_on_off
          DemEnableConditionGroupRef = EnableConditionGroup_VIPBatteryVoltageAndIgnOn
          DemOperationCycleRef = Ignition_on_off
          DemDebounceAlgorithmClass  # DemDebounceCounterBased
            DemDebounceMonitorInternal
      4 x DemDTCClass, all with DemDTCSeverity=DEM_DTC_SEV_NO_SEVERITY, DemImmediateNvStorage=false:
        DTCClass_DTC_0x927412: DemUdsDTC=9597970
        DTCClass_DTC_0x9a031e: DemUdsDTC=10093342
        DTCClass_DTC_0x93f612: DemUdsDTC=9696786
        DTCClass_DTC_0x93f613: DemUdsDTC=9696787
      Missing_Controller_Pedal_Missing_Message (DemEventParameter):
        DemEventKind = DEM_EVENT_KIND_SWC
        DemMaxNumberFreezeFrameRecords = 1
        DemEventLatchTestFailed = false
        DemEventTimeSeries = DEM_TIMESERIES_SNAPSHOT_NONE
        DemEventAvailable = false
        DemEventId = 60
        DemEventAvailableInVariant = true
        DemEventCreateInfoPort = true
        DemDTCClassRef = DTCClass_DTC_0xd00987
        DemExtendedDataClassRef = ExtendedDataClass_4f5344cd
        DemFreezeFrameClassRef = FreezeFrameClass_80c88891
        DemEventClass:
          DemAgingAllowed = true
          DemAgingCycleCounterThreshold = 40
          DemEventDestination = DEM_DTC_ORIGIN_PRIMARY_MEMORY
          DemEventPriority = 1
          DemEventSignificance = DEM_EVENT_SIGNIFICANCE_FAULT
          DemEventFailureCycleCounterThreshold = 0
          DemConsiderPtoStatus = false
          DemFFPrestorageSupported = false
          DemAgingCycleRef = Ignition_on_off
          DemEnableConditionGroupRef = EnableConditionGroup_VIPBatteryVoltageAndIgnOn
          DemOperationCycleRef = Ignition_on_off
          DemDebounceAlgorithmClass  # DemDebounceCounterBased
            DemDebounceMonitorInternal
      DTCClass_DTC_0x92764b (DemDTCClass): DemDTCSeverity=DEM_DTC_SEV_NO_SEVERITY, DemUdsDTC=9598539, DemImmediateNvStorage=false
      Missing_Electronic_Gerodisc_Missing_Message (DemEventParameter):
        DemEventKind = DEM_EVENT_KIND_SWC
        DemMaxNumberFreezeFrameRecords = 1
        DemEventLatchTestFailed = false
        DemEventTimeSeries = DEM_TIMESERIES_SNAPSHOT_NONE
        DemEventAvailable = false
        DemEventId = 65
        DemEventAvailableInVariant = true
        DemEventCreateInfoPort = true
        DemDTCClassRef = DTCClass_DTC_0xc11587
        DemExtendedDataClassRef = ExtendedDataClass_4f5344cd
        DemFreezeFrameClassRef = FreezeFrameClass_80c88891
        DemEventClass:
          DemAgingAllowed = true
          DemAgingCycleCounterThreshold = 40
          DemEventDestination = DEM_DTC_ORIGIN_PRIMARY_MEMORY
          DemEventPriority = 1
          DemEventSignificance = DEM_EVENT_SIGNIFICANCE_FAULT
          DemEventFailureCycleCounterThreshold = 0
          DemConsiderPtoStatus = false
          DemFFPrestorageSupported = false
          DemAgingCycleRef = Ignition_on_off
          DemEnableConditionGroupRef = EnableConditionGroup_VIPBatteryVoltageAndIgnOn
          DemOperationCycleRef = Ignition_on_off
          DemDebounceAlgorithmClass  # DemDebounceCounterBased
            DemDebounceMonitorInternal
      Speaker_FL_short_across_General_Electrical_Failure (DemEventParameter):
        DemEventKind = DEM_EVENT_KIND_SWC
        DemMaxNumberFreezeFrameRecords = 1
        DemEventLatchTestFailed = false
        DemEventTimeSeries = DEM_TIMESERIES_SNAPSHOT_NONE
        DemEventAvailable = false
        DemEventId = 90
        DemEventAvailableInVariant = true
        DemEventCreateInfoPort = true
        DemDTCClassRef = DTCClass_DTC_0x9a0101
        DemExtendedDataClassRef = ExtendedDataClass_4f5344cd
        DemFreezeFrameClassRef = FreezeFrameClass_80c88891
        DemEventClass:
          DemAgingAllowed = true
          DemAgingCycleCounterThreshold = 40
          DemEventDestination = DEM_DTC_ORIGIN_PRIMARY_MEMORY
          DemEventPriority = 1
          DemEventSignificance = DEM_EVENT_SIGNIFICANCE_FAULT
          DemConsiderPtoStatus = false
          DemFFPrestorageSupported = false
          DemAgingCycleRef = Ignition_on_off
          DemEnableConditionGroupRef = EnableConditionGroup_BatteryVoltage
          DemOperationCycleRef = Ignition_on_off
          DemDebounceAlgorithmClass  # DemDebounceTimeBase
            DemDebounceMonitorInternal
      DTCClass_DTC_0x93f611 (DemDTCClass): DemDTCSeverity=DEM_DTC_SEV_NO_SEVERITY, DemUdsDTC=9696785, DemImmediateNvStorage=false
      Missing_Nextrac_Torque_On_Demand_Missing_Message (DemEventParameter):
        DemEventKind = DEM_EVENT_KIND_SWC
        DemMaxNumberFreezeFrameRecords = 1
        DemEventLatchTestFailed = false
        DemEventTimeSeries = DEM_TIMESERIES_SNAPSHOT_NONE
        DemEventAvailable = false
        DemEventId = 70
        DemEventAvailableInVariant = true
        DemEventCreateInfoPort = true
        DemDTCClassRef = DTCClass_DTC_0xc11487
        DemExtendedDataClassRef = ExtendedDataClass_4f5344cd
        DemFreezeFrameClassRef = FreezeFrameClass_80c88891
        DemEventClass:
          DemAgingAllowed = true
          DemAgingCycleCounterThreshold = 40
          DemEventDestination = DEM_DTC_ORIGIN_PRIMARY_MEMORY
          DemEventPriority = 1
          DemEventSignificance = DEM_EVENT_SIGNIFICANCE_FAULT
          DemEventFailureCycleCounterThreshold = 0
          DemConsiderPtoStatus = false
          DemFFPrestorageSupported = false
          DemAgingCycleRef = Ignition_on_off
          DemEnableConditionGroupRef = EnableConditionGroup_VIPBatteryVoltageAndIgnOn
          DemOperationCycleRef = Ignition_on_off
          DemDebounceAlgorithmClass  # DemDebounceCounterBased
            DemDebounceMonitorInternal
      Fuel_sensor1_short_to_GND_Circuit_Short_To_Ground (DemEventParameter):
        DemEventKind = DEM_EVENT_KIND_SWC
        DemMaxNumberFreezeFrameRecords = 1
        DemEventLatchTestFailed = false
        DemEventTimeSeries = DEM_TIMESERIES_SNAPSHOT_NONE
        DemEventAvailable = false
        DemEventId = 8
        DemEventAvailableInVariant = true
        DemEventCreateInfoPort = true
        DemDTCClassRef = DTCClass_DTC_0xa13011
        DemExtendedDataClassRef = ExtendedDataClass_4f5344cd
        DemFreezeFrameClassRef = FreezeFrameClass_80c88891
        DemEventClass:
          DemAgingAllowed = true
          DemAgingCycleCounterThreshold = 40
          DemEventDestination = DEM_DTC_ORIGIN_PRIMARY_MEMORY
          DemEventPriority = 1
          DemEventSignificance = DEM_EVENT_SIGNIFICANCE_FAULT
          DemConsiderPtoStatus = false
          DemFFPrestorageSupported = false
          DemAgingCycleRef = Ignition_on_off
          DemEnableConditionGroupRef = EnableConditionGroup_VIPBatteryVoltageAndIgnOn
          DemOperationCycleRef = Ignition_on_off
          DemDebounceAlgorithmClass  # DemDebounceTimeBase
            DemDebounceMonitorInternal
      DTCClass_DTC_0x9a0125 (DemDTCClass): DemDTCSeverity=DEM_DTC_SEV_NO_SEVERITY, DemUdsDTC=10092837, DemImmediateNvStorage=false
      5 x DemEventParameter, all with DemEventKind=DEM_EVENT_KIND_SWC, DemMaxNumberFreezeFrameRecords=1, DemEventLatchTestFailed=false, DemEventTimeSeries=DEM_TIMESERIES_SNAPSHOT_NONE, DemEventAvailable=false, DemEventAvailableInVariant=true, DemEventCreateInfoPort=true, DemExtendedDataClassRef=ExtendedDataClass_4f5344cd, DemFreezeFrameClassRef=FreezeFrameClass_80c88891:
        Mic_2_short_to_BAT_Circuit_Short_To_Battery: DemEventId=53, DemDTCClassRef=DTCClass_DTC_0x93f612
          DemEventClass:
            DemAgingAllowed = true
            DemAgingCycleCounterThreshold = 40
            DemEventDestination = DEM_DTC_ORIGIN_PRIMARY_MEMORY
            DemEventPriority = 1
            DemEventSignificance = DEM_EVENT_SIGNIFICANCE_FAULT
            DemConsiderPtoStatus = false
            DemFFPrestorageSupported = false
            DemAgingCycleRef = Ignition_on_off
            DemEnableConditionGroupRef = EnableConditionGroup_VIPBatteryVoltage2AndIgnOn
            DemOperationCycleRef = Ignition_on_off
            DemDebounceAlgorithmClass  # DemDebounceTimeBase
              DemDebounceMonitorInternal
        Speaker_RL_short_to_ground_Circuit_Short_To_Ground: DemEventId=104, DemDTCClassRef=DTCClass_DTC_0x9a0311
          DemEventClass:
            DemAgingAllowed = true
            DemAgingCycleCounterThreshold = 40
            DemEventDestination = DEM_DTC_ORIGIN_PRIMARY_MEMORY
            DemEventPriority = 1
            DemEventSignificance = DEM_EVENT_SIGNIFICANCE_FAULT
            DemConsiderPtoStatus = false
            DemFFPrestorageSupported = false
            DemAgingCycleRef = Ignition_on_off
            DemEnableConditionGroupRef = EnableConditionGroup_VIPBatteryVoltageAndIgnOn
            DemOperationCycleRef = Ignition_on_off
            DemDebounceAlgorithmClass  # DemDebounceTimeBase
              DemDebounceMonitorInternal
        SecOC_key_storage_exception_Calibration_Parameter_Memory_Failure: DemEventId=77, DemDTCClassRef=DTCClass_DTC_0xd00a46
          DemEventClass:
            DemAgingAllowed = true
            DemAgingCycleCounterThreshold = 40
            DemEventDestination = DEM_DTC_ORIGIN_PRIMARY_MEMORY
            DemEventPriority = 1
            DemEventSignificance = DEM_EVENT_SIGNIFICANCE_FAULT
            DemConsiderPtoStatus = false
            DemFFPrestorageSupported = false
            DemAgingCycleRef = Ignition_on_off
            DemOperationCycleRef = Ignition_on_off
            DemEnableConditionGroupRef = EnableConditionGroup_IgnOn
            DemDebounceAlgorithmClass
              DemDebounceMonitorInternal
                DemCallbackGetFDC
        Lost_communication_with_IP_Display_Front_Missing_Message: DemEventId=40, DemDTCClassRef=DTCClass_DTC_0x908d87
          DemEventClass:
            DemAgingAllowed = true
            DemAgingCycleCounterThreshold = 40
            DemEventDestination = DEM_DTC_ORIGIN_PRIMARY_MEMORY
            DemEventPriority = 1
            DemEventSignificance = DEM_EVENT_SIGNIFICANCE_FAULT
            DemConsiderPtoStatus = false
            DemFFPrestorageSupported = false
            DemAgingCycleRef = Ignition_on_off
            DemOperationCycleRef = Ignition_on_off
            DemEnableConditionGroupRef = EnableConditionGroup_IgnOn
            DemDebounceAlgorithmClass
              DemDebounceMonitorInternal
                DemCallbackGetFDC
        Lost_communication_with_RVC_Missing_Message: DemEventId=44, DemDTCClassRef=DTCClass_DTC_0x910087
          DemEventClass:
            DemAgingAllowed = true
            DemAgingCycleCounterThreshold = 40
            DemEventDestination = DEM_DTC_ORIGIN_PRIMARY_MEMORY
            DemEventPriority = 1
            DemEventSignificance = DEM_EVENT_SIGNIFICANCE_FAULT
            DemConsiderPtoStatus = false
            DemFFPrestorageSupported = false
            DemAgingCycleRef = Ignition_on_off
            DemOperationCycleRef = Ignition_on_off
            DemEnableConditionGroupRef = EnableConditionGroup_IgnOn
            DemDebounceAlgorithmClass
              DemDebounceMonitorInternal
                DemCallbackGetFDC
      DTCClass_DTC_0xc10187 (DemDTCClass): DemDTCSeverity=DEM_DTC_SEV_NO_SEVERITY, DemUdsDTC=12648839, DemImmediateNvStorage=false
      3 x DemEventParameter, all with DemEventKind=DEM_EVENT_KIND_SWC, DemMaxNumberFreezeFrameRecords=1, DemEventLatchTestFailed=false, DemEventTimeSeries=DEM_TIMESERIES_SNAPSHOT_NONE, DemEventAvailable=false, DemEventAvailableInVariant=true, DemEventCreateInfoPort=true, DemExtendedDataClassRef=ExtendedDataClass_4f5344cd, DemFreezeFrameClassRef=FreezeFrameClass_80c88891:
        Speaker_FL_short_to_battery_Circuit_Short_To_Battery: DemEventId=91, DemDTCClassRef=DTCClass_DTC_0x9a0112
          DemEventClass:
            DemAgingAllowed = true
            DemAgingCycleCounterThreshold = 40
            DemEventDestination = DEM_DTC_ORIGIN_PRIMARY_MEMORY
            DemEventPriority = 1
            DemEventSignificance = DEM_EVENT_SIGNIFICANCE_FAULT
            DemConsiderPtoStatus = false
            DemFFPrestorageSupported = false
            DemAgingCycleRef = Ignition_on_off
            DemEnableConditionGroupRef = EnableConditionGroup_VIPBatteryVoltageAndIgnOn
            DemOperationCycleRef = Ignition_on_off
            DemDebounceAlgorithmClass  # DemDebounceTimeBase
              DemDebounceMonitorInternal
        INVALID_SHORTNAME_HUT_Display_Touch_Panel_failure_Internal_Electronic_Failure: DemEventId=17, DemDTCClassRef=DTCClass_DTC_0xa20449
          DemEventClass:
            DemAgingAllowed = true
            DemAgingCycleCounterThreshold = 40
            DemEventDestination = DEM_DTC_ORIGIN_PRIMARY_MEMORY
            DemEventPriority = 2
            DemEventSignificance = DEM_EVENT_SIGNIFICANCE_FAULT
            DemConsiderPtoStatus = false
            DemFFPrestorageSupported = false
            DemAgingCycleRef = Ignition_on_off
            DemOperationCycleRef = Ignition_on_off
            DemDebounceAlgorithmClass
              DemDebounceMonitorInternal
                DemCallbackGetFDC
        Speaker_Woofer_short_to_ground_Circuit_Short_To_Ground: DemEventId=116, DemDTCClassRef=DTCClass_DTC_0x9a0611
          DemEventClass:
            DemAgingAllowed = true
            DemAgingCycleCounterThreshold = 40
            DemEventDestination = DEM_DTC_ORIGIN_PRIMARY_MEMORY
            DemEventPriority = 1
            DemEventSignificance = DEM_EVENT_SIGNIFICANCE_FAULT
            DemConsiderPtoStatus = false
            DemFFPrestorageSupported = false
            DemAgingCycleRef = Ignition_on_off
            DemEnableConditionGroupRef = EnableConditionGroup_VIPBatteryVoltageAndIgnOn
            DemOperationCycleRef = Ignition_on_off
            DemDebounceAlgorithmClass  # DemDebounceTimeBase
              DemDebounceMonitorInternal
      4 x DemDTCClass, all with DemDTCSeverity=DEM_DTC_SEV_NO_SEVERITY, DemImmediateNvStorage=false:
        DTCClass_DTC_0x9a0113: DemUdsDTC=10092819
        DTCClass_DTC_0x9a0111: DemUdsDTC=10092817
        DTCClass_DTC_0x927312: DemUdsDTC=9597714
        DTCClass_DTC_0x9a0112: DemUdsDTC=10092818
      Speaker_RL_open_Circuit_Open (DemEventParameter):
        DemEventKind = DEM_EVENT_KIND_SWC
        DemMaxNumberFreezeFrameRecords = 1
        DemEventLatchTestFailed = false
        DemEventTimeSeries = DEM_TIMESERIES_SNAPSHOT_NONE
        DemEventAvailable = false
        DemEventId = 99
        DemEventAvailableInVariant = true
        DemEventCreateInfoPort = true
        DemDTCClassRef = DTCClass_DTC_0x9a0313
        DemExtendedDataClassRef = ExtendedDataClass_4f5344cd
        DemFreezeFrameClassRef = FreezeFrameClass_80c88891
        DemEventClass:
          DemAgingAllowed = true
          DemAgingCycleCounterThreshold = 40
          DemEventDestination = DEM_DTC_ORIGIN_PRIMARY_MEMORY
          DemEventPriority = 1
          DemEventSignificance = DEM_EVENT_SIGNIFICANCE_FAULT
          DemConsiderPtoStatus = false
          DemFFPrestorageSupported = false
          DemAgingCycleRef = Ignition_on_off
          DemEnableConditionGroupRef = EnableConditionGroup_BatteryVoltage
          DemOperationCycleRef = Ignition_on_off
          DemDebounceAlgorithmClass  # DemDebounceTimeBase
            DemDebounceMonitorInternal
      DTCClass_DTC_0xc23387 (DemDTCClass): DemDTCSeverity=DEM_DTC_SEV_NO_SEVERITY, DemUdsDTC=12727175, DemImmediateNvStorage=false
      4 x DemEventParameter, all with DemEventKind=DEM_EVENT_KIND_SWC, DemMaxNumberFreezeFrameRecords=1, DemEventLatchTestFailed=false, DemEventTimeSeries=DEM_TIMESERIES_SNAPSHOT_NONE, DemEventAvailable=false, DemEventAvailableInVariant=true, DemEventCreateInfoPort=true, DemExtendedDataClassRef=ExtendedDataClass_4f5344cd, DemFreezeFrameClassRef=FreezeFrameClass_80c88891:
        Missing_Engine_Control_Module_Missing_Message: DemEventId=66, DemDTCClassRef=DTCClass_DTC_0xc10087
          DemEventClass:
            DemAgingAllowed = true
            DemAgingCycleCounterThreshold = 40
            DemEventDestination = DEM_DTC_ORIGIN_PRIMARY_MEMORY
            DemEventPriority = 1
            DemEventSignificance = DEM_EVENT_SIGNIFICANCE_FAULT
            DemConsiderPtoStatus = false
            DemFFPrestorageSupported = false
            DemAgingCycleRef = Ignition_on_off
            DemEnableConditionGroupRef = EnableConditionGroup_VIPBatteryVoltageAndIgnOn
            DemOperationCycleRef = Ignition_on_off
            DemDebounceAlgorithmClass  # DemDebounceCounterBased
              DemDebounceMonitorInternal
        Over_voltage_Circuit_Voltage_Above_Threshold: DemEventId=75, DemDTCClassRef=DTCClass_DTC_0xd10017
          DemEventClass:
            DemAgingAllowed = true
            DemAgingCycleCounterThreshold = 40
            DemEventDestination = DEM_DTC_ORIGIN_PRIMARY_MEMORY
            DemEventPriority = 1
            DemEventSignificance = DEM_EVENT_SIGNIFICANCE_FAULT
            DemConsiderPtoStatus = false
            DemFFPrestorageSupported = false
            DemAgingCycleRef = Ignition_on_off
            DemEnableConditionGroupRef = (unset)
            DemOperationCycleRef = Ignition_on_off
            DemDebounceAlgorithmClass  # DemDebounceTimeBase
              DemDebounceMonitorInternal
        IP_Display_IIC_communication_failure_Bus_Signal_Message_Failure: DemEventId=36, DemDTCClassRef=DTCClass_DTC_0xa10408
          DemEventClass:
            DemAgingAllowed = true
            DemAgingCycleCounterThreshold = 40
            DemEventDestination = DEM_DTC_ORIGIN_PRIMARY_MEMORY
            DemEventPriority = 2
            DemEventSignificance = DEM_EVENT_SIGNIFICANCE_FAULT
            DemConsiderPtoStatus = false
            DemFFPrestorageSupported = false
            DemAgingCycleRef = Ignition_on_off
            DemOperationCycleRef = Ignition_on_off
            DemDebounceAlgorithmClass
              DemDebounceMonitorInternal
                DemCallbackGetFDC
        Missing_Controler_Headlamp_Missing_Message: DemEventId=59, DemDTCClassRef=DTCClass_DTC_0xc24187
          DemEventClass:
            DemAgingAllowed = true
            DemAgingCycleCounterThreshold = 40
            DemEventDestination = DEM_DTC_ORIGIN_PRIMARY_MEMORY
            DemEventPriority = 1
            DemEventSignificance = DEM_EVENT_SIGNIFICANCE_FAULT
            DemEventFailureCycleCounterThreshold = 0
            DemConsiderPtoStatus = false
            DemFFPrestorageSupported = false
            DemAgingCycleRef = Ignition_on_off
            DemEnableConditionGroupRef = EnableConditionGroup_VIPBatteryVoltageAndIgnOn
            DemOperationCycleRef = Ignition_on_off
            DemDebounceAlgorithmClass  # DemDebounceCounterBased
              DemDebounceMonitorInternal
      DTCClass_DTC_0x9a021e (DemDTCClass): DemDTCSeverity=DEM_DTC_SEV_NO_SEVERITY, DemUdsDTC=10093086, DemImmediateNvStorage=false
      Speaker_FR_short_across_General_Electrical_Failure (DemEventParameter):
        DemEventKind = DEM_EVENT_KIND_SWC
        DemMaxNumberFreezeFrameRecords = 1
        DemEventLatchTestFailed = false
        DemEventTimeSeries = DEM_TIMESERIES_SNAPSHOT_NONE
        DemEventAvailable = false
        DemEventId = 96
        DemEventAvailableInVariant = true
        DemEventCreateInfoPort = true
        DemDTCClassRef = DTCClass_DTC_0x9a0201
        DemExtendedDataClassRef = ExtendedDataClass_4f5344cd
        DemFreezeFrameClassRef = FreezeFrameClass_80c88891
        DemEventClass:
          DemAgingAllowed = true
          DemAgingCycleCounterThreshold = 40
          DemEventDestination = DEM_DTC_ORIGIN_PRIMARY_MEMORY
          DemEventPriority = 1
          DemEventSignificance = DEM_EVENT_SIGNIFICANCE_FAULT
          DemConsiderPtoStatus = false
          DemFFPrestorageSupported = false
          DemAgingCycleRef = Ignition_on_off
          DemEnableConditionGroupRef = EnableConditionGroup_BatteryVoltage
          DemOperationCycleRef = Ignition_on_off
          DemDebounceAlgorithmClass  # DemDebounceTimeBase
            DemDebounceMonitorInternal
      DTCClass_DTC_0xa10049 (DemDTCClass): DemDTCSeverity=DEM_DTC_SEV_NO_SEVERITY, DemUdsDTC=10551369, DemImmediateNvStorage=false
      DTCClass_DTC_0xc15887 (DemDTCClass): DemDTCSeverity=DEM_DTC_SEV_NO_SEVERITY, DemUdsDTC=12671111, DemImmediateNvStorage=false
      3 x DemEventParameter, all with DemEventKind=DEM_EVENT_KIND_SWC, DemMaxNumberFreezeFrameRecords=1, DemEventLatchTestFailed=false, DemEventTimeSeries=DEM_TIMESERIES_SNAPSHOT_NONE, DemEventAvailable=false, DemEventAvailableInVariant=true, DemEventCreateInfoPort=true, DemExtendedDataClassRef=ExtendedDataClass_4f5344cd, DemFreezeFrameClassRef=FreezeFrameClass_80c88891:
        TUNER_FM1_open_Circuit_Open: DemEventId=118, DemDTCClassRef=DTCClass_DTC_0x9a1013
          DemEventClass:
            DemAgingAllowed = true
            DemAgingCycleCounterThreshold = 40
            DemEventDestination = DEM_DTC_ORIGIN_PRIMARY_MEMORY
            DemEventPriority = 1
            DemEventSignificance = DEM_EVENT_SIGNIFICANCE_FAULT
            DemConsiderPtoStatus = false
            DemFFPrestorageSupported = false
            DemAgingCycleRef = Ignition_on_off
            DemOperationCycleRef = Ignition_on_off
            DemEnableConditionGroupRef = EnableConditionGroup_VIPBatteryVoltageAndIgnOn
            DemDebounceAlgorithmClass
              DemDebounceMonitorInternal
                DemCallbackGetFDC
        INVALID_SHORTNAME_HUT_Display_Over_voltage_Circuit_Voltage_Above_Threshold: DemEventId=15, DemDTCClassRef=DTCClass_DTC_0xa20017
          DemEventClass:
            DemAgingAllowed = true
            DemAgingCycleCounterThreshold = 40
            DemEventDestination = DEM_DTC_ORIGIN_PRIMARY_MEMORY
            DemEventPriority = 2
            DemEventSignificance = DEM_EVENT_SIGNIFICANCE_FAULT
            DemConsiderPtoStatus = false
            DemFFPrestorageSupported = false
            DemAgingCycleRef = Ignition_on_off
            DemOperationCycleRef = Ignition_on_off
            DemDebounceAlgorithmClass
              DemDebounceMonitorInternal
                DemCallbackGetFDC
        Speaker_FL_output_waveform_lack_fidelity_Signal_Shape_Waveform_Failure: DemEventId=88, DemDTCClassRef=DTCClass_DTC_0x9a0125
          DemEventClass:
            DemAgingAllowed = true
            DemAgingCycleCounterThreshold = 40
            DemEventDestination = DEM_DTC_ORIGIN_PRIMARY_MEMORY
            DemEventPriority = 1
            DemEventSignificance = DEM_EVENT_SIGNIFICANCE_FAULT
            DemConsiderPtoStatus = false
            DemFFPrestorageSupported = false
            DemAgingCycleRef = Ignition_on_off
            DemEnableConditionGroupRef = EnableConditionGroup_VIPBatteryVoltageAndIgnOn
            DemOperationCycleRef = Ignition_on_off
            DemDebounceAlgorithmClass  # DemDebounceTimeBase
              DemDebounceMonitorInternal
      DTCClass_DTC_0x908d87 (DemDTCClass): DemDTCSeverity=DEM_DTC_SEV_NO_SEVERITY, DemUdsDTC=9473415, DemImmediateNvStorage=false
      INVALID_SHORTNAME_HUT_Display_backlight_module_status_Internal_Electronic_Failure (DemEventParameter):
        DemEventKind = DEM_EVENT_KIND_SWC
        DemMaxNumberFreezeFrameRecords = 1
        DemEventLatchTestFailed = false
        DemEventTimeSeries = DEM_TIMESERIES_SNAPSHOT_NONE
        DemEventAvailable = false
        DemEventId = 18
        DemEventAvailableInVariant = true
        DemEventCreateInfoPort = true
        DemDTCClassRef = DTCClass_DTC_0xa20149
        DemExtendedDataClassRef = ExtendedDataClass_4f5344cd
        DemFreezeFrameClassRef = FreezeFrameClass_80c88891
        DemEventClass:
          DemAgingAllowed = true
          DemAgingCycleCounterThreshold = 40
          DemEventDestination = DEM_DTC_ORIGIN_PRIMARY_MEMORY
          DemEventPriority = 2
          DemEventSignificance = DEM_EVENT_SIGNIFICANCE_FAULT
          DemConsiderPtoStatus = false
          DemFFPrestorageSupported = false
          DemAgingCycleRef = Ignition_on_off
          DemOperationCycleRef = Ignition_on_off
          DemDebounceAlgorithmClass
            DemDebounceMonitorInternal
              DemCallbackGetFDC
      DTCClass_DTC_0x9a1119 (DemDTCClass): DemDTCSeverity=DEM_DTC_SEV_NO_SEVERITY, DemUdsDTC=10096921, DemImmediateNvStorage=false
      Synchronization_counter_data_NVM_erasure_failed_Calibration_Parameter_Memory_Failure (DemEventParameter):
        DemEventKind = DEM_EVENT_KIND_SWC
        DemMaxNumberFreezeFrameRecords = 1
        DemEventLatchTestFailed = false
        DemEventTimeSeries = DEM_TIMESERIES_SNAPSHOT_NONE
        DemEventAvailable = false
        DemEventId = 117
        DemEventAvailableInVariant = true
        DemEventCreateInfoPort = true
        DemDTCClassRef = DTCClass_DTC_0xd01046
        DemExtendedDataClassRef = ExtendedDataClass_4f5344cd
        DemFreezeFrameClassRef = FreezeFrameClass_80c88891
        DemEventClass:
          DemAgingAllowed = true
          DemAgingCycleCounterThreshold = 40
          DemEventDestination = DEM_DTC_ORIGIN_PRIMARY_MEMORY
          DemEventPriority = 1
          DemEventSignificance = DEM_EVENT_SIGNIFICANCE_FAULT
          DemConsiderPtoStatus = false
          DemFFPrestorageSupported = false
          DemAgingCycleRef = Ignition_on_off
          DemOperationCycleRef = Ignition_on_off
          DemEnableConditionGroupRef = EnableConditionGroup_IgnOn
          DemDebounceAlgorithmClass
            DemDebounceMonitorInternal
              DemCallbackGetFDC
      DTCClass_DTC_0xd10687 (DemDTCClass): DemDTCSeverity=DEM_DTC_SEV_NO_SEVERITY, DemUdsDTC=13698695, DemImmediateNvStorage=false
      Missing_Wireless_Power_Charger_Missing_Message (DemEventParameter):
        DemEventKind = DEM_EVENT_KIND_SWC
        DemMaxNumberFreezeFrameRecords = 1
        DemEventLatchTestFailed = false
        DemEventTimeSeries = DEM_TIMESERIES_SNAPSHOT_NONE
        DemEventAvailable = false
        DemEventId = 74
        DemEventAvailableInVariant = true
        DemEventCreateInfoPort = true
        DemDTCClassRef = DTCClass_DTC_0xd02987
        DemExtendedDataClassRef = ExtendedDataClass_4f5344cd
        DemFreezeFrameClassRef = FreezeFrameClass_80c88891
        DemEventClass:
          DemAgingAllowed = true
          DemAgingCycleCounterThreshold = 40
          DemEventDestination = DEM_DTC_ORIGIN_PRIMARY_MEMORY
          DemEventPriority = 1
          DemEventSignificance = DEM_EVENT_SIGNIFICANCE_FAULT
          DemEventFailureCycleCounterThreshold = 0
          DemConsiderPtoStatus = false
          DemFFPrestorageSupported = false
          DemAgingCycleRef = Ignition_on_off
          DemEnableConditionGroupRef = EnableConditionGroup_VIPBatteryVoltageAndIgnOn
          DemOperationCycleRef = Ignition_on_off
          DemDebounceAlgorithmClass  # DemDebounceCounterBased
            DemDebounceMonitorInternal
      DTCClass_DTC_0x9a1112 (DemDTCClass): DemDTCSeverity=DEM_DTC_SEV_NO_SEVERITY, DemUdsDTC=10096914, DemImmediateNvStorage=false
      DTCClass_DTC_0x9a1113 (DemDTCClass): DemDTCSeverity=DEM_DTC_SEV_NO_SEVERITY, DemUdsDTC=10096915, DemImmediateNvStorage=false
      IP_Display_PRNDM_Telltale_failure_Internal_Electronic_Failure (DemEventParameter):
        DemEventKind = DEM_EVENT_KIND_SWC
        DemMaxNumberFreezeFrameRecords = 1
        DemEventLatchTestFailed = false
        DemEventTimeSeries = DEM_TIMESERIES_SNAPSHOT_NONE
        DemEventAvailable = false
        DemEventId = 37
        DemEventAvailableInVariant = true
        DemEventCreateInfoPort = true
        DemDTCClassRef = DTCClass_DTC_0xa10349
        DemExtendedDataClassRef = ExtendedDataClass_4f5344cd
        DemFreezeFrameClassRef = FreezeFrameClass_80c88891
        DemEventClass:
          DemAgingAllowed = true
          DemAgingCycleCounterThreshold = 40
          DemEventDestination = DEM_DTC_ORIGIN_PRIMARY_MEMORY
          DemEventPriority = 2
          DemEventSignificance = DEM_EVENT_SIGNIFICANCE_FAULT
          DemConsiderPtoStatus = false
          DemFFPrestorageSupported = false
          DemAgingCycleRef = Ignition_on_off
          DemOperationCycleRef = Ignition_on_off
          DemDebounceAlgorithmClass
            DemDebounceMonitorInternal
              DemCallbackGetFDC
      IP_Display_ICD_screen_IC_failure_Internal_Electronic_Failure (DemEventParameter):
        DemEventKind = DEM_EVENT_KIND_SWC
        DemMaxNumberFreezeFrameRecords = 1
        DemEventLatchTestFailed = false
        DemEventTimeSeries = DEM_TIMESERIES_SNAPSHOT_NONE
        DemEventAvailable = false
        DemEventId = 35
        DemEventAvailableInVariant = true
        DemEventCreateInfoPort = true
        DemDTCClassRef = DTCClass_DTC_0xa10149
        DemExtendedDataClassRef = ExtendedDataClass_4f5344cd
        DemFreezeFrameClassRef = FreezeFrameClass_80c88891
        DemEventClass:
          DemAgingAllowed = true
          DemAgingCycleCounterThreshold = 40
          DemEventDestination = DEM_DTC_ORIGIN_PRIMARY_MEMORY
          DemEventPriority = 2
          DemEventSignificance = DEM_EVENT_SIGNIFICANCE_FAULT
          DemConsiderPtoStatus = false
          DemFFPrestorageSupported = false
          DemAgingCycleRef = Ignition_on_off
          DemOperationCycleRef = Ignition_on_off
          DemDebounceAlgorithmClass
            DemDebounceMonitorInternal
              DemCallbackGetFDC
      DTCClass_DTC_0x9a1111 (DemDTCClass): DemDTCSeverity=DEM_DTC_SEV_NO_SEVERITY, DemUdsDTC=10096913, DemImmediateNvStorage=false
      Missing_Combination_Switch_Assembly_Missing_Message (DemEventParameter):
        DemEventKind = DEM_EVENT_KIND_SWC
        DemMaxNumberFreezeFrameRecords = 1
        DemEventLatchTestFailed = false
        DemEventTimeSeries = DEM_TIMESERIES_SNAPSHOT_NONE
        DemEventAvailable = false
        DemEventId = 58
        DemEventAvailableInVariant = true
        DemEventCreateInfoPort = true
        DemDTCClassRef = DTCClass_DTC_0xd10687
        DemExtendedDataClassRef = ExtendedDataClass_4f5344cd
        DemFreezeFrameClassRef = FreezeFrameClass_80c88891
        DemEventClass:
          DemAgingAllowed = true
          DemAgingCycleCounterThreshold = 40
          DemEventDestination = DEM_DTC_ORIGIN_PRIMARY_MEMORY
          DemEventPriority = 1
          DemEventSignificance = DEM_EVENT_SIGNIFICANCE_FAULT
          DemConsiderPtoStatus = false
          DemFFPrestorageSupported = false
          DemAgingCycleRef = Ignition_on_off
          DemEnableConditionGroupRef = EnableConditionGroup_VIPBatteryVoltageAndIgnOn
          DemOperationCycleRef = Ignition_on_off
          DemDebounceAlgorithmClass  # DemDebounceCounterBased
            DemDebounceMonitorInternal
      DTCClass_DTC_0xc07388 (DemDTCClass): DemDTCSeverity=DEM_DTC_SEV_NO_SEVERITY, DemUdsDTC=12612488, DemImmediateNvStorage=false
      DTCClass_DTC_0xa10017 (DemDTCClass): DemDTCSeverity=DEM_DTC_SEV_NO_SEVERITY, DemUdsDTC=10551319, DemImmediateNvStorage=false
      3 x DemEventParameter, all with DemEventKind=DEM_EVENT_KIND_SWC, DemMaxNumberFreezeFrameRecords=1, DemEventLatchTestFailed=false, DemEventTimeSeries=DEM_TIMESERIES_SNAPSHOT_NONE, DemEventAvailable=false, DemEventAvailableInVariant=true, DemEventCreateInfoPort=true, DemExtendedDataClassRef=ExtendedDataClass_4f5344cd, DemFreezeFrameClassRef=FreezeFrameClass_80c88891:
        Ethernet_signal_lines_short_circuit_Circuit_Short_To_Battery: DemEventId=6, DemDTCClassRef=DTCClass_DTC_0xe00c12
          DemEventClass:
            DemAgingAllowed = true
            DemAgingCycleCounterThreshold = 40
            DemEventDestination = DEM_DTC_ORIGIN_PRIMARY_MEMORY
            DemEventPriority = 1
            DemEventSignificance = DEM_EVENT_SIGNIFICANCE_FAULT
            DemConsiderPtoStatus = false
            DemFFPrestorageSupported = false
            DemAgingCycleRef = Ignition_on_off
            DemOperationCycleRef = Ignition_on_off
            DemEnableConditionGroupRef = EnableConditionGroup_VIPBatteryVoltageAndIgnOn
            DemDebounceAlgorithmClass
              DemDebounceMonitorInternal
                DemCallbackGetFDC
        TUNER_FM1_short_to_battary_Circuit_Short_To_Battery: DemEventId=120, DemDTCClassRef=DTCClass_DTC_0x9a1012
          DemEventClass:
            DemAgingAllowed = true
            DemAgingCycleCounterThreshold = 40
            DemEventDestination = DEM_DTC_ORIGIN_PRIMARY_MEMORY
            DemEventPriority = 1
            DemEventSignificance = DEM_EVENT_SIGNIFICANCE_FAULT
            DemConsiderPtoStatus = false
            DemFFPrestorageSupported = false
            DemAgingCycleRef = Ignition_on_off
            DemOperationCycleRef = Ignition_on_off
            DemEnableConditionGroupRef = EnableConditionGroup_VIPBatteryVoltage2AndIgnOn
            DemDebounceAlgorithmClass
              DemDebounceMonitorInternal
                DemCallbackGetFDC
        Speaker_Center_output_waveform_lack_fidelity_Signal_Shape_Waveform_Failure: DemEventId=82, DemDTCClassRef=DTCClass_DTC_0x9a0525
          DemEventClass:
            DemAgingAllowed = true
            DemAgingCycleCounterThreshold = 40
            DemEventDestination = DEM_DTC_ORIGIN_PRIMARY_MEMORY
            DemEventPriority = 1
            DemEventSignificance = DEM_EVENT_SIGNIFICANCE_FAULT
            DemConsiderPtoStatus = false
            DemFFPrestorageSupported = false
            DemAgingCycleRef = Ignition_on_off
            DemEnableConditionGroupRef = EnableConditionGroup_VIPBatteryVoltageAndIgnOn
            DemOperationCycleRef = Ignition_on_off
            DemDebounceAlgorithmClass  # DemDebounceTimeBase
              DemDebounceMonitorInternal
      DTCClass_DTC_0xd00987 (DemDTCClass): DemDTCSeverity=DEM_DTC_SEV_NO_SEVERITY, DemUdsDTC=13633927, DemImmediateNvStorage=false
