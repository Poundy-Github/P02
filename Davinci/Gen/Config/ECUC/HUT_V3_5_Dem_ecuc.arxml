[part 2 of 2: package /ActiveEcuC]
AUTOSAR XML (schema 00046)
package /ActiveEcuC  (continued)
  module config Dem: implementation-config-variant=VARIANT-PRE-COMPILE, module-description=Dem_Impl  (continued)
    DemConfigSet  (continued)
      missing_Right_Rear_Side_Detection_System_Missing_Message (DemEventParameter):
        DemEventKind = DEM_EVENT_KIND_SWC
        DemMaxNumberFreezeFrameRecords = 1
        DemEventLatchTestFailed = false
        DemEventTimeSeries = DEM_TIMESERIES_SNAPSHOT_NONE
        DemEventAvailable = false
        DemEventId = 131
        DemEventAvailableInVariant = true
        DemEventCreateInfoPort = true
        DemDTCClassRef = DTCClass_DTC_0xc23387
        DemExtendedDataClassRef = ExtendedDataClass_4f5344cd
        DemFreezeFrameClassRef = FreezeFrameClass_80c88891
        DemEventClass:
          DemAgingAllowed = true
          DemAgingCycleCounterThreshold = 40
          DemEventDestination = DEM_DTC_ORIGIN_PRIMARY_MEMORY
          DemEventPriority = 1
          DemEventSignificance = DEM_EVENT_SIGNIFICANCE_FAULT
          DemEventFailureCycleCounterThreshold = 0
          DemConsiderPtoStatus = false
          DemFFPrestorageSupported = false
          DemAgingCycleRef = Ignition_on_off
          DemEnableConditionGroupRef = EnableConditionGroup_VIPBatteryVoltageAndIgnOn
          DemOperationCycleRef = Ignition_on_off
          DemDebounceAlgorithmClass  # DemDebounceCounterBased
            DemDebounceMonitorInternal
      DTCClass_DTC_0x9a011e (DemDTCClass): DemDTCSeverity=DEM_DTC_SEV_NO_SEVERITY, DemUdsDTC=10092830, DemImmediateNvStorage=false
      Missing_Elec_Region_Control_System_Body_Missing_Message (DemEventParameter):
        DemEventKind = DEM_EVENT_KIND_SWC
        DemMaxNumberFreezeFrameRecords = 1
        DemEventLatchTestFailed = false
        DemEventTimeSeries = DEM_TIMESERIES_SNAPSHOT_NONE
        DemEventAvailable = false
        DemEventId = 62
        DemEventAvailableInVariant = true
        DemEventCreateInfoPort = true
        DemDTCClassRef = DTCClass_DTC_0xc14087
        DemExtendedDataClassRef = ExtendedDataClass_4f5344cd
        DemFreezeFrameClassRef = FreezeFrameClass_80c88891
        DemEventClass:
          DemAgingAllowed = true
          DemAgingCycleCounterThreshold = 40
          DemEventDestination = DEM_DTC_ORIGIN_PRIMARY_MEMORY
          DemEventPriority = 1
          DemEventSignificance = DEM_EVENT_SIGNIFICANCE_FAULT
          DemEventFailureCycleCounterThreshold = 0
          DemConsiderPtoStatus = false
          DemFFPrestorageSupported = false
          DemAgingCycleRef = Ignition_on_off
          DemEnableConditionGroupRef = EnableConditionGroup_VIPBatteryVoltageAndIgnOn
          DemOperationCycleRef = Ignition_on_off
          DemDebounceAlgorithmClass  # DemDebounceCounterBased
            DemDebounceMonitorInternal
      DTCClass_DTC_0xd01046 (DemDTCClass): DemDTCSeverity=DEM_DTC_SEV_NO_SEVERITY, DemUdsDTC=13635654, DemImmediateNvStorage=false
      DTCClass_DTC_0xa10149 (DemDTCClass): DemDTCSeverity=DEM_DTC_SEV_NO_SEVERITY, DemUdsDTC=10551625, DemImmediateNvStorage=false
      5 x DemEventParameter, all with DemEventKind=DEM_EVENT_KIND_SWC, DemMaxNumberFreezeFrameRecords=1, DemEventLatchTestFailed=false, DemEventTimeSeries=DEM_TIMESERIES_SNAPSHOT_NONE, DemEventAvailable=false, DemEventAvailableInVariant=true, DemEventCreateInfoPort=true, DemExtendedDataClassRef=ExtendedDataClass_4f5344cd, DemFreezeFrameClassRef=FreezeFrameClass_80c88891:
        Speaker_FR_output_waveform_lack_fidelity_Signal_Shape_Waveform_Failure: DemEventId=94, DemDTCClassRef=DTCClass_DTC_0x9a0225
          DemEventClass:
            DemAgingAllowed = true
            DemAgingCycleCounterThreshold = 40
            DemEventDestination = DEM_DTC_ORIGIN_PRIMARY_MEMORY
            DemEventPriority = 1
            DemEventSignificance = DEM_EVENT_SIGNIFICANCE_FAULT
            DemConsiderPtoStatus = false
            DemFFPrestorageSupported = false
            DemAgingCycleRef = Ignition_on_off
            DemEnableConditionGroupRef = EnableConditionGroup_VIPBatteryVoltageAndIgnOn
            DemOperationCycleRef = Ignition_on_off
            DemDebounceAlgorithmClass  # DemDebounceTimeBase
              DemDebounceMonitorInternal
        Missing_Electrical_Stable_Program_Antilock_Brake_System_Missing_Message: DemEventId=64, DemDTCClassRef=DTCClass_DTC_0xc12287
          DemEventClass:
            DemAgingAllowed = true
            DemAgingCycleCounterThreshold = 40
            DemEventDestination = DEM_DTC_ORIGIN_PRIMARY_MEMORY
            DemEventPriority = 1
            DemEventSignificance = DEM_EVENT_SIGNIFICANCE_FAULT
            DemEventFailureCycleCounterThreshold = 0
            DemConsiderPtoStatus = false
            DemFFPrestorageSupported = false
            DemAgingCycleRef = Ignition_on_off
            DemEnableConditionGroupRef = EnableConditionGroup_VIPBatteryVoltageAndIgnOn
            DemOperationCycleRef = Ignition_on_off
            DemDebounceAlgorithmClass  # DemDebounceCounterBased
              DemDebounceMonitorInternal
        Speaker_Center_short_to_ground_Circuit_Short_To_Ground: DemEventId=86, DemDTCClassRef=DTCClass_DTC_0x9a0511
          DemEventClass:
            DemAgingAllowed = true
            DemAgingCycleCounterThreshold = 40
            DemEventDestination = DEM_DTC_ORIGIN_PRIMARY_MEMORY
            DemEventPriority = 1
            DemEventSignificance = DEM_EVENT_SIGNIFICANCE_FAULT
            DemConsiderPtoStatus = false
            DemFFPrestorageSupported = false
            DemAgingCycleRef = Ignition_on_off
            DemEnableConditionGroupRef = EnableConditionGroup_VIPBatteryVoltageAndIgnOn
            DemOperationCycleRef = Ignition_on_off
            DemDebounceAlgorithmClass  # DemDebounceTimeBase
              DemDebounceMonitorInternal
        missing_Tyre_Pressure_Monitoring_Systems_Missing_Message: DemEventId=134, DemDTCClassRef=DTCClass_DTC_0xc12787
          DemEventClass:
            DemAgingAllowed = true
            DemAgingCycleCounterThreshold = 40
            DemEventDestination = DEM_DTC_ORIGIN_PRIMARY_MEMORY
            DemEventPriority = 1
            DemEventSignificance = DEM_EVENT_SIGNIFICANCE_FAULT
            DemEventFailureCycleCounterThreshold = 0
            DemConsiderPtoStatus = false
            DemFFPrestorageSupported = false
            DemAgingCycleRef = Ignition_on_off
            DemEnableConditionGroupRef = EnableConditionGroup_VIPBatteryVoltageAndIgnOn
            DemOperationCycleRef = Ignition_on_off
            DemDebounceAlgorithmClass  # DemDebounceCounterBased
              DemDebounceMonitorInternal
        Speaker_Woofer_output_waveform_lack_fidelity_Signal_Shape_Waveform_Failure: DemEventId=112, DemDTCClassRef=DTCClass_DTC_0x9a0625
          DemEventClass:
            DemAgingAllowed = true
            DemAgingCycleCounterThreshold = 40
            DemEventDestination = DEM_DTC_ORIGIN_PRIMARY_MEMORY
            DemEventPriority = 1
            DemEventSignificance = DEM_EVENT_SIGNIFICANCE_FAULT
            DemConsiderPtoStatus = false
            DemFFPrestorageSupported = false
            DemAgingCycleRef = Ignition_on_off
            DemEnableConditionGroupRef = EnableConditionGroup_VIPBatteryVoltageAndIgnOn
            DemOperationCycleRef = Ignition_on_off
            DemDebounceAlgorithmClass  # DemDebounceTimeBase
              DemDebounceMonitorInternal
      DTCClass_DTC_0x9a1019 (DemDTCClass): DemDTCSeverity=DEM_DTC_SEV_NO_SEVERITY, DemUdsDTC=10096665, DemImmediateNvStorage=false
      DTCClass_DTC_0x9a0601 (DemDTCClass): DemDTCSeverity=DEM_DTC_SEV_NO_SEVERITY, DemUdsDTC=10094081, DemImmediateNvStorage=false
      Missing_AC_Air_Condition_Rear_Front_Control_panel_Missing_Message (DemEventParameter):
        DemEventKind = DEM_EVENT_KIND_SWC
        DemMaxNumberFreezeFrameRecords = 1
        DemEventLatchTestFailed = false
        DemEventTimeSeries = DEM_TIMESERIES_SNAPSHOT_NONE
        DemEventAvailable = false
        DemEventId = 55
        DemEventAvailableInVariant = true
        DemEventCreateInfoPort = true
        DemDTCClassRef = DTCClass_DTC_0xc16487
        DemExtendedDataClassRef = ExtendedDataClass_4f5344cd
        DemFreezeFrameClassRef = FreezeFrameClass_80c88891
        DemEventClass:
          DemAgingAllowed = true
          DemAgingCycleCounterThreshold = 40
          DemEventDestination = DEM_DTC_ORIGIN_PRIMARY_MEMORY
          DemEventPriority = 1
          DemEventSignificance = DEM_EVENT_SIGNIFICANCE_FAULT
          DemEventFailureCycleCounterThreshold = 0
          DemConsiderPtoStatus = false
          DemFFPrestorageSupported = false
          DemAgingCycleRef = Ignition_on_off
          DemEnableConditionGroupRef = EnableConditionGroup_VIPBatteryVoltageAndIgnOn
          DemOperationCycleRef = Ignition_on_off
          DemDebounceAlgorithmClass  # DemDebounceCounterBased
            DemDebounceMonitorInternal
      4 x DemDTCClass, all with DemDTCSeverity=DEM_DTC_SEV_NO_SEVERITY, DemImmediateNvStorage=false:
        DTCClass_DTC_0x9a1013: DemUdsDTC=10096659
        DTCClass_DTC_0x9a1011: DemUdsDTC=10096657
        DTCClass_DTC_0x9a1012: DemUdsDTC=10096658
        DTCClass_DTC_0xc24387: DemUdsDTC=12731271
      missing_Telematics_control_Box_Missing_Message (DemEventParameter):
        DemEventKind = DEM_EVENT_KIND_SWC
        DemMaxNumberFreezeFrameRecords = 1
        DemEventLatchTestFailed = false
        DemEventTimeSeries = DEM_TIMESERIES_SNAPSHOT_NONE
        DemEventAvailable = false
        DemEventId = 132
        DemEventAvailableInVariant = true
        DemEventCreateInfoPort = true
        DemDTCClassRef = DTCClass_DTC_0xc19887
        DemExtendedDataClassRef = ExtendedDataClass_4f5344cd
        DemFreezeFrameClassRef = FreezeFrameClass_80c88891
        DemEventClass:
          DemAgingAllowed = true
          DemAgingCycleCounterThreshold = 40
          DemEventDestination = DEM_DTC_ORIGIN_PRIMARY_MEMORY
          DemEventPriority = 1
          DemEventSignificance = DEM_EVENT_SIGNIFICANCE_FAULT
          DemEventFailureCycleCounterThreshold = 0
          DemConsiderPtoStatus = false
          DemFFPrestorageSupported = false
          DemAgingCycleRef = Ignition_on_off
          DemEnableConditionGroupRef = EnableConditionGroup_VIPBatteryVoltageAndIgnOn
          DemOperationCycleRef = Ignition_on_off
          DemDebounceAlgorithmClass  # DemDebounceCounterBased
            DemDebounceMonitorInternal
      DTCClass_DTC_0xa10116 (DemDTCClass): DemDTCSeverity=DEM_DTC_SEV_NO_SEVERITY, DemUdsDTC=10551574, DemImmediateNvStorage=false
      ControlModuleCANBus_off_Bus_off (DemEventParameter):
        DemEventKind = DEM_EVENT_KIND_SWC
        DemMaxNumberFreezeFrameRecords = 1
        DemEventLatchTestFailed = false
        DemEventTimeSeries = DEM_TIMESERIES_SNAPSHOT_NONE
        DemEventAvailable = false
        DemEventId = 4
        DemEventAvailableInVariant = true
        DemEventCreateInfoPort = true
        DemDTCClassRef = DTCClass_DTC_0xc07388
        DemExtendedDataClassRef = ExtendedDataClass_4f5344cd
        DemFreezeFrameClassRef = FreezeFrameClass_80c88891
        DemEventClass:
          DemAgingAllowed = true
          DemAgingCycleCounterThreshold = 40
          DemEventDestination = DEM_DTC_ORIGIN_PRIMARY_MEMORY
          DemEventPriority = 1
          DemEventSignificance = DEM_EVENT_SIGNIFICANCE_FAULT
          DemConsiderPtoStatus = false
          DemFFPrestorageSupported = false
          DemAgingCycleRef = Ignition_on_off
          DemEnableConditionGroupRef = EnableConditionGroup_VIPBatteryVoltageAndIgnOn
          DemOperationCycleRef = Ignition_on_off
          DemDebounceAlgorithmClass
            DemDebounceMonitorInternal
              DemCallbackGetFDC
      DTCClass_DTC_0xc12287 (DemDTCClass): DemDTCSeverity=DEM_DTC_SEV_NO_SEVERITY, DemUdsDTC=12657287, DemImmediateNvStorage=false
      4 x DemEventParameter, all with DemEventKind=DEM_EVENT_KIND_SWC, DemMaxNumberFreezeFrameRecords=1, DemEventLatchTestFailed=false, DemEventTimeSeries=DEM_TIMESERIES_SNAPSHOT_NONE, DemEventAvailable=false, DemEventAvailableInVariant=true, DemEventCreateInfoPort=true, DemExtendedDataClassRef=ExtendedDataClass_4f5344cd, DemFreezeFrameClassRef=FreezeFrameClass_80c88891:
        Speaker_RR_resistance_out_of_range_Circuit_Resistance_Out_of_Range: DemEventId=107, DemDTCClassRef=DTCClass_DTC_0x9a041e
          DemEventClass:
            DemAgingAllowed = true
            DemAgingCycleCounterThreshold = 40
            DemEventDestination = DEM_DTC_ORIGIN_PRIMARY_MEMORY
            DemEventPriority = 1
            DemEventSignificance = DEM_EVENT_SIGNIFICANCE_FAULT
            DemConsiderPtoStatus = false
            DemFFPrestorageSupported = false
            DemAgingCycleRef = Ignition_on_off
            DemEnableConditionGroupRef = EnableConditionGroup_BatteryVoltage
            DemOperationCycleRef = Ignition_on_off
            DemDebounceAlgorithmClass  # DemDebounceTimeBase
              DemDebounceMonitorInternal
        Missing_Driver_Door_Control_Module_Missing_Message: DemEventId=61, DemDTCClassRef=DTCClass_DTC_0xc19987
          DemEventClass:
            DemAgingAllowed = true
            DemAgingCycleCounterThreshold = 40
            DemEventDestination = DEM_DTC_ORIGIN_PRIMARY_MEMORY
            DemEventPriority = 1
            DemEventSignificance = DEM_EVENT_SIGNIFICANCE_FAULT
            DemEventFailureCycleCounterThreshold = 0
            DemConsiderPtoStatus = false
            DemFFPrestorageSupported = false
            DemAgingCycleRef = Ignition_on_off
            DemEnableConditionGroupRef = EnableConditionGroup_VIPBatteryVoltageAndIgnOn
            DemOperationCycleRef = Ignition_on_off
            DemDebounceAlgorithmClass  # DemDebounceCounterBased
              DemDebounceMonitorInternal
        A2B_short_to_battery_Circuit_Short_To_Battery: DemEventId=2, DemDTCClassRef=DTCClass_DTC_0x95f812
          DemEventClass:
            DemAgingAllowed = true
            DemAgingCycleCounterThreshold = 40
            DemEventDestination = DEM_DTC_ORIGIN_PRIMARY_MEMORY
            DemEventPriority = 1
            DemEventSignificance = DEM_EVENT_SIGNIFICANCE_FAULT
            DemConsiderPtoStatus = false
            DemFFPrestorageSupported = false
            DemAgingCycleRef = Ignition_on_off
            DemOperationCycleRef = Ignition_on_off
            DemEnableConditionGroupRef = EnableConditionGroup_VIPBatteryVoltageAndIgnOn
            DemDebounceAlgorithmClass
              DemDebounceMonitorInternal
                DemCallbackGetFDC
        Lost_communication_with_IVI_Display_Front_Missing_Message: DemEventId=41, DemDTCClassRef=DTCClass_DTC_0x908e87
          DemEventClass:
            DemAgingAllowed = true
            DemAgingCycleCounterThreshold = 40
            DemEventDestination = DEM_DTC_ORIGIN_PRIMARY_MEMORY
            DemEventPriority = 1
            DemEventSignificance = DEM_EVENT_SIGNIFICANCE_FAULT
            DemConsiderPtoStatus = false
            DemFFPrestorageSupported = false
            DemAgingCycleRef = Ignition_on_off
            DemOperationCycleRef = Ignition_on_off
            DemEnableConditionGroupRef = EnableConditionGroup_IgnOn
            DemDebounceAlgorithmClass
              DemDebounceMonitorInternal
                DemCallbackGetFDC
      3 x DemDTCClass, all with DemDTCSeverity=DEM_DTC_SEV_NO_SEVERITY, DemImmediateNvStorage=false:
        DTCClass_DTC_0xe01113: DemUdsDTC=14684435
        DTCClass_DTC_0xd10887: DemUdsDTC=13699207
        DTCClass_DTC_0xa10249: DemUdsDTC=10551881
      14 x DemEventParameter, all with DemEventTimeSeries=DEM_TIMESERIES_SNAPSHOT_NONE, DemEventAvailable=false, DemEventKind=DEM_EVENT_KIND_BSW, DemEventAvailableInVariant=true, DemEventLatchTestFailed=false, DemEventCreateInfoPort=true:
        AutoCreatedDemEvent_McuDemEventParameterRefs_MCU_E_WRITE_TIMEOUT_FAILURE: DemEventId=135
          DemEventClass:
            DemAgingAllowed = false
            DemConsiderPtoStatus = false
            DemEventDestination = DEM_DTC_ORIGIN_PRIMARY_MEMORY
            DemEventPriority = 2
            DemFFPrestorageSupported = false
            DemOperationCycleRef = Ignition_on_off
            DemDebounceAlgorithmClass
              DemDebounceMonitorInternal
        AutoCreatedDemEvent_McuDemEventParameterRefs_MCU_E_REG_WRITE_VERIFY: DemEventId=136
          DemEventClass:
            DemAgingAllowed = false
            DemConsiderPtoStatus = false
            DemEventDestination = DEM_DTC_ORIGIN_PRIMARY_MEMORY
            DemEventPriority = 2
            DemFFPrestorageSupported = false
            DemOperationCycleRef = Ignition_on_off
            DemDebounceAlgorithmClass
              DemDebounceMonitorInternal
        AutoCreatedDemEvent_McuDemEventParameterRefs_MCU_E_LVI_FAILURE: DemEventId=137
          DemEventClass:
            DemAgingAllowed = false
            DemConsiderPtoStatus = false
            DemEventDestination = DEM_DTC_ORIGIN_PRIMARY_MEMORY
            DemEventPriority = 2
            DemFFPrestorageSupported = false
            DemOperationCycleRef = Ignition_on_off
            DemDebounceAlgorithmClass
              DemDebounceMonitorInternal
        AutoCreatedDemEvent_McuDemEventParameterRefs_MCU_E_INCONCISTENCY_RESF_FAILURE: DemEventId=138
          DemEventClass:
            DemAgingAllowed = false
            DemConsiderPtoStatus = false
            DemEventDestination = DEM_DTC_ORIGIN_PRIMARY_MEMORY
            DemEventPriority = 2
            DemFFPrestorageSupported = false
            DemOperationCycleRef = Ignition_on_off
            DemDebounceAlgorithmClass
              DemDebounceMonitorInternal
        AutoCreatedDemEvent_McuDemEventParameterRefs_MCU_E_CVM_SETTING_FAILURE: DemEventId=139
          DemEventClass:
            DemAgingAllowed = false
            DemConsiderPtoStatus = false
            DemEventDestination = DEM_DTC_ORIGIN_PRIMARY_MEMORY
            DemEventPriority = 2
            DemFFPrestorageSupported = false
            DemOperationCycleRef = Ignition_on_off
            DemDebounceAlgorithmClass
              DemDebounceMonitorInternal
        AutoCreatedDemEvent_McuDemEventParameterRefs_MCU_E_CLOCK_FAILURE: DemEventId=140
          DemEventClass:
            DemAgingAllowed = false
            DemConsiderPtoStatus = false
            DemEventDestination = DEM_DTC_ORIGIN_PRIMARY_MEMORY
            DemEventPriority = 2
            DemFFPrestorageSupported = false
            DemOperationCycleRef = Ignition_on_off
            DemDebounceAlgorithmClass
              DemDebounceMonitorInternal
        AutoCreatedDemEvent_PortDemEventParameterRefs_PORT_E_WRITE_TIMEOUT_FAILURE: DemEventId=141
          DemEventClass:
            DemAgingAllowed = false
            DemConsiderPtoStatus = false
            DemEventDestination = DEM_DTC_ORIGIN_PRIMARY_MEMORY
            DemEventPriority = 2
            DemFFPrestorageSupported = false
            DemOperationCycleRef = Ignition_on_off
            DemDebounceAlgorithmClass
              DemDebounceMonitorInternal
        AutoCreatedDemEvent_PwmDemEventParameterRefs_PWM_E_TIMER_FAILURE: DemEventId=142
          DemEventClass:
            DemAgingAllowed = false
            DemConsiderPtoStatus = false
            DemEventDestination = DEM_DTC_ORIGIN_PRIMARY_MEMORY
            DemEventPriority = 2
            DemFFPrestorageSupported = false
            DemOperationCycleRef = Ignition_on_off
            DemDebounceAlgorithmClass
              DemDebounceMonitorInternal
        AutoCreatedDemEvent_PwmDemEventParameterRefs_PWM_E_TIMEOUT_FAILURE: DemEventId=146
          DemEventClass:
            DemAgingAllowed = false
            DemConsiderPtoStatus = false
            DemEventDestination = DEM_DTC_ORIGIN_PRIMARY_MEMORY
            DemEventPriority = 2
            DemFFPrestorageSupported = false
            DemOperationCycleRef = Ignition_on_off
            DemDebounceAlgorithmClass
              DemDebounceMonitorInternal
        AutoCreatedDemEvent_PwmDemEventParameterRefs_PWM_E_REWRITE_FAILED: DemEventId=145
          DemEventClass:
            DemAgingAllowed = false
            DemConsiderPtoStatus = false
            DemEventDestination = DEM_DTC_ORIGIN_PRIMARY_MEMORY
            DemEventPriority = 2
            DemFFPrestorageSupported = false
            DemOperationCycleRef = Ignition_on_off
            DemDebounceAlgorithmClass
              DemDebounceMonitorInternal
        AutoCreatedDemEvent_PwmDemEventParameterRefs_PWM_E_REG_WRITE_VERIFY: DemEventId=144
          DemEventClass:
            DemAgingAllowed = false
            DemConsiderPtoStatus = false
            DemEventDestination = DEM_DTC_ORIGIN_PRIMARY_MEMORY
            DemEventPriority = 2
            DemFFPrestorageSupported = false
            DemOperationCycleRef = Ignition_on_off
            DemDebounceAlgorithmClass
              DemDebounceMonitorInternal
        AutoCreatedDemEvent_PwmDemEventParameterRefs_PWM_E_DIAG_FAILURE: DemEventId=143
          DemEventClass:
            DemAgingAllowed = false
            DemConsiderPtoStatus = false
            DemEventDestination = DEM_DTC_ORIGIN_PRIMARY_MEMORY
            DemEventPriority = 2
            DemFFPrestorageSupported = false
            DemOperationCycleRef = Ignition_on_off
            DemDebounceAlgorithmClass
              DemDebounceMonitorInternal
        AutoCreatedDemEvent_GptDemEventParameterRefs_GPT_E_TIMEOUT_FAILURE: DemEventId=157
          DemEventClass:
            DemAgingAllowed = false
            DemConsiderPtoStatus = false
            DemEventDestination = DEM_DTC_ORIGIN_PRIMARY_MEMORY
            DemEventPriority = 2
            DemFFPrestorageSupported = false
            DemOperationCycleRef = Ignition_on_off
            DemDebounceAlgorithmClass
              DemDebounceMonitorInternal
        AutoCreatedDemEvent_GptDemEventParameterRefs_GPT_E_REG_WRITE_VERIFY: DemEventId=147
          DemEventClass:
            DemAgingAllowed = false
            DemConsiderPtoStatus = false
            DemEventDestination = DEM_DTC_ORIGIN_PRIMARY_MEMORY
            DemEventPriority = 2
            DemFFPrestorageSupported = false
            DemOperationCycleRef = Ignition_on_off
            DemDebounceAlgorithmClass
              DemDebounceMonitorInternal
      DTCClass_DTC_0xea0040 (DemDTCClass): DemDTCSeverity=DEM_DTC_SEV_NO_SEVERITY, DemUdsDTC=15335488, DemImmediateNvStorage=false
      DTCClass_DTC_0xc12887 (DemDTCClass): DemDTCSeverity=DEM_DTC_SEV_NO_SEVERITY, DemUdsDTC=12658823, DemImmediateNvStorage=false
      Missing_Electric_Park_Brake_controller (DemEventParameter):
        DemEventKind = DEM_EVENT_KIND_SWC
        DemMaxNumberFreezeFrameRecords = 1
        DemEventTimeSeries = DEM_TIMESERIES_SNAPSHOT_NONE
        DemEventAvailable = false
        DemEventId = 158
        DemEventAvailableInVariant = true
        DemEventLatchTestFailed = false
        DemEventCreateInfoPort = true
        DemDTCClassRef = DTCClass_DTC_0xc12887
        DemExtendedDataClassRef = ExtendedDataClass_4f5344cd
        DemFreezeFrameClassRef = FreezeFrameClass_80c88891
        DemEventClass:
          DemAgingAllowed = true
          DemAgingCycleCounterThreshold = 40
          DemEventDestination = DEM_DTC_ORIGIN_PRIMARY_MEMORY
          DemEventPriority = 1
          DemEventSignificance = DEM_EVENT_SIGNIFICANCE_FAULT
          DemEventFailureCycleCounterThreshold = 0
          DemConsiderPtoStatus = false
          DemFFPrestorageSupported = false
          DemAgingCycleRef = Ignition_on_off
          DemEnableConditionGroupRef = EnableConditionGroup_VIPBatteryVoltageAndIgnOn
          DemOperationCycleRef = Ignition_on_off
          DemDebounceAlgorithmClass  # DemDebounceCounterBased
            DemDebounceMonitorInternal
      14 x DemDTCClass, all with DemDTCSeverity=DEM_DTC_SEV_NO_SEVERITY, DemImmediateNvStorage=false:
        DTCClass_DTC_0x908487: DemUdsDTC=9471111
        DTCClass_DTC_0x908587: DemUdsDTC=9471367
        DTCClass_DTC_0x908687: DemUdsDTC=9471623
        DTCClass_DTC_0x908787: DemUdsDTC=9471879
        DTCClass_DTC_0x908887: DemUdsDTC=9472135
        DTCClass_DTC_0xa30017: DemUdsDTC=10682391
        DTCClass_DTC_0xa30008: DemUdsDTC=10682376
        DTCClass_DTC_0xa30116: DemUdsDTC=10682646
        DTCClass_DTC_0xa30149: DemUdsDTC=10682697
        DTCClass_DTC_0xa30249: DemUdsDTC=10682953
        DTCClass_DTC_0xa30349: DemUdsDTC=10683209
        DTCClass_DTC_0xa30449: DemUdsDTC=10683465
        DTCClass_DTC_0xa30549: DemUdsDTC=10683721
        DTCClass_DTC_0xa30649: DemUdsDTC=10683977
      14 x DemEventParameter, all with DemEventKind=DEM_EVENT_KIND_SWC, DemMaxNumberFreezeFrameRecords=1, DemEventLatchTestFailed=false, DemEventTimeSeries=DEM_TIMESERIES_SNAPSHOT_NONE, DemEventAvailable=false, DemEventAvailableInVariant=true, DemEventCreateInfoPort=true, DemExtendedDataClassRef=ExtendedDataClass_4f5344cd, DemFreezeFrameClassRef=FreezeFrameClass_80c88891:
        Lost_communication_with_ConsoleDisplay: DemEventId=43, DemDTCClassRef=DTCClass_DTC_0x908887
          DemEventClass:
            DemAgingAllowed = true
            DemAgingCycleCounterThreshold = 40
            DemEventDestination = DEM_DTC_ORIGIN_PRIMARY_MEMORY
            DemEventPriority = 1
            DemEventSignificance = DEM_EVENT_SIGNIFICANCE_FAULT
            DemConsiderPtoStatus = false
            DemFFPrestorageSupported = false
            DemAgingCycleRef = Ignition_on_off
            DemOperationCycleRef = Ignition_on_off
            DemEnableConditionGroupRef = EnableConditionGroup_IgnOn
            DemDebounceAlgorithmClass
              DemDebounceMonitorInternal
                DemCallbackGetFDC
        Lost_communication_with_DMS: DemEventId=47, DemDTCClassRef=DTCClass_DTC_0x908687
          DemEventClass:
            DemAgingAllowed = true
            DemAgingCycleCounterThreshold = 40
            DemEventDestination = DEM_DTC_ORIGIN_PRIMARY_MEMORY
            DemEventPriority = 1
            DemEventSignificance = DEM_EVENT_SIGNIFICANCE_FAULT
            DemConsiderPtoStatus = false
            DemFFPrestorageSupported = false
            DemAgingCycleRef = Ignition_on_off
            DemOperationCycleRef = Ignition_on_off
            DemEnableConditionGroupRef = EnableConditionGroup_IgnOn
            DemDebounceAlgorithmClass
              DemDebounceMonitorInternal
                DemCallbackGetFDC
        Lost_communication_with_DVR: DemEventId=49, DemDTCClassRef=DTCClass_DTC_0x908587
          DemEventClass:
            DemAgingAllowed = true
            DemAgingCycleCounterThreshold = 40
            DemEventDestination = DEM_DTC_ORIGIN_PRIMARY_MEMORY
            DemEventPriority = 1
            DemEventSignificance = DEM_EVENT_SIGNIFICANCE_FAULT
            DemConsiderPtoStatus = false
            DemFFPrestorageSupported = false
            DemAgingCycleRef = Ignition_on_off
            DemOperationCycleRef = Ignition_on_off
            DemEnableConditionGroupRef = EnableConditionGroup_IgnOn
            DemDebounceAlgorithmClass
              DemDebounceMonitorInternal
                DemCallbackGetFDC
        Lost_communication_with_InCarCamera: DemEventId=42, DemDTCClassRef=DTCClass_DTC_0x908487
          DemEventClass:
            DemAgingAllowed = true
            DemAgingCycleCounterThreshold = 40
            DemEventDestination = DEM_DTC_ORIGIN_PRIMARY_MEMORY
            DemEventPriority = 1
            DemEventSignificance = DEM_EVENT_SIGNIFICANCE_FAULT
            DemConsiderPtoStatus = false
            DemFFPrestorageSupported = false
            DemAgingCycleRef = Ignition_on_off
            DemOperationCycleRef = Ignition_on_off
            DemEnableConditionGroupRef = EnableConditionGroup_IgnOn
            DemDebounceAlgorithmClass
              DemDebounceMonitorInternal
                DemCallbackGetFDC
        Lost_communication_with_PassengerDisplay: DemEventId=45, DemDTCClassRef=DTCClass_DTC_0x908787
          DemEventClass:
            DemAgingAllowed = true
            DemAgingCycleCounterThreshold = 40
            DemEventDestination = DEM_DTC_ORIGIN_PRIMARY_MEMORY
            DemEventPriority = 1
            DemEventSignificance = DEM_EVENT_SIGNIFICANCE_FAULT
            DemConsiderPtoStatus = false
            DemFFPrestorageSupported = false
            DemAgingCycleRef = Ignition_on_off
            DemOperationCycleRef = Ignition_on_off
            DemEnableConditionGroupRef = EnableConditionGroup_IgnOn
            DemDebounceAlgorithmClass
              DemDebounceMonitorInternal
                DemCallbackGetFDC
        HVAC_Display_OverVoltage: DemEventId=23, DemDTCClassRef=DTCClass_DTC_0xa30017
          DemEventClass:
            DemAgingAllowed = true
            DemAgingCycleCounterThreshold = 40
            DemEventDestination = DEM_DTC_ORIGIN_PRIMARY_MEMORY
            DemEventPriority = 2
            DemEventSignificance = DEM_EVENT_SIGNIFICANCE_FAULT
            DemConsiderPtoStatus = false
            DemFFPrestorageSupported = false
            DemAgingCycleRef = Ignition_on_off
            DemOperationCycleRef = Ignition_on_off
            DemDebounceAlgorithmClass
              DemDebounceMonitorInternal
                DemCallbackGetFDC
        HVAC_Display_LowVoltage: DemEventId=24, DemDTCClassRef=DTCClass_DTC_0xa30116
          DemEventClass:
            DemAgingAllowed = true
            DemAgingCycleCounterThreshold = 40
            DemEventDestination = DEM_DTC_ORIGIN_PRIMARY_MEMORY
            DemEventPriority = 2
            DemEventSignificance = DEM_EVENT_SIGNIFICANCE_FAULT
            DemConsiderPtoStatus = false
            DemFFPrestorageSupported = false
            DemAgingCycleRef = Ignition_on_off
            DemOperationCycleRef = Ignition_on_off
            DemDebounceAlgorithmClass
              DemDebounceMonitorInternal
                DemCallbackGetFDC
        HVAC_Display_NotReceiveBacklightValue: DemEventId=25, DemDTCClassRef=DTCClass_DTC_0xa30008
          DemEventClass:
            DemAgingAllowed = true
            DemAgingCycleCounterThreshold = 40
            DemEventDestination = DEM_DTC_ORIGIN_PRIMARY_MEMORY
            DemEventPriority = 2
            DemEventSignificance = DEM_EVENT_SIGNIFICANCE_FAULT
            DemConsiderPtoStatus = false
            DemFFPrestorageSupported = false
            DemAgingCycleRef = Ignition_on_off
            DemOperationCycleRef = Ignition_on_off
            DemDebounceAlgorithmClass
              DemDebounceMonitorInternal
                DemCallbackGetFDC
        HVAC_Display_BacklightModuleError: DemEventId=26, DemDTCClassRef=DTCClass_DTC_0xa30149
          DemEventClass:
            DemAgingAllowed = true
            DemAgingCycleCounterThreshold = 40
            DemEventDestination = DEM_DTC_ORIGIN_PRIMARY_MEMORY
            DemEventPriority = 2
            DemEventSignificance = DEM_EVENT_SIGNIFICANCE_FAULT
            DemConsiderPtoStatus = false
            DemFFPrestorageSupported = false
            DemAgingCycleRef = Ignition_on_off
            DemOperationCycleRef = Ignition_on_off
            DemDebounceAlgorithmClass
              DemDebounceMonitorInternal
                DemCallbackGetFDC
        HVAC_Display_TFT_Failure: DemEventId=27, DemDTCClassRef=DTCClass_DTC_0xa30249
          DemEventClass:
            DemAgingAllowed = true
            DemAgingCycleCounterThreshold = 40
            DemEventDestination = DEM_DTC_ORIGIN_PRIMARY_MEMORY
            DemEventPriority = 2
            DemEventSignificance = DEM_EVENT_SIGNIFICANCE_FAULT
            DemConsiderPtoStatus = false
            DemFFPrestorageSupported = false
            DemAgingCycleRef = Ignition_on_off
            DemOperationCycleRef = Ignition_on_off
            DemDebounceAlgorithmClass
              DemDebounceMonitorInternal
                DemCallbackGetFDC
        HVAC_Display_VideoSignalConnectFailure: DemEventId=28, DemDTCClassRef=DTCClass_DTC_0xa30349
          DemEventClass:
            DemAgingAllowed = true
            DemAgingCycleCounterThreshold = 40
            DemEventDestination = DEM_DTC_ORIGIN_PRIMARY_MEMORY
            DemEventPriority = 2
            DemEventSignificance = DEM_EVENT_SIGNIFICANCE_FAULT
            DemConsiderPtoStatus = false
            DemFFPrestorageSupported = false
            DemAgingCycleRef = Ignition_on_off
            DemOperationCycleRef = Ignition_on_off
            DemDebounceAlgorithmClass
              DemDebounceMonitorInternal
                DemCallbackGetFDC
        HVAC_Display_TouchPanelFailure: DemEventId=29, DemDTCClassRef=DTCClass_DTC_0xa30449
          DemEventClass:
            DemAgingAllowed = true
            DemAgingCycleCounterThreshold = 40
            DemEventDestination = DEM_DTC_ORIGIN_PRIMARY_MEMORY
            DemEventPriority = 2
            DemEventSignificance = DEM_EVENT_SIGNIFICANCE_FAULT
            DemConsiderPtoStatus = false
            DemFFPrestorageSupported = false
            DemAgingCycleRef = Ignition_on_off
            DemOperationCycleRef = Ignition_on_off
            DemDebounceAlgorithmClass
              DemDebounceMonitorInternal
                DemCallbackGetFDC
        HVAC_Display_VibratorFailure: DemEventId=30, DemDTCClassRef=DTCClass_DTC_0xa30549
          DemEventClass:
            DemAgingAllowed = true
            DemAgingCycleCounterThreshold = 40
            DemEventDestination = DEM_DTC_ORIGIN_PRIMARY_MEMORY
            DemEventPriority = 2
            DemEventSignificance = DEM_EVENT_SIGNIFICANCE_FAULT
            DemConsiderPtoStatus = false
            DemFFPrestorageSupported = false
            DemAgingCycleRef = Ignition_on_off
            DemOperationCycleRef = Ignition_on_off
            DemDebounceAlgorithmClass
              DemDebounceMonitorInternal
                DemCallbackGetFDC
        HVAC_Display_ForceInductionFailure: DemEventId=31, DemDTCClassRef=DTCClass_DTC_0xa30649
          DemEventClass:
            DemAgingAllowed = true
            DemAgingCycleCounterThreshold = 40
            DemEventDestination = DEM_DTC_ORIGIN_PRIMARY_MEMORY
            DemEventPriority = 2
            DemEventSignificance = DEM_EVENT_SIGNIFICANCE_FAULT
            DemConsiderPtoStatus = false
            DemFFPrestorageSupported = false
            DemAgingCycleRef = Ignition_on_off
            DemOperationCycleRef = Ignition_on_off
            DemDebounceAlgorithmClass
              DemDebounceMonitorInternal
                DemCallbackGetFDC
      DTCClass_DTC_0xea0240 (DemDTCClass): DemDTCSeverity=DEM_DTC_SEV_NO_SEVERITY, DemUdsDTC=15336000, DemImmediateNvStorage=false
      SecOC_GWSecOcFailure (DemEventParameter):
        DemEventKind = DEM_EVENT_KIND_SWC
        DemMaxNumberFreezeFrameRecords = 1
        DemEventLatchTestFailed = false
        DemEventTimeSeries = DEM_TIMESERIES_SNAPSHOT_NONE
        DemEventAvailable = false
        DemEventId = 81
        DemEventAvailableInVariant = true
        DemEventCreateInfoPort = false
        DemDTCClassRef = DTCClass_DTC_0xea0240
        DemExtendedDataClassRef = ExtendedDataClass_4f5344cd
        DemFreezeFrameClassRef = FreezeFrameClass_80c88891
        DemEventClass:
          DemAgingAllowed = true
          DemAgingCycleCounterThreshold = 40
          DemEventDestination = DEM_DTC_ORIGIN_PRIMARY_MEMORY
          DemEventPriority = 1
          DemEventSignificance = DEM_EVENT_SIGNIFICANCE_FAULT
          DemConsiderPtoStatus = false
          DemFFPrestorageSupported = false
          DemAgingCycleRef = Ignition_on_off
          DemOperationCycleRef = Ignition_on_off
          DemEnableConditionGroupRef = EnableConditionGroup_IgnOn
          DemDebounceAlgorithmClass
            DemDebounceMonitorInternal
              DemCallbackGetFDC
      SecOC_TBoxSecOcFailure (DemEventParameter):
        DemEventKind = DEM_EVENT_KIND_SWC
        DemMaxNumberFreezeFrameRecords = 1
        DemEventLatchTestFailed = false
        DemEventTimeSeries = DEM_TIMESERIES_SNAPSHOT_NONE
        DemEventAvailable = false
        DemEventId = 78
        DemEventAvailableInVariant = true
        DemEventCreateInfoPort = false
        DemDTCClassRef = DTCClass_DTC_0xea0040
        DemExtendedDataClassRef = ExtendedDataClass_4f5344cd
        DemFreezeFrameClassRef = FreezeFrameClass_80c88891
        DemEventClass:
          DemAgingAllowed = true
          DemAgingCycleCounterThreshold = 40
          DemEventDestination = DEM_DTC_ORIGIN_PRIMARY_MEMORY
          DemEventPriority = 1
          DemEventSignificance = DEM_EVENT_SIGNIFICANCE_FAULT
          DemConsiderPtoStatus = false
          DemFFPrestorageSupported = false
          DemAgingCycleRef = Ignition_on_off
          DemOperationCycleRef = Ignition_on_off
          DemEnableConditionGroupRef = EnableConditionGroup_IgnOn
          DemDebounceAlgorithmClass
            DemDebounceMonitorInternal
              DemCallbackGetFDC
      DTCClass_DTC_0xc10487 (DemDTCClass): DemDTCSeverity=DEM_DTC_SEV_NO_SEVERITY, DemUdsDTC=12649607, DemImmediateNvStorage=false
      Missing_PrePretensioner_Mechatronic_Integrated (DemEventParameter):
        DemEventKind = DEM_EVENT_KIND_SWC
        DemMaxNumberFreezeFrameRecords = 1
        DemEventLatchTestFailed = false
        DemEventTimeSeries = DEM_TIMESERIES_SNAPSHOT_NONE
        DemEventAvailable = false
        DemEventId = 167
        DemEventAvailableInVariant = true
        DemEventCreateInfoPort = true
        DemDTCClassRef = DTCClass_DTC_0xd10b87
        DemExtendedDataClassRef = ExtendedDataClass_4f5344cd
        DemFreezeFrameClassRef = FreezeFrameClass_80c88891
        DemEventClass:
          DemAgingAllowed = true
          DemAgingCycleCounterThreshold = 40
          DemEventDestination = DEM_DTC_ORIGIN_PRIMARY_MEMORY
          DemEventPriority = 1
          DemEventSignificance = DEM_EVENT_SIGNIFICANCE_FAULT
          DemEventFailureCycleCounterThreshold = 0
          DemConsiderPtoStatus = false
          DemFFPrestorageSupported = false
          DemAgingCycleRef = Ignition_on_off
          DemEnableConditionGroupRef = EnableConditionGroup_VIPBatteryVoltageAndIgnOn
          DemOperationCycleRef = Ignition_on_off
          DemDebounceAlgorithmClass  # DemDebounceCounterBased
            DemDebounceMonitorInternal
      3 x DemDTCClass, all with DemDTCSeverity=DEM_DTC_SEV_NO_SEVERITY, DemImmediateNvStorage=false:
        DTCClass_DTC_0xc2b587: DemUdsDTC=12760455
        DTCClass_DTC_0xd10b87: DemUdsDTC=13699975
        DTCClass_DTC_0xd02687: DemUdsDTC=13641351
      Missing_Driver_Seat_Memory_module (DemEventParameter):
        DemEventKind = DEM_EVENT_KIND_SWC
        DemMaxNumberFreezeFrameRecords = 1
        DemEventLatchTestFailed = false
        DemEventTimeSeries = DEM_TIMESERIES_SNAPSHOT_NONE
        DemEventAvailable = false
        DemEventId = 160
        DemEventAvailableInVariant = true
        DemEventCreateInfoPort = true
        DemDTCClassRef = DTCClass_DTC_0xc20887
        DemExtendedDataClassRef = ExtendedDataClass_4f5344cd
        DemFreezeFrameClassRef = FreezeFrameClass_80c88891
        DemEventClass:
          DemAgingAllowed = true
          DemAgingCycleCounterThreshold = 40
          DemEventDestination = DEM_DTC_ORIGIN_PRIMARY_MEMORY
          DemEventPriority = 1
          DemEventSignificance = DEM_EVENT_SIGNIFICANCE_FAULT
          DemEventFailureCycleCounterThreshold = 0
          DemConsiderPtoStatus = false
          DemFFPrestorageSupported = false
          DemAgingCycleRef = Ignition_on_off
          DemEnableConditionGroupRef = EnableConditionGroup_VIPBatteryVoltageAndIgnOn
          DemOperationCycleRef = Ignition_on_off
          DemDebounceAlgorithmClass  # DemDebounceCounterBased
            DemDebounceMonitorInternal
      4 x DemDTCClass, all with DemDTCSeverity=DEM_DTC_SEV_NO_SEVERITY, DemImmediateNvStorage=false:
        DTCClass_DTC_0xc24687: DemUdsDTC=12732039
        DTCClass_DTC_0xc20887: DemUdsDTC=12716167
        DTCClass_DTC_0xc24787: DemUdsDTC=12732295
        DTCClass_DTC_0xc15c87: DemUdsDTC=12672135
      3 x DemEventParameter, all with DemEventKind=DEM_EVENT_KIND_SWC, DemMaxNumberFreezeFrameRecords=1, DemEventLatchTestFailed=false, DemEventTimeSeries=DEM_TIMESERIES_SNAPSHOT_NONE, DemEventAvailable=false, DemEventAvailableInVariant=true, DemEventCreateInfoPort=true, DemExtendedDataClassRef=ExtendedDataClass_4f5344cd, DemFreezeFrameClassRef=FreezeFrameClass_80c88891:
        Missing_Rear_Heat_Vent_Seat_Module: DemEventId=168, DemDTCClassRef=DTCClass_DTC_0xc24787
          DemEventClass:
            DemAgingAllowed = true
            DemAgingCycleCounterThreshold = 40
            DemEventDestination = DEM_DTC_ORIGIN_PRIMARY_MEMORY
            DemEventPriority = 1
            DemEventSignificance = DEM_EVENT_SIGNIFICANCE_FAULT
            DemEventFailureCycleCounterThreshold = 0
            DemConsiderPtoStatus = false
            DemFFPrestorageSupported = false
            DemAgingCycleRef = Ignition_on_off
            DemEnableConditionGroupRef = EnableConditionGroup_VIPBatteryVoltageAndIgnOn
            DemOperationCycleRef = Ignition_on_off
            DemDebounceAlgorithmClass  # DemDebounceCounterBased
              DemDebounceMonitorInternal
        Missing_Hybrid_Vehicle_Control_Unit_Vehicle_control_unit_HCCAN: DemEventId=161, DemDTCClassRef=DTCClass_DTC_0xc29387
          DemEventClass:
            DemAgingAllowed = true
            DemAgingCycleCounterThreshold = 40
            DemEventDestination = DEM_DTC_ORIGIN_PRIMARY_MEMORY
            DemEventPriority = 1
            DemEventSignificance = DEM_EVENT_SIGNIFICANCE_FAULT
            DemEventFailureCycleCounterThreshold = 0
            DemConsiderPtoStatus = false
            DemFFPrestorageSupported = false
            DemAgingCycleRef = Ignition_on_off
            DemOperationCycleRef = Ignition_on_off
            DemEnableConditionGroupRef = EnableConditionGroup_VIPBatteryVoltageAndIgnOn
            DemDebounceAlgorithmClass  # DemDebounceCounterBased
              DemDebounceMonitorInternal
        MissingBattery_Management_System: DemEventId=159, DemDTCClassRef=DTCClass_DTC_0xc11187
          DemEventClass:
            DemAgingAllowed = true
            DemAgingCycleCounterThreshold = 40
            DemEventDestination = DEM_DTC_ORIGIN_PRIMARY_MEMORY
            DemEventPriority = 1
            DemEventSignificance = DEM_EVENT_SIGNIFICANCE_FAULT
            DemEventFailureCycleCounterThreshold = 0
            DemConsiderPtoStatus = false
            DemFFPrestorageSupported = false
            DemAgingCycleRef = Ignition_on_off
            DemEnableConditionGroupRef = EnableConditionGroup_VIPBatteryVoltageAndIgnOn
            DemOperationCycleRef = Ignition_on_off
            DemDebounceAlgorithmClass  # DemDebounceCounterBased
              DemDebounceMonitorInternal
      DTCClass_DTC_0xc29387 (DemDTCClass): DemDTCSeverity=DEM_DTC_SEV_NO_SEVERITY, DemUdsDTC=12751751, DemImmediateNvStorage=false
      DTCClass_DTC_0xc11187 (DemDTCClass): DemDTCSeverity=DEM_DTC_SEV_NO_SEVERITY, DemUdsDTC=12652935, DemImmediateNvStorage=false
      3 x DemEventParameter, all with DemEventKind=DEM_EVENT_KIND_SWC, DemMaxNumberFreezeFrameRecords=1, DemEventLatchTestFailed=false, DemEventTimeSeries=DEM_TIMESERIES_SNAPSHOT_NONE, DemEventAvailable=false, DemEventAvailableInVariant=true, DemEventCreateInfoPort=true, DemExtendedDataClassRef=ExtendedDataClass_4f5344cd, DemFreezeFrameClassRef=FreezeFrameClass_80c88891:
        Missing_Intelligent_Driving_Controller_Level2: DemEventId=164, DemDTCClassRef=DTCClass_DTC_0xc15c87
          DemEventClass:
            DemAgingAllowed = true
            DemAgingCycleCounterThreshold = 40
            DemEventDestination = DEM_DTC_ORIGIN_PRIMARY_MEMORY
            DemEventPriority = 1
            DemEventSignificance = DEM_EVENT_SIGNIFICANCE_FAULT
            DemEventFailureCycleCounterThreshold = 0
            DemConsiderPtoStatus = false
            DemFFPrestorageSupported = false
            DemAgingCycleRef = Ignition_on_off
            DemEnableConditionGroupRef = EnableConditionGroup_VIPBatteryVoltageAndIgnOn
            DemOperationCycleRef = Ignition_on_off
            DemDebounceAlgorithmClass  # DemDebounceCounterBased
              DemDebounceMonitorInternal
        Missing_Right_Headlamp_Control_Module: DemEventId=169, DemDTCClassRef=DTCClass_DTC_0xc24287
          DemEventClass:
            DemAgingAllowed = true
            DemAgingCycleCounterThreshold = 40
            DemEventDestination = DEM_DTC_ORIGIN_PRIMARY_MEMORY
            DemEventPriority = 1
            DemEventSignificance = DEM_EVENT_SIGNIFICANCE_FAULT
            DemEventFailureCycleCounterThreshold = 0
            DemConsiderPtoStatus = false
            DemFFPrestorageSupported = false
            DemAgingCycleRef = Ignition_on_off
            DemEnableConditionGroupRef = EnableConditionGroup_VIPBatteryVoltageAndIgnOn
            DemOperationCycleRef = Ignition_on_off
            DemDebounceAlgorithmClass  # DemDebounceCounterBased
              DemDebounceMonitorInternal
        Missing_Seat_Control_Module: DemEventId=170, DemDTCClassRef=DTCClass_DTC_0xc24687
          DemEventClass:
            DemAgingAllowed = true
            DemAgingCycleCounterThreshold = 40
            DemEventDestination = DEM_DTC_ORIGIN_PRIMARY_MEMORY
            DemEventPriority = 1
            DemEventSignificance = DEM_EVENT_SIGNIFICANCE_FAULT
            DemEventFailureCycleCounterThreshold = 0
            DemConsiderPtoStatus = false
            DemFFPrestorageSupported = false
            DemAgingCycleRef = Ignition_on_off
            DemEnableConditionGroupRef = EnableConditionGroup_VIPBatteryVoltageAndIgnOn
            DemOperationCycleRef = Ignition_on_off
            DemDebounceAlgorithmClass  # DemDebounceCounterBased
              DemDebounceMonitorInternal
      DTCClass_DTC_0xc24287 (DemDTCClass): DemDTCSeverity=DEM_DTC_SEV_NO_SEVERITY, DemUdsDTC=12731015, DemImmediateNvStorage=false
      Missing_Hybrid_Vehicle_Control_Unit_Vehicle_control_unit_PTCAN (DemEventParameter):
        DemEventKind = DEM_EVENT_KIND_SWC
        DemMaxNumberFreezeFrameRecords = 1
        DemEventLatchTestFailed = false
        DemEventTimeSeries = DEM_TIMESERIES_SNAPSHOT_NONE
        DemEventAvailable = false
        DemEventId = 162
        DemEventAvailableInVariant = true
        DemEventCreateInfoPort = true
        DemDTCClassRef = DTCClass_DTC_0xd02687
        DemExtendedDataClassRef = ExtendedDataClass_4f5344cd
        DemFreezeFrameClassRef = FreezeFrameClass_80c88891
        DemEventClass:
          DemAgingAllowed = true
          DemAgingCycleCounterThreshold = 40
          DemEventDestination = DEM_DTC_ORIGIN_PRIMARY_MEMORY
          DemEventPriority = 1
          DemEventSignificance = DEM_EVENT_SIGNIFICANCE_FAULT
          DemEventFailureCycleCounterThreshold = 0
          DemConsiderPtoStatus = false
          DemFFPrestorageSupported = false
          DemAgingCycleRef = Ignition_on_off
          DemEnableConditionGroupRef = EnableConditionGroup_VIPBatteryVoltageAndIgnOn
          DemOperationCycleRef = Ignition_on_off
          DemDebounceAlgorithmClass  # DemDebounceCounterBased
            DemDebounceMonitorInternal
      DTCClass_DTC_0xc23087 (DemDTCClass): DemDTCSeverity=DEM_DTC_SEV_NO_SEVERITY, DemUdsDTC=12726407, DemImmediateNvStorage=false
      4 x DemEventParameter, all with DemEventKind=DEM_EVENT_KIND_SWC, DemMaxNumberFreezeFrameRecords=1, DemEventLatchTestFailed=false, DemEventTimeSeries=DEM_TIMESERIES_SNAPSHOT_NONE, DemEventAvailable=false, DemEventAvailableInVariant=true, DemEventCreateInfoPort=true, DemExtendedDataClassRef=ExtendedDataClass_4f5344cd, DemFreezeFrameClassRef=FreezeFrameClass_80c88891:
        Missing_Ibooster: DemEventId=163, DemDTCClassRef=DTCClass_DTC_0xc25e87
          DemEventClass:
            DemAgingAllowed = true
            DemAgingCycleCounterThreshold = 40
            DemEventDestination = DEM_DTC_ORIGIN_PRIMARY_MEMORY
            DemEventPriority = 1
            DemEventSignificance = DEM_EVENT_SIGNIFICANCE_FAULT
            DemEventFailureCycleCounterThreshold = 0
            DemConsiderPtoStatus = false
            DemFFPrestorageSupported = false
            DemAgingCycleRef = Ignition_on_off
            DemEnableConditionGroupRef = EnableConditionGroup_VIPBatteryVoltageAndIgnOn
            DemOperationCycleRef = Ignition_on_off
            DemDebounceAlgorithmClass  # DemDebounceCounterBased
              DemDebounceMonitorInternal
        missing_Adaptive_Cruise_Control_system_Radar_Control_Module: DemEventId=171, DemDTCClassRef=DTCClass_DTC_0xc10487
          DemEventClass:
            DemAgingAllowed = true
            DemAgingCycleCounterThreshold = 40
            DemEventDestination = DEM_DTC_ORIGIN_PRIMARY_MEMORY
            DemEventPriority = 1
            DemEventSignificance = DEM_EVENT_SIGNIFICANCE_FAULT
            DemEventFailureCycleCounterThreshold = 0
            DemConsiderPtoStatus = false
            DemFFPrestorageSupported = false
            DemAgingCycleRef = Ignition_on_off
            DemEnableConditionGroupRef = EnableConditionGroup_VIPBatteryVoltageAndIgnOn
            DemOperationCycleRef = Ignition_on_off
            DemDebounceAlgorithmClass  # DemDebounceCounterBased
              DemDebounceMonitorInternal
        missing_Right_Corner_Radar: DemEventId=173, DemDTCClassRef=DTCClass_DTC_0xc2b587
          DemEventClass:
            DemAgingAllowed = true
            DemAgingCycleCounterThreshold = 40
            DemEventDestination = DEM_DTC_ORIGIN_PRIMARY_MEMORY
            DemEventPriority = 1
            DemEventSignificance = DEM_EVENT_SIGNIFICANCE_FAULT
            DemEventFailureCycleCounterThreshold = 0
            DemConsiderPtoStatus = false
            DemFFPrestorageSupported = false
            DemAgingCycleRef = Ignition_on_off
            DemEnableConditionGroupRef = EnableConditionGroup_VIPBatteryVoltageAndIgnOn
            DemOperationCycleRef = Ignition_on_off
            DemDebounceAlgorithmClass  # DemDebounceCounterBased
              DemDebounceMonitorInternal
        Missing_Onboard_charger: DemEventId=165, DemDTCClassRef=DTCClass_DTC_0xc1bb87
          DemEventClass:
            DemAgingAllowed = true
            DemAgingCycleCounterThreshold = 40
            DemEventDestination = DEM_DTC_ORIGIN_PRIMARY_MEMORY
            DemEventPriority = 1
            DemEventSignificance = DEM_EVENT_SIGNIFICANCE_FAULT
            DemEventFailureCycleCounterThreshold = 0
            DemConsiderPtoStatus = false
            DemFFPrestorageSupported = false
            DemAgingCycleRef = Ignition_on_off
            DemEnableConditionGroupRef = EnableConditionGroup_VIPBatteryVoltageAndIgnOn
            DemOperationCycleRef = Ignition_on_off
            DemDebounceAlgorithmClass  # DemDebounceCounterBased
              DemDebounceMonitorInternal
      DTCClass_DTC_0xc1bb87 (DemDTCClass): DemDTCSeverity=DEM_DTC_SEV_NO_SEVERITY, DemUdsDTC=12696455, DemImmediateNvStorage=false
      Missing_Power_Lift_Gate_module (DemEventParameter):
        DemEventKind = DEM_EVENT_KIND_SWC
        DemMaxNumberFreezeFrameRecords = 1
        DemEventLatchTestFailed = false
        DemEventTimeSeries = DEM_TIMESERIES_SNAPSHOT_NONE
        DemEventAvailable = false
        DemEventId = 166
        DemEventAvailableInVariant = true
        DemEventCreateInfoPort = true
        DemDTCClassRef = DTCClass_DTC_0xc23087
        DemExtendedDataClassRef = ExtendedDataClass_4f5344cd
        DemFreezeFrameClassRef = FreezeFrameClass_80c88891
        DemEventClass:
          DemAgingAllowed = true
          DemAgingCycleCounterThreshold = 40
          DemEventDestination = DEM_DTC_ORIGIN_PRIMARY_MEMORY
          DemEventPriority = 1
          DemEventSignificance = DEM_EVENT_SIGNIFICANCE_FAULT
          DemEventFailureCycleCounterThreshold = 0
          DemConsiderPtoStatus = false
          DemFFPrestorageSupported = false
          DemAgingCycleRef = Ignition_on_off
          DemEnableConditionGroupRef = EnableConditionGroup_VIPBatteryVoltageAndIgnOn
          DemOperationCycleRef = Ignition_on_off
          DemDebounceAlgorithmClass  # DemDebounceCounterBased
            DemDebounceMonitorInternal
      12 x DemDTCClass, all with DemDTCSeverity=DEM_DTC_SEV_NO_SEVERITY, DemImmediateNvStorage=false:
        DTCClass_DTC_0xc25e87: DemUdsDTC=12738183
        DTCClass_DTC_0xA10093: DemUdsDTC=10551443
        DTCClass_DTC_0xA10157: DemUdsDTC=10551639
        DTCClass_DTC_0xA20093: DemUdsDTC=10616979
        DTCClass_DTC_0xA20157: DemUdsDTC=10617175
        DTCClass_DTC_0xA30093: DemUdsDTC=10682515
        DTCClass_DTC_0xA30157: DemUdsDTC=10682711
        DTCClass_DTC_0xA40093: DemUdsDTC=10748051
        DTCClass_DTC_0xA40157: DemUdsDTC=10748247
        DTCClass_DTC_0xA50093: DemUdsDTC=10813587
        DTCClass_DTC_0xA50157: DemUdsDTC=10813783
        DTCClass_DTC_0xd12006: DemUdsDTC=13705222
      27 x DemEventParameter, all with DemEventTimeSeries=DEM_TIMESERIES_SNAPSHOT_NONE, DemEventAvailable=false, DemEventAvailableInVariant=true, DemEventLatchTestFailed=false, DemEventCreateInfoPort=true:
        FactoryModeNotClosed: DemEventId=172, DemEventKind=DEM_EVENT_KIND_SWC, DemMaxNumberFreezeFrameRecords=1, DemFreezeFrameClassRef=FreezeFrameClass_80c88891, DemExtendedDataClassRef=ExtendedDataClass_4f5344cd, DemDTCClassRef=DTCClass_DTC_0xd12006
          DemEventClass:
            DemAgingAllowed = true
            DemConsiderPtoStatus = false
            DemEventDestination = DEM_DTC_ORIGIN_PRIMARY_MEMORY
            DemEventPriority = 1
            DemFFPrestorageSupported = false
            DemAgingCycleCounterThreshold = 40
            DemOperationCycleRef = Ignition_on_off
            DemAgingCycleRef = Ignition_on_off
            DemDebounceAlgorithmClass
              DemDebounceMonitorInternal
        LostComWithAVMFrontCamera: DemEventId=174, DemEventKind=DEM_EVENT_KIND_SWC, DemMaxNumberFreezeFrameRecords=1, DemFreezeFrameClassRef=FreezeFrameClass_80c88891, DemExtendedDataClassRef=ExtendedDataClass_4f5344cd, DemDTCClassRef=DTCClass_DTC_0x910187
          DemEventClass:
            DemAgingAllowed = true
            DemConsiderPtoStatus = false
            DemEventDestination = DEM_DTC_ORIGIN_PRIMARY_MEMORY
            DemEventPriority = 1
            DemFFPrestorageSupported = false
            DemAgingCycleCounterThreshold = 40
            DemOperationCycleRef = Ignition_on_off
            DemAgingCycleRef = Ignition_on_off
            DemEnableConditionGroupRef = EnableConditionGroup_IgnOn
            DemDebounceAlgorithmClass
              DemDebounceMonitorInternal
        LostComWithAVMLeftCamera: DemEventId=176, DemEventKind=DEM_EVENT_KIND_SWC, DemMaxNumberFreezeFrameRecords=1, DemFreezeFrameClassRef=FreezeFrameClass_80c88891, DemExtendedDataClassRef=ExtendedDataClass_4f5344cd, DemDTCClassRef=DTCClass_DTC_0x910387
          DemEventClass:
            DemAgingAllowed = true
            DemConsiderPtoStatus = false
            DemEventDestination = DEM_DTC_ORIGIN_PRIMARY_MEMORY
            DemEventPriority = 1
            DemFFPrestorageSupported = false
            DemAgingCycleCounterThreshold = 40
            DemOperationCycleRef = Ignition_on_off
            DemAgingCycleRef = Ignition_on_off
            DemEnableConditionGroupRef = EnableConditionGroup_IgnOn
            DemDebounceAlgorithmClass
              DemDebounceMonitorInternal
        LostComWithAVMRearCamera: DemEventId=175, DemEventKind=DEM_EVENT_KIND_SWC, DemMaxNumberFreezeFrameRecords=1, DemFreezeFrameClassRef=FreezeFrameClass_80c88891, DemExtendedDataClassRef=ExtendedDataClass_4f5344cd, DemDTCClassRef=DTCClass_DTC_0x910287
          DemEventClass:
            DemAgingAllowed = true
            DemConsiderPtoStatus = false
            DemEventDestination = DEM_DTC_ORIGIN_PRIMARY_MEMORY
            DemEventPriority = 1
            DemFFPrestorageSupported = false
            DemAgingCycleCounterThreshold = 40
            DemOperationCycleRef = Ignition_on_off
            DemAgingCycleRef = Ignition_on_off
            DemEnableConditionGroupRef = EnableConditionGroup_IgnOn
            DemDebounceAlgorithmClass
              DemDebounceMonitorInternal
        LostComWithAVMRightCamera: DemEventId=177, DemEventKind=DEM_EVENT_KIND_SWC, DemMaxNumberFreezeFrameRecords=1, DemFreezeFrameClassRef=FreezeFrameClass_80c88891, DemExtendedDataClassRef=ExtendedDataClass_4f5344cd, DemDTCClassRef=DTCClass_DTC_0x910487
          DemEventClass:
            DemAgingAllowed = true
            DemConsiderPtoStatus = false
            DemEventDestination = DEM_DTC_ORIGIN_PRIMARY_MEMORY
            DemEventPriority = 1
            DemFFPrestorageSupported = false
            DemAgingCycleCounterThreshold = 40
            DemOperationCycleRef = Ignition_on_off
            DemAgingCycleRef = Ignition_on_off
            DemEnableConditionGroupRef = EnableConditionGroup_IgnOn
            DemDebounceAlgorithmClass
              DemDebounceMonitorInternal
        Read_CPScreen_IDFailed: DemEventId=183, DemEventKind=DEM_EVENT_KIND_SWC, DemMaxNumberFreezeFrameRecords=1, DemFreezeFrameClassRef=FreezeFrameClass_80c88891, DemExtendedDataClassRef=ExtendedDataClass_4f5344cd, DemDTCClassRef=DTCClass_DTC_0xA30093
          DemEventClass:
            DemAgingAllowed = true
            DemConsiderPtoStatus = false
            DemEventDestination = DEM_DTC_ORIGIN_PRIMARY_MEMORY
            DemEventPriority = 1
            DemFFPrestorageSupported = false
            DemAgingCycleCounterThreshold = 40
            DemOperationCycleRef = Ignition_on_off
            DemAgingCycleRef = Ignition_on_off
            DemDebounceAlgorithmClass
              DemDebounceMonitorInternal
        Read_ClusterScreenIDFailed: DemEventId=178, DemEventKind=DEM_EVENT_KIND_SWC, DemMaxNumberFreezeFrameRecords=1, DemFreezeFrameClassRef=FreezeFrameClass_80c88891, DemExtendedDataClassRef=ExtendedDataClass_4f5344cd, DemDTCClassRef=DTCClass_DTC_0xA10093
          DemEventClass:
            DemAgingAllowed = true
            DemConsiderPtoStatus = false
            DemEventDestination = DEM_DTC_ORIGIN_PRIMARY_MEMORY
            DemEventPriority = 1
            DemFFPrestorageSupported = false
            DemAgingCycleCounterThreshold = 40
            DemOperationCycleRef = Ignition_on_off
            DemAgingCycleRef = Ignition_on_off
            DemDebounceAlgorithmClass
              DemDebounceMonitorInternal
        Read_CoDriverScreenIDFailed: DemEventId=187, DemEventKind=DEM_EVENT_KIND_SWC, DemMaxNumberFreezeFrameRecords=1, DemFreezeFrameClassRef=FreezeFrameClass_80c88891, DemExtendedDataClassRef=ExtendedDataClass_4f5344cd, DemDTCClassRef=DTCClass_DTC_0xA40093
          DemEventClass:
            DemAgingAllowed = true
            DemConsiderPtoStatus = false
            DemEventDestination = DEM_DTC_ORIGIN_PRIMARY_MEMORY
            DemEventPriority = 1
            DemFFPrestorageSupported = false
            DemAgingCycleCounterThreshold = 40
            DemOperationCycleRef = Ignition_on_off
            DemAgingCycleRef = Ignition_on_off
            DemDebounceAlgorithmClass
              DemDebounceMonitorInternal
        Read_HUDScreen_IDFailed: DemEventId=190, DemEventKind=DEM_EVENT_KIND_SWC, DemMaxNumberFreezeFrameRecords=1, DemFreezeFrameClassRef=FreezeFrameClass_80c88891, DemExtendedDataClassRef=ExtendedDataClass_4f5344cd, DemDTCClassRef=DTCClass_DTC_0xA50093
          DemEventClass:
            DemAgingAllowed = true
            DemConsiderPtoStatus = false
            DemEventDestination = DEM_DTC_ORIGIN_PRIMARY_MEMORY
            DemEventPriority = 1
            DemFFPrestorageSupported = false
            DemAgingCycleCounterThreshold = 40
            DemOperationCycleRef = Ignition_on_off
            DemAgingCycleRef = Ignition_on_off
            DemEnableConditionGroupRef = EnableConditionGroup_IgnOn
            DemDebounceAlgorithmClass
              DemDebounceMonitorInternal
        Read_IVIScreen_IDFailed: DemEventId=180, DemEventKind=DEM_EVENT_KIND_SWC, DemMaxNumberFreezeFrameRecords=1, DemFreezeFrameClassRef=FreezeFrameClass_80c88891, DemExtendedDataClassRef=ExtendedDataClass_4f5344cd, DemDTCClassRef=DTCClass_DTC_0xA20093
          DemEventClass:
            DemAgingAllowed = true
            DemConsiderPtoStatus = false
            DemEventDestination = DEM_DTC_ORIGIN_PRIMARY_MEMORY
            DemEventPriority = 1
            DemFFPrestorageSupported = false
            DemAgingCycleCounterThreshold = 40
            DemOperationCycleRef = Ignition_on_off
            DemAgingCycleRef = Ignition_on_off
            DemDebounceAlgorithmClass
              DemDebounceMonitorInternal
        ScreenCPDriverErr: DemEventId=185, DemEventKind=DEM_EVENT_KIND_SWC, DemMaxNumberFreezeFrameRecords=1, DemFreezeFrameClassRef=FreezeFrameClass_80c88891, DemExtendedDataClassRef=ExtendedDataClass_4f5344cd, DemDTCClassRef=DTCClass_DTC_0xA30157
          DemEventClass:
            DemAgingAllowed = true
            DemConsiderPtoStatus = false
            DemEventDestination = DEM_DTC_ORIGIN_PRIMARY_MEMORY
            DemEventPriority = 1
            DemFFPrestorageSupported = false
            DemAgingCycleCounterThreshold = 40
            DemOperationCycleRef = Ignition_on_off
            DemAgingCycleRef = Ignition_on_off
            DemDebounceAlgorithmClass
              DemDebounceMonitorInternal
        ScreenClusterDriverErr: DemEventId=179, DemEventKind=DEM_EVENT_KIND_SWC, DemMaxNumberFreezeFrameRecords=1, DemFreezeFrameClassRef=FreezeFrameClass_80c88891, DemExtendedDataClassRef=ExtendedDataClass_4f5344cd, DemDTCClassRef=DTCClass_DTC_0xA10157
          DemEventClass:
            DemAgingAllowed = true
            DemConsiderPtoStatus = false
            DemEventDestination = DEM_DTC_ORIGIN_PRIMARY_MEMORY
            DemEventPriority = 1
            DemFFPrestorageSupported = false
            DemAgingCycleCounterThreshold = 40
            DemOperationCycleRef = Ignition_on_off
            DemAgingCycleRef = Ignition_on_off
            DemDebounceAlgorithmClass
              DemDebounceMonitorInternal
        ScreenCoDriverErr: DemEventId=188, DemEventKind=DEM_EVENT_KIND_SWC, DemMaxNumberFreezeFrameRecords=1, DemFreezeFrameClassRef=FreezeFrameClass_80c88891, DemExtendedDataClassRef=ExtendedDataClass_4f5344cd, DemDTCClassRef=DTCClass_DTC_0xA40157
          DemEventClass:
            DemAgingAllowed = true
            DemConsiderPtoStatus = false
            DemEventDestination = DEM_DTC_ORIGIN_PRIMARY_MEMORY
            DemEventPriority = 1
            DemFFPrestorageSupported = false
            DemAgingCycleCounterThreshold = 40
            DemOperationCycleRef = Ignition_on_off
            DemAgingCycleRef = Ignition_on_off
            DemDebounceAlgorithmClass
              DemDebounceMonitorInternal
        ScreenHUDDriverErr: DemEventId=192, DemEventKind=DEM_EVENT_KIND_SWC, DemMaxNumberFreezeFrameRecords=1, DemFreezeFrameClassRef=FreezeFrameClass_80c88891, DemExtendedDataClassRef=ExtendedDataClass_4f5344cd, DemDTCClassRef=DTCClass_DTC_0xA50157
          DemEventClass:
            DemAgingAllowed = true
            DemConsiderPtoStatus = false
            DemEventDestination = DEM_DTC_ORIGIN_PRIMARY_MEMORY
            DemEventPriority = 1
            DemFFPrestorageSupported = false
            DemAgingCycleCounterThreshold = 40
            DemOperationCycleRef = Ignition_on_off
            DemAgingCycleRef = Ignition_on_off
            DemDebounceAlgorithmClass
              DemDebounceMonitorInternal
        ScreenIVIDriverErr: DemEventId=181, DemEventKind=DEM_EVENT_KIND_SWC, DemMaxNumberFreezeFrameRecords=1, DemFreezeFrameClassRef=FreezeFrameClass_80c88891, DemExtendedDataClassRef=ExtendedDataClass_4f5344cd, DemDTCClassRef=DTCClass_DTC_0xA20157
          DemEventClass:
            DemAgingAllowed = true
            DemConsiderPtoStatus = false
            DemEventDestination = DEM_DTC_ORIGIN_PRIMARY_MEMORY
            DemEventPriority = 1
            DemFFPrestorageSupported = false
            DemAgingCycleCounterThreshold = 40
            DemOperationCycleRef = Ignition_on_off
            DemAgingCycleRef = Ignition_on_off
            DemDebounceAlgorithmClass
              DemDebounceMonitorInternal
        AutoCreatedDemEvent_CortstDemEventParameterRefs_RAMTST_E_Core: DemEventId=148, DemEventKind=DEM_EVENT_KIND_BSW
          DemEventClass:
            DemAgingAllowed = false
            DemConsiderPtoStatus = false
            DemEventDestination = DEM_DTC_ORIGIN_PRIMARY_MEMORY
            DemEventPriority = 2
            DemFFPrestorageSupported = false
            DemOperationCycleRef = Ignition_on_off
            DemDebounceAlgorithmClass
              DemDebounceMonitorInternal (DemDebounceCounterBased):
                DemDebounceBehavior = DEM_DEBOUNCE_FREEZE
                DemDebounceCounterDecrementStepSize = 1
                DemDebounceCounterFailedThreshold = 127
                DemDebounceCounterIncrementStepSize = 1
                DemDebounceCounterJumpDown = true
                DemDebounceCounterJumpDownValue = 0
                DemDebounceCounterJumpUp = true
                DemDebounceCounterJumpUpValue = 0
                DemDebounceCounterPassedThreshold = -128
                DemDebounceCounterStorage = false
                DemDebounceContinuous = false
        AutoCreatedDemEvent_FlststDemEventParameterRefs_FLSTST_E_ECC_FAILED: DemEventId=149, DemEventKind=DEM_EVENT_KIND_BSW
          DemEventClass:
            DemAgingAllowed = false
            DemConsiderPtoStatus = false
            DemEventDestination = DEM_DTC_ORIGIN_PRIMARY_MEMORY
            DemEventPriority = 2
            DemFFPrestorageSupported = false
            DemOperationCycleRef = Ignition_on_off
            DemDebounceAlgorithmClass
              DemDebounceMonitorInternal
        AutoCreatedDemEvent_FlststDemEventParameterRefs_FLSTST_E_FLSTEST_FAILURE: DemEventId=150, DemEventKind=DEM_EVENT_KIND_BSW
          DemEventClass:
            DemAgingAllowed = false
            DemConsiderPtoStatus = false
            DemEventDestination = DEM_DTC_ORIGIN_PRIMARY_MEMORY
            DemEventPriority = 2
            DemFFPrestorageSupported = false
            DemOperationCycleRef = Ignition_on_off
            DemDebounceAlgorithmClass
              DemDebounceMonitorInternal
        AutoCreatedDemEvent_FlststDemEventParameterRefs_FLSTST_E_REG_WRITE_VERIFY: DemEventId=151, DemEventKind=DEM_EVENT_KIND_BSW
          DemEventClass:
            DemAgingAllowed = false
            DemConsiderPtoStatus = false
            DemEventDestination = DEM_DTC_ORIGIN_PRIMARY_MEMORY
            DemEventPriority = 2
            DemFFPrestorageSupported = false
            DemOperationCycleRef = Ignition_on_off
            DemDebounceAlgorithmClass
              DemDebounceMonitorInternal
        AutoCreatedDemEvent_RamtstDemEventParameterRefs_RAMTST_E_ECC_FAILED: DemEventId=152, DemEventKind=DEM_EVENT_KIND_BSW
          DemEventClass:
            DemAgingAllowed = false
            DemConsiderPtoStatus = false
            DemEventDestination = DEM_DTC_ORIGIN_PRIMARY_MEMORY
            DemEventPriority = 2
            DemFFPrestorageSupported = false
            DemOperationCycleRef = Ignition_on_off
            DemDebounceAlgorithmClass
              DemDebounceMonitorInternal
        AutoCreatedDemEvent_RamtstDemEventParameterRefs_RAMTST_E_MIAN_RAM_FAILURE: DemEventId=153, DemEventKind=DEM_EVENT_KIND_BSW
          DemEventClass:
            DemAgingAllowed = false
            DemConsiderPtoStatus = false
            DemEventDestination = DEM_DTC_ORIGIN_PRIMARY_MEMORY
            DemEventPriority = 2
            DemFFPrestorageSupported = false
            DemOperationCycleRef = Ignition_on_off
            DemDebounceAlgorithmClass
              DemDebounceMonitorInternal
        AutoCreatedDemEvent_RamtstDemEventParameterRefs_RAMTST_E_PART_RAM_FAILURE: DemEventId=154, DemEventKind=DEM_EVENT_KIND_BSW
          DemEventClass:
            DemAgingAllowed = false
            DemConsiderPtoStatus = false
            DemEventDestination = DEM_DTC_ORIGIN_PRIMARY_MEMORY
            DemEventPriority = 2
            DemFFPrestorageSupported = false
            DemOperationCycleRef = Ignition_on_off
            DemDebounceAlgorithmClass
              DemDebounceMonitorInternal
        AutoCreatedDemEvent_RamtstDemEventParameterRefs_RAMTST_E_RAM_FAILURE: DemEventId=155, DemEventKind=DEM_EVENT_KIND_BSW
          DemEventClass:
            DemAgingAllowed = false
            DemConsiderPtoStatus = false
            DemEventDestination = DEM_DTC_ORIGIN_PRIMARY_MEMORY
            DemEventPriority = 2
            DemFFPrestorageSupported = false
            DemOperationCycleRef = Ignition_on_off
            DemDebounceAlgorithmClass
              DemDebounceMonitorInternal
        AutoCreatedDemEvent_RamtstDemEventParameterRefs_RAMTST_E_RUNFL_RAM_FAILURE: DemEventId=156, DemEventKind=DEM_EVENT_KIND_BSW
          DemEventClass:
            DemAgingAllowed = false
            DemConsiderPtoStatus = false
            DemEventDestination = DEM_DTC_ORIGIN_PRIMARY_MEMORY
            DemEventPriority = 2
            DemFFPrestorageSupported = false
            DemOperationCycleRef = Ignition_on_off
            DemDebounceAlgorithmClass
              DemDebounceMonitorInternal
        AVM_CamerOpenCircuit: DemEventId=193, DemEventKind=DEM_EVENT_KIND_SWC, DemMaxNumberFreezeFrameRecords=1, DemFreezeFrameClassRef=FreezeFrameClass_80c88891, DemExtendedDataClassRef=ExtendedDataClass_4f5344cd, DemDTCClassRef=DTCClass_DTC_0x910113
          DemEventClass:
            DemAgingAllowed = true
            DemConsiderPtoStatus = false
            DemEventDestination = DEM_DTC_ORIGIN_PRIMARY_MEMORY
            DemEventPriority = 1
            DemFFPrestorageSupported = false
            DemAgingCycleCounterThreshold = 40
            DemOperationCycleRef = Ignition_on_off
            DemAgingCycleRef = Ignition_on_off
            DemEnableConditionGroupRef = EnableConditionGroup_IgnOn
            DemDebounceAlgorithmClass
              DemDebounceMonitorInternal
        AVM_CamerShortToBattery: DemEventId=189, DemEventKind=DEM_EVENT_KIND_SWC, DemMaxNumberFreezeFrameRecords=1, DemFreezeFrameClassRef=FreezeFrameClass_80c88891, DemExtendedDataClassRef=ExtendedDataClass_4f5344cd, DemDTCClassRef=DTCClass_DTC_0x910112
          DemEventClass:
            DemAgingAllowed = true
            DemConsiderPtoStatus = false
            DemEventDestination = DEM_DTC_ORIGIN_PRIMARY_MEMORY
            DemEventPriority = 1
            DemFFPrestorageSupported = false
            DemAgingCycleCounterThreshold = 40
            DemOperationCycleRef = Ignition_on_off
            DemAgingCycleRef = Ignition_on_off
            DemEnableConditionGroupRef = EnableConditionGroup_BatteryVoltage3
            DemDebounceAlgorithmClass
              DemDebounceMonitorInternal
        AVM_CamerShortToGround: DemEventId=191, DemEventKind=DEM_EVENT_KIND_SWC, DemMaxNumberFreezeFrameRecords=1, DemFreezeFrameClassRef=FreezeFrameClass_80c88891, DemExtendedDataClassRef=ExtendedDataClass_4f5344cd, DemDTCClassRef=DTCClass_DTC_0x910111
          DemEventClass:
            DemAgingAllowed = true
            DemConsiderPtoStatus = false
            DemEventDestination = DEM_DTC_ORIGIN_PRIMARY_MEMORY
            DemEventPriority = 1
            DemFFPrestorageSupported = false
            DemAgingCycleCounterThreshold = 40
            DemOperationCycleRef = Ignition_on_off
            DemAgingCycleRef = Ignition_on_off
            DemEnableConditionGroupRef = EnableConditionGroup_IgnOn
            DemDebounceAlgorithmClass
              DemDebounceMonitorInternal
      11 x DemDTCClass, all with DemDTCSeverity=DEM_DTC_SEV_NO_SEVERITY, DemImmediateNvStorage=false:
        DTCClass_DTC_0x910011: DemUdsDTC=9502737
        DTCClass_DTC_0x910012: DemUdsDTC=9502738
        DTCClass_DTC_0x910013: DemUdsDTC=9502739
        DTCClass_DTC_0x910087: DemUdsDTC=9502855
        DTCClass_DTC_0x910111: DemUdsDTC=9502993
        DTCClass_DTC_0x910112: DemUdsDTC=9502994
        DTCClass_DTC_0x910113: DemUdsDTC=9502995
        DTCClass_DTC_0x910187: DemUdsDTC=9503111
        DTCClass_DTC_0x910287: DemUdsDTC=9503367
        DTCClass_DTC_0x910387: DemUdsDTC=9503623
        DTCClass_DTC_0x910487: DemUdsDTC=9503879
      3 x DemEventParameter, all with DemEventTimeSeries=DEM_TIMESERIES_SNAPSHOT_NONE, DemEventAvailable=false, DemEventKind=DEM_EVENT_KIND_SWC, DemEventAvailableInVariant=true, DemEventLatchTestFailed=false, DemEventCreateInfoPort=true, DemMaxNumberFreezeFrameRecords=1, DemFreezeFrameClassRef=FreezeFrameClass_80c88891, DemExtendedDataClassRef=ExtendedDataClass_4f5344cd:
        RVC_CamerShortToBattery: DemEventId=184, DemDTCClassRef=DTCClass_DTC_0x910012
          DemEventClass:
            DemAgingAllowed = true
            DemConsiderPtoStatus = false
            DemEventDestination = DEM_DTC_ORIGIN_PRIMARY_MEMORY
            DemEventPriority = 1
            DemFFPrestorageSupported = false
            DemAgingCycleCounterThreshold = 40
            DemOperationCycleRef = Ignition_on_off
            DemAgingCycleRef = Ignition_on_off
            DemEnableConditionGroupRef = EnableConditionGroup_VIPBatteryVoltage2AndIgnOn
            DemDebounceAlgorithmClass
              DemDebounceMonitorInternal
        RVC_CameraOpenCircuit: DemEventId=186, DemDTCClassRef=DTCClass_DTC_0x910013
          DemEventClass:
            DemAgingAllowed = true
            DemConsiderPtoStatus = false
            DemEventDestination = DEM_DTC_ORIGIN_PRIMARY_MEMORY
            DemEventPriority = 1
            DemFFPrestorageSupported = false
            DemAgingCycleCounterThreshold = 40
            DemOperationCycleRef = Ignition_on_off
            DemAgingCycleRef = Ignition_on_off
            DemEnableConditionGroupRef = EnableConditionGroup_IgnOn
            DemDebounceAlgorithmClass
              DemDebounceMonitorInternal
        RVC_CameraShortToGround: DemEventId=182, DemDTCClassRef=DTCClass_DTC_0x910011
          DemEventClass:
            DemAgingAllowed = true
            DemConsiderPtoStatus = false
            DemEventDestination = DEM_DTC_ORIGIN_PRIMARY_MEMORY
            DemEventPriority = 1
            DemFFPrestorageSupported = false
            DemAgingCycleCounterThreshold = 40
            DemOperationCycleRef = Ignition_on_off
            DemAgingCycleRef = Ignition_on_off
            DemEnableConditionGroupRef = EnableConditionGroup_IgnOn
            DemDebounceAlgorithmClass
              DemDebounceMonitorInternal
      DemDTCClass_0x927649 (DemDTCClass): DemImmediateNvStorage=false, DemDTCSeverity=DEM_DTC_SEV_NO_SEVERITY, DemUdsDTC=9598537
      Temperature_SensorError (DemEventParameter):
        DemEventTimeSeries = DEM_TIMESERIES_SNAPSHOT_NONE
        DemEventAvailable = false
        DemEventId = 194
        DemEventKind = DEM_EVENT_KIND_SWC
        DemEventAvailableInVariant = true
        DemEventLatchTestFailed = false
        DemEventCreateInfoPort = true
        DemMaxNumberFreezeFrameRecords = 1
        DemExtendedDataClassRef = ExtendedDataClass_4f5344cd
        DemFreezeFrameClassRef = FreezeFrameClass_80c88891
        DemDTCClassRef = DemDTCClass_0x927649
        DemEventClass:
          DemAgingAllowed = true
          DemConsiderPtoStatus = false
          DemEventDestination = DEM_DTC_ORIGIN_PRIMARY_MEMORY
          DemEventPriority = 1
          DemFFPrestorageSupported = false
          DemAgingCycleCounterThreshold = 40
          DemOperationCycleRef = Ignition_on_off
          DemAgingCycleRef = Ignition_on_off
          DemEnableConditionGroupRef = EnableConditionGroup_IgnOn
          DemDebounceAlgorithmClass
            DemDebounceMonitorInternal
      16 x DemDTCClass, all with DemDTCSeverity=DEM_DTC_SEV_NO_SEVERITY, DemImmediateNvStorage=false:
        DTCClass_DTC_0x910511: DemUdsDTC=9504017
        DTCClass_DTC_0x910512: DemUdsDTC=9504018
        DTCClass_DTC_0x910513: DemUdsDTC=9504019
        DTCClass_DTC_0x910611: DemUdsDTC=9504273
        DTCClass_DTC_0x910612: DemUdsDTC=9504274
        DTCClass_DTC_0x910613: DemUdsDTC=9504275
        DTCClass_DTC_0x910711: DemUdsDTC=9504529
        DTCClass_DTC_0x910712: DemUdsDTC=9504530
        DTCClass_DTC_0x910713: DemUdsDTC=9504531
        DTCClass_DTC_0x9A0701: DemUdsDTC=10094337
        DTCClass_DTC_0x9A0711: DemUdsDTC=10094353
        DTCClass_DTC_0x9A0712: DemUdsDTC=10094354
        DTCClass_DTC_0x9A0713: DemUdsDTC=10094355
        DTCClass_DTC_0x9A071E: DemUdsDTC=10094366
        DTCClass_DTC_0x9A0725: DemUdsDTC=10094373
        DTCClass_DTC_0xe00487: DemUdsDTC=14681223
      15 x DemEventParameter, all with DemEventTimeSeries=DEM_TIMESERIES_SNAPSHOT_NONE, DemEventAvailable=false, DemEventKind=DEM_EVENT_KIND_SWC, DemEventAvailableInVariant=true, DemEventLatchTestFailed=false, DemEventCreateInfoPort=true, DemMaxNumberFreezeFrameRecords=1, DemExtendedDataClassRef=ExtendedDataClass_4f5344cd, DemFreezeFrameClassRef=FreezeFrameClass_80c88891:
        Internal_DMS_CameraCircuitOpen: DemEventId=207, DemDTCClassRef=DTCClass_DTC_0x910513
          DemEventClass:
            DemAgingAllowed = true
            DemConsiderPtoStatus = false
            DemEventDestination = DEM_DTC_ORIGIN_PRIMARY_MEMORY
            DemEventPriority = 1
            DemFFPrestorageSupported = false
            DemAgingCycleCounterThreshold = 40
            DemEventSignificance = DEM_EVENT_SIGNIFICANCE_FAULT
            DemOperationCycleRef = Ignition_on_off
            DemAgingCycleRef = Ignition_on_off
            DemEnableConditionGroupRef = EnableConditionGroup_IgnOn
            DemDebounceAlgorithmClass
              DemDebounceMonitorInternal
        Internal_DMS_CameraShortToBattery: DemEventId=201, DemDTCClassRef=DTCClass_DTC_0x910512
          DemEventClass:
            DemAgingAllowed = true
            DemConsiderPtoStatus = false
            DemEventDestination = DEM_DTC_ORIGIN_PRIMARY_MEMORY
            DemEventPriority = 1
            DemFFPrestorageSupported = false
            DemAgingCycleCounterThreshold = 40
            DemEventSignificance = DEM_EVENT_SIGNIFICANCE_FAULT
            DemOperationCycleRef = Ignition_on_off
            DemAgingCycleRef = Ignition_on_off
            DemEnableConditionGroupRef = EnableConditionGroup_BatteryVoltage4
            DemDebounceAlgorithmClass
              DemDebounceMonitorInternal
        Internal_DMS_CameraShortToGround: DemEventId=195, DemDTCClassRef=DTCClass_DTC_0x910511
          DemEventClass:
            DemAgingAllowed = true
            DemConsiderPtoStatus = false
            DemEventDestination = DEM_DTC_ORIGIN_PRIMARY_MEMORY
            DemEventPriority = 1
            DemFFPrestorageSupported = false
            DemAgingCycleCounterThreshold = 40
            DemEventSignificance = DEM_EVENT_SIGNIFICANCE_FAULT
            DemOperationCycleRef = Ignition_on_off
            DemAgingCycleRef = Ignition_on_off
            DemEnableConditionGroupRef = EnableConditionGroup_IgnOn
            DemDebounceAlgorithmClass
              DemDebounceMonitorInternal
        Internal_DVR_CameraCircuitOpen: DemEventId=208, DemDTCClassRef=DTCClass_DTC_0x910613
          DemEventClass:
            DemAgingAllowed = true
            DemConsiderPtoStatus = false
            DemEventDestination = DEM_DTC_ORIGIN_PRIMARY_MEMORY
            DemEventPriority = 1
            DemFFPrestorageSupported = false
            DemAgingCycleCounterThreshold = 40
            DemEventSignificance = DEM_EVENT_SIGNIFICANCE_FAULT
            DemOperationCycleRef = Ignition_on_off
            DemAgingCycleRef = Ignition_on_off
            DemEnableConditionGroupRef = EnableConditionGroup_IgnOn
            DemDebounceAlgorithmClass
              DemDebounceMonitorInternal
        Internal_DVR_CameraShortToBattery: DemEventId=203, DemDTCClassRef=DTCClass_DTC_0x910612
          DemEventClass:
            DemAgingAllowed = true
            DemConsiderPtoStatus = false
            DemEventDestination = DEM_DTC_ORIGIN_PRIMARY_MEMORY
            DemEventPriority = 1
            DemFFPrestorageSupported = false
            DemAgingCycleCounterThreshold = 40
            DemEventSignificance = DEM_EVENT_SIGNIFICANCE_FAULT
            DemOperationCycleRef = Ignition_on_off
            DemAgingCycleRef = Ignition_on_off
            DemEnableConditionGroupRef = EnableConditionGroup_BatteryVoltage4
            DemDebounceAlgorithmClass
              DemDebounceMonitorInternal
        Internal_DVR_CameraShortToGround: DemEventId=197, DemDTCClassRef=DTCClass_DTC_0x910611
          DemEventClass:
            DemAgingAllowed = true
            DemConsiderPtoStatus = false
            DemEventDestination = DEM_DTC_ORIGIN_PRIMARY_MEMORY
            DemEventPriority = 1
            DemFFPrestorageSupported = false
            DemAgingCycleCounterThreshold = 40
            DemEventSignificance = DEM_EVENT_SIGNIFICANCE_FAULT
            DemOperationCycleRef = Ignition_on_off
            DemAgingCycleRef = Ignition_on_off
            DemEnableConditionGroupRef = EnableConditionGroup_IgnOn
            DemDebounceAlgorithmClass
              DemDebounceMonitorInternal
        Internal_OMS_CameraCircuitOpen: DemEventId=209, DemDTCClassRef=DTCClass_DTC_0x910713
          DemEventClass:
            DemAgingAllowed = true
            DemConsiderPtoStatus = false
            DemEventDestination = DEM_DTC_ORIGIN_PRIMARY_MEMORY
            DemEventPriority = 1
            DemFFPrestorageSupported = false
            DemAgingCycleCounterThreshold = 40
            DemEventSignificance = DEM_EVENT_SIGNIFICANCE_FAULT
            DemOperationCycleRef = Ignition_on_off
            DemAgingCycleRef = Ignition_on_off
            DemEnableConditionGroupRef = EnableConditionGroup_IgnOn
            DemDebounceAlgorithmClass
              DemDebounceMonitorInternal
        Internal_OMS_CameraShortToBattery: DemEventId=205, DemDTCClassRef=DTCClass_DTC_0x910712
          DemEventClass:
            DemAgingAllowed = true
            DemConsiderPtoStatus = false
            DemEventDestination = DEM_DTC_ORIGIN_PRIMARY_MEMORY
            DemEventPriority = 1
            DemFFPrestorageSupported = false
            DemAgingCycleCounterThreshold = 40
            DemEventSignificance = DEM_EVENT_SIGNIFICANCE_FAULT
            DemOperationCycleRef = Ignition_on_off
            DemAgingCycleRef = Ignition_on_off
            DemEnableConditionGroupRef = EnableConditionGroup_BatteryVoltage4
            DemDebounceAlgorithmClass
              DemDebounceMonitorInternal
        Internal_OMS_CameraShortToGround: DemEventId=199, DemDTCClassRef=DTCClass_DTC_0x910711
          DemEventClass:
            DemAgingAllowed = true
            DemConsiderPtoStatus = false
            DemEventDestination = DEM_DTC_ORIGIN_PRIMARY_MEMORY
            DemEventPriority = 1
            DemFFPrestorageSupported = false
            DemAgingCycleCounterThreshold = 40
            DemEventSignificance = DEM_EVENT_SIGNIFICANCE_FAULT
            DemOperationCycleRef = Ignition_on_off
            DemAgingCycleRef = Ignition_on_off
            DemEnableConditionGroupRef = EnableConditionGroup_IgnOn
            DemDebounceAlgorithmClass
              DemDebounceMonitorInternal
        Speaker_AVAS_CircuitOpen: DemEventId=202, DemDTCClassRef=DTCClass_DTC_0x9A0713
          DemEventClass:
            DemAgingAllowed = true
            DemConsiderPtoStatus = false
            DemEventDestination = DEM_DTC_ORIGIN_PRIMARY_MEMORY
            DemEventPriority = 1
            DemFFPrestorageSupported = false
            DemAgingCycleCounterThreshold = 40
            DemEventSignificance = DEM_EVENT_SIGNIFICANCE_FAULT
            DemOperationCycleRef = Ignition_on_off
            DemAgingCycleRef = Ignition_on_off
            DemEnableConditionGroupRef = EnableConditionGroup_BatteryVoltage
            DemDebounceAlgorithmClass
              DemDebounceMonitorInternal
        Speaker_AVAS_ResistanceOutOfRange: DemEventId=204, DemDTCClassRef=DTCClass_DTC_0x9A071E
          DemEventClass:
            DemAgingAllowed = true
            DemConsiderPtoStatus = false
            DemEventDestination = DEM_DTC_ORIGIN_PRIMARY_MEMORY
            DemEventPriority = 1
            DemFFPrestorageSupported = false
            DemAgingCycleCounterThreshold = 40
            DemEventSignificance = DEM_EVENT_SIGNIFICANCE_FAULT
            DemOperationCycleRef = Ignition_on_off
            DemAgingCycleRef = Ignition_on_off
            DemEnableConditionGroupRef = EnableConditionGroup_BatteryVoltage
            DemDebounceAlgorithmClass
              DemDebounceMonitorInternal
        Speaker_AVAS_ShortAcross: DemEventId=196, DemDTCClassRef=DTCClass_DTC_0x9A0701
          DemEventClass:
            DemAgingAllowed = true
            DemConsiderPtoStatus = false
            DemEventDestination = DEM_DTC_ORIGIN_PRIMARY_MEMORY
            DemEventPriority = 1
            DemFFPrestorageSupported = false
            DemAgingCycleCounterThreshold = 40
            DemEventSignificance = DEM_EVENT_SIGNIFICANCE_FAULT
            DemOperationCycleRef = Ignition_on_off
            DemAgingCycleRef = Ignition_on_off
            DemEnableConditionGroupRef = EnableConditionGroup_BatteryVoltage
            DemDebounceAlgorithmClass
              DemDebounceMonitorInternal
        Speaker_AVAS_ShortToBattery: DemEventId=200, DemDTCClassRef=DTCClass_DTC_0x9A0712
          DemEventClass:
            DemAgingAllowed = true
            DemConsiderPtoStatus = false
            DemEventDestination = DEM_DTC_ORIGIN_PRIMARY_MEMORY
            DemEventPriority = 1
            DemFFPrestorageSupported = false
            DemAgingCycleCounterThreshold = 40
            DemEventSignificance = DEM_EVENT_SIGNIFICANCE_FAULT
            DemOperationCycleRef = Ignition_on_off
            DemAgingCycleRef = Ignition_on_off
            DemEnableConditionGroupRef = EnableConditionGroup_VIPBatteryVoltageAndIgnOn
            DemDebounceAlgorithmClass
              DemDebounceMonitorInternal
        Speaker_AVAS_ShortToGround: DemEventId=198, DemDTCClassRef=DTCClass_DTC_0x9A0711
          DemEventClass:
            DemAgingAllowed = true
            DemConsiderPtoStatus = false
            DemEventDestination = DEM_DTC_ORIGIN_PRIMARY_MEMORY
            DemEventPriority = 1
            DemFFPrestorageSupported = false
            DemAgingCycleCounterThreshold = 40
            DemEventSignificance = DEM_EVENT_SIGNIFICANCE_FAULT
            DemOperationCycleRef = Ignition_on_off
            DemAgingCycleRef = Ignition_on_off
            DemEnableConditionGroupRef = EnableConditionGroup_VIPBatteryVoltageAndIgnOn
            DemDebounceAlgorithmClass
              DemDebounceMonitorInternal
        Speaker_AVAS_WaveformLackFidelity: DemEventId=206, DemDTCClassRef=DTCClass_DTC_0x9A0725
          DemEventClass:
            DemAgingAllowed = true
            DemConsiderPtoStatus = false
            DemEventDestination = DEM_DTC_ORIGIN_PRIMARY_MEMORY
            DemEventPriority = 1
            DemFFPrestorageSupported = false
            DemAgingCycleCounterThreshold = 40
            DemEventSignificance = DEM_EVENT_SIGNIFICANCE_FAULT
            DemOperationCycleRef = Ignition_on_off
            DemAgingCycleRef = Ignition_on_off
            DemEnableConditionGroupRef = EnableConditionGroup_VIPBatteryVoltageAndIgnOn
            DemDebounceAlgorithmClass
              DemDebounceMonitorInternal
      4 x DemDTCClass, all with DemDTCSeverity=DEM_DTC_SEV_NO_SEVERITY, DemImmediateNvStorage=false:
        DTCClass_DTC_0x9A0811: DemUdsDTC=10094609
        DTCClass_DTC_0x9A0812: DemUdsDTC=10094610
        DTCClass_DTC_0x9A0813: DemUdsDTC=10094611
        DTCClass_DTC_0x9A0819: DemUdsDTC=10094617
      8 x DemEventParameter, all with DemEventTimeSeries=DEM_TIMESERIES_SNAPSHOT_NONE, DemEventAvailable=false, DemEventKind=DEM_EVENT_KIND_SWC, DemEventAvailableInVariant=true, DemEventLatchTestFailed=false, DemEventCreateInfoPort=true, DemMaxNumberFreezeFrameRecords=1, DemExtendedDataClassRef=ExtendedDataClass_4f5344cd, DemFreezeFrameClassRef=FreezeFrameClass_80c88891:
        GPS_AntennaOpen: DemEventId=210, DemDTCClassRef=DTCClass_DTC_0x9A0813
          DemEventClass:
            DemAgingAllowed = true
            DemConsiderPtoStatus = false
            DemEventDestination = DEM_DTC_ORIGIN_PRIMARY_MEMORY
            DemEventPriority = 1
            DemFFPrestorageSupported = false
            DemAgingCycleCounterThreshold = 40
            DemEventSignificance = DEM_EVENT_SIGNIFICANCE_FAULT
            DemOperationCycleRef = Ignition_on_off
            DemAgingCycleRef = Ignition_on_off
            DemEnableConditionGroupRef = EnableConditionGroup_VIPBatteryVoltageAndIgnOn
            DemDebounceAlgorithmClass
              DemDebounceMonitorInternal
        GPS_AntennaShortToBattery: DemEventId=212, DemDTCClassRef=DTCClass_DTC_0x9A0812
          DemEventClass:
            DemAgingAllowed = true
            DemConsiderPtoStatus = false
            DemEventDestination = DEM_DTC_ORIGIN_PRIMARY_MEMORY
            DemEventPriority = 1
            DemFFPrestorageSupported = false
            DemAgingCycleCounterThreshold = 40
            DemEventSignificance = DEM_EVENT_SIGNIFICANCE_FAULT
            DemOperationCycleRef = Ignition_on_off
            DemAgingCycleRef = Ignition_on_off
            DemEnableConditionGroupRef = EnableConditionGroup_VIPBatteryVoltage2AndIgnOn
            DemDebounceAlgorithmClass
              DemDebounceMonitorInternal
        GPS_AntennaShortToGround: DemEventId=211, DemDTCClassRef=DTCClass_DTC_0x9A0811
          DemEventClass:
            DemAgingAllowed = true
            DemConsiderPtoStatus = false
            DemEventDestination = DEM_DTC_ORIGIN_PRIMARY_MEMORY
            DemEventPriority = 1
            DemFFPrestorageSupported = false
            DemAgingCycleCounterThreshold = 40
            DemEventSignificance = DEM_EVENT_SIGNIFICANCE_FAULT
            DemOperationCycleRef = Ignition_on_off
            DemAgingCycleRef = Ignition_on_off
            DemEnableConditionGroupRef = EnableConditionGroup_VIPBatteryVoltageAndIgnOn
            DemDebounceAlgorithmClass
              DemDebounceMonitorInternal
        GPS_OverCurrent: DemEventId=213, DemDTCClassRef=DTCClass_DTC_0x9A0819
          DemEventClass:
            DemAgingAllowed = true
            DemConsiderPtoStatus = false
            DemEventDestination = DEM_DTC_ORIGIN_PRIMARY_MEMORY
            DemEventPriority = 1
            DemFFPrestorageSupported = false
            DemAgingCycleCounterThreshold = 40
            DemEventSignificance = DEM_EVENT_SIGNIFICANCE_FAULT
            DemOperationCycleRef = Ignition_on_off
            DemAgingCycleRef = Ignition_on_off
            DemEnableConditionGroupRef = EnableConditionGroup_VIPBatteryVoltageAndIgnOn
            DemDebounceAlgorithmClass
              DemDebounceMonitorInternal
        SVC_CameraShortToGround: DemEventId=214, DemDTCClassRef=DTCClass_DTC_0x910811
          DemEventClass:
            DemAgingAllowed = true
            DemConsiderPtoStatus = false
            DemEventDestination = DEM_DTC_ORIGIN_PRIMARY_MEMORY
            DemEventPriority = 1
            DemFFPrestorageSupported = false
            DemAgingCycleCounterThreshold = 40
            DemEventSignificance = DEM_EVENT_SIGNIFICANCE_FAULT
            DemOperationCycleRef = Ignition_on_off
            DemAgingCycleRef = Ignition_on_off
            DemEnableConditionGroupRef = EnableConditionGroup_IgnOn
            DemDebounceAlgorithmClass
              DemDebounceMonitorInternal
        SVC_CameraShortToBattery: DemEventId=215, DemDTCClassRef=DTCClass_DTC_0x910812
          DemEventClass:
            DemAgingAllowed = true
            DemConsiderPtoStatus = false
            DemEventDestination = DEM_DTC_ORIGIN_PRIMARY_MEMORY
            DemEventPriority = 1
            DemFFPrestorageSupported = false
            DemAgingCycleCounterThreshold = 40
            DemEventSignificance = DEM_EVENT_SIGNIFICANCE_FAULT
            DemOperationCycleRef = Ignition_on_off
            DemAgingCycleRef = Ignition_on_off
            DemEnableConditionGroupRef = EnableConditionGroup_BatteryVoltage3
            DemDebounceAlgorithmClass
              DemDebounceMonitorInternal
        SVC_CameraOpen: DemEventId=216, DemDTCClassRef=DTCClass_DTC_0x910813
          DemEventClass:
            DemAgingAllowed = true
            DemConsiderPtoStatus = false
            DemEventDestination = DEM_DTC_ORIGIN_PRIMARY_MEMORY
            DemEventPriority = 1
            DemFFPrestorageSupported = false
            DemAgingCycleCounterThreshold = 40
            DemEventSignificance = DEM_EVENT_SIGNIFICANCE_FAULT
            DemOperationCycleRef = Ignition_on_off
            DemAgingCycleRef = Ignition_on_off
            DemEnableConditionGroupRef = EnableConditionGroup_IgnOn
            DemDebounceAlgorithmClass
              DemDebounceMonitorInternal
        Lost_communication_with_SVC_Missing_Message: DemEventId=217, DemDTCClassRef=DTCClass_DTC_0x910887
          DemEventClass:
            DemAgingAllowed = true
            DemConsiderPtoStatus = false
            DemEventDestination = DEM_DTC_ORIGIN_PRIMARY_MEMORY
            DemEventPriority = 1
            DemFFPrestorageSupported = false
            DemAgingCycleCounterThreshold = 40
            DemEventSignificance = DEM_EVENT_SIGNIFICANCE_FAULT
            DemOperationCycleRef = Ignition_on_off
            DemAgingCycleRef = Ignition_on_off
            DemEnableConditionGroupRef = EnableConditionGroup_IgnOn
            DemDebounceAlgorithmClass
              DemDebounceMonitorInternal
      11 x DemDTCClass, all with DemDTCSeverity=DEM_DTC_SEV_NO_SEVERITY, DemImmediateNvStorage=false:
        DTCClass_DTC_0x910811: DemUdsDTC=9504785
        DTCClass_DTC_0x910812: DemUdsDTC=9504786
        DTCClass_DTC_0x910813: DemUdsDTC=9504787
        DTCClass_DTC_0x910887: DemUdsDTC=9504903
        DTCClass_DTC_0xc15187: DemUdsDTC=12669319
        DTCClass_DTC_0xc14087: DemUdsDTC=12664967
        DTCClass_DTC_0xC15C40: DemUdsDTC=12672064
        DTCClass_DTC_0xC14340: DemUdsDTC=12665664
        DTCClass_DTC_0xC15D40: DemUdsDTC=12672320
        DTCClass_DTC_0xC10140: DemUdsDTC=12648768
        DTCClass_DTC_0xC41640: DemUdsDTC=12850752
      5 x DemEventParameter, all with DemEventTimeSeries=DEM_TIMESERIES_SNAPSHOT_NONE, DemEventAvailable=false, DemEventKind=DEM_EVENT_KIND_SWC, DemEventAvailableInVariant=true, DemEventLatchTestFailed=false, DemEventCreateInfoPort=true, DemMaxNumberFreezeFrameRecords=1, DemExtendedDataClassRef=ExtendedDataClass_4f5344cd, DemFreezeFrameClassRef=FreezeFrameClass_80c88891:
        SecOC_Security_PDU_Verification_Failed_from_IDC_L2: DemEventId=218, DemDTCClassRef=DTCClass_DTC_0xC15C40
          DemEventClass:
            DemAgingAllowed = true
            DemConsiderPtoStatus = false
            DemEventDestination = DEM_DTC_ORIGIN_PRIMARY_MEMORY
            DemEventPriority = 1
            DemFFPrestorageSupported = false
            DemAgingCycleCounterThreshold = 40
            DemEventSignificance = DEM_EVENT_SIGNIFICANCE_FAULT
            DemOperationCycleRef = Ignition_on_off
            DemAgingCycleRef = Ignition_on_off
            DemEnableConditionGroupRef = EnableConditionGroup_IgnOn
            DemDebounceAlgorithmClass
              DemDebounceMonitorInternal
        SecOC_Security_PDU_Verification_Failed_from_IDC_L3: DemEventId=219, DemDTCClassRef=DTCClass_DTC_0xC15D40
          DemEventClass:
            DemAgingAllowed = true
            DemConsiderPtoStatus = false
            DemEventDestination = DEM_DTC_ORIGIN_PRIMARY_MEMORY
            DemEventPriority = 1
            DemFFPrestorageSupported = false
            DemAgingCycleCounterThreshold = 40
            DemEventSignificance = DEM_EVENT_SIGNIFICANCE_FAULT
            DemOperationCycleRef = Ignition_on_off
            DemAgingCycleRef = Ignition_on_off
            DemEnableConditionGroupRef = EnableConditionGroup_IgnOn
            DemDebounceAlgorithmClass
              DemDebounceMonitorInternal
        SecOC_Security_PDU_Verification_Failed_from_IFC: DemEventId=220, DemDTCClassRef=DTCClass_DTC_0xC14340
          DemEventClass:
            DemAgingAllowed = true
            DemConsiderPtoStatus = false
            DemEventDestination = DEM_DTC_ORIGIN_PRIMARY_MEMORY
            DemEventPriority = 1
            DemFFPrestorageSupported = false
            DemAgingCycleCounterThreshold = 40
            DemEventSignificance = DEM_EVENT_SIGNIFICANCE_FAULT
            DemOperationCycleRef = Ignition_on_off
            DemAgingCycleRef = Ignition_on_off
            DemEnableConditionGroupRef = EnableConditionGroup_IgnOn
            DemDebounceAlgorithmClass
              DemDebounceMonitorInternal
        SecOC_Security_PDU_Verification_Failed_from_TCU: DemEventId=221, DemDTCClassRef=DTCClass_DTC_0xC10140
          DemEventClass:
            DemAgingAllowed = true
            DemConsiderPtoStatus = false
            DemEventDestination = DEM_DTC_ORIGIN_PRIMARY_MEMORY
            DemEventPriority = 1
            DemFFPrestorageSupported = false
            DemAgingCycleCounterThreshold = 40
            DemEventSignificance = DEM_EVENT_SIGNIFICANCE_FAULT
            DemOperationCycleRef = Ignition_on_off
            DemAgingCycleRef = Ignition_on_off
            DemEnableConditionGroupRef = EnableConditionGroup_IgnOn
            DemDebounceAlgorithmClass
              DemDebounceMonitorInternal
        SecOC_Security_PDU_Verification_Failed_from_ESP: DemEventId=222, DemDTCClassRef=DTCClass_DTC_0xC41640
          DemEventClass:
            DemAgingAllowed = true
            DemConsiderPtoStatus = false
            DemEventDestination = DEM_DTC_ORIGIN_PRIMARY_MEMORY
            DemEventPriority = 1
            DemFFPrestorageSupported = false
            DemAgingCycleCounterThreshold = 40
            DemEventSignificance = DEM_EVENT_SIGNIFICANCE_FAULT
            DemOperationCycleRef = Ignition_on_off
            DemAgingCycleRef = Ignition_on_off
            DemEnableConditionGroupRef = EnableConditionGroup_IgnOn
            DemDebounceAlgorithmClass
              DemDebounceMonitorInternal
      DTCClass_DTC_0xd12387 (DemDTCClass): DemDTCSeverity=DEM_DTC_SEV_NO_SEVERITY, DemUdsDTC=13706119, DemImmediateNvStorage=false
      Lost_Communication_With_Depth_Of_Water_Detection_Module (DemEventParameter):
        DemEventTimeSeries = DEM_TIMESERIES_SNAPSHOT_NONE
        DemEventAvailable = false
        DemEventId = 223
        DemEventKind = DEM_EVENT_KIND_SWC
        DemEventAvailableInVariant = true
        DemEventLatchTestFailed = false
        DemEventCreateInfoPort = true
        DemMaxNumberFreezeFrameRecords = 1
        DemExtendedDataClassRef = ExtendedDataClass_4f5344cd
        DemFreezeFrameClassRef = FreezeFrameClass_80c88891
        DemDTCClassRef = DTCClass_DTC_0xd12387
        DemEventClass:
          DemAgingAllowed = true
          DemConsiderPtoStatus = false
          DemEventDestination = DEM_DTC_ORIGIN_PRIMARY_MEMORY
          DemEventPriority = 1
          DemFFPrestorageSupported = false
          DemAgingCycleCounterThreshold = 40
          DemEventSignificance = DEM_EVENT_SIGNIFICANCE_FAULT
          DemOperationCycleRef = Ignition_on_off
          DemAgingCycleRef = Ignition_on_off
          DemEnableConditionGroupRef = EnableConditionGroup_VIPBatteryVoltageAndIgnOn
          DemDebounceAlgorithmClass
            DemDebounceMonitorInternal
      DTCClass_DTC_0xF01200 (DemDTCClass): DemDTCSeverity=DEM_DTC_SEV_NO_SEVERITY, DemUdsDTC=15733248, DemImmediateNvStorage=false
      AbnormalWakeupSleep (DemEventParameter):
        DemEventTimeSeries = DEM_TIMESERIES_SNAPSHOT_NONE
        DemEventAvailable = false
        DemEventId = 224
        DemEventKind = DEM_EVENT_KIND_SWC
        DemEventAvailableInVariant = true
        DemEventLatchTestFailed = false
        DemEventCreateInfoPort = true
        DemMaxNumberFreezeFrameRecords = 1
        DemExtendedDataClassRef = ExtendedDataClass_4f5344cd
        DemFreezeFrameClassRef = FreezeFrameClass_80c88891
        DemDTCClassRef = DTCClass_DTC_0xF01200
        DemEventClass:
          DemAgingAllowed = true
          DemConsiderPtoStatus = false
          DemEventDestination = DEM_DTC_ORIGIN_PRIMARY_MEMORY
          DemEventPriority = 1
          DemFFPrestorageSupported = false
          DemAgingCycleCounterThreshold = 40
          DemEventSignificance = DEM_EVENT_SIGNIFICANCE_FAULT
          DemOperationCycleRef = Ignition_on_off
          DemAgingCycleRef = Ignition_on_off
          DemDebounceAlgorithmClass
            DemDebounceMonitorInternal
    DemGeneral:
      DemAgingCycleCounterProcessing = DEM_PROCESS_AGINGCTR_INTERN
      DemDebounceCounterBasedSupport = true
      DemDebounceTimeBasedSupport = false
      DemDtcStatusAvailabilityMask = 123
      DemEnableConditionSupport = true
      DemMaxNumberEventEntryMirror = 0
      DemPTOSupport = false
      DemTypeOfFreezeFrameRecordNumeration = DEM_FF_RECNUM_CALCULATED
      DemGeneralInterfaceSupport = false
      DemDataElementDefaultEndianness = LITTLE_ENDIAN
      DemAgingRequieresTestedCycle = false
      DemTriggerMonitorInitBeforeClearOk = true
      DemExtendedDataCapture = DEM_TRIGGER_EVENT_MEMORY_STORAGE
      DemFreezeFrameCapture = DEM_TRIGGER_EVENT_MEMORY_STORAGE
      DemOperationCycleProcessing = DEM_PROCESS_OPCYC_STATE
      DemMaxNumberTimeSeriesSnapshots = 0
      DemAvailabilitySupport = DEM_EVENT_AVAILABILITY
      DemAvailabilityStorage = false
      DemBswErrorBufferSize = 0
      DemClearDTCBehavior = DEM_CLRRESP_NONVOLATILE_FINISH
      DemClearDTCLimitation = DEM_ALL_SUPPORTED_DTCS
      DemDevErrorDetect = true
      DemEventCombinationSupport = DEM_EVCOMB_DISABLED
      DemEventDisplacementStrategy = DEM_DISPLACEMENT_LEGACY_403
      DemEventMemoryEntryStorageTrigger = DEM_STORAGE_ON_CONFIRMED
      DemMaxNumberEventEntryOBDFreezeFrame = 0
      DemMaxNumberEventEntryPermanent = 0
      DemMaxNumberEventEntryPrimary = 20
      DemMaxNumberEventEntrySecondary = 0
      DemMaxNumberPrestoredFF = 0
      DemOBDSupport = DEM_OBD_NO_OBD_SUPPORT
      DemOccurrenceCounterProcessing = DEM_PROCESS_OCCCTR_CDTC
      DemOperationCycleStatusStorage = true
      DemResetConfirmedBitOnOverflow = true
      DemStatusBitHandlingTestFailedSinceLastClear = DEM_STATUS_BIT_NORMAL
      DemStatusBitStorageTestFailed = false
      DemStorageConditionSupport = false
      DemSuppressionSupport = DEM_DTC_SUPPRESSION
      DemTaskTime = 0.01
      DemTriggerDcmReports = false
      DemTriggerDltReports = false
      DemTriggerFiMReports = false
      DemTriggerFiMReportsExtended = false
      DemTriggerMonitorInitForEnableConditions = false
      DemTypeOfDTCSupported = DEM_DTC_TRANSLATION_ISO15031_6
      DemVersionInfoApi = false
      DemBswApiVersion = DEM_BSW_API_4_XX_XX
      DemBswApiVersionNvM = DEM_BSW_API_4_XX_XX
      DemBswApiVersionFiM = DEM_BSW_API_4_XX_XX
      DemAgingAfterHealing = DEM_AGING_WHILE_HEALING
      DemAgingBehavior = DEM_AGING_TYPE_1
      DemAgingCounterBehavior = DEM_AGING_COUNT_ALWAYS
      DemAgingCounterReporting = DEM_AGING_NORMAL_REPORTING
      DemAgingRetainEnvironmentalData = false
      DemCompiledPostbuildCrc = 1407157381
      DemCompiledPostbuildCrcMode = DEM_POSTBUILD_CRC_AUTOMATIC
      DemEventDisplacementFallbackStrategy = DEM_FALLBACK_DISCARD_NEW_EVENT
      DemGeneralDiagnosticInfoSupport = true
      DemJ1939Support = false
      DemNvSynchronizeSupport = false
      DemPendingDtcProcessing = DEM_PROCESS_PDTC_ALL_DTC
      DemResetDebounceBehavior = DEM_RESET_DEBOUNCE_ON_DISABLE_ENABLE_CONDITIONS
      DemResetTestFailedOnOperationCycleStart = true
      DemRetryStorageSupport = true
      DemSafeBswChecks = false
      DemUseMemcopyMacros = false
      DemUseRte = true
      DemUserControlledWirBehavior = DEM_ENABLED_DURING_CONTROLDTCSETTING
      DemUserDefinedCompareAndSwap = false
      DemWarningIndicatorRequestedProcessing = DEM_PROCESS_WIR_STOREDONLY
      DemUseMultiPartitionFiM = false
      DemReportSuppressedDTCsInService19x0A = false
      DemSupportAgingForAllDTCs = false
      DemLatchTestFailedBehavior = DEM_LATCH_TF_ONLY_THIS_CYCLE
      DemDcmSupport = true
      DemEvMemOverflowIndicationSupport = true
      DemExtendedDataVisibility = DEM_VISIBILITY_STOREDONLY
      ExtendedDataClass_4f5344cd (DemExtendedDataClass): DemExtendedDataRecordClassRef=DTCOccurrenceCounter, DemExtendedDataRecordClassRef=SelfAgingCounter
      DemPostbuild: DemEventAvailableDefaultSupport=false, DemMaxSizeFreezeFrame=16, DemMaxNumberDtr=0, DemMaxSizeGlobalFreezeFrame=0
      Ignition_on_off (DemOperationCycle): DemOperationCycleAutostart=true, DemOperationCycleType=DEM_OPCYC_IGNITION, DemOperationCycleAutomaticEnd=false
      DID_0xd004_Odometer (DemDataClass):
        DemDataElementDataSize = 3
        DemDataElementDataType = UINT8_N
        DemDataElementEndianness = opaque
        DemDataElementUsePort = USE_DATA_CLIENT_SERVER_PORT
        DemDataElementStoreNonVolatile = true
      EnableConditionGroup_PowerModeOn (DemEnableConditionGroup): DemEnableConditionRef=PowerModeOn
      DID_0xd003_OperatingVoltage (DemDataClass): DemDataElementDataSize=1, DemDataElementDataType=UINT8, DemDataElementUsePort=USE_DATA_CLIENT_SERVER_PORT, DemDataElementStoreNonVolatile=true
      DemEventMemorySet
        DemClearDTCNotification_Start (DemClearDTCNotification): DemClearDtcNotificationTime=START
        DemClearDTCNotification_Finish (DemClearDTCNotification): DemClearDtcNotificationTime=FINISH
      ActualRotationSpeed (DemDidClass): DemDidIdentifier=53254, DemDidDataClassRef=DID_0xd006_ActualRotationSpeed
      DID_0xd002_EngineSpeed (DemDataClass):
        DemDataElementDataSize = 2
        DemDataElementDataType = UINT16
        DemDataElementEndianness = BIG_ENDIAN
        DemDataElementUsePort = USE_DATA_CLIENT_SERVER_PORT
        DemDataElementStoreNonVolatile = true
      EnableConditionGroup_IgnOn (DemEnableConditionGroup): DemEnableConditionRef=IgnOn
      IgnOn (DemEnableCondition): DemEnableConditionStatus=false, DemEnableConditionId=5
      PowerModeOn (DemEnableCondition): DemEnableConditionStatus=false, DemEnableConditionId=6
      DTCOccurrenceCounter (DemExtendedDataRecordClass): DemExtendedDataRecordNumber=1, DemDataClassRef=DTCOccurrenceCounter_DTCOccurrenceCounter
      Wakeup (DemEnableCondition): DemEnableConditionStatus=false, DemEnableConditionId=7
      EngineSpeed (DemDidClass): DemDidIdentifier=53250, DemDidDataClassRef=DID_0xd002_EngineSpeed
      SelfAgingCounter (DemExtendedDataRecordClass): DemExtendedDataRecordNumber=2, DemDataClassRef=SelfAgingCounter_SelfAgingCounter
      EnableConditionGroup_Wakeup (DemEnableConditionGroup): DemEnableConditionRef=Wakeup
      DTCOccurrenceTimer (DemDidClass): DemDidIdentifier=53253, DemDidDataClassRef=DID_0xd005_DTC_Occurrence_Timer
      DID_0xd001_Vehicle_Speed (DemDataClass):
        DemDataElementDataSize = 2
        DemDataElementDataType = UINT16
        DemDataElementEndianness = BIG_ENDIAN
        DemDataElementUsePort = USE_DATA_CLIENT_SERVER_PORT
        DemDataElementStoreNonVolatile = true
      DTCOccurrenceCounter_DTCOccurrenceCounter (DemDataClass):
        DemDataElementDataSize = 1
        DemDataElementDataType = UINT8
        DemDataElementUsePort = USE_DATA_INTERNAL
        DemDataElementStoreNonVolatile = true
        DemDataElementInternalData = DEM_OCCCTR
      VehicleSpeed (DemDidClass): DemDidIdentifier=53249, DemDidDataClassRef=DID_0xd001_Vehicle_Speed
      DID_0xd006_ActualRotationSpeed (DemDataClass):
        DemDataElementDataSize = 2
        DemDataElementDataType = UINT16
        DemDataElementEndianness = BIG_ENDIAN
        DemDataElementUsePort = USE_DATA_CLIENT_SERVER_PORT
        DemDataElementStoreNonVolatile = true
      OperatingVoltage (DemDidClass): DemDidIdentifier=53251, DemDidDataClassRef=DID_0xd003_OperatingVoltage
      SelfAgingCounter_SelfAgingCounter (DemDataClass):
        DemDataElementDataSize = 1
        DemDataElementDataType = UINT8
        DemDataElementUsePort = USE_DATA_INTERNAL
        DemDataElementStoreNonVolatile = true
        DemDataElementInternalData = DEM_AGINGCTR
      DID_0xd005_DTC_Occurrence_Timer (DemDataClass):
        DemDataElementDataSize = 4
        DemDataElementDataType = UINT32
        DemDataElementEndianness = BIG_ENDIAN
        DemDataElementUsePort = USE_DATA_CLIENT_SERVER_PORT
        DemDataElementStoreNonVolatile = true
      FreezeFrameClass_80c88891 (DemFreezeFrameClass):
        DemDidClassRef = VehicleSpeed
        DemDidClassRef = EngineSpeed
        DemDidClassRef = OperatingVoltage
        DemDidClassRef = Odometer
        DemDidClassRef = DTCOccurrenceTimer
        DemDidClassRef = ActualRotationSpeed
        DemDidClassRef = ActualRotationSpeed02
      Odometer (DemDidClass): DemDidIdentifier=53252, DemDidDataClassRef=DID_0xd004_Odometer
      DemClient: DemClientId=0
      22 x DemNvRamBlockId:
        Dem_AdminData: DemNvRamBlockIdType=DEM_NVBLOCK_ADMIN, DemNvRamBlockIdRef=DemAdminDataBlock
        Dem_StatusData: DemNvRamBlockIdType=DEM_NVBLOCK_STATUS, DemNvRamBlockIdRef=DemStatusDataBlock
        Dem_PrimaryEntry{0..7}: DemNvRamBlockIdType=DEM_NVBLOCK_PRIMARY, DemNvRamBlockIdIndex={0..7}, DemNvRamBlockIdRef=DemPrimaryDataBlock{0..7}
        Dem_PrimaryEntry{10..19}: DemNvRamBlockIdType=DEM_NVBLOCK_PRIMARY, DemNvRamBlockIdIndex={10..19}, DemNvRamBlockIdRef=DemPrimaryDataBlock{10..19}
        Dem_PrimaryEntry8: DemNvRamBlockIdType=DEM_NVBLOCK_PRIMARY, DemNvRamBlockIdIndex=8, DemNvRamBlockIdRef=DemPrimaryDataBlock8
        Dem_PrimaryEntry9: DemNvRamBlockIdType=DEM_NVBLOCK_PRIMARY, DemNvRamBlockIdIndex=9, DemNvRamBlockIdRef=DemPrimaryDataBlock9
      Power_up_down (DemOperationCycle): DemOperationCycleAutostart=true, DemOperationCycleType=DEM_OPCYC_POWER, DemOperationCycleAutomaticEnd=false
      BatteryVoltag (DemEnableCondition): DemEnableConditionId=1, DemEnableConditionStatus=false
      EnableConditionGroup_VIPBatteryVoltageAndIgnOn (DemEnableConditionGroup): DemEnableConditionRef=BatteryVoltag, DemEnableConditionRef=IgnOn
      ActualRotationSpeed02 (DemDidClass): DemDidIdentifier=53255, DemDidDataClassRef=DID_0xd007_ActualRotationSpeed02
      DID_0xd007_ActualRotationSpeed02 (DemDataClass):
        DemDataElementDataSize = 2
        DemDataElementDataType = UINT16
        DemDataElementEndianness = opaque
        DemDataElementUsePort = USE_DATA_CLIENT_SERVER_PORT
        DemDataElementStoreNonVolatile = true
      BatteryVoltag2 (DemEnableCondition): DemEnableConditionId=2, DemEnableConditionStatus=false
      3 x DemEnableConditionGroup:
        EnableConditionGroup_BatteryVoltage: DemEnableConditionRef=BatteryVoltag
        EnableConditionGroup_BatteryVoltage2: DemEnableConditionRef=BatteryVoltag2
        EnableConditionGroup_VIPBatteryVoltage2AndIgnOn: DemEnableConditionRef=BatteryVoltag2, DemEnableConditionRef=IgnOn
      BatteryVoltag3 (DemEnableCondition): DemEnableConditionId=3, DemEnableConditionStatus=false
      BatteryVoltag4 (DemEnableCondition): DemEnableConditionId=4, DemEnableConditionStatus=false
      EnableConditionGroup_BatteryVoltage3 (DemEnableConditionGroup): DemEnableConditionRef=BatteryVoltag3
      EnableConditionGroup_BatteryVoltage4 (DemEnableConditionGroup): DemEnableConditionRef=BatteryVoltag4
