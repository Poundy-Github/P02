AUTOSAR XML (schema 00046)
package /ActiveEcuC
  module config Pwm: implementation-config-variant=VARIANT-POST-BUILD, module-description=Pwm_Impl
    PwmChannelConfigSet0 (PwmChannelConfigSet)
      PwmDiagUnit0 (PwmDiagUnit): PwmDiagBaudRateClk0=1, PwmDiagBaudRateClk1=2, PwmDiagBaudRateClk2=3, PwmDiagBaudRateClk3=4, PwmDiagCounterPeriod=4095
      PwmDiagChannel0 (PwmDiagChannel):
        PwmDiagChannelId = 10
        PwmDiagDutycycleDefault = 8192
        PwmDiagOutputSelection = DIAG_CH00
        PwmDiagClk = PWMCLK0
        PwmOffset = 2000
        PwmTriggerDelay = 767
        PwmSyncStartReq = false
        PwmComplexDriverInit = false
        PwmPolarity = PWM_HIGH
        PwmNotification = PwmDiag_Notif0
        PwmOffsetDelayAdjust = false
        PwmIntrPriority = false
        PwmDiagPeriodSelection = CONFIGURED_BY_PWSAPRD
        PwmTcbrUpdateTiming = TCBR_UPDATE_RISING_EDGE
        PwmTrgoutCondition = TRGOUT_HIGH_LEVEL
        PwmDiagLoopCount = 10000
      PwmTaUnit_TAUJ3 (PwmTaUnit):
        PwmPrescalerCk0 = PCLK_DIVBY_2_POWOF_3
        PwmPrescalerCk1 = PCLK_DIVBY_2_POWOF_6
        PwmPrescalerCk2 = PCLK_DIVBY_2_POWOF_0
        PwmPrescalerCk3BaudRate = 255
        PwmPrescalerCk3Pre = PCLK_DIVBY_2_POWOF_15
        PwmTaUnitSelection = TAUJ3
      4 x PwmChannel, all with PwmChannelClass=PWM_VARIABLE_PERIOD, PwmDutycycleDefault=0, PwmIdleState=PWM_LOW, PwmPolarity=PWM_HIGH, PwmComplexDriverInit=false, PwmIntrPriority=false, PwmSyncStartReq=false, PwmNotification=NULL, PwmMcuClockReferencePoint=McuClockReferencePoint_TAUJ_1_3:
        VIP_ETN_1V_SYNC_MASTER: PwmChannelId=2, PwmPeriodDefault=32, PwmChannelClk=CK2, PwmTimerChannelSelection=TAUJ3O2, PwmTimerMode=PWM_MASTER_CHANNEL
        VIP_ETN_1V_SYNC_SLAVE: PwmChannelId=3, PwmPeriodDefault=32, PwmChannelClk=CK2, PwmTimerChannelSelection=TAUJ3O3, PwmTimerMode=PWM_SLAVE_CHANNEL
        VIP_USB1_SYNC_MASTER: PwmChannelId=0, PwmPeriodDefault=1000, PwmChannelClk=CK0, PwmTimerChannelSelection=TAUJ3O0, PwmTimerMode=PWM_MASTER_CHANNEL
        VIP_USB1_SYNC_SLAVE: PwmChannelId=1, PwmPeriodDefault=1000, PwmChannelClk=CK0, PwmTimerChannelSelection=TAUJ3O1, PwmTimerMode=PWM_SLAVE_CHANNEL
      PwmTaUnit_TAUJ1 (PwmTaUnit):
        PwmPrescalerCk0 = PCLK_DIVBY_2_POWOF_0
        PwmPrescalerCk1 = PCLK_DIVBY_2_POWOF_15
        PwmPrescalerCk2 = PCLK_DIVBY_2_POWOF_15
        PwmPrescalerCk3BaudRate = 255
        PwmPrescalerCk3Pre = PCLK_DIVBY_2_POWOF_15
        PwmTaUnitSelection = TAUJ1
      PwmTaUnit_TAUB0 (PwmTaUnit):
        PwmPrescalerCk0 = PCLK_DIVBY_2_POWOF_0
        PwmPrescalerCk1 = PCLK_DIVBY_2_POWOF_15
        PwmPrescalerCk2 = PCLK_DIVBY_2_POWOF_15
        PwmPrescalerCk3BaudRate = 255
        PwmPrescalerCk3Pre = PCLK_DIVBY_2_POWOF_15
        PwmTaUnitSelection = TAUB0
      4 x PwmChannel, all with PwmChannelClass=PWM_VARIABLE_PERIOD, PwmPeriodDefault=80, PwmChannelClk=CK0, PwmComplexDriverInit=false, PwmIntrPriority=false, PwmSyncStartReq=false, PwmNotification=:
        VIP_PWR_VG10V_SYNC_MASTER: PwmChannelId=4, PwmDutycycleDefault=32768, PwmIdleState=PWM_HIGH, PwmPolarity=PWM_HIGH, PwmTimerChannelSelection=TAUJ1O0, PwmTimerMode=PWM_MASTER_CHANNEL, PwmMcuClockReferencePoint=McuClockReferencePoint_TAUJ_1_3
        VIP_PWR_VG10V_SYNC_SLAVE: PwmChannelId=5, PwmDutycycleDefault=32768, PwmIdleState=PWM_HIGH, PwmPolarity=PWM_HIGH, PwmTimerChannelSelection=TAUJ1O1, PwmTimerMode=PWM_SLAVE_CHANNEL, PwmMcuClockReferencePoint=McuClockReferencePoint_TAUJ_1_3
        VIP_VD3V3_SYNC_MASTER: PwmChannelId=6, PwmDutycycleDefault=0, PwmIdleState=PWM_LOW, PwmPolarity=PWM_LOW, PwmTimerChannelSelection=TAUB0O0, PwmTimerMode=PWM_MASTER_CHANNEL, PwmMcuClockReferencePoint=McuClockReferencePoint_TAUB
        VIP_VD3V3_SYNC_SLAVE: PwmChannelId=7, PwmDutycycleDefault=0, PwmIdleState=PWM_LOW, PwmPolarity=PWM_LOW, PwmTimerChannelSelection=TAUB0O1, PwmTimerMode=PWM_SLAVE_CHANNEL, PwmMcuClockReferencePoint=McuClockReferencePoint_TAUB
    PwmConfigurationOfOptApiServices:
      PwmDeInitApi = true
      PwmGetOutputState = true
      PwmSetDutyCycle = true
      PwmSetOutputToIdle = true
      PwmSetPeriodAndDuty = true
      PwmVersionInfoApi = false
      PwmSetTriggerDelay = true
      PwmSelectChannelClk = true
      PwmSetChannelOutput = true
      PwmControlTriggerOutput = true
    PwmGeneral:
      PwmDevErrorDetect = false
      PwmDutycycleUpdatedEndperiod = true
      PwmIndex = 0
      PwmNotificationSupported = false
      PwmPeriodUpdatedEndperiod = false
      PwmAlreadyInitDetCheck = true
      PwmClearPendingInterrupts = true
      PwmCriticalSectionProtection = true
      PwmDeviceName = R7F701651
      PwmDiagnosticSupport = false
      PwmPWGARamMirror = DISABLE
      PwmPWGAWriteVerify = WV_DISABLE
      PwmSyncStartSupport = false
      PwmTAUDBRamMirror = DISABLE
      PwmTAUDBWriteVerify = WV_DISABLE
      PwmTAUJRamMirror = DISABLE
      PwmTAUJWriteVerify = WV_DISABLE
      PwmUseWriteVerifyErrorInterface = false
      PwmVersionCheckExternalModules = false
      PwmWriteVerifyErrorInterface = NULL
      PwmPowerStateConfig: PwmPowerState=0, PwmPowerStateReadyCbkRef=NULL
    PwmDemEventParameterRefs:
      PWM_E_DIAG_FAILURE = AutoCreatedDemEvent_PwmDemEventParameterRefs_PWM_E_DIAG_FAILURE
      PWM_E_TIMER_FAILURE = AutoCreatedDemEvent_PwmDemEventParameterRefs_PWM_E_TIMER_FAILURE
      PWM_E_TIMEOUT_FAILURE = AutoCreatedDemEvent_PwmDemEventParameterRefs_PWM_E_TIMEOUT_FAILURE
      PWM_E_REWRITE_FAILED = AutoCreatedDemEvent_PwmDemEventParameterRefs_PWM_E_REWRITE_FAILED
      PWM_E_REG_WRITE_VERIFY = AutoCreatedDemEvent_PwmDemEventParameterRefs_PWM_E_REG_WRITE_VERIFY
