AUTOSAR XML (schema 00046)
package /ActiveEcuC
  module config CanTp: implementation-config-variant=VARIANT-PRE-COMPILE, module-description=CanTp_Impl
    CanTpGeneral:
      CanTpChangeParameterApi = false
      CanTpDevErrorDetect = true
      CanTpPaddingByte = 204
      CanTpReadParameterApi = false
      CanTpVersionInfoApi = false
      CanTpPaddingActive = true
      CanTpHavePaddingByte = true
      CanTpNumRxChannels = 0
      CanTpNumTxChannels = 0
      CanTpEnableSplitMainFunction = false
      CanTpSupportStandardAddressing = true
      CanTpSupportExtendedAddressing = false
      CanTpSupportMixed11Addressing = false
      CanTpSupportMixed29Addressing = false
      CanTpSupportNormalFixedAddressing = false
      CanTpOnlyNotifyInformedAppl = true
      CanTpRc = false
      CanTpTc = false
      CanTpSafeBswChecks = false
      CanTpEnableConstantBS = true
      CanTpEnableTransmitQueue = true
      CanTpUseOnlyFirstFc = true
      CanTpFlexibleDataRateSupport = true
      CanTpSupportedLowerLayers = CANTP_LOWER_LAYER_CANIF
      CanTpSupportLongFirstFrames = true
    CanTpConfig: CanTpMainFunctionPeriod=0.005
      4 x CanTpChannel, all with CanTpChannelMode=CANTP_MODE_FULL_DUPLEX:
        TPCH_57cc351d
          CanTpRxNSdu_3e4fc4df (CanTpRxNSdu):
            CanTpRxAddressingFormat = CANTP_STANDARD
            CanTpRxDl = 8
            CanTpRxTaType = CANTP_CANFD_FUNCTIONAL
            CanTpNbr = 0.1
            CanTpRxNSduId = 2
            CanTpRxPaddingActivation = CANTP_ON
            CanTpRxNSduRef = DiagFuncReq_oB30_for_SC_CAN_V3_2_93239eac_Rx
            CanTpRxNPdu_4ba4a7e4 (CanTpRxNPdu): CanTpRxNPduId=3, CanTpRxNPduRef=DiagFuncReq_Tp_oB30_for_SC_CAN_V3_2_16517e6b_Rx
        TPCH_5e9a88a8
          CanTpTxNSdu_5a6f1069 (CanTpTxNSdu):
            CanTpTxAddressingFormat = CANTP_STANDARD
            CanTpTxDl = 8
            CanTpTxTaType = CANTP_PHYSICAL
            CanTpNas = 0.025
            CanTpNcs = 0.045
            CanTpTc = false
            CanTpTxNSduId = 1
            CanTpTxPaddingActivation = CANTP_ON
            CanTpNbs = 0.075
            CanTpTxNSduRef = HUT_Phy_Resp_oB30_for_SC_CAN_V3_2_20_e2aa5bb4_Tx
            CanTpRxFcNPdu_2185859a (CanTpRxFcNPdu): CanTpRxFcNPduId=0, CanTpRxFcNPduRef=HUT_Phy_Req_Tp_oB30_for_SC_CAN_V3_2_20_200e5e76_Rx
            CanTpTxNPdu_2185859a (CanTpTxNPdu): CanTpTxNPduConfirmationPduId=0, CanTpTxNPduRef=HUT_Phy_Resp_Tp_oB30_for_SC_CAN_V3_2_20_4bbb4ddf_Tx
          CanTpRxNSdu_5a6f1069 (CanTpRxNSdu):
            CanTpRxAddressingFormat = CANTP_STANDARD
            CanTpRxDl = 8
            CanTpRxTaType = CANTP_PHYSICAL
            CanTpNbr = 0
            CanTpRxNSduId = 1
            CanTpRxPaddingActivation = CANTP_ON
            CanTpBs = 0
            CanTpNar = 0.025
            CanTpNcr = 0.15
            CanTpRxWftMax = 0
            CanTpSTmin = 0
            CanTpRxNSduRef = HUT_Phy_Req_oB30_for_SC_CAN_V3_2_20_98e0d928_Rx
            CanTpTxFcNPdu_037f5168 (CanTpTxFcNPdu): CanTpTxFcNPduConfirmationPduId=0, CanTpTxFcNPduRef=HUT_Phy_Resp_Tp_oB30_for_SC_CAN_V3_2_20_4bbb4ddf_Tx
            CanTpRxNPdu_037f5168 (CanTpRxNPdu): CanTpRxNPduId=0, CanTpRxNPduRef=HUT_Phy_Req_Tp_oB30_for_SC_CAN_V3_2_20_200e5e76_Rx
        TPCH_a2697219
          CanTpRxNSdu_0c0cf4f1 (CanTpRxNSdu):
            CanTpRxAddressingFormat = CANTP_STANDARD
            CanTpRxDl = 8
            CanTpRxTaType = CANTP_FUNCTIONAL
            CanTpNbr = 0.1
            CanTpRxNSduId = 3
            CanTpRxPaddingActivation = CANTP_ON
            CanTpBs = 0
            CanTpSTmin = 0
            CanTpRxNSduRef = DiagFuncReq_oB30_for_SC_CAN_V3_2_20_4d8be182_Rx
            CanTpRxNPdu_233f39d0 (CanTpRxNPdu): CanTpRxNPduId=2, CanTpRxNPduRef=DiagFuncReq_Tp_oB30_for_SC_CAN_V3_2_20_391e823e_Rx
        TPCH_1e946ab0
          CanTpRxNSdu_8892e7d5 (CanTpRxNSdu):
            CanTpRxAddressingFormat = CANTP_STANDARD
            CanTpRxDl = 8
            CanTpRxTaType = CANTP_CANFD_PHYSICAL
            CanTpNbr = 0
            CanTpRxNSduId = 0
            CanTpRxPaddingActivation = CANTP_ON
            CanTpBs = 0
            CanTpNar = 0.025
            CanTpNcr = 0.15
            CanTpRxWftMax = 0
            CanTpSTmin = 0
            CanTpRxNSduRef = HUT_Phy_Req_oB30_for_SC_CAN_V3_2_6551238f_Rx
            CanTpTxFcNPdu_a46f9c70 (CanTpTxFcNPdu): CanTpTxFcNPduConfirmationPduId=1, CanTpTxFcNPduRef=HUT_Phy_Resp_Tp_oB30_for_SC_CAN_V3_2_b970c45d_Tx
            CanTpRxNPdu_a46f9c70 (CanTpRxNPdu): CanTpRxNPduId=1, CanTpRxNPduRef=HUT_Phy_Req_Tp_oB30_for_SC_CAN_V3_2_c33a46c1_Rx
          CanTpTxNSdu_8892e7d5 (CanTpTxNSdu):
            CanTpTxAddressingFormat = CANTP_STANDARD
            CanTpTxDl = 8
            CanTpTxTaType = CANTP_CANFD_PHYSICAL
            CanTpNas = 0.025
            CanTpNcs = 0.045
            CanTpTc = false
            CanTpTxNSduId = 0
            CanTpTxPaddingActivation = CANTP_ON
            CanTpNbs = 0.075
            CanTpTxNSduRef = HUT_Phy_Resp_oB30_for_SC_CAN_V3_2_69356df1_Tx
            CanTpRxFcNPdu_86954882 (CanTpRxFcNPdu): CanTpRxFcNPduId=1, CanTpRxFcNPduRef=HUT_Phy_Req_Tp_oB30_for_SC_CAN_V3_2_c33a46c1_Rx
            CanTpTxNPdu_86954882 (CanTpTxNPdu): CanTpTxNPduConfirmationPduId=1, CanTpTxNPduRef=HUT_Phy_Resp_Tp_oB30_for_SC_CAN_V3_2_b970c45d_Tx
