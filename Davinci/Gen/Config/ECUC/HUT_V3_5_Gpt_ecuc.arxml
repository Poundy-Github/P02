AUTOSAR XML (schema 00046)
package /ActiveEcuC
  module config Gpt: implementation-config-variant=VARIANT-POST-BUILD, module-description=Gpt_Impl
    GptDriverConfiguration0 (GptDriverConfiguration):
      GptDevErrorDetect = false
      GptPredefTimer100us32bitEnable = false
      GptPredefTimer1usEnablingGrade = GPT_PREDEF_TIMER_1US_DISABLED
      GptPredefTimerHarwareUnitSelection = OSTM0
      GptReportWakeupSource = false
      GptCriticalSectionProtection = true
      GptDeviceName = R7F701651
      GptClearPendingInterrupts = true
      GptVersionCheckExternalModules = false
      GptAlreadyInitDetCheck = true
      GptTimerOutputEnable = true
      GptOSTMWriteVerify = WV_DISABLE
      GptTAUDBWriteVerify = WV_DISABLE
      GptTAUJWriteVerify = WV_DISABLE
      GptWUFWriteVerify = WV_DISABLE
      GptOSTMRamMirror = DISABLE
      GptTAUDBRamMirror = DISABLE
      GptTAUJRamMirror = DISABLE
      GptUseWriteVerifyErrorInterface = false
      GptWakeUpFactorClearIsr = false
      GptWriteVerifyErrorInterface = NULL
      GptEnableClkImmediateValue = false
      CpuClkFreqRefImmediateValue = 24000000
      GptTimeOutWaitingTime = 2
      GptOSTMClkRefPoint = McuClockReferencePoint_OSTM
      GptClockReferencePoint_TAUB (GptClockReferencePoint): GptClockReference=McuClockReferencePoint_TAUB, CpuClockFrequencyRef=McuClockSettingConfig
      GptClockReferencePoint_TAUJ (GptClockReferencePoint): GptClockReference=McuClockReferencePoint_TAUJ_0_2, CpuClockFrequencyRef=McuClockSettingConfig
    GptConfigurationOfOptApiServices:
      GptDeinitApi = true
      GptEnableDisableNotificationApi = true
      GptTimeElapsedApi = true
      GptTimeRemainingApi = true
      GptVersionInfoApi = false
      GptWakeupFunctionalityApi = false
    GptChannelConfigSet0 (GptChannelConfigSet)
      GptTaUnit_TAUJ0 (GptTaUnit):
        GptPrescalerCk0 = PCLK_DIVBY_2_POWOF_01
        GptPrescalerCk1 = PCLK_DIVBY_2_POWOF_06
        GptPrescalerCk2 = PCLK_DIVBY_2_POWOF_15
        GptPrescalerCk3BaudRate = 0
        GptPrescalerCk3Pre = PCLK_DIVBY_2_POWOF_15
        GptTaUnitSelection = TAUJ0
        GptTauUnitClkRefPoint = McuAwoTauj
      GptChannelConfiguration_tick (GptChannelConfiguration):
        GptChannelId = 0
        GptChannelMode = GPT_CH_MODE_CONTINUOUS
        GptChannelTickFrequency = 10000000
        GptChannelTickValueMax = 4294967295
        GptEnableWakeup = false
        GptChannelClk = CK0
        GptTimerInputSelection = TAUJ0I0
        GptChannelClkSrcRef = GptClockReferencePoint_TAUJ
      GptChannelConfiguration_1ms_tick (GptChannelConfiguration):
        GptChannelId = 1
        GptChannelMode = GPT_CH_MODE_CONTINUOUS
        GptChannelTickFrequency = 625000
        GptChannelTickValueMax = 4294967295
        GptEnableWakeup = false
        GptChannelClk = CK1
        GptTimerInputSelection = TAUJ0I1
        GptNotification = GptIsr_1ms_tick
        GptChannelClkSrcRef = GptClockReferencePoint_TAUJ
    GptDemEventParameterRefs:
      GPT_E_TIMEOUT_FAILURE = AutoCreatedDemEvent_GptDemEventParameterRefs_GPT_E_TIMEOUT_FAILURE
      GPT_E_REG_WRITE_VERIFY = AutoCreatedDemEvent_GptDemEventParameterRefs_GPT_E_REG_WRITE_VERIFY
