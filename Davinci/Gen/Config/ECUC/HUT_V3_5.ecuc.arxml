AUTOSAR XML (schema 00046)
package /ActiveEcuC
  ecuc value collection ActiveEcuC: ecu-extract=SYSTEM
    ecuc-values:
      Com
      Os
      CanSM
      CanTp
      LinTrcv
      EcuC
      BswM
      vSet
      Rte
      EcuM
      CanNm
      PduR
      Dcm
      Lin
      Nm
      Can
      CanIf
      Det
      ComM
      Dio
      Fee
      Fls
      Mcu
      Port
      MemIf
      NvM
      vLinkGen
      vBRS
      vBaseEnv
      Dem
      Crc
      Adc
      Gpt
      Icu
      Pwm
      Spi
      WdgIf
      WdgM
      Wdg
      E2EPW
      CanTrcv
      CryIf
      Crypto
      Csm
      SecOC
      FvM
      CorTst
      FlsTst
      RamTst
