AUTOSAR XML (schema 00046)
package /ActiveEcuC
  module config CryIf: implementation-config-variant=VARIANT-PRE-COMPILE, module-description=CryIf_Impl
    CryIfChannel_CMAC (CryIfChannel): CryIfChannelId=0, CryIfDriverObjectRef=Crypto_30_vHsm_Hal
    CryIfGeneral: CryIfDevErrorDetect=true, CryIfVersionInfoApi=false, CryIfMaxNumberOfKeyElements=10, CryIfMaxSizeOfKeyElement=32, CryIfRedirection=false
    CryIfKey: CryIfKeyId=0, CryIfKeyRef=CryIfKey_vHsm_Aggregated_hsm_hal_cmac
    CryIfCryptoModule: CryIfSupportsKeyElementCopyPartial=true, CryIfCancelJobApiUsesJobType=true, CryIfCryptoModuleRef=Crypto
    3 x CryIfKey:
      CryIfKey_Flash: CryIfKeyId=3, CryIfKeyRef=vHsm_Hardware
      CryIfKey_Aes128: CryIfKeyId=2, CryIfKeyRef=CryIfKey_Aes128
      CryIfKey_RandomSeed: CryIfKeyId=4, CryIfKeyRef=CryIfKey_Random
    CryIfChannel_KeySetValid (CryIfChannel): CryIfChannelId=1, CryIfDriverObjectRef=Crypto_30_vHsm_KeyM
    3 x CryIfKey:
      CryIfKey_SecureBootAPP_A: CryIfKeyId=5, CryIfKeyRef=vHsm_SecureBoot_Segment_APPL_0
      CryIfKey_SecureBootAPP_B: CryIfKeyId=6, CryIfKeyRef=vHsm_SecureBoot_Segment_APPL_1
      CryIfKey_SecureBootAppKey: CryIfKeyId=1, CryIfKeyRef=vHsm_SecureBoot_Group_APPL
    CryIfChannel_SecOC_Generate (CryIfChannel): CryIfChannelId=2, CryIfDriverObjectRef=Crypto_30_Hsm_Hal_AesCmacGenerate
    CryIfChannel_SecOC_Verify (CryIfChannel): CryIfChannelId=3, CryIfDriverObjectRef=Crypto_30_Hsm_Hal_AesCmacVerify
