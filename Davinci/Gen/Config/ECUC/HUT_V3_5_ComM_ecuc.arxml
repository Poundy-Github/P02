AUTOSAR XML (schema 00046)
package /ActiveEcuC
  module config ComM: implementation-config-variant=VARIANT-PRE-COMPILE, module-description=ComM_Impl
    ComMGeneral:
      ComMPncIdCounting = COMM_PNC_ID_COUNT_FROM_NM_MESSAGE
      ComMPncSupport = false
      ComMDevErrorDetect = true
      ComMEcuGroupClassification = 3
      ComMModeLimitationEnabled = false
      ComMSynchronousWakeUp = false
      ComMTMinFullComModeDuration = 5
      ComMVersionInfoApi = false
      ComMWakeupInhibitionEnabled = false
      ComMSafeBswChecks = false
      ComMGeneration: ComMOutOfBoundsWriteSanitizer=false, ComMOutOfBoundsReadSanitizer=false
    ComMConfigSet: ComMPncEnabled=false
      CN_B30_for_SC_CAN_V3_2_9e267e6f (ComMUser): ComMUserIdentifier=0, ComMUserModeNotification=false
      CN_B30_for_SC_CAN_V3_2_c0d6c67b (ComMChannel):
        ComMBusType = COMM_BUS_TYPE_CAN
        ComMChannelId = 0
        ComMFullCommRequestNotificationEnabled = false
        ComMMainFunctionPeriod = 0.005
        ComMNoCom = false
        ComMNoWakeup = false
        ComMNetworkManagement: ComMNmVariant=FULL, ComMPncNmRequest=false
        CN_B30_for_SC_CAN_V3_2_ca54f597 (ComMUserPerChannel): ComMUserChannel=CN_B30_for_SC_CAN_V3_2_9e267e6f
