AUTOSAR XML (schema 00046)
package /ActiveEcuC
  module config BswM: implementation-config-variant=VARIANT-PRE-COMPILE, module-description=BswM_Impl
    BswMGeneral:
      BswMCanSMEnabled = true
      BswMComMEnabled = true
      BswMDcmEnabled = true
      BswMDevErrorDetect = true
      BswMEcuMEnabled = true
      BswMEthIfEnabled = false
      BswMEthSMEnabled = false
      BswMFrSMEnabled = false
      BswMGenericRequestEnabled = true
      BswMJ1939DcmEnabled = false
      BswMJ1939NmEnabled = false
      BswMLinSMEnabled = false
      BswMLinTPEnabled = false
      BswMNmEnabled = false
      BswMNvMEnabled = true
      BswMPduREnabled = false
      BswMRuleControlEnabled = false
      BswMSdEnabled = false
      BswMVersionInfoApi = false
      BswMWdgMEnabled = true
      BswMModeCheck = true
      BswMActionListQueueSearchAlgorithm = LINEAR_SEARCH
      BswMSafeBswChecks = false
      BswMMainFunctionPeriod = 0.01
      BswMCommonData
      BswMGeneration:
        BswMOutOfBoundsWriteSanitizer = false
        BswMOutOfBoundsReadSanitizer = false
        BswMReduceConstantData2Define = true
        BswMBoolDataInArrayOfStructStrategy = BITMASKING
        BswMInterfacesForDeactivatedData = false
    BswMConfig
      BswMArbitration
        CC_CN_B30_for_SC_CAN_V3_2_c0d6c67b_RX (BswMRule):
          BswMNestedExecutionOnly = false
          BswMRuleId = 1
          BswMRuleInitState = BSWM_FALSE
          BswMRuleExpressionRef = CC_LE_CN_B30_for_SC_CAN_V3_2_c0d6c67b_RX
          BswMRuleFalseActionList = CC_AL_CN_B30_for_SC_CAN_V3_2_c0d6c67b_RX_Disable
          BswMRuleTrueActionList = CC_AL_CN_B30_for_SC_CAN_V3_2_c0d6c67b_RX_EnableNoinit
        CC_LE_CN_B30_for_SC_CAN_V3_2_c0d6c67b_RX (BswMLogicalExpression):
          BswMLogicalOperator = BSWM_AND
          BswMArgumentRef = CC_Cond_CanSMIndication_CN_B30_for_SC_CAN_V3_2_c0d6c67b_NEQ_CANSM_BSWM_NO_COMMUNICATION
          BswMArgumentRef = CC_Cond_DcmComIndication_CN_B30_for_SC_CAN_V3_2_c0d6c67b_NEQ_DCM_DISABLE_RX_ENABLE_TX_NORM
          BswMArgumentRef = CC_Cond_DcmComIndication_CN_B30_for_SC_CAN_V3_2_c0d6c67b_NEQ_DCM_DISABLE_RX_TX_NORMAL
          BswMArgumentRef = CC_Cond_DcmComIndication_CN_B30_for_SC_CAN_V3_2_c0d6c67b_NEQ_DCM_DISABLE_RX_ENABLE_TX_NORM_NM
          BswMArgumentRef = CC_Cond_DcmComIndication_CN_B30_for_SC_CAN_V3_2_c0d6c67b_NEQ_DCM_DISABLE_RX_TX_NORM_NM
        CC_Cond_CanSMIndication_CN_B30_for_SC_CAN_V3_2_c0d6c67b_NEQ_CANSM_BSWM_NO_COMMUNICATION (BswMModeCondition): BswMConditionType=BSWM_EQUALS_NOT, BswMConditionMode=CC_CanSMIndication_CN_B30_for_SC_CAN_V3_2_c0d6c67b
          BswMConditionValue
            BswMBswMode: BswMBswRequestedMode=CANSM_BSWM_NO_COMMUNICATION
        CC_CanSMIndication_CN_B30_for_SC_CAN_V3_2_c0d6c67b (BswMModeRequestPort): BswMArbitrateOnInit=false, BswMRequestProcessing=BSWM_IMMEDIATE
          BswMModeRequestSource
            BswMCanSMIndication: BswMCanSMChannelRef=CN_B30_for_SC_CAN_V3_2_c0d6c67b
          BswMModeInitValue
            BswMBswModeInitValue: BswMBswModeInitValueMode=CANSM_BSWM_NO_COMMUNICATION
        CC_CN_B30_for_SC_CAN_V3_2_c0d6c67b_RX_DM (BswMRule):
          BswMNestedExecutionOnly = false
          BswMRuleId = 2
          BswMRuleInitState = BSWM_FALSE
          BswMRuleExpressionRef = CC_LE_CN_B30_for_SC_CAN_V3_2_c0d6c67b_RX_DM
          BswMRuleTrueActionList = AL_NONE
        CC_LE_CN_B30_for_SC_CAN_V3_2_c0d6c67b_RX_DM (BswMLogicalExpression):
          BswMLogicalOperator = BSWM_AND
          BswMArgumentRef = CC_Cond_CanSMIndication_CN_B30_for_SC_CAN_V3_2_c0d6c67b_EQ_CANSM_BSWM_FULL_COMMUNICATION
          BswMArgumentRef = CC_Cond_DcmComIndication_CN_B30_for_SC_CAN_V3_2_c0d6c67b_NEQ_DCM_DISABLE_RX_ENABLE_TX_NORM
          BswMArgumentRef = CC_Cond_DcmComIndication_CN_B30_for_SC_CAN_V3_2_c0d6c67b_NEQ_DCM_DISABLE_RX_TX_NORMAL
          BswMArgumentRef = CC_Cond_DcmComIndication_CN_B30_for_SC_CAN_V3_2_c0d6c67b_NEQ_DCM_DISABLE_RX_ENABLE_TX_NORM_NM
          BswMArgumentRef = CC_Cond_DcmComIndication_CN_B30_for_SC_CAN_V3_2_c0d6c67b_NEQ_DCM_DISABLE_RX_TX_NORM_NM
        CC_Cond_CanSMIndication_CN_B30_for_SC_CAN_V3_2_c0d6c67b_EQ_CANSM_BSWM_FULL_COMMUNICATION (BswMModeCondition): BswMConditionType=BSWM_EQUALS, BswMConditionMode=CC_CanSMIndication_CN_B30_for_SC_CAN_V3_2_c0d6c67b
          BswMConditionValue
            BswMBswMode: BswMBswRequestedMode=CANSM_BSWM_FULL_COMMUNICATION
        CC_CN_B30_for_SC_CAN_V3_2_c0d6c67b_TX (BswMRule):
          BswMNestedExecutionOnly = false
          BswMRuleId = 3
          BswMRuleInitState = BSWM_FALSE
          BswMRuleExpressionRef = CC_LE_CN_B30_for_SC_CAN_V3_2_c0d6c67b_TX
          BswMRuleTrueActionList = AL_NONE
        CC_LE_CN_B30_for_SC_CAN_V3_2_c0d6c67b_TX (BswMLogicalExpression):
          BswMLogicalOperator = BSWM_AND
          BswMArgumentRef = CC_Cond_CanSMIndication_CN_B30_for_SC_CAN_V3_2_c0d6c67b_EQ_CANSM_BSWM_FULL_COMMUNICATION
          BswMArgumentRef = CC_Cond_DcmComIndication_CN_B30_for_SC_CAN_V3_2_c0d6c67b_NEQ_DCM_DISABLE_RX_TX_NORMAL
          BswMArgumentRef = CC_Cond_DcmComIndication_CN_B30_for_SC_CAN_V3_2_c0d6c67b_NEQ_DCM_ENABLE_RX_DISABLE_TX_NM
          BswMArgumentRef = CC_Cond_DcmComIndication_CN_B30_for_SC_CAN_V3_2_c0d6c67b_NEQ_DCM_DISABLE_RX_TX_NM
          BswMArgumentRef = CC_Cond_DcmComIndication_CN_B30_for_SC_CAN_V3_2_c0d6c67b_NEQ_DCM_ENABLE_RX_DISABLE_TX_NORM_NM
          BswMArgumentRef = CC_Cond_DcmComIndication_CN_B30_for_SC_CAN_V3_2_c0d6c67b_NEQ_DCM_DISABLE_RX_TX_NORM_NM
        ESH_LE_RunReached (BswMLogicalExpression): BswMLogicalOperator=BSWM_AND, BswMArgumentRef=ESH_Cond_StateIsRun, BswMArgumentRef=ESH_Cond_ModeIsRun, BswMArgumentRef=LE_Shutdown_Req
        ESH_Cond_StateIsRun (BswMModeCondition): BswMConditionType=BSWM_EQUALS, BswMConditionMode=ESH_State
          BswMConditionValue
            BswMBswMode: BswMBswRequestedMode=ESH_RUN
        ESH_State (BswMModeRequestPort): BswMArbitrateOnInit=true, BswMRequestProcessing=BSWM_IMMEDIATE
          BswMModeRequestSource
            BswMGenericRequest: BswMModeRequesterId=230, BswMRequestedModeMax=9
              9 x BswMGenericRequestMode:
                ESH_INIT: BswMGenericRequestModeValue=0
                ESH_RUN: BswMGenericRequestModeValue=1
                ESH_POST_RUN: BswMGenericRequestModeValue=2
                ESH_PREP_SHUTDOWN: BswMGenericRequestModeValue=3
                ESH_WAIT_FOR_NVM: BswMGenericRequestModeValue=4
                ESH_SHUTDOWN: BswMGenericRequestModeValue=5
                ESH_WAKEUP: BswMGenericRequestModeValue=6
                ESH_SLEEP: BswMGenericRequestModeValue=7
                ESH_READ_NVM: BswMGenericRequestModeValue=8
          BswMModeInitValue
            BswMBswModeInitValue: BswMBswModeInitValueMode=ESH_INIT
        ESH_Cond_ModeIsRun (BswMModeCondition): BswMConditionType=BSWM_EQUALS, BswMConditionMode=ESH_ModeNotification
          BswMConditionValue
            BswMModeDeclaration: BswMModeValueRef=RUN
        ESH_ModeNotification (BswMModeRequestPort): BswMArbitrateOnInit=false, BswMRequestProcessing=BSWM_DEFERRED
          BswMModeRequestSource
            BswMSwcModeNotification: BswMSwcModeNotificationModeDeclarationGroupPrototypeRef=BswM_MDGP_ESH_Mode
          BswMModeInitValue
            BswMSwcModeInitValue: BswMSwcModeInitValueRef=STARTUP
        ESH_Cond_NoComOn_CN_B30_for_SC_CAN_V3_2_c0d6c67b (BswMModeCondition): BswMConditionType=BSWM_EQUALS, BswMConditionMode=ESH_ComMIndication_CN_B30_for_SC_CAN_V3_2_c0d6c67b
          BswMConditionValue
            BswMBswMode: BswMBswRequestedMode=COMM_NO_COMMUNICATION
        ESH_ComMIndication_CN_B30_for_SC_CAN_V3_2_c0d6c67b (BswMModeRequestPort): BswMArbitrateOnInit=false, BswMRequestProcessing=BSWM_DEFERRED
          BswMModeRequestSource
            BswMComMIndication: BswMComMChannelRef=CN_B30_for_SC_CAN_V3_2_c0d6c67b
          BswMModeInitValue
            BswMBswModeInitValue: BswMBswModeInitValueMode=COMM_NO_COMMUNICATION
        ESH_LE_RunReleased (BswMLogicalExpression): BswMLogicalOperator=BSWM_AND, BswMArgumentRef=ESH_Cond_RunRequest0IsReleased, BswMArgumentRef=ESH_Cond_RunRequest1IsReleased
        ESH_Cond_RunRequest0IsReleased (BswMModeCondition): BswMConditionType=BSWM_EQUALS, BswMConditionMode=ESH_RunRequest_0
          BswMConditionValue
            BswMModeDeclaration: BswMModeValueRef=RELEASED
        ESH_RunRequest_0 (BswMModeRequestPort): BswMArbitrateOnInit=false, BswMRequestProcessing=BSWM_DEFERRED
          BswMModeRequestSource
            BswMSwcModeRequest: BswMModeRequestDataElementPrototypeName=requestedMode, BswMSwcModeRequestModeDeclarationGroupPrototypeRef=BswM_MDGP_ESH_RunRequest
          BswMModeInitValue
            BswMSwcModeInitValue: BswMSwcModeInitValueRef=RELEASED
        ESH_Cond_RunRequest1IsReleased (BswMModeCondition): BswMConditionType=BSWM_EQUALS, BswMConditionMode=ESH_RunRequest_1
          BswMConditionValue
            BswMModeDeclaration: BswMModeValueRef=RELEASED
        ESH_RunRequest_1 (BswMModeRequestPort): BswMArbitrateOnInit=false, BswMRequestProcessing=BSWM_DEFERRED
          BswMModeRequestSource
            BswMSwcModeRequest: BswMModeRequestDataElementPrototypeName=requestedMode, BswMSwcModeRequestModeDeclarationGroupPrototypeRef=BswM_MDGP_ESH_RunRequest
          BswMModeInitValue
            BswMSwcModeInitValue: BswMSwcModeInitValueRef=RELEASED
        ESH_Cond_SelfRunReqTimerExpired (BswMModeCondition): BswMConditionType=BSWM_EQUALS, BswMConditionMode=ESH_SelfRunRequestTimer
          BswMConditionValue
            BswMBswMode: BswMBswRequestedMode=BSWM_TIMER_EXPIRED
        ESH_SelfRunRequestTimer (BswMModeRequestPort): BswMArbitrateOnInit=false, BswMRequestProcessing=BSWM_DEFERRED
          BswMModeRequestSource
            BswMTimer
          BswMModeInitValue
            BswMBswModeInitValue: BswMBswModeInitValueMode=BSWM_TIMER_STOPPED
        ESH_R5_RunToPostRunNested (BswMRule):
          BswMNestedExecutionOnly = true
          BswMRuleId = 16
          BswMRuleInitState = BSWM_FALSE
          BswMRuleExpressionRef = ESH_LE_ComMNoPendingRequests
          BswMRuleTrueActionList = ESH_AL_A5_RunToPostRun
          BswMRuleFalseActionList = AL_A5_FalseAction
        ESH_LE_ComMNoPendingRequests (BswMLogicalExpression): BswMLogicalOperator=BSWM_OR, BswMArgumentRef=ESH_Cond_ComMNoPendingRequests, BswMArgumentRef=BswMModeCondition_031
        ESH_Cond_ComMNoPendingRequests (BswMModeCondition): BswMConditionType=BSWM_EQUALS, BswMConditionMode=ESH_ComMPendingRequests
          BswMConditionValue
            BswMBswMode: BswMBswRequestedMode=ESH_COMM_NO_REQUEST
        ESH_ComMPendingRequests (BswMModeRequestPort): BswMArbitrateOnInit=false, BswMRequestProcessing=BSWM_DEFERRED
          BswMModeRequestSource
            BswMGenericRequest: BswMModeRequesterId=232, BswMRequestedModeMax=2
              ESH_COMM_NO_REQUEST (BswMGenericRequestMode): BswMGenericRequestModeValue=0
              ESH_COMM_PENDING_REQUEST (BswMGenericRequestMode): BswMGenericRequestModeValue=1
          BswMModeInitValue
            BswMBswModeInitValue: BswMBswModeInitValueMode=ESH_COMM_NO_REQUEST
        ESH_R11_WaitToReset (BswMRule):
          BswMNestedExecutionOnly = false
          BswMRuleId = 22
          BswMRuleInitState = BSWM_FALSE
          BswMRuleExpressionRef = ESH_LE_WriteNvMToReset
          BswMRuleTrueActionList = ESH_AL_A11_WaitForNvMToShutdown
        ESH_LE_ReadNvMToSleep (BswMLogicalExpression):
          BswMLogicalOperator = BSWM_AND
          BswMArgumentRef = BswMModeCondition_032
          BswMArgumentRef = BswMModeCondition_034
          BswMArgumentRef = ESH_LE_ReadNotPending
          BswMArgumentRef = ESH_LE_NoWakeupOrKillAll
        ESH_Cond_StateIsWaitForNvm (BswMModeCondition): BswMConditionType=BSWM_EQUALS, BswMConditionMode=ESH_State
          BswMConditionValue
            BswMBswMode: BswMBswRequestedMode=ESH_WAIT_FOR_NVM
        ESH_LE_WriteNotPending (BswMLogicalExpression): BswMLogicalOperator=BSWM_OR, BswMArgumentRef=ESH_Cond_NvMWAIsNotPending, BswMArgumentRef=ESH_Cond_NvWWriteAllTimerNotRunning
        ESH_Cond_NvMWAIsNotPending (BswMModeCondition): BswMConditionType=BSWM_EQUALS_NOT, BswMConditionMode=ESH_NvMIndication
          BswMConditionValue
            BswMBswMode: BswMBswRequestedMode=NVM_REQ_PENDING
        ESH_NvMIndication (BswMModeRequestPort): BswMArbitrateOnInit=false, BswMRequestProcessing=BSWM_DEFERRED
          BswMModeRequestSource
            BswMNvMJobModeIndication: BswMNvmService=NvmWriteAll
          BswMModeInitValue
            BswMBswModeInitValue: BswMBswModeInitValueMode=NVM_REQ_OK
        ESH_Cond_NvWWriteAllTimerNotRunning (BswMModeCondition): BswMConditionType=BSWM_EQUALS_NOT, BswMConditionMode=ESH_NvM_WriteAllTimer
          BswMConditionValue
            BswMBswMode: BswMBswRequestedMode=BSWM_TIMER_STARTED
        ESH_NvM_WriteAllTimer (BswMModeRequestPort): BswMArbitrateOnInit=false, BswMRequestProcessing=BSWM_DEFERRED
          BswMModeRequestSource
            BswMTimer
          BswMModeInitValue
            BswMBswModeInitValue: BswMBswModeInitValueMode=BSWM_TIMER_STOPPED
        ESH_LE_NoWakeupOrKillAll (BswMLogicalExpression): BswMArgumentRef=ESH_LE_NoWakeup
        ESH_LE_NoWakeup (BswMLogicalExpression): BswMLogicalOperator=BSWM_AND, BswMArgumentRef=ESH_Cond_ComMNoPendingRequests, BswMArgumentRef=LE_No_Valid_WakeUp
        ESH_Cond_NoValidatedWakeups (BswMModeCondition): BswMConditionType=BSWM_EQUALS, BswMConditionMode=ESH_EcuM_GetValidatedWakeupEvents
          BswMConditionValue
            BswMBswMode: BswMBswRequestedMode=0
        ESH_EcuM_GetValidatedWakeupEvents (BswMModeRequestPort): BswMArbitrateOnInit=false, BswMRequestProcessing=BSWM_DEFERRED
          BswMModeRequestSource
            BswMUserConditionRequest: BswMUserCondition=EcuM_GetValidatedWakeupEvents()
        ESH_R3_WakeupToPrep (BswMRule):
          BswMNestedExecutionOnly = false
          BswMRuleId = 14
          BswMRuleInitState = BSWM_FALSE
          BswMRuleExpressionRef = ESH_LE_WakeupToPrepShutdown
          BswMRuleTrueActionList = ESH_AL_A3_WakeupToPrep
        ESH_LE_WakeupToPrepShutdown (BswMLogicalExpression):
          BswMLogicalOperator = BSWM_AND
          BswMArgumentRef = ESH_Cond_StateIsWakeup
          BswMArgumentRef = ESH_LE_CancelNotPending
          BswMArgumentRef = ESH_Cond_NoPendingWakeups
          BswMArgumentRef = ESH_LE_NoWakeup
          BswMArgumentRef = ESH_Cond_ModeIsWakeup
        ESH_Cond_StateIsWakeup (BswMModeCondition): BswMConditionType=BSWM_EQUALS, BswMConditionMode=ESH_State
          BswMConditionValue
            BswMBswMode: BswMBswRequestedMode=ESH_WAKEUP
        ESH_LE_CancelNotPending (BswMLogicalExpression): BswMLogicalOperator=BSWM_OR, BswMArgumentRef=ESH_Cond_NvMWAIsNotPending, BswMArgumentRef=ESH_Cond_NvWCancelTimerNotRunning
        ESH_Cond_NvWCancelTimerNotRunning (BswMModeCondition): BswMConditionType=BSWM_EQUALS_NOT, BswMConditionMode=ESH_NvM_CancelWriteAllTimer
          BswMConditionValue
            BswMBswMode: BswMBswRequestedMode=BSWM_TIMER_STARTED
        ESH_NvM_CancelWriteAllTimer (BswMModeRequestPort): BswMArbitrateOnInit=false, BswMRequestProcessing=BSWM_DEFERRED
          BswMModeRequestSource
            BswMTimer
          BswMModeInitValue
            BswMBswModeInitValue: BswMBswModeInitValueMode=BSWM_TIMER_STOPPED
        ESH_Cond_NoPendingWakeups (BswMModeCondition): BswMConditionType=BSWM_EQUALS, BswMConditionMode=ESH_EcuM_GetPendingWakeupEvents
          BswMConditionValue
            BswMBswMode: BswMBswRequestedMode=0
        ESH_EcuM_GetPendingWakeupEvents (BswMModeRequestPort): BswMArbitrateOnInit=false, BswMRequestProcessing=BSWM_DEFERRED
          BswMModeRequestSource
            BswMUserConditionRequest: BswMUserCondition=EcuM_GetPendingWakeupEvents()
        ESH_Cond_ModeIsWakeup (BswMModeCondition): BswMConditionType=BSWM_EQUALS, BswMConditionMode=ESH_ModeNotification
          BswMConditionValue
            BswMModeDeclaration: BswMModeValueRef=WAKEUP
        ESH_R10_WaitToWakeup (BswMRule):
          BswMNestedExecutionOnly = false
          BswMRuleId = 21
          BswMRuleInitState = BSWM_FALSE
          BswMRuleExpressionRef = ESH_LE_WaitForNvMToWakeup
          BswMRuleTrueActionList = ESH_AL_A10_WaitForNvMWakeup
        ESH_LE_WaitForNvMToWakeup (BswMLogicalExpression): BswMLogicalOperator=BSWM_AND, BswMArgumentRef=BswMModeCondition_033, BswMArgumentRef=BswMModeCondition_042, BswMArgumentRef=ESH_LE_ValidWakeup
        ESH_LE_ValidWakeup (BswMLogicalExpression): BswMLogicalOperator=BSWM_OR, BswMArgumentRef=ESH_Cond_ComMPendingRequests, BswMArgumentRef=LE_Valid_WakeUp
        ESH_Cond_ValidatedWakeups (BswMModeCondition): BswMConditionType=BSWM_EQUALS_NOT, BswMConditionMode=ESH_EcuM_GetValidatedWakeupEvents
          BswMConditionValue
            BswMBswMode: BswMBswRequestedMode=0
        ESH_Cond_ComMPendingRequests (BswMModeCondition): BswMConditionType=BSWM_EQUALS, BswMConditionMode=ESH_ComMPendingRequests
          BswMConditionValue
            BswMBswMode: BswMBswRequestedMode=ESH_COMM_PENDING_REQUEST
        ESH_R2_WakeupToRun (BswMRule):
          BswMNestedExecutionOnly = false
          BswMRuleId = 13
          BswMRuleInitState = BSWM_FALSE
          BswMRuleExpressionRef = ESH_LE_WakeupToRun
          BswMRuleTrueActionList = ESH_AL_A2_WakeupToRun
        ESH_LE_WakeupToRun (BswMLogicalExpression):
          BswMLogicalOperator = BSWM_AND
          BswMArgumentRef = ESH_Cond_StateIsWakeup
          BswMArgumentRef = ESH_LE_ValidWakeup
          BswMArgumentRef = ESH_LE_CancelNotPending
          BswMArgumentRef = ESH_Cond_ModeIsWakeup
          BswMArgumentRef = BswMModeCondition_076
        ESH_2_1_DemInit (BswMRule):
          BswMNestedExecutionOnly = true
          BswMRuleId = 11
          BswMRuleInitState = BSWM_FALSE
          BswMRuleExpressionRef = ESH_LE_DemNotInitialized
          BswMRuleTrueActionList = ESH_AL_A2_1_DemInit
        ESH_LE_DemNotInitialized (BswMLogicalExpression): BswMLogicalOperator=BSWM_OR, BswMArgumentRef=ESH_Cond_DemNotInitialized
        ESH_Cond_DemNotInitialized (BswMModeCondition): BswMConditionType=BSWM_EQUALS, BswMConditionMode=ESH_DemInitStatus
          BswMConditionValue
            BswMBswMode: BswMBswRequestedMode=DEM_NOT_INITIALIZED
        ESH_DemInitStatus (BswMModeRequestPort): BswMArbitrateOnInit=false, BswMRequestProcessing=BSWM_IMMEDIATE
          BswMModeRequestSource
            BswMGenericRequest: BswMModeRequesterId=231, BswMRequestedModeMax=2
              DEM_INITIALIZED (BswMGenericRequestMode): BswMGenericRequestModeValue=0
              DEM_NOT_INITIALIZED (BswMGenericRequestMode): BswMGenericRequestModeValue=1
          BswMModeInitValue
            BswMBswModeInitValue: BswMBswModeInitValueMode=DEM_INITIALIZED
        ESH_R1_InitToWakeup (BswMRule):
          BswMNestedExecutionOnly = false
          BswMRuleId = 12
          BswMRuleInitState = BSWM_FALSE
          BswMRuleExpressionRef = ESH_LE_InitToWakeup
          BswMRuleTrueActionList = ESH_AL_A1_InitToWakeup
        ESH_LE_InitToWakeup (BswMLogicalExpression): BswMLogicalOperator=BSWM_AND, BswMArgumentRef=ESH_Cond_StateIsInit
        ESH_Cond_StateIsInit (BswMModeCondition): BswMConditionType=BSWM_EQUALS, BswMConditionMode=ESH_State
          BswMConditionValue
            BswMBswMode: BswMBswRequestedMode=ESH_INIT
        ESH_R8_PostRunToPrepNested (BswMRule):
          BswMNestedExecutionOnly = true
          BswMRuleId = 19
          BswMRuleInitState = BSWM_FALSE
          BswMRuleExpressionRef = ESH_LE_Dem_PostRunRequested
          BswMRuleTrueActionList = ESH_AL_A8_PostRunToPrepShutdown
        3 x BswMLogicalExpression:
          ESH_LE_Dem_PostRunRequested: BswMLogicalOperator=BSWM_OR, BswMArgumentRef=ESH_Cond_DemPostRunRequested, BswMArgumentRef=LE_Normal_Reset_Req
          ESH_LE_PostRunToPrep: BswMArgumentRef=ESH_LE_PostRunReleased
          ESH_LE_PostRunReleased: BswMLogicalOperator=BSWM_AND, BswMArgumentRef=ESH_Cond_PostRunRequest0IsReleased, BswMArgumentRef=ESH_Cond_PostRunRequest1IsReleased
        ESH_Cond_PostRunRequest0IsReleased (BswMModeCondition): BswMConditionType=BSWM_EQUALS, BswMConditionMode=ESH_PostRunRequest_0
          BswMConditionValue
            BswMModeDeclaration: BswMModeValueRef=RELEASED
        ESH_PostRunRequest_0 (BswMModeRequestPort): BswMArbitrateOnInit=false, BswMRequestProcessing=BSWM_DEFERRED
          BswMModeRequestSource
            BswMSwcModeRequest: BswMModeRequestDataElementPrototypeName=requestedMode, BswMSwcModeRequestModeDeclarationGroupPrototypeRef=BswM_MDGP_ESH_RunRequest
          BswMModeInitValue
            BswMSwcModeInitValue: BswMSwcModeInitValueRef=RELEASED
        ESH_Cond_PostRunRequest1IsReleased (BswMModeCondition): BswMConditionType=BSWM_EQUALS, BswMConditionMode=ESH_PostRunRequest_1
          BswMConditionValue
            BswMModeDeclaration: BswMModeValueRef=RELEASED
        ESH_PostRunRequest_1 (BswMModeRequestPort): BswMArbitrateOnInit=false, BswMRequestProcessing=BSWM_DEFERRED
          BswMModeRequestSource
            BswMSwcModeRequest: BswMModeRequestDataElementPrototypeName=requestedMode, BswMSwcModeRequestModeDeclarationGroupPrototypeRef=BswM_MDGP_ESH_RunRequest
          BswMModeInitValue
            BswMSwcModeInitValue: BswMSwcModeInitValueRef=RELEASED
        ESH_Cond_DemPostRunRequested (BswMModeCondition): BswMConditionType=BSWM_EQUALS, BswMConditionMode=ESH_DemPostRunRequested
          BswMConditionValue
            BswMBswMode: BswMBswRequestedMode=FALSE
        ESH_DemPostRunRequested (BswMModeRequestPort): BswMArbitrateOnInit=false, BswMRequestProcessing=BSWM_DEFERRED
          BswMModeRequestSource
            BswMGenericRequest: BswMModeRequesterId=233, BswMRequestedModeMax=2
              TRUE (BswMGenericRequestMode): BswMGenericRequestModeValue=0
              FALSE (BswMGenericRequestMode): BswMGenericRequestModeValue=1
          BswMModeInitValue
            BswMBswModeInitValue: BswMBswModeInitValueMode=TRUE
        ESH_R7_PostRunNested (BswMRule):
          BswMNestedExecutionOnly = true
          BswMRuleId = 18
          BswMRuleInitState = BSWM_FALSE
          BswMRuleExpressionRef = ESH_LE_PostRunToRun
          BswMRuleFalseActionList = ESH_AL_A7_1_ESH_PostRunToPrepCheck
          BswMRuleTrueActionList = ESH_AL_A7_PostRunToRun
        3 x BswMLogicalExpression:
          ESH_LE_PostRunToRun: BswMArgumentRef=ESH_LE_RunRequestsOrWakeup
          ESH_LE_RunRequestsOrWakeup: BswMLogicalOperator=BSWM_AND, BswMArgumentRef=ESH_LE_ValidWakeup, BswMArgumentRef=BswMModeCondition_045, BswMArgumentRef=BswMModeCondition_077
          ESH_LE_RunRequested: BswMLogicalOperator=BSWM_OR, BswMArgumentRef=ESH_Cond_RunRequest0IsRequested, BswMArgumentRef=ESH_Cond_RunRequest1IsRequested
        ESH_Cond_RunRequest0IsRequested (BswMModeCondition): BswMConditionType=BSWM_EQUALS, BswMConditionMode=ESH_RunRequest_0
          BswMConditionValue
            BswMModeDeclaration: BswMModeValueRef=REQUESTED
        ESH_Cond_RunRequest1IsRequested (BswMModeCondition): BswMConditionType=BSWM_EQUALS, BswMConditionMode=ESH_RunRequest_1
          BswMConditionValue
            BswMModeDeclaration: BswMModeValueRef=REQUESTED
        ESH_R6_PostRun (BswMRule):
          BswMNestedExecutionOnly = false
          BswMRuleId = 17
          BswMRuleInitState = BSWM_FALSE
          BswMRuleExpressionRef = ESH_LE_PostRun
          BswMRuleTrueActionList = ESH_AL_A6_ExitPostRun
        ESH_LE_PostRun (BswMLogicalExpression):
          BswMLogicalOperator = BSWM_AND
          BswMArgumentRef = ESH_Cond_StateIsPostRun
          BswMArgumentRef = ESH_Cond_ModeIsPostRun
          BswMArgumentRef = BswMModeCondition_044
        ESH_Cond_StateIsPostRun (BswMModeCondition): BswMConditionType=BSWM_EQUALS, BswMConditionMode=ESH_State
          BswMConditionValue
            BswMBswMode: BswMBswRequestedMode=ESH_POST_RUN
        ESH_Cond_ModeIsPostRun (BswMModeCondition): BswMConditionType=BSWM_EQUALS, BswMConditionMode=ESH_ModeNotification
          BswMConditionValue
            BswMModeDeclaration: BswMModeValueRef=POSTRUN
        ESH_R9_PrepToWait (BswMRule):
          BswMNestedExecutionOnly = false
          BswMRuleId = 20
          BswMRuleInitState = BSWM_FALSE
          BswMRuleExpressionRef = ESH_LE_PrepShutdownToWaitForNvM
          BswMRuleTrueActionList = ESH_AL_A9_PrepShutdownToWaitForNvM
        ESH_LE_PrepShutdownToWaitForNvM (BswMLogicalExpression): BswMLogicalOperator=BSWM_AND, BswMArgumentRef=ESH_Cond_StateIsPrepShutdown, BswMArgumentRef=ESH_Cond_ModeIsShutdown
        ESH_Cond_StateIsPrepShutdown (BswMModeCondition): BswMConditionType=BSWM_EQUALS, BswMConditionMode=ESH_State
          BswMConditionValue
            BswMBswMode: BswMBswRequestedMode=ESH_PREP_SHUTDOWN
        ESH_Cond_ModeIsShutdown (BswMModeCondition): BswMConditionType=BSWM_EQUALS, BswMConditionMode=ESH_ModeNotification
          BswMConditionValue
            BswMModeDeclaration: BswMModeValueRef=SHUTDOWN
        PowerModeShutdownReq (BswMModeRequestPort): BswMArbitrateOnInit=false, BswMRequestProcessing=BSWM_IMMEDIATE
          BswMModeRequestSource
            BswMSwcModeRequest: BswMModeRequestDataElementPrototypeName=requestedMode, BswMSwcModeRequestModeDeclarationGroupPrototypeRef=BswM_MDGP_BswMRteShutdownReqMode
          BswMModeInitValue
            BswMSwcModeInitValue: BswMSwcModeInitValueRef=BswMReqNone
        ESH_R4_RunToPostRun (BswMRule):
          BswMNestedExecutionOnly = false
          BswMRuleId = 15
          BswMRuleInitState = BSWM_FALSE
          BswMRuleExpressionRef = ESH_LE_RunToPostRunTransition
          BswMRuleTrueActionList = ESH_AL_A4_ExitRun
        4 x BswMLogicalExpression:
          ESH_LE_RunToPostRunTransition: BswMArgumentRef=ESH_LE_RunReached
          ESH_LE_NoRunAndNoKillAllRequest: BswMLogicalOperator=BSWM_OR, BswMArgumentRef=LE_Normal_Reset_Req, BswMArgumentRef=ESH_LE_NoRunReasons
          ESH_LE_NoRunReasons: BswMLogicalOperator=BSWM_AND, BswMArgumentRef=ESH_LE_AllChannelsNoCom
          ESH_LE_AllChannelsNoCom: BswMLogicalOperator=BSWM_AND, BswMArgumentRef=BswMModeCondition_007
        BswMModeCondition: BswMConditionType=BSWM_EQUALS, BswMConditionMode=PowerModeShutdownReq
          BswMConditionValue
            BswMModeDeclaration: BswMModeValueRef=BswMReqSleepEmergency
        LE_Sleep_Req (BswMLogicalExpression): BswMArgumentRef=BswMModeCondition_003
        LE_Normal_Reset_Req (BswMLogicalExpression): BswMArgumentRef=BswMModeCondition_002
        3 x BswMModeCondition, all with BswMConditionType=BSWM_EQUALS, BswMConditionMode=PowerModeShutdownReq:
          BswMModeCondition_001
            BswMConditionValue
              BswMModeDeclaration: BswMModeValueRef=BswMReqShutdownEmergency
          BswMModeCondition_002
            BswMConditionValue
              BswMModeDeclaration: BswMModeValueRef=BswMReqShutdown
          BswMModeCondition_003
            BswMConditionValue
              BswMModeDeclaration: BswMModeValueRef=BswMReqSleep
        LE_Shutdown_Req (BswMLogicalExpression): BswMLogicalOperator=BSWM_OR, BswMArgumentRef=LE_Normal_Reset_Req, BswMArgumentRef=LE_Sleep_Req
        ESH_LE_WriteNvMToReset (BswMLogicalExpression):
          BswMLogicalOperator = BSWM_AND
          BswMArgumentRef = ESH_Cond_StateIsWaitForNvm
          BswMArgumentRef = LE_Normal_Reset_Req
          BswMArgumentRef = ESH_LE_WriteNotPending
        ESH_R12_NVMReadToSleep (BswMRule):
          BswMNestedExecutionOnly = false
          BswMRuleId = 23
          BswMRuleInitState = BSWM_FALSE
          BswMRuleExpressionRef = ESH_LE_ReadNvMToSleep
          BswMRuleTrueActionList = ESH_AL_A12_WaitForNvMToNormalSleep
        LE_Emergency_Req (BswMLogicalExpression): BswMLogicalOperator=BSWM_OR, BswMArgumentRef=BswMModeCondition_001, BswMArgumentRef=BswMModeCondition_027
        BswMModeCondition_004 (BswMModeCondition): BswMConditionType=BSWM_EQUALS, BswMConditionMode=PowerModeShutdownReq
          BswMConditionValue
            BswMModeDeclaration: BswMModeValueRef=BswMReqSleepEmergency
        ESH_LE_PrepShutdownToReset (BswMLogicalExpression):
          BswMLogicalOperator = BSWM_AND
          BswMArgumentRef = ESH_Cond_StateIsPrepShutdown
          BswMArgumentRef = ESH_Cond_ModeIsShutdown
          BswMArgumentRef = LE_Normal_Reset_Req
        BswMModeCondition_005 (BswMModeCondition): BswMConditionType=BSWM_EQUALS, BswMConditionMode=PowerModeShutdownReq
          BswMConditionValue
            BswMModeDeclaration: BswMModeValueRef=BswMReqShutdownEmergency
        ESH_LE_PrepShutdownToSleep (BswMLogicalExpression):
          BswMLogicalOperator = BSWM_AND
          BswMArgumentRef = ESH_Cond_StateIsPrepShutdown
          BswMArgumentRef = ESH_Cond_ModeIsShutdown
          BswMArgumentRef = BswMModeCondition_006
          BswMArgumentRef = BswMModeCondition_018
        5 x BswMModeCondition, all with BswMConditionType=BSWM_EQUALS, BswMConditionMode=PowerModeShutdownReq:
          BswMModeCondition_006
            BswMConditionValue
              BswMModeDeclaration: BswMModeValueRef=BswMReqSleepEmergency
          BswMModeCondition_007
            BswMConditionValue
              BswMModeDeclaration: BswMModeValueRef=BswMReqSleep
          BswMModeCondition_008
            BswMConditionValue
              BswMModeDeclaration: BswMModeValueRef=BswMReqShutdownEmergency
          BswMModeCondition_009
            BswMConditionValue
              BswMModeDeclaration: BswMModeValueRef=BswMReqShutdown
          BswMModeCondition_010
            BswMConditionValue
              BswMModeDeclaration: BswMModeValueRef=BswMReqSleepEmergency
        LE_Not_Normal_Sleep_Req (BswMLogicalExpression): BswMLogicalOperator=BSWM_OR, BswMArgumentRef=BswMModeCondition_029, BswMArgumentRef=BswMModeCondition_009, BswMArgumentRef=BswMModeCondition_008
        4 x BswMModeCondition:
          BswMModeCondition_011: BswMConditionType=BSWM_EQUALS, BswMConditionMode=PowerModeShutdownReq
            BswMConditionValue
              BswMModeDeclaration: BswMModeValueRef=BswMReqSleep
          BswMModeCondition_012: BswMConditionType=BSWM_EQUALS, BswMConditionMode=PowerModeShutdownReq
            BswMConditionValue
              BswMModeDeclaration: BswMModeValueRef=BswMReqSleep
          BswMModeCondition_013: BswMConditionType=BSWM_EQUALS_NOT, BswMConditionMode=ESH_EcuM_GetValidatedWakeupEvents
            BswMConditionValue
              BswMBswMode: BswMBswRequestedMode=ECUM_WKSOURCE_COMMON_WAKEUP
          BswMModeCondition_014: BswMConditionType=BSWM_EQUALS_NOT, BswMConditionMode=ESH_EcuM_GetValidatedWakeupEvents
            BswMConditionValue
              BswMBswMode: BswMBswRequestedMode=0
        LE_Valid_WakeUp (BswMLogicalExpression): BswMLogicalOperator=BSWM_AND, BswMArgumentRef=BswMModeCondition_014, BswMArgumentRef=BswMModeCondition_013
        LE_No_Valid_WakeUp (BswMLogicalExpression): BswMLogicalOperator=BSWM_OR, BswMArgumentRef=BswMModeCondition_015, BswMArgumentRef=BswMModeCondition_016
        3 x BswMModeCondition, all with BswMConditionType=BSWM_EQUALS, BswMConditionMode=ESH_EcuM_GetValidatedWakeupEvents:
          BswMModeCondition_015
            BswMConditionValue
              BswMBswMode: BswMBswRequestedMode=0
          BswMModeCondition_016
            BswMConditionValue
              BswMBswMode: BswMBswRequestedMode=ECUM_WKSOURCE_COMMON_WAKEUP
          BswMModeCondition_017
            BswMConditionValue
              BswMBswMode: BswMBswRequestedMode=ECUM_WKSOURCE_LVI
        LE_LVI_Wakeup (BswMLogicalExpression): BswMLogicalOperator=BSWM_AND, BswMArgumentRef=LE_Sleep_Req, BswMArgumentRef=BswMModeCondition_017
        BswMModeCondition_018 (BswMModeCondition): BswMConditionType=BSWM_EQUALS_NOT, BswMConditionMode=ESH_EcuM_GetValidatedWakeupEvents
          BswMConditionValue
            BswMBswMode: BswMBswRequestedMode=ECUM_WKSOURCE_LVI
        ESH_R16_EmergencyReset (BswMRule):
          BswMNestedExecutionOnly = false
          BswMRuleId = 26
          BswMRuleInitState = BSWM_FALSE
          BswMRuleExpressionRef = LE_Emergency_Reset_Req
          BswMRuleTrueActionList = ESH_AL_A16_PreToReset
        ESH_R17_EmergencySleep (BswMRule):
          BswMNestedExecutionOnly = false
          BswMRuleId = 27
          BswMRuleInitState = BSWM_FALSE
          BswMRuleExpressionRef = LE_Emergency_Sleep_Req
          BswMRuleTrueActionList = ESH_AL_A17_PreToSleep
        BswMModeCondition_019 (BswMModeCondition): BswMConditionType=BSWM_EQUALS, BswMConditionMode=PowerModeShutdownReq
          BswMConditionValue
            BswMModeDeclaration: BswMModeValueRef=BswMReqSleepEmergency
        LE_Emergency_Sleep_Req (BswMLogicalExpression): BswMArgumentRef=BswMModeCondition_028
        LE_Emergency_Reset_Req (BswMLogicalExpression): BswMArgumentRef=BswMModeCondition_020
        BswMModeCondition_020 (BswMModeCondition): BswMConditionType=BSWM_EQUALS, BswMConditionMode=PowerModeShutdownReq
          BswMConditionValue
            BswMModeDeclaration: BswMModeValueRef=BswMReqShutdownEmergency
        ESH_R13_PostToWait (BswMRule):
          BswMNestedExecutionOnly = false
          BswMRuleId = 24
          BswMRuleInitState = BSWM_FALSE
          BswMRuleExpressionRef = LE_PostRunToWait
          BswMRuleTrueActionList = ESH_AL_A13_PostRunToWait
        4 x BswMModeCondition, all with BswMConditionType=BSWM_EQUALS:
          BswMModeCondition_021: BswMConditionMode=PowerModeShutdownReq
            BswMConditionValue
              BswMModeDeclaration: BswMModeValueRef=BswMReqSleep
          BswMModeCondition_022: BswMConditionMode=PowerModeShutdownReq
            BswMConditionValue
              BswMModeDeclaration: BswMModeValueRef=BswMReqShutdown
          BswMModeCondition_023: BswMConditionMode=ESH_State
            BswMConditionValue
              BswMBswMode: BswMBswRequestedMode=ESH_POST_RUN
          BswMModeCondition_024: BswMConditionMode=ESH_ModeNotification
            BswMConditionValue
              BswMModeDeclaration: BswMModeValueRef=POSTRUN
        LE_PostRunToWait (BswMLogicalExpression): BswMLogicalOperator=BSWM_AND, BswMArgumentRef=BswMModeCondition_024, BswMArgumentRef=BswMModeCondition_023, BswMArgumentRef=BswMModeCondition_022
        BswMModeCondition_025 (BswMModeCondition): BswMConditionType=BSWM_EQUALS, BswMConditionMode=PowerModeShutdownReq
          BswMConditionValue
            BswMModeDeclaration: BswMModeValueRef=BswMReqSleep
        BswMModeCondition_026 (BswMModeCondition): BswMConditionType=BSWM_EQUALS, BswMConditionMode=PowerModeShutdownReq
          BswMConditionValue
            BswMModeDeclaration: BswMModeValueRef=BswMReqSleep
        PowerModeShutdownReq_EmergencySleep (BswMModeRequestPort): BswMArbitrateOnInit=false, BswMRequestProcessing=BSWM_IMMEDIATE
          BswMModeRequestSource
            BswMSwcModeRequest: BswMModeRequestDataElementPrototypeName=requestedMode, BswMSwcModeRequestModeDeclarationGroupPrototypeRef=BswM_MDGP_BswMRteShutdownReqMode
          BswMModeInitValue
            BswMSwcModeInitValue: BswMSwcModeInitValueRef=BswMReqNone
        7 x BswMModeCondition:
          BswMModeCondition_027: BswMConditionType=BSWM_EQUALS, BswMConditionMode=PowerModeShutdownReq_EmergencySleep
            BswMConditionValue
              BswMModeDeclaration: BswMModeValueRef=BswMReqSleepEmergency
          BswMModeCondition_028: BswMConditionType=BSWM_EQUALS, BswMConditionMode=PowerModeShutdownReq_EmergencySleep
            BswMConditionValue
              BswMModeDeclaration: BswMModeValueRef=BswMReqSleepEmergency
          BswMModeCondition_029: BswMConditionType=BSWM_EQUALS, BswMConditionMode=PowerModeShutdownReq_EmergencySleep
            BswMConditionValue
              BswMModeDeclaration: BswMModeValueRef=BswMReqShutdownEmergency
          BswMModeCondition_030: BswMConditionType=BSWM_EQUALS, BswMConditionMode=PowerModeShutdownReq_EmergencySleep
            BswMConditionValue
              BswMModeDeclaration: BswMModeValueRef=BswMReqSleepEmergency
          BswMModeCondition_031: BswMConditionType=BSWM_EQUALS, BswMConditionMode=PowerModeShutdownReq
            BswMConditionValue
              BswMModeDeclaration: BswMModeValueRef=BswMReqShutdown
          BswMModeCondition_032: BswMConditionType=BSWM_EQUALS_NOT, BswMConditionMode=PowerModeShutdownReq
            BswMConditionValue
              BswMModeDeclaration: BswMModeValueRef=BswMReqShutdown
          CC_Cond_DcmComIndication_CN_B30_for_SC_CAN_V3_2_c0d6c67b_NEQ_DCM_DISABLE_RX_TX_NORMAL: BswMConditionType=BSWM_EQUALS_NOT, BswMConditionMode=CC_DcmComIndication_CN_B30_for_SC_CAN_V3_2_c0d6c67b
            BswMConditionValue
              BswMBswMode: BswMBswRequestedMode=DCM_DISABLE_RX_TX_NORMAL
        CC_DcmComIndication_CN_B30_for_SC_CAN_V3_2_c0d6c67b (BswMModeRequestPort): BswMArbitrateOnInit=false, BswMRequestProcessing=BSWM_IMMEDIATE
          BswMModeRequestSource
            BswMDcmComModeRequest: BswMDcmComMChannelRef=CN_B30_for_SC_CAN_V3_2_c0d6c67b
          BswMModeInitValue
            BswMBswModeInitValue: BswMBswModeInitValueMode=DCM_ENABLE_RX_TX_NORM
        BswMModeCondition_033 (BswMModeCondition): BswMConditionType=BSWM_EQUALS_NOT, BswMConditionMode=PowerModeShutdownReq
          BswMConditionValue
            BswMModeDeclaration: BswMModeValueRef=BswMReqShutdown
        BswMModeCondition_034 (BswMModeCondition): BswMConditionType=BSWM_EQUALS, BswMConditionMode=ESH_State
          BswMConditionValue
            BswMBswMode: BswMBswRequestedMode=ESH_READ_NVM
        ESH_NvMReadIndication (BswMModeRequestPort): BswMArbitrateOnInit=false, BswMRequestProcessing=BSWM_DEFERRED
          BswMModeRequestSource
            BswMGenericRequest: BswMModeRequesterId=253, BswMRequestedModeMax=2
              NVM_READ_OK (BswMGenericRequestMode): BswMGenericRequestModeValue=0
              NVM_READ_PENDING (BswMGenericRequestMode): BswMGenericRequestModeValue=1
          BswMModeInitValue
            BswMBswModeInitValue: BswMBswModeInitValueMode=NVM_READ_OK
        ESH_NvM_ReadTimer (BswMModeRequestPort): BswMArbitrateOnInit=false, BswMRequestProcessing=BSWM_DEFERRED
          BswMModeRequestSource
            BswMTimer
          BswMModeInitValue
            BswMBswModeInitValue: BswMBswModeInitValueMode=BSWM_TIMER_STOPPED
        ESH_LE_ReadNotPending (BswMLogicalExpression): BswMLogicalOperator=BSWM_OR, BswMArgumentRef=BswMModeCondition_036, BswMArgumentRef=BswMModeCondition_035
        BswMModeCondition_035 (BswMModeCondition): BswMConditionType=BSWM_EQUALS_NOT, BswMConditionMode=ESH_NvM_ReadTimer
          BswMConditionValue
            BswMBswMode: BswMBswRequestedMode=BSWM_TIMER_STARTED
        BswMModeCondition_036 (BswMModeCondition): BswMConditionType=BSWM_EQUALS_NOT, BswMConditionMode=ESH_NvMReadIndication
          BswMConditionValue
            BswMBswMode: BswMBswRequestedMode=NVM_READ_PENDING
        ESH_R15_WriteToReadNVM (BswMRule):
          BswMNestedExecutionOnly = false
          BswMRuleId = 25
          BswMRuleInitState = BSWM_FALSE
          BswMRuleExpressionRef = ESH_LE_WriteToReadNVM
          BswMRuleTrueActionList = ESH_AL_A15_WaitWriteToReadNVM
        ESH_LE_WriteToReadNVM (BswMLogicalExpression):
          BswMLogicalOperator = BSWM_AND
          BswMArgumentRef = BswMModeCondition_037
          BswMArgumentRef = BswMModeCondition_046
          BswMArgumentRef = ESH_LE_NoWakeup
          BswMArgumentRef = ESH_LE_WriteNotPending
        BswMModeCondition_037 (BswMModeCondition): BswMConditionType=BSWM_EQUALS, BswMConditionMode=ESH_State
          BswMConditionValue
            BswMBswMode: BswMBswRequestedMode=ESH_WAIT_FOR_NVM
        ESH_R18_ReadToWakeup (BswMRule):
          BswMNestedExecutionOnly = false
          BswMRuleId = 28
          BswMRuleInitState = BSWM_FALSE
          BswMRuleExpressionRef = ESH_LE_ReadNvMToWakeup
          BswMRuleTrueActionList = ESH_AL_A18_ReadNvMToWakeup
        ESH_LE_ReadNvMToWakeup (BswMLogicalExpression): BswMLogicalOperator=BSWM_AND, BswMArgumentRef=BswMModeCondition_033, BswMArgumentRef=BswMModeCondition_038, BswMArgumentRef=ESH_LE_ValidWakeup
        BswMModeCondition_038 (BswMModeCondition): BswMConditionType=BSWM_EQUALS, BswMConditionMode=ESH_State
          BswMConditionValue
            BswMBswMode: BswMBswRequestedMode=ESH_READ_NVM
        ESH_R19_ReadNVM (BswMRule):
          BswMNestedExecutionOnly = false
          BswMRuleId = 29
          BswMRuleInitState = BSWM_FALSE
          BswMRuleExpressionRef = ESH_LE_NVMRead
          BswMRuleTrueActionList = ESH_AL_A19_ReadNVM
        ESH_LE_NVMRead (BswMLogicalExpression): BswMLogicalOperator=BSWM_AND, BswMArgumentRef=BswMModeCondition_039, BswMArgumentRef=BswMModeCondition_043
        3 x BswMModeCondition, all with BswMConditionType=BSWM_EQUALS, BswMConditionMode=ESH_State:
          BswMModeCondition_039
            BswMConditionValue
              BswMBswMode: BswMBswRequestedMode=ESH_READ_NVM
          BswMModeCondition_040
            BswMConditionValue
              BswMBswMode: BswMBswRequestedMode=ESH_WAIT_FOR_NVM
          BswMModeCondition_041
            BswMConditionValue
              BswMBswMode: BswMBswRequestedMode=ESH_READ_NVM
        LE_WriteOrReadNVM_State (BswMLogicalExpression): BswMLogicalOperator=BSWM_OR, BswMArgumentRef=BswMModeCondition_041, BswMArgumentRef=BswMModeCondition_040
        5 x BswMModeCondition:
          BswMModeCondition_042: BswMConditionType=BSWM_EQUALS, BswMConditionMode=ESH_State
            BswMConditionValue
              BswMBswMode: BswMBswRequestedMode=ESH_WAIT_FOR_NVM
          BswMModeCondition_043: BswMConditionType=BSWM_EQUALS, BswMConditionMode=ESH_ModeNotification
            BswMConditionValue
              BswMModeDeclaration: BswMModeValueRef=NVMPROCESS
          BswMModeCondition_044: BswMConditionType=BSWM_EQUALS_NOT, BswMConditionMode=PowerModeShutdownReq
            BswMConditionValue
              BswMModeDeclaration: BswMModeValueRef=BswMReqShutdown
          BswMModeCondition_045: BswMConditionType=BSWM_EQUALS_NOT, BswMConditionMode=PowerModeShutdownReq
            BswMConditionValue
              BswMModeDeclaration: BswMModeValueRef=BswMReqShutdown
          BswMModeCondition_046: BswMConditionType=BSWM_EQUALS_NOT, BswMConditionMode=PowerModeShutdownReq
            BswMConditionValue
              BswMModeDeclaration: BswMModeValueRef=BswMReqShutdown
        CC_CN_B30_for_SC_CAN_V3_2_c0d6c67b_NM (BswMRule):
          BswMNestedExecutionOnly = false
          BswMRuleId = 0
          BswMRuleInitState = BSWM_FALSE
          BswMRuleExpressionRef = CC_LE_CN_B30_for_SC_CAN_V3_2_c0d6c67b_NM
          BswMRuleTrueActionList = CC_AL_CN_B30_for_SC_CAN_V3_2_c0d6c67b_NmDisable
        CC_LE_CN_B30_for_SC_CAN_V3_2_c0d6c67b_NM (BswMLogicalExpression):
          BswMLogicalOperator = BSWM_OR
          BswMArgumentRef = CC_Cond_DcmComIndication_CN_B30_for_SC_CAN_V3_2_c0d6c67b_EQ_DCM_ENABLE_RX_DISABLE_TX_NM
          BswMArgumentRef = CC_Cond_DcmComIndication_CN_B30_for_SC_CAN_V3_2_c0d6c67b_EQ_DCM_DISABLE_RX_TX_NM
          BswMArgumentRef = CC_Cond_DcmComIndication_CN_B30_for_SC_CAN_V3_2_c0d6c67b_EQ_DCM_ENABLE_RX_DISABLE_TX_NORM_NM
          BswMArgumentRef = CC_Cond_DcmComIndication_CN_B30_for_SC_CAN_V3_2_c0d6c67b_EQ_DCM_DISABLE_RX_TX_NORM_NM
        29 x BswMModeCondition:
          CC_Cond_DcmComIndication_CN_B30_for_SC_CAN_V3_2_c0d6c67b_NEQ_DCM_DISABLE_RX_TX_NORM_NM: BswMConditionType=BSWM_EQUALS_NOT, BswMConditionMode=CC_DcmComIndication_CN_B30_for_SC_CAN_V3_2_c0d6c67b
            BswMConditionValue
              BswMBswMode: BswMBswRequestedMode=DCM_DISABLE_RX_TX_NORM_NM
          CC_Cond_DcmComIndication_CN_B30_for_SC_CAN_V3_2_c0d6c67b_EQ_DCM_DISABLE_RX_TX_NORM_NM: BswMConditionType=BSWM_EQUALS, BswMConditionMode=CC_DcmComIndication_CN_B30_for_SC_CAN_V3_2_c0d6c67b
            BswMConditionValue
              BswMBswMode: BswMBswRequestedMode=DCM_DISABLE_RX_TX_NORM_NM
          CC_Cond_DcmComIndication_CN_B30_for_SC_CAN_V3_2_c0d6c67b_NEQ_DCM_DISABLE_RX_ENABLE_TX_NORM: BswMConditionType=BSWM_EQUALS_NOT, BswMConditionMode=CC_DcmComIndication_CN_B30_for_SC_CAN_V3_2_c0d6c67b
            BswMConditionValue
              BswMBswMode: BswMBswRequestedMode=DCM_DISABLE_RX_ENABLE_TX_NORM
          CC_Cond_DcmComIndication_CN_B30_for_SC_CAN_V3_2_c0d6c67b_NEQ_DCM_DISABLE_RX_ENABLE_TX_NM: BswMConditionType=BSWM_EQUALS_NOT, BswMConditionMode=CC_DcmComIndication_CN_B30_for_SC_CAN_V3_2_c0d6c67b
            BswMConditionValue
              BswMBswMode: BswMBswRequestedMode=DCM_DISABLE_RX_ENABLE_TX_NM
          CC_Cond_DcmComIndication_CN_B30_for_SC_CAN_V3_2_c0d6c67b_NEQ_DCM_DISABLE_RX_TX_NM: BswMConditionType=BSWM_EQUALS_NOT, BswMConditionMode=CC_DcmComIndication_CN_B30_for_SC_CAN_V3_2_c0d6c67b
            BswMConditionValue
              BswMBswMode: BswMBswRequestedMode=DCM_DISABLE_RX_TX_NM
          CC_Cond_DcmComIndication_CN_B30_for_SC_CAN_V3_2_c0d6c67b_NEQ_DCM_DISABLE_RX_ENABLE_TX_NORM_NM: BswMConditionType=BSWM_EQUALS_NOT, BswMConditionMode=CC_DcmComIndication_CN_B30_for_SC_CAN_V3_2_c0d6c67b
            BswMConditionValue
              BswMBswMode: BswMBswRequestedMode=DCM_DISABLE_RX_ENABLE_TX_NORM_NM
          CC_Cond_DcmComIndication_CN_B30_for_SC_CAN_V3_2_c0d6c67b_NEQ_DCM_ENABLE_RX_DISABLE_TX_NM: BswMConditionType=BSWM_EQUALS_NOT, BswMConditionMode=CC_DcmComIndication_CN_B30_for_SC_CAN_V3_2_c0d6c67b
            BswMConditionValue
              BswMBswMode: BswMBswRequestedMode=DCM_ENABLE_RX_DISABLE_TX_NM
          CC_Cond_DcmComIndication_CN_B30_for_SC_CAN_V3_2_c0d6c67b_NEQ_DCM_ENABLE_RX_DISABLE_TX_NORM_NM: BswMConditionType=BSWM_EQUALS_NOT, BswMConditionMode=CC_DcmComIndication_CN_B30_for_SC_CAN_V3_2_c0d6c67b
            BswMConditionValue
              BswMBswMode: BswMBswRequestedMode=DCM_ENABLE_RX_DISABLE_TX_NORM_NM
          CC_Cond_DcmComIndication_CN_B30_for_SC_CAN_V3_2_c0d6c67b_EQ_DCM_ENABLE_RX_DISABLE_TX_NM: BswMConditionType=BSWM_EQUALS, BswMConditionMode=CC_DcmComIndication_CN_B30_for_SC_CAN_V3_2_c0d6c67b
            BswMConditionValue
              BswMBswMode: BswMBswRequestedMode=DCM_ENABLE_RX_DISABLE_TX_NM
          CC_Cond_DcmComIndication_CN_B30_for_SC_CAN_V3_2_c0d6c67b_EQ_DCM_DISABLE_RX_TX_NM: BswMConditionType=BSWM_EQUALS, BswMConditionMode=CC_DcmComIndication_CN_B30_for_SC_CAN_V3_2_c0d6c67b
            BswMConditionValue
              BswMBswMode: BswMBswRequestedMode=DCM_DISABLE_RX_TX_NM
          CC_Cond_DcmComIndication_CN_B30_for_SC_CAN_V3_2_c0d6c67b_EQ_DCM_ENABLE_RX_DISABLE_TX_NORM_NM: BswMConditionType=BSWM_EQUALS, BswMConditionMode=CC_DcmComIndication_CN_B30_for_SC_CAN_V3_2_c0d6c67b
            BswMConditionValue
              BswMBswMode: BswMBswRequestedMode=DCM_ENABLE_RX_DISABLE_TX_NORM_NM
          BswMModeCondition_047: BswMConditionType=BSWM_EQUALS, BswMConditionMode=CC_DcmComIndication_CN_B30_for_SC_CAN_V3_2_c0d6c67b
            BswMConditionValue
              BswMBswMode: BswMBswRequestedMode=DCM_DISABLE_RX_ENABLE_TX_NORM_NM
          BswMModeCondition_048: BswMConditionType=BSWM_EQUALS, BswMConditionMode=CC_DcmComIndication_CN_B30_for_SC_CAN_V3_2_c0d6c67b
            BswMConditionValue
              BswMBswMode: BswMBswRequestedMode=DCM_ENABLE_RX_TX_NORM_NM
          BswMModeCondition_049: BswMConditionType=BSWM_EQUALS, BswMConditionMode=CC_DcmComIndication_CN_B30_for_SC_CAN_V3_2_c0d6c67b
            BswMConditionValue
              BswMBswMode: BswMBswRequestedMode=DCM_DISABLE_RX_ENABLE_TX_NORM
          BswMModeCondition_050: BswMConditionType=BSWM_EQUALS, BswMConditionMode=CC_DcmComIndication_CN_B30_for_SC_CAN_V3_2_c0d6c67b
            BswMConditionValue
              BswMBswMode: BswMBswRequestedMode=DCM_ENABLE_RX_TX_NORM
          BswMModeCondition_051: BswMConditionType=BSWM_EQUALS, BswMConditionMode=CC_CanSMIndication_CN_B30_for_SC_CAN_V3_2_c0d6c67b
            BswMConditionValue
              BswMBswMode: BswMBswRequestedMode=CANSM_BSWM_FULL_COMMUNICATION
          BswMModeCondition_052: BswMConditionType=BSWM_EQUALS, BswMConditionMode=CC_DcmComIndication_CN_B30_for_SC_CAN_V3_2_c0d6c67b
            BswMConditionValue
              BswMBswMode: BswMBswRequestedMode=DCM_ENABLE_RX_DISABLE_TX_NORM
          BswMModeCondition_053: BswMConditionType=BSWM_EQUALS, BswMConditionMode=CC_DcmComIndication_CN_B30_for_SC_CAN_V3_2_c0d6c67b
            BswMConditionValue
              BswMBswMode: BswMBswRequestedMode=DCM_ENABLE_RX_DISABLE_TX_NORM_NM
          BswMModeCondition_054: BswMConditionType=BSWM_EQUALS_NOT, BswMConditionMode=CC_CanSMIndication_CN_B30_for_SC_CAN_V3_2_c0d6c67b
            BswMConditionValue
              BswMBswMode: BswMBswRequestedMode=CANSM_BSWM_NO_COMMUNICATION
          BswMModeCondition_055: BswMConditionType=BSWM_EQUALS, BswMConditionMode=CC_DcmComIndication_CN_B30_for_SC_CAN_V3_2_c0d6c67b
            BswMConditionValue
              BswMBswMode: BswMBswRequestedMode=DCM_ENABLE_RX_DISABLE_TX_NORM
          BswMModeCondition_056: BswMConditionType=BSWM_EQUALS, BswMConditionMode=CC_DcmComIndication_CN_B30_for_SC_CAN_V3_2_c0d6c67b
            BswMConditionValue
              BswMBswMode: BswMBswRequestedMode=DCM_DISABLE_RX_TX_NORMAL
          BswMModeCondition_057: BswMConditionType=BSWM_EQUALS, BswMConditionMode=CC_DcmComIndication_CN_B30_for_SC_CAN_V3_2_c0d6c67b
            BswMConditionValue
              BswMBswMode: BswMBswRequestedMode=DCM_ENABLE_RX_DISABLE_TX_NORM_NM
          BswMModeCondition_058: BswMConditionType=BSWM_EQUALS, BswMConditionMode=CC_DcmComIndication_CN_B30_for_SC_CAN_V3_2_c0d6c67b
            BswMConditionValue
              BswMBswMode: BswMBswRequestedMode=DCM_DISABLE_RX_TX_NORM_NM
          BswMModeCondition_059: BswMConditionType=BSWM_EQUALS, BswMConditionMode=CC_DcmComIndication_CN_B30_for_SC_CAN_V3_2_c0d6c67b
            BswMConditionValue
              BswMBswMode: BswMBswRequestedMode=DCM_DISABLE_RX_TX_NORM_NM
          BswMModeCondition_060: BswMConditionType=BSWM_EQUALS, BswMConditionMode=CC_DcmComIndication_CN_B30_for_SC_CAN_V3_2_c0d6c67b
            BswMConditionValue
              BswMBswMode: BswMBswRequestedMode=DCM_DISABLE_RX_ENABLE_TX_NORM_NM
          BswMModeCondition_061: BswMConditionType=BSWM_EQUALS, BswMConditionMode=CC_DcmComIndication_CN_B30_for_SC_CAN_V3_2_c0d6c67b
            BswMConditionValue
              BswMBswMode: BswMBswRequestedMode=DCM_DISABLE_RX_TX_NORMAL
          BswMModeCondition_062: BswMConditionType=BSWM_EQUALS, BswMConditionMode=CC_DcmComIndication_CN_B30_for_SC_CAN_V3_2_c0d6c67b
            BswMConditionValue
              BswMBswMode: BswMBswRequestedMode=DCM_DISABLE_RX_ENABLE_TX_NORM
          BswMModeCondition_063: BswMConditionType=BSWM_EQUALS, BswMConditionMode=CC_DcmComIndication_CN_B30_for_SC_CAN_V3_2_c0d6c67b
            BswMConditionValue
              BswMBswMode: BswMBswRequestedMode=DCM_ENABLE_RX_TX_NM
          BswMModeCondition_064: BswMConditionType=BSWM_EQUALS, BswMConditionMode=CC_DcmComIndication_CN_B30_for_SC_CAN_V3_2_c0d6c67b
            BswMConditionValue
              BswMBswMode: BswMBswRequestedMode=DCM_ENABLE_RX_TX_NORM_NM
        5 x BswMRule, all with BswMNestedExecutionOnly=false, BswMRuleInitState=BSWM_FALSE:
          DCMIndication_R1_NORM_TX_ENABLE: BswMRuleId=4, BswMRuleExpressionRef=LE_DCM_R1, BswMRuleTrueActionList=CC_AL_CN_B30_for_SC_CAN_V3_2_c0d6c67b_TX_EnableNoinit_MISC
          DCMIndication_R2_NORM_RX_ENABLE: BswMRuleId=6, BswMRuleExpressionRef=LE_DCM_R2, BswMRuleTrueActionList=CC_AL_CN_B30_for_SC_CAN_V3_2_c0d6c67b_RX_EnableNoinit_MISC
          DCMIndication_R3_NORM_TX_DISABLE: BswMRuleId=7, BswMRuleExpressionRef=LE_DCM_R3, BswMRuleTrueActionList=CC_AL_CN_B30_for_SC_CAN_V3_2_c0d6c67b_TX_Disable_MISC
          DCMIndication_R4_NORM_RX_DISABLE: BswMRuleId=9, BswMRuleExpressionRef=LE_DCM_R4, BswMRuleTrueActionList=CC_AL_CN_B30_for_SC_CAN_V3_2_c0d6c67b_RX_Disable_MISC
          DCMIndication_R5_NM_ENABLE: BswMRuleId=10, BswMRuleExpressionRef=LE_R5_NM_RX_TX_ENABLE, BswMRuleTrueActionList=CC_AL_CN_B30_for_SC_CAN_V3_2_c0d6c67b_NmEnable
        9 x BswMLogicalExpression:
          LE_DCM_R1: BswMLogicalOperator=BSWM_AND, BswMArgumentRef=LE_R1_NORM_TX_ENABLE, BswMArgumentRef=BswMModeCondition_051, BswMArgumentRef=BswMModeCondition_070, BswMArgumentRef=BswMModeCondition_072
          LE_DCM_R2: BswMLogicalOperator=BSWM_AND, BswMArgumentRef=LE_R2_NORM_RX_ENABLE, BswMArgumentRef=BswMModeCondition_054
          LE_DCM_R3: BswMLogicalOperator=BSWM_AND, BswMArgumentRef=LE_R3_NORM_TX_DISABLE, BswMArgumentRef=BswMModeCondition_051, BswMArgumentRef=BswMModeCondition_071
          LE_DCM_R4: BswMLogicalOperator=BSWM_AND, BswMArgumentRef=LE_R4_NORM_RX_DISABLE, BswMArgumentRef=BswMModeCondition_054
          LE_R1_NORM_TX_ENABLE: BswMLogicalOperator=BSWM_OR, BswMArgumentRef=BswMModeCondition_050, BswMArgumentRef=BswMModeCondition_049, BswMArgumentRef=BswMModeCondition_048, BswMArgumentRef=BswMModeCondition_047
          LE_R2_NORM_RX_ENABLE: BswMLogicalOperator=BSWM_OR, BswMArgumentRef=BswMModeCondition_050, BswMArgumentRef=BswMModeCondition_052, BswMArgumentRef=BswMModeCondition_053, BswMArgumentRef=BswMModeCondition_065
          LE_R3_NORM_TX_DISABLE: BswMLogicalOperator=BSWM_OR, BswMArgumentRef=BswMModeCondition_055, BswMArgumentRef=BswMModeCondition_056, BswMArgumentRef=BswMModeCondition_057, BswMArgumentRef=BswMModeCondition_058
          LE_R4_NORM_RX_DISABLE: BswMLogicalOperator=BSWM_OR, BswMArgumentRef=BswMModeCondition_062, BswMArgumentRef=BswMModeCondition_061, BswMArgumentRef=BswMModeCondition_060, BswMArgumentRef=BswMModeCondition_059
          LE_R5_NM_RX_TX_ENABLE: BswMLogicalOperator=BSWM_OR, BswMArgumentRef=BswMModeCondition_063, BswMArgumentRef=BswMModeCondition_064
        BswMModeCondition_065 (BswMModeCondition): BswMConditionType=BSWM_EQUALS, BswMConditionMode=CC_DcmComIndication_CN_B30_for_SC_CAN_V3_2_c0d6c67b
          BswMConditionValue
            BswMBswMode: BswMBswRequestedMode=DCM_ENABLE_RX_TX_NORM_NM
        VehicleTypeOptionChoose (BswMModeRequestPort): BswMArbitrateOnInit=false, BswMRequestProcessing=BSWM_DEFERRED
          BswMModeRequestSource
            BswMSwcModeRequest: BswMSwcModeRequestPortInterfaceRef=requestedMode
          BswMModeInitValue
            BswMCompuScaleModeValue: BswMCompuConstText=FUEL, BswMCompuMethodRef=BswM_BswMRteVehicleTypeOptionChoose
        DCMIndication_R6_NORM_TX_ENABLE (BswMRule):
          BswMNestedExecutionOnly = false
          BswMRuleId = 5
          BswMRuleInitState = BSWM_FALSE
          BswMRuleExpressionRef = LE_DCM_R6
          BswMRuleTrueActionList = CC_AL_CN_B30_for_SC_CAN_V3_2_c0d6c67b_TX_EnableNoinit_MISC_HEV
        DCMIndication_R7_NORM_TX_DISABLE (BswMRule):
          BswMNestedExecutionOnly = false
          BswMRuleId = 8
          BswMRuleInitState = BSWM_FALSE
          BswMRuleExpressionRef = LE_DCM_R7
          BswMRuleTrueActionList = CC_AL_CN_B30_for_SC_CAN_V3_2_c0d6c67b_TX_Disable_MISC_HEV
        4 x BswMModeCondition, all with BswMConditionType=BSWM_EQUALS, BswMConditionMode=VehicleTypeOptionChoose:
          BswMModeCondition_066
            BswMConditionValue
              BswMBswMode: BswMBswRequestedMode=FUEL
          BswMModeCondition_067
            BswMConditionValue
              BswMBswMode: BswMBswRequestedMode=FUEL
          BswMModeCondition_068
            BswMConditionValue
              BswMBswMode: BswMBswRequestedMode=EV
          BswMModeCondition_069
            BswMConditionValue
              BswMBswMode: BswMBswRequestedMode=EV
        LE_DCM_R6 (BswMLogicalExpression):
          BswMLogicalOperator = BSWM_AND
          BswMArgumentRef = LE_R1_NORM_TX_ENABLE
          BswMArgumentRef = BswMModeCondition_051
          BswMArgumentRef = BswMModeCondition_068
          BswMArgumentRef = BswMModeCondition_073
        LE_DCM_R7 (BswMLogicalExpression): BswMLogicalOperator=BSWM_AND, BswMArgumentRef=LE_R3_NORM_TX_DISABLE, BswMArgumentRef=BswMModeCondition_051, BswMArgumentRef=BswMModeCondition_069
        BswMModeCondition_070 (BswMModeCondition): BswMConditionType=BSWM_EQUALS, BswMConditionMode=VehicleTypeOptionChoose
          BswMConditionValue
            BswMBswMode: BswMBswRequestedMode=FUEL
        BswMModeCondition_071 (BswMModeCondition): BswMConditionType=BSWM_EQUALS, BswMConditionMode=VehicleTypeOptionChoose
          BswMConditionValue
            BswMBswMode: BswMBswRequestedMode=FUEL
        CanServerBusStateReq (BswMModeRequestPort): BswMArbitrateOnInit=false, BswMRequestProcessing=BSWM_DEFERRED
          BswMModeRequestSource
            BswMSwcModeRequest: BswMSwcModeRequestPortInterfaceRef=requestedMode
          BswMModeInitValue
            BswMCompuScaleModeValue: BswMCompuConstText=BLOCK_STATE, BswMCompuMethodRef=BswM_BswMRteModeBusStateReq
        4 x BswMModeCondition, all with BswMConditionType=BSWM_EQUALS, BswMConditionMode=CanServerBusStateReq:
          BswMModeCondition_072
            BswMConditionValue
              BswMBswMode: BswMBswRequestedMode=UNBLOCK_STATE
          BswMModeCondition_073
            BswMConditionValue
              BswMBswMode: BswMBswRequestedMode=UNBLOCK_STATE
          BswMModeCondition_074
            BswMConditionValue
              BswMBswMode: BswMBswRequestedMode=BLOCK_STATE
          BswMModeCondition_075
            BswMConditionValue
              BswMBswMode: BswMBswRequestedMode=BLOCK_STATE
        CanCommunicationVolEnable (BswMModeRequestPort): BswMArbitrateOnInit=false, BswMRequestProcessing=BSWM_DEFERRED
          BswMModeRequestSource
            BswMSwcModeRequest: BswMSwcModeRequestPortInterfaceRef=requestedMode
          BswMModeInitValue
            BswMCompuScaleModeValue: BswMCompuConstText=Vol_Disable, BswMCompuMethodRef=BswM_BswMRteModeVolEnable
        BswMModeCondition_076 (BswMModeCondition): BswMConditionType=BSWM_EQUALS, BswMConditionMode=CanCommunicationVolEnable
          BswMConditionValue
            BswMBswMode: BswMBswRequestedMode=Vol_Enable
        BswMModeCondition_077 (BswMModeCondition): BswMConditionType=BSWM_EQUALS, BswMConditionMode=CanCommunicationVolEnable
          BswMConditionValue
            BswMBswMode: BswMBswRequestedMode=Vol_Enable
      BswMModeControl: BswMInitActionListRef=INIT_AL_Initialize
        BswM_DataFlashStop (BswMAction)
          BswMAvailableActions
            BswMUserCallout: BswMUserCalloutFunction=BswM_DataFlashStop(), BswMCreateCallout=true, BswMUserCode=Cdd_HsmDataFlashStop();, BswMUserIncludeFile=Cdd_Hsm.h
        BswM_DataFlashStart (BswMAction)
          BswMAvailableActions
            BswMUserCallout: BswMUserCalloutFunction=BswM_DataFlashStart(), BswMCreateCallout=true, BswMUserCode=Cdd_HsmDataFlashStart();, BswMUserIncludeFile=Cdd_Hsm.h
        CC_AL_CN_B30_for_SC_CAN_V3_2_c0d6c67b_RX_Disable (BswMActionList): BswMActionListExecution=BSWM_TRIGGER
          ComEx_DisableRxTimeout (BswMActionListItem): BswMAbortOnFail=false, BswMActionListItemIndex=0, BswMActionListItemRef=BswMModeControl/ComEx_DisableRxTimeout
        CC_DisablePDUGroup_HUT_oB30_for_SC_CAN_V3_2_Rx_4400ad35 (BswMAction)
          BswMAvailableActions
            BswMPduGroupSwitch: BswMPduGroupSwitchReinit=false, BswMDisabledPduGroupRef=HUT_oB30_for_SC_CAN_V3_2_Rx_4400ad35
        CC_DisablePDUGroup_ComIPduGroup (BswMAction)
          BswMAvailableActions
            BswMPduGroupSwitch: BswMPduGroupSwitchReinit=false, BswMDisabledPduGroupRef=ComIPduGroup
        CC_AL_CN_B30_for_SC_CAN_V3_2_c0d6c67b_RX_EnableNoinit (BswMActionList): BswMActionListExecution=BSWM_TRIGGER
          ComEx_EnableRxTimeout (BswMActionListItem): BswMAbortOnFail=false, BswMActionListItemIndex=0, BswMActionListItemRef=BswMModeControl/ComEx_EnableRxTimeout
        CC_EnablePDUGroup_HUT_oB30_for_SC_CAN_V3_2_Rx_4400ad35 (BswMAction)
          BswMAvailableActions
            BswMPduGroupSwitch: BswMPduGroupSwitchReinit=false, BswMEnabledPduGroupRef=HUT_oB30_for_SC_CAN_V3_2_Rx_4400ad35
        CC_EnablePDUGroup_ComIPduGroup (BswMAction)
          BswMAvailableActions
            BswMPduGroupSwitch: BswMPduGroupSwitchReinit=false, BswMEnabledPduGroupRef=ComIPduGroup
        CC_AL_CN_B30_for_SC_CAN_V3_2_c0d6c67b_Disable_DM (BswMActionList): BswMActionListExecution=BSWM_TRIGGER
          CC_DisableDM_HUT_oB30_for_SC_CAN_V3_2_Rx_4400ad35 (BswMActionListItem): BswMAbortOnFail=false, BswMActionListItemIndex=0, BswMActionListItemRef=BswMModeControl/CC_DisableDM_HUT_oB30_for_SC_CAN_V3_2_Rx_4400ad35
        CC_DisableDM_HUT_oB30_for_SC_CAN_V3_2_Rx_4400ad35 (BswMAction)
          BswMAvailableActions
            BswMDeadlineMonitoringControl: BswMDisabledDMPduGroupRef=HUT_oB30_for_SC_CAN_V3_2_Rx_4400ad35
        CC_DisableDM_ComIPduGroup (BswMAction)
          BswMAvailableActions
            BswMDeadlineMonitoringControl: BswMDisabledDMPduGroupRef=ComIPduGroup
        CC_AL_CN_B30_for_SC_CAN_V3_2_c0d6c67b_Enable_DM (BswMActionList): BswMActionListExecution=BSWM_TRIGGER
          CC_EnableDM_HUT_oB30_for_SC_CAN_V3_2_Rx_4400ad35 (BswMActionListItem): BswMAbortOnFail=false, BswMActionListItemIndex=0, BswMActionListItemRef=BswMModeControl/CC_EnableDM_HUT_oB30_for_SC_CAN_V3_2_Rx_4400ad35
        CC_EnableDM_HUT_oB30_for_SC_CAN_V3_2_Rx_4400ad35 (BswMAction)
          BswMAvailableActions
            BswMDeadlineMonitoringControl: BswMEnabledDMPduGroupRef=HUT_oB30_for_SC_CAN_V3_2_Rx_4400ad35
        CC_EnableDM_ComIPduGroup (BswMAction)
          BswMAvailableActions
            BswMDeadlineMonitoringControl: BswMEnabledDMPduGroupRef=ComIPduGroup
        CC_AL_CN_B30_for_SC_CAN_V3_2_c0d6c67b_TX_Disable (BswMActionList): BswMActionListExecution=BSWM_TRIGGER
          CC_DisablePDUGroup_HUT_oB30_for_SC_CAN_V3_2_Tx_125a0ab3 (BswMActionListItem): BswMAbortOnFail=false, BswMActionListItemIndex=0, BswMActionListItemRef=BswMModeControl/CC_DisablePDUGroup_HUT_oB30_for_SC_CAN_V3_2_Tx_125a0ab3
          CC_DisablePDUGroup_HUT_oB30_for_SC_CAN_V3_2_Tx_HEV (BswMActionListItem): BswMAbortOnFail=false, BswMActionListItemIndex=1, BswMActionListItemRef=BswMModeControl/CC_DisablePDUGroup_HUT_oB30_for_SC_CAN_V3_2_Tx_HEV
        CC_DisablePDUGroup_HUT_oB30_for_SC_CAN_V3_2_Tx_125a0ab3 (BswMAction)
          BswMAvailableActions
            BswMPduGroupSwitch:
              BswMPduGroupSwitchReinit = false
              BswMDisabledPduGroupRef = HUT_oB30_for_SC_CAN_V3_2_Tx_125a0ab3
              BswMDisabledPduGroupRef = HUT_oB30_for_SC_CAN_V3_2_Tx_HEV
        CC_AL_CN_B30_for_SC_CAN_V3_2_c0d6c67b_TX_EnableNoinit (BswMActionList): BswMActionListExecution=BSWM_TRIGGER
          CC_EnablePDUGroup_HUT_oB30_for_SC_CAN_V3_2_Tx_125a0ab3 (BswMActionListItem): BswMAbortOnFail=false, BswMActionListItemIndex=0, BswMActionListItemRef=BswMModeControl/CC_EnablePDUGroup_HUT_oB30_for_SC_CAN_V3_2_Tx_125a0ab3
          CC_EnablePDUGroup_HUT_oB30_for_SC_CAN_V3_2_Tx_HEV (BswMActionListItem): BswMAbortOnFail=false, BswMActionListItemIndex=1, BswMActionListItemRef=BswMModeControl/CC_EnablePDUGroup_HUT_oB30_for_SC_CAN_V3_2_Tx_HEV
        CC_EnablePDUGroup_HUT_oB30_for_SC_CAN_V3_2_Tx_125a0ab3 (BswMAction)
          BswMAvailableActions
            BswMPduGroupSwitch:
              BswMPduGroupSwitchReinit = false
              BswMEnabledPduGroupRef = HUT_oB30_for_SC_CAN_V3_2_Tx_125a0ab3
              BswMDisabledPduGroupRef = HUT_oB30_for_SC_CAN_V3_2_Tx_HEV
        ESH_AL_A4_ExitRun (BswMActionList): BswMActionListExecution=BSWM_CONDITION
          4 x BswMActionListItem, all with BswMAbortOnFail=false:
            ESH_Action_EnterExclusiveArea: BswMActionListItemIndex=0, BswMActionListItemRef=BswMModeControl/ESH_Action_EnterExclusiveArea
            ESH_Action_ComMCheckPendingRequests: BswMActionListItemIndex=1, BswMActionListItemRef=BswMModeControl/ESH_Action_ComMCheckPendingRequests
            ESH_R5_RunToPostRunNested: BswMActionListItemIndex=2, BswMActionListItemRef=BswMArbitration/ESH_R5_RunToPostRunNested
            ESH_Action_ExitExclusiveArea: BswMActionListItemIndex=3, BswMActionListItemRef=BswMModeControl/ESH_Action_ExitExclusiveArea
        6 x BswMAction:
          ESH_Action_EnterExclusiveArea
            BswMAvailableActions
              BswMUserCallout: BswMUserCalloutFunction=SchM_Enter_BswM_BSWM_EXCLUSIVE_AREA_0(), BswMCreateCallout=false, BswMUserIncludeFile=SchM_BswM.h
          ESH_Action_ComMCheckPendingRequests
            BswMAvailableActions
              BswMUserCallout:
                BswMUserCalloutFunction = ESH_ComM_CheckPendingRequests()
                BswMCreateCallout = true
                BswMUserCode = ComM_StateType CN_B30_for_SC_CAN_V3_2_c0d6c67b = COMM_NO_COM_NO_PENDING_REQUEST; (void)ComM_GetState(ComMConf_ComMChannel_CN_B30_for_SC_CAN_V3_2_c0d6c67b, &CN_B30_for_SC_CAN_V3_2_c0d6c67b); /* SBSW_BSWM_FCTCALL_LOCALVAR */ if(CN_B30_for_SC_CAN_V3_2_c0d6c67b != COMM_NO_COM_NO_PENDING_REQUEST) { BswM_RequestMode(BSWM_GENERIC_ESH_ComMPendingRequests, BSWM_GENERICVALUE_ESH_ComMPendingRequests_ESH_COMM_PENDING_REQUEST); } else { BswM_RequestMode(BSWM_GENERIC_ESH_ComMPendingRequests, BSWM_GENERICVALUE_ESH_ComMPendingRequests_ESH_COMM_NO_REQUEST); }
          ESH_Action_ComMDisallow_CN_B30_for_SC_CAN_V3_2_c0d6c67b
            BswMAvailableActions
              BswMComMAllowCom: BswMComAllowed=false, BswMComMAllowChannelRef=CN_B30_for_SC_CAN_V3_2_c0d6c67b
          ESH_Action_EcuMClearValidatedWakeupEvents
            BswMAvailableActions
              BswMUserCallout: BswMUserCalloutFunction=EcuM_ClearValidatedWakeupEvent(ECUM_WKSOURCE_ALL_SOURCES), BswMCreateCallout=false, BswMUserIncludeFile=EcuM.h
          ESH_Action_OnEnterPostRun
            BswMAvailableActions
              BswMUserCallout: BswMUserCalloutFunction=BswM_ESH_OnEnterPostRun(), BswMCreateCallout=true
          ESH_Action_SwitchPostRun
            BswMAvailableActions
              BswMRteSwitch: BswMSwitchedMode=POSTRUN, BswMRteSwitchPortRef=ESH_ModeSwitch
        ESH_ModeSwitch (BswMSwitchPort): BswMModeSwitchInterfaceRef=BswM_MSI_ESH_Mode
        ESH_Action_ESH_PostRun (BswMAction)
          BswMAvailableActions
            BswMGenericModeSwitch: BswMGenericRequestRef=ESH_State, BswMGenericRequestModeRef=ESH_POST_RUN
        ESH_Action_ExitExclusiveArea (BswMAction)
          BswMAvailableActions
            BswMUserCallout: BswMUserCalloutFunction=SchM_Exit_BswM_BSWM_EXCLUSIVE_AREA_0(), BswMCreateCallout=false, BswMUserIncludeFile=SchM_BswM.h
        ESH_AL_A11_WaitForNvMToShutdown (BswMActionList): BswMActionListExecution=BSWM_CONDITION
          5 x BswMActionListItem, all with BswMAbortOnFail=false:
            ESH_Action_WriteAllTimer_Stop: BswMActionListItemIndex=0, BswMActionListItemRef=BswMModeControl/ESH_Action_WriteAllTimer_Stop
            ESH_Action_OnEnterShutdown: BswMActionListItemIndex=2, BswMActionListItemRef=BswMModeControl/ESH_Action_OnEnterShutdown
            Select_Shutdown_Target_OFF: BswMActionListItemIndex=3, BswMActionListItemRef=BswMModeControl/Select_Shutdown_Target_OFF
            ESH_Action_ESH_Shutdown: BswMActionListItemIndex=1, BswMActionListItemRef=BswMModeControl/ESH_Action_ESH_Shutdown
            ESH_Action_EcuMGoToSelectedShutdownTarget: BswMActionListItemIndex=4, BswMActionListItemRef=BswMModeControl/ESH_Action_EcuMGoToSelectedShutdownTarget
        3 x BswMAction:
          ESH_Action_WriteAllTimer_Stop
            BswMAvailableActions
              BswMTimerControl: BswMTimerAction=BSWM_TIMER_STOP, BswMTimerValue=0, BswMTimerRef=ESH_NvM_WriteAllTimer
          ESH_Action_OnEnterShutdown
            BswMAvailableActions
              BswMUserCallout: BswMUserCalloutFunction=BswM_ESH_OnEnterShutdown(), BswMCreateCallout=true, BswMUserCode=, BswMUserIncludeFile=AMP.h
          ESH_Action_EcuMGoToSelectedShutdownTarget
            BswMAvailableActions
              BswMUserCallout: BswMUserCalloutFunction=(void)EcuM_GoToSelectedShutdownTarget(), BswMCreateCallout=false, BswMUserIncludeFile=EcuM.h
        ESH_AL_A3_WakeupToPrep (BswMActionList): BswMActionListExecution=BSWM_CONDITION
          3 x BswMActionListItem, all with BswMAbortOnFail=false:
            ESH_Action_OnEnterPrepShutdown: BswMActionListItemIndex=0, BswMActionListItemRef=BswMModeControl/ESH_Action_OnEnterPrepShutdown
            ESH_Action_SwitchShutdown: BswMActionListItemIndex=1, BswMActionListItemRef=BswMModeControl/ESH_Action_SwitchShutdown
            ESH_Action_ESH_PrepShutdown: BswMActionListItemIndex=2, BswMActionListItemRef=BswMModeControl/ESH_Action_ESH_PrepShutdown
        3 x BswMAction:
          ESH_Action_OnEnterPrepShutdown
            BswMAvailableActions
              BswMUserCallout: BswMUserCalloutFunction=BswM_ESH_OnEnterPrepShutdown(), BswMCreateCallout=true
          ESH_Action_SwitchShutdown
            BswMAvailableActions
              BswMRteSwitch: BswMSwitchedMode=SHUTDOWN, BswMRteSwitchPortRef=ESH_ModeSwitch
          ESH_Action_ESH_PrepShutdown
            BswMAvailableActions
              BswMGenericModeSwitch: BswMGenericRequestRef=ESH_State, BswMGenericRequestModeRef=ESH_PREP_SHUTDOWN
        ESH_AL_A10_WaitForNvMWakeup (BswMActionList): BswMActionListExecution=BSWM_CONDITION
          6 x BswMActionListItem, all with BswMAbortOnFail=false:
            ESH_Action_WriteAllTimer_Stop: BswMActionListItemIndex=0, BswMActionListItemRef=BswMModeControl/ESH_Action_WriteAllTimer_Stop
            ESH_Action_CancelWriteAllTimer_Start: BswMActionListItemIndex=1, BswMActionListItemRef=BswMModeControl/ESH_Action_CancelWriteAllTimer_Start
            ESH_Action_CancelNvMWriteAll: BswMActionListItemIndex=2, BswMActionListItemRef=BswMModeControl/ESH_Action_CancelNvMWriteAll
            ESH_Action_OnEnterWakeup: BswMActionListItemIndex=3, BswMActionListItemRef=BswMModeControl/ESH_Action_OnEnterWakeup
            ESH_Action_SwitchWakeup: BswMActionListItemIndex=4, BswMActionListItemRef=BswMModeControl/ESH_Action_SwitchWakeup
            ESH_Action_ESH_Wakeup: BswMActionListItemIndex=5, BswMActionListItemRef=BswMModeControl/ESH_Action_ESH_Wakeup
        6 x BswMAction:
          ESH_Action_CancelWriteAllTimer_Start
            BswMAvailableActions
              BswMTimerControl: BswMTimerAction=BSWM_TIMER_START, BswMTimerValue=60, BswMTimerRef=ESH_NvM_CancelWriteAllTimer
          ESH_Action_CancelNvMWriteAll
            BswMAvailableActions
              BswMUserCallout: BswMUserCalloutFunction=NvM_CancelWriteAll(), BswMCreateCallout=false, BswMUserIncludeFile=NvM.h
          ESH_Action_OnEnterWakeup
            BswMAvailableActions
              BswMUserCallout: BswMUserCalloutFunction=BswM_ESH_OnEnterWakeup(), BswMCreateCallout=true, BswMUserCode=
          ESH_Action_SwitchWakeup
            BswMAvailableActions
              BswMRteSwitch: BswMSwitchedMode=WAKEUP, BswMRteSwitchPortRef=ESH_ModeSwitch
          ESH_Action_ESH_Wakeup
            BswMAvailableActions
              BswMGenericModeSwitch: BswMGenericRequestRef=ESH_State, BswMGenericRequestModeRef=ESH_WAKEUP
          ESH_Action_CancelWriteAllTimer_Stop
            BswMAvailableActions
              BswMTimerControl: BswMTimerAction=BSWM_TIMER_STOP, BswMTimerValue=0, BswMTimerRef=ESH_NvM_CancelWriteAllTimer
        ESH_AL_A2_1_DemInit (BswMActionList): BswMActionListExecution=BSWM_CONDITION
          3 x BswMActionListItem, all with BswMAbortOnFail=false:
            ESH_Action_DemInit: BswMActionListItemIndex=0, BswMActionListItemRef=BswMModeControl/ESH_Action_DemInit
            ESH_Action_DemInitialized: BswMActionListItemIndex=1, BswMActionListItemRef=BswMModeControl/ESH_Action_DemInitialized
            ESH_VConfig_retry: BswMActionListItemIndex=2, BswMActionListItemRef=BswMModeControl/ESH_VConfig_retry
        7 x BswMAction:
          ESH_Action_DemInit
            BswMAvailableActions
              BswMUserCallout: BswMUserCalloutFunction=Dem_Init(Dem_Config_Ptr), BswMCreateCallout=false, BswMUserIncludeFile=Dem.h
          ESH_Action_DemInitialized
            BswMAvailableActions
              BswMGenericModeSwitch: BswMGenericRequestRef=ESH_DemInitStatus, BswMGenericRequestModeRef=DEM_INITIALIZED
          ESH_Action_ComMAllow_CN_B30_for_SC_CAN_V3_2_c0d6c67b
            BswMAvailableActions
              BswMComMAllowCom: BswMComAllowed=true, BswMComMAllowChannelRef=CN_B30_for_SC_CAN_V3_2_c0d6c67b
          ESH_Action_SelfRunRequestTimer_Start
            BswMAvailableActions
              BswMTimerControl: BswMTimerAction=BSWM_TIMER_START, BswMTimerValue=0.1, BswMTimerRef=ESH_SelfRunRequestTimer
          ESH_Action_OnEnterRun
            BswMAvailableActions
              BswMUserCallout: BswMUserCalloutFunction=BswM_ESH_OnEnterRun(), BswMCreateCallout=true
          ESH_Action_SwitchRun
            BswMAvailableActions
              BswMRteSwitch: BswMSwitchedMode=RUN, BswMRteSwitchPortRef=ESH_ModeSwitch
          ESH_Action_ESH_Run
            BswMAvailableActions
              BswMGenericModeSwitch: BswMGenericRequestRef=ESH_State, BswMGenericRequestModeRef=ESH_RUN
        ESH_AL_A1_InitToWakeup (BswMActionList): BswMActionListExecution=BSWM_CONDITION
          3 x BswMActionListItem, all with BswMAbortOnFail=false:
            ESH_Action_OnEnterWakeup: BswMActionListItemIndex=0, BswMActionListItemRef=BswMModeControl/ESH_Action_OnEnterWakeup
            ESH_Action_SwitchWakeup: BswMActionListItemIndex=1, BswMActionListItemRef=BswMModeControl/ESH_Action_SwitchWakeup
            ESH_Action_ESH_Wakeup: BswMActionListItemIndex=2, BswMActionListItemRef=BswMModeControl/ESH_Action_ESH_Wakeup
        ESH_AL_A8_PostRunToPrepShutdown (BswMActionList): BswMActionListExecution=BSWM_CONDITION
          5 x BswMActionListItem, all with BswMAbortOnFail=false:
            ESH_Action_DemShutdown: BswMActionListItemIndex=0, BswMActionListItemRef=BswMModeControl/ESH_Action_DemShutdown
            ESH_Action_DemNotInitialized: BswMActionListItemIndex=1, BswMActionListItemRef=BswMModeControl/ESH_Action_DemNotInitialized
            ESH_Action_OnEnterPrepShutdown: BswMActionListItemIndex=2, BswMActionListItemRef=BswMModeControl/ESH_Action_OnEnterPrepShutdown
            ESH_Action_SwitchShutdown: BswMActionListItemIndex=3, BswMActionListItemRef=BswMModeControl/ESH_Action_SwitchShutdown
            ESH_Action_ESH_PrepShutdown: BswMActionListItemIndex=4, BswMActionListItemRef=BswMModeControl/ESH_Action_ESH_PrepShutdown
        ESH_Action_DemShutdown (BswMAction)
          BswMAvailableActions
            BswMUserCallout: BswMUserCalloutFunction=Dem_Shutdown(), BswMCreateCallout=false, BswMUserIncludeFile=Dem.h
        ESH_Action_DemNotInitialized (BswMAction)
          BswMAvailableActions
            BswMGenericModeSwitch: BswMGenericRequestRef=ESH_DemInitStatus, BswMGenericRequestModeRef=DEM_NOT_INITIALIZED
        ESH_AL_A7_1_ESH_PostRunToPrepCheck (BswMActionList): BswMActionListExecution=BSWM_CONDITION
          ESH_R8_PostRunToPrepNested (BswMActionListItem): BswMAbortOnFail=false, BswMActionListItemIndex=0, BswMActionListItemRef=BswMArbitration/ESH_R8_PostRunToPrepNested
        ESH_AL_A6_ExitPostRun (BswMActionList): BswMActionListExecution=BSWM_CONDITION
          5 x BswMActionListItem, all with BswMAbortOnFail=false:
            ESH_Action_EnterExclusiveArea: BswMActionListItemIndex=0, BswMActionListItemRef=BswMModeControl/ESH_Action_EnterExclusiveArea
            ESH_Action_ComMCheckPendingRequests: BswMActionListItemIndex=1, BswMActionListItemRef=BswMModeControl/ESH_Action_ComMCheckPendingRequests
            ESH_Action_DemPostRunRequested: BswMActionListItemIndex=2, BswMActionListItemRef=BswMModeControl/ESH_Action_DemPostRunRequested
            ESH_R7_PostRunNested: BswMActionListItemIndex=3, BswMActionListItemRef=BswMArbitration/ESH_R7_PostRunNested
            ESH_Action_ExitExclusiveArea: BswMActionListItemIndex=4, BswMActionListItemRef=BswMModeControl/ESH_Action_ExitExclusiveArea
        ESH_Action_DemPostRunRequested (BswMAction)
          BswMAvailableActions
            BswMUserCallout:
              BswMUserCalloutFunction = ESH_Dem_PostRunRequested()
              BswMCreateCallout = true
              BswMUserIncludeFile = Dem.h
              BswMUserCode = boolean isRequested = FALSE; (void)Dem_PostRunRequested(&isRequested); /* SBSW_BSWM_FCTCALL_LOCALVAR */ if (isRequested == TRUE) { BswM_RequestMode(BSWM_GENERIC_ESH_DemPostRunRequested, BSWM_GENERICVALUE_ESH_DemPostRunRequested_TRUE); } else { BswM_RequestMode(BSWM_GENERIC_ESH_DemPostRunRequested, BSWM_GENERICVALUE_ESH_DemPostRunRequested_FALSE); }
        ESH_AL_A9_PrepShutdownToWaitForNvM (BswMActionList): BswMActionListExecution=BSWM_CONDITION
          6 x BswMActionListItem, all with BswMAbortOnFail=false:
            ESH_Action_WriteAllTimer_Start: BswMActionListItemIndex=0, BswMActionListItemRef=BswMModeControl/ESH_Action_WriteAllTimer_Start
            ESH_Action_NvMWriteAll: BswMActionListItemIndex=1, BswMActionListItemRef=BswMModeControl/ESH_Action_NvMWriteAll
            ESH_Action_ComMCheckPendingRequests: BswMActionListItemIndex=2, BswMActionListItemRef=BswMModeControl/ESH_Action_ComMCheckPendingRequests
            ESH_Action_OnEnterWaitForNvm: BswMActionListItemIndex=3, BswMActionListItemRef=BswMModeControl/ESH_Action_OnEnterWaitForNvm
            ESH_Action_ESH_WaitForNvm: BswMActionListItemIndex=4, BswMActionListItemRef=BswMModeControl/ESH_Action_ESH_WaitForNvm
            ESH_Mode_NVM: BswMActionListItemIndex=5, BswMActionListItemRef=BswMModeControl/ESH_Mode_NVM
        4 x BswMAction:
          ESH_Action_WriteAllTimer_Start
            BswMAvailableActions
              BswMTimerControl: BswMTimerAction=BSWM_TIMER_START, BswMTimerValue=60, BswMTimerRef=ESH_NvM_WriteAllTimer
          ESH_Action_NvMWriteAll
            BswMAvailableActions
              BswMUserCallout: BswMUserCalloutFunction=NvM_WriteAll(), BswMCreateCallout=false, BswMUserIncludeFile=NvM.h
          ESH_Action_OnEnterWaitForNvm
            BswMAvailableActions
              BswMUserCallout: BswMUserCalloutFunction=BswM_ESH_OnEnterWaitForNvm(), BswMCreateCallout=true
          ESH_Action_ESH_WaitForNvm
            BswMAvailableActions
              BswMGenericModeSwitch: BswMGenericRequestRef=ESH_State, BswMGenericRequestModeRef=ESH_WAIT_FOR_NVM
        INIT_AL_Initialize (BswMActionList): BswMActionListExecution=BSWM_CONDITION
          30 x BswMActionListItem, all with BswMAbortOnFail=false:
            INIT_Action_LinTrcv_30_Tle7259_Init: BswMActionListItemIndex=4, BswMActionListItemRef=BswMModeControl/INIT_Action_LinTrcv_30_Tle7259_Init
            INIT_Action_Can_Init: BswMActionListItemIndex=5, BswMActionListItemRef=BswMModeControl/INIT_Action_Can_Init
            INIT_Action_Lin_Init: BswMActionListItemIndex=7, BswMActionListItemRef=BswMModeControl/INIT_Action_Lin_Init
            INIT_Action_CanIf_Init: BswMActionListItemIndex=8, BswMActionListItemRef=BswMModeControl/INIT_Action_CanIf_Init
            INIT_Action_Fee_30_SmallSector_Init: BswMActionListItemIndex=21, BswMActionListItemRef=BswMModeControl/INIT_Action_Fee_30_SmallSector_Init
            INIT_Action_Com_Init: BswMActionListItemIndex=11, BswMActionListItemRef=BswMModeControl/INIT_Action_Com_Init
            INIT_Action_PduR_Init: BswMActionListItemIndex=12, BswMActionListItemRef=BswMModeControl/INIT_Action_PduR_Init
            INIT_Action_CanSM_Init: BswMActionListItemIndex=14, BswMActionListItemRef=BswMModeControl/INIT_Action_CanSM_Init
            INIT_Action_CanNm_Init: BswMActionListItemIndex=15, BswMActionListItemRef=BswMModeControl/INIT_Action_CanNm_Init
            INIT_Action_Nm_Init: BswMActionListItemIndex=16, BswMActionListItemRef=BswMModeControl/INIT_Action_Nm_Init
            INIT_Action_CanTp_Init: BswMActionListItemIndex=17, BswMActionListItemRef=BswMModeControl/INIT_Action_CanTp_Init
            INIT_Action_NvM_Init: BswMActionListItemIndex=22, BswMActionListItemRef=BswMModeControl/INIT_Action_NvM_Init
            INIT_Action_EnableInterrupts: BswMActionListItemIndex=0, BswMActionListItemRef=BswMModeControl/INIT_Action_EnableInterrupts
            INIT_Action_ComM_Init: BswMActionListItemIndex=24, BswMActionListItemRef=BswMModeControl/INIT_Action_ComM_Init
            INIT_Action_Dcm_Init: BswMActionListItemIndex=25, BswMActionListItemRef=BswMModeControl/INIT_Action_Dcm_Init
            INIT_Action_Dem_Init: BswMActionListItemIndex=26, BswMActionListItemRef=BswMModeControl/INIT_Action_Dem_Init
            INIT_Action_Rte_Start: BswMActionListItemIndex=29, BswMActionListItemRef=BswMModeControl/INIT_Action_Rte_Start
            INIT_Action_NvMReadAll: BswMActionListItemIndex=23, BswMActionListItemRef=BswMModeControl/INIT_Action_NvMReadAll
            INIT_Action_Wdg_59_DriverA_Init: BswMActionListItemIndex=2, BswMActionListItemRef=BswMModeControl/INIT_Action_Wdg_59_DriverA_Init
            INIT_Action_WdgM_Init: BswMActionListItemIndex=10, BswMActionListItemRef=BswMModeControl/INIT_Action_WdgM_Init
            INIT_Action_Read_WakeUp: BswMActionListItemIndex=1, BswMActionListItemRef=BswMModeControl/INIT_Action_Read_WakeUp
            BswMCDDInitList: BswMActionListItemIndex=28, BswMActionListItemRef=BswMModeControl/BswMCDDInitList
            INIT_Action_CanTrcv_30_Tja1040_Init: BswMActionListItemIndex=3, BswMActionListItemRef=BswMModeControl/INIT_Action_CanTrcv_30_Tja1040_Init
            INIT_Action_Crypto_30_vHsm_Init: BswMActionListItemIndex=6, BswMActionListItemRef=BswMModeControl/INIT_Action_Crypto_30_vHsm_Init
            INIT_Action_CryIf_Init: BswMActionListItemIndex=9, BswMActionListItemRef=BswMModeControl/INIT_Action_CryIf_Init
            INIT_Action_Csm_Init: BswMActionListItemIndex=18, BswMActionListItemRef=BswMModeControl/INIT_Action_Csm_Init
            INIT_Action_Fls_Init: BswMActionListItemIndex=20, BswMActionListItemRef=BswMModeControl/INIT_Action_Fls_Init
            BswM_DataFlashStart: BswMActionListItemIndex=19, BswMActionListItemRef=BswMModeControl/BswM_DataFlashStart
            INIT_Action_SecOC_Init: BswMActionListItemIndex=13, BswMActionListItemRef=BswMModeControl/INIT_Action_SecOC_Init
            INIT_Action_FvM_Init: BswMActionListItemIndex=27, BswMActionListItemRef=BswMModeControl/INIT_Action_FvM_Init
        18 x BswMAction:
          INIT_Action_LinTrcv_30_Tle7259_Init
            BswMAvailableActions
              BswMUserCallout:
                BswMUserCalloutFunction = LinTrcv_30_Tle7259_Init(LinTrcv_30_Tle7259_Config_Ptr)
                BswMCreateCallout = false
                BswMUserIncludeFile = LinTrcv_30_Tle7259.h
          INIT_Action_Can_Init
            BswMAvailableActions
              BswMUserCallout: BswMUserCalloutFunction=Can_Init(Can_Config_Ptr), BswMCreateCallout=false, BswMUserIncludeFile=Can.h
          INIT_Action_Lin_Init
            BswMAvailableActions
              BswMUserCallout: BswMUserCalloutFunction=Lin_Init(Lin_Config_Ptr), BswMCreateCallout=false, BswMUserIncludeFile=Lin.h
          INIT_Action_CanIf_Init
            BswMAvailableActions
              BswMUserCallout: BswMUserCalloutFunction=CanIf_Init(CanIf_Config_Ptr), BswMCreateCallout=false, BswMUserIncludeFile=CanIf.h
          INIT_Action_Fee_30_SmallSector_Init
            BswMAvailableActions
              BswMUserCallout: BswMUserCalloutFunction=Fee_30_SmallSector_Init(), BswMCreateCallout=false, BswMUserIncludeFile=Fee_30_SmallSector.h
          INIT_Action_Com_Init
            BswMAvailableActions
              BswMUserCallout: BswMUserCalloutFunction=Com_Init(Com_Config_Ptr), BswMCreateCallout=false, BswMUserIncludeFile=Com.h
          INIT_Action_PduR_Init
            BswMAvailableActions
              BswMUserCallout: BswMUserCalloutFunction=PduR_Init(PduR_Config_Ptr), BswMCreateCallout=false, BswMUserIncludeFile=PduR.h
          INIT_Action_CanSM_Init
            BswMAvailableActions
              BswMUserCallout: BswMUserCalloutFunction=CanSM_Init(CanSM_Config_Ptr), BswMCreateCallout=false, BswMUserIncludeFile=CanSM_EcuM.h
          INIT_Action_CanNm_Init
            BswMAvailableActions
              BswMUserCallout: BswMUserCalloutFunction=CanNm_Init(CanNm_Config_Ptr), BswMCreateCallout=false, BswMUserIncludeFile=CanNm.h
          INIT_Action_Nm_Init
            BswMAvailableActions
              BswMUserCallout: BswMUserCalloutFunction=Nm_Init(), BswMCreateCallout=false, BswMUserIncludeFile=Nm.h
          INIT_Action_CanTp_Init
            BswMAvailableActions
              BswMUserCallout: BswMUserCalloutFunction=CanTp_Init(CanTp_Config_Ptr), BswMCreateCallout=false, BswMUserIncludeFile=CanTp.h
          INIT_Action_NvM_Init
            BswMAvailableActions
              BswMUserCallout: BswMUserCalloutFunction=NvM_Init(), BswMCreateCallout=false, BswMUserIncludeFile=NvM.h
          INIT_Action_EnableInterrupts
            BswMAvailableActions
              BswMUserCallout: BswMUserCalloutFunction=BswM_AL_SetProgrammableInterrupts(), BswMCreateCallout=true, BswMUserCode=
          INIT_Action_ComM_Init
            BswMAvailableActions
              BswMUserCallout: BswMUserCalloutFunction=ComM_Init(), BswMCreateCallout=false, BswMUserIncludeFile=ComM.h
          INIT_Action_Dcm_Init
            BswMAvailableActions
              BswMUserCallout: BswMUserCalloutFunction=Dcm_Init(NULL_PTR), BswMCreateCallout=false, BswMUserIncludeFile=Dcm.h
          INIT_Action_Dem_Init
            BswMAvailableActions
              BswMUserCallout: BswMUserCalloutFunction=Dem_Init(Dem_Config_Ptr), BswMCreateCallout=false, BswMUserIncludeFile=Dem.h
          INIT_Action_Rte_Start
            BswMAvailableActions
              BswMUserCallout: BswMUserCalloutFunction=Rte_Start(), BswMCreateCallout=false, BswMUserIncludeFile=Rte_Main.h
          INIT_Action_NvMReadAll
            BswMAvailableActions
              BswMUserCallout: BswMUserCalloutFunction=BswM_INIT_NvMReadAll(), BswMCreateCallout=true, BswMUserCode=
        3 x BswMActionList, all with BswMActionListExecution=BSWM_CONDITION:
          ESH_AL_A5_RunToPostRun
            5 x BswMActionListItem, all with BswMAbortOnFail=false:
              ESH_Action_ComMDisallow_CN_B30_for_SC_CAN_V3_2_c0d6c67b: BswMActionListItemIndex=0, BswMActionListItemRef=BswMModeControl/ESH_Action_ComMDisallow_CN_B30_for_SC_CAN_V3_2_c0d6c67b
              ESH_Action_EcuMClearValidatedWakeupEvents: BswMActionListItemIndex=1, BswMActionListItemRef=BswMModeControl/ESH_Action_EcuMClearValidatedWakeupEvents
              ESH_Action_OnEnterPostRun: BswMActionListItemIndex=2, BswMActionListItemRef=BswMModeControl/ESH_Action_OnEnterPostRun
              ESH_Action_SwitchPostRun: BswMActionListItemIndex=3, BswMActionListItemRef=BswMModeControl/ESH_Action_SwitchPostRun
              ESH_Action_ESH_PostRun: BswMActionListItemIndex=4, BswMActionListItemRef=BswMModeControl/ESH_Action_ESH_PostRun
          ESH_AL_A2_WakeupToRun
            8 x BswMActionListItem, all with BswMAbortOnFail=false:
              ESH_Action_CancelWriteAllTimer_Stop: BswMActionListItemIndex=0, BswMActionListItemRef=BswMModeControl/ESH_Action_CancelWriteAllTimer_Stop
              ESH_2_1_DemInit: BswMActionListItemIndex=1, BswMActionListItemRef=BswMArbitration/ESH_2_1_DemInit
              ESH_Action_ComMAllow_CN_B30_for_SC_CAN_V3_2_c0d6c67b: BswMActionListItemIndex=2, BswMActionListItemRef=BswMModeControl/ESH_Action_ComMAllow_CN_B30_for_SC_CAN_V3_2_c0d6c67b
              ESH_Action_SelfRunRequestTimer_Start: BswMActionListItemIndex=3, BswMActionListItemRef=BswMModeControl/ESH_Action_SelfRunRequestTimer_Start
              ESH_Action_OnEnterRun: BswMActionListItemIndex=4, BswMActionListItemRef=BswMModeControl/ESH_Action_OnEnterRun
              ESH_Action_SwitchRun: BswMActionListItemIndex=5, BswMActionListItemRef=BswMModeControl/ESH_Action_SwitchRun
              ESH_Action_ESH_Run: BswMActionListItemIndex=6, BswMActionListItemRef=BswMModeControl/ESH_Action_ESH_Run
              Action_RTE_REQUEST_BswMRteModeRequestPort_TRUE: BswMActionListItemIndex=7, BswMActionListItemRef=BswMModeControl/Action_RTE_REQUEST_BswMRteModeRequestPort_TRUE
          ESH_AL_A7_PostRunToRun
            6 x BswMActionListItem, all with BswMAbortOnFail=false:
              ESH_Action_ComMAllow_CN_B30_for_SC_CAN_V3_2_c0d6c67b: BswMActionListItemIndex=0, BswMActionListItemRef=BswMModeControl/ESH_Action_ComMAllow_CN_B30_for_SC_CAN_V3_2_c0d6c67b
              ESH_Action_SelfRunRequestTimer_Start: BswMActionListItemIndex=1, BswMActionListItemRef=BswMModeControl/ESH_Action_SelfRunRequestTimer_Start
              ESH_Action_OnEnterRun: BswMActionListItemIndex=2, BswMActionListItemRef=BswMModeControl/ESH_Action_OnEnterRun
              ESH_Action_SwitchRun: BswMActionListItemIndex=3, BswMActionListItemRef=BswMModeControl/ESH_Action_SwitchRun
              ESH_Action_ESH_Run: BswMActionListItemIndex=4, BswMActionListItemRef=BswMModeControl/ESH_Action_ESH_Run
              Action_RTE_REQUEST_BswMRteModeRequestPort_TRUE: BswMActionListItemIndex=5, BswMActionListItemRef=BswMModeControl/Action_RTE_REQUEST_BswMRteModeRequestPort_TRUE
        BswMRteModeRequestPort: BswMRteModeInitValue=FALSE, BswMRteModeRequestPortInterfaceRef=Power.Ecum_Set_SystemState_Run.Element
        7 x BswMAction:
          Action_RTE_REQUEST_BswMRteModeRequestPort_TRUE
            BswMAvailableActions
              BswMRteModeRequest: BswMRequestedMode=TRUE, BswMRteModeRequestPortRef=BswMRteModeRequestPort
          Action_RTE_REQUEST_BswMRteModeRequestPort_FALSE
            BswMAvailableActions
              BswMRteModeRequest: BswMRequestedMode=FALSE, BswMRteModeRequestPortRef=BswMRteModeRequestPort
          INIT_Action_Wdg_59_DriverA_Init
            BswMAvailableActions
              BswMUserCallout: BswMUserCalloutFunction=Wdg_59_DriverA_Init(WdgSettingsConfig), BswMCreateCallout=false, BswMUserIncludeFile=Wdg_59_DriverA.h
          INIT_Action_WdgM_Init
            BswMAvailableActions
              BswMUserCallout: BswMUserCalloutFunction=WdgM_Init(&WdgMConfig_Mode0_core0), BswMCreateCallout=false, BswMUserIncludeFile=WdgM.h
          Select_Shutdown_Target_Normal_SLEEP
            BswMAvailableActions
              BswMEcuMSelectShutdownTarget: BswMEcuMShutdownTarget=SLEEP, BswMEcuMSleepModeRef=EcuMSleepMode_NormalSleep
          Select_Shutdown_Target_OFF
            BswMAvailableActions
              BswMEcuMSelectShutdownTarget: BswMEcuMShutdownTarget=OFF
          Select_Shutdown_Target_Lvi_SLEEP
            BswMAvailableActions
              BswMEcuMSelectShutdownTarget: BswMEcuMShutdownTarget=SLEEP, BswMEcuMSleepModeRef=EcuMSleepMode_LviSleep
        ESH_AL_A12_WaitForNvMToNormalSleep (BswMActionList): BswMActionListExecution=BSWM_CONDITION
          7 x BswMActionListItem, all with BswMAbortOnFail=false:
            ESH_Action_WriteAllTimer_Stop: BswMActionListItemIndex=0, BswMActionListItemRef=BswMModeControl/ESH_Action_WriteAllTimer_Stop
            ESH_Action_OnEnterShutdown: BswMActionListItemIndex=3, BswMActionListItemRef=BswMModeControl/ESH_Action_OnEnterShutdown
            ESH_Action_EcuMGoToSelectedShutdownTarget: BswMActionListItemIndex=5, BswMActionListItemRef=BswMModeControl/ESH_Action_EcuMGoToSelectedShutdownTarget
            Select_Shutdown_Target_Normal_SLEEP: BswMActionListItemIndex=4, BswMActionListItemRef=BswMModeControl/Select_Shutdown_Target_Normal_SLEEP
            ESH_Action_ESH_Sleep: BswMActionListItemIndex=2, BswMActionListItemRef=BswMModeControl/ESH_Action_ESH_Sleep
            Action_PostSleep: BswMActionListItemIndex=6, BswMActionListItemRef=BswMModeControl/Action_PostSleep
            ESH_Action_ReadNVM_Stop: BswMActionListItemIndex=1, BswMActionListItemRef=BswMModeControl/ESH_Action_ReadNVM_Stop
        Action_RTE_SWITCH_ESH_ModeSwitch_SHUTDOWN (BswMAction)
          BswMAvailableActions
            BswMRteSwitch: BswMSwitchedMode=SHUTDOWN, BswMRteSwitchPortRef=ESH_ModeSwitch
        ESH_AL_A16_PreToReset (BswMActionList): BswMActionListExecution=BSWM_CONDITION
          4 x BswMActionListItem, all with BswMAbortOnFail=false:
            ESH_Action_OnEnterShutdown: BswMActionListItemIndex=1, BswMActionListItemRef=BswMModeControl/ESH_Action_OnEnterShutdown
            ESH_Action_EcuMGoToSelectedShutdownTarget: BswMActionListItemIndex=3, BswMActionListItemRef=BswMModeControl/ESH_Action_EcuMGoToSelectedShutdownTarget
            Select_Shutdown_Target_OFF: BswMActionListItemIndex=2, BswMActionListItemRef=BswMModeControl/Select_Shutdown_Target_OFF
            ESH_Action_ESH_Shutdown: BswMActionListItemIndex=0, BswMActionListItemRef=BswMModeControl/ESH_Action_ESH_Shutdown
        ESH_AL_A17_PreToSleep (BswMActionList): BswMActionListExecution=BSWM_CONDITION
          5 x BswMActionListItem, all with BswMAbortOnFail=false:
            ESH_Action_OnEnterShutdown: BswMActionListItemIndex=1, BswMActionListItemRef=BswMModeControl/ESH_Action_OnEnterShutdown
            ESH_Action_EcuMGoToSelectedShutdownTarget: BswMActionListItemIndex=3, BswMActionListItemRef=BswMModeControl/ESH_Action_EcuMGoToSelectedShutdownTarget
            Select_Shutdown_Target_Lvi_SLEEP: BswMActionListItemIndex=2, BswMActionListItemRef=BswMModeControl/Select_Shutdown_Target_Lvi_SLEEP
            ESH_Action_ESH_Sleep: BswMActionListItemIndex=0, BswMActionListItemRef=BswMModeControl/ESH_Action_ESH_Sleep
            Action_PostSleep: BswMActionListItemIndex=4, BswMActionListItemRef=BswMModeControl/Action_PostSleep
        3 x BswMAction:
          ESH_Action_ESH_Shutdown
            BswMAvailableActions
              BswMGenericModeSwitch: BswMGenericRequestRef=ESH_State, BswMGenericRequestModeRef=ESH_SHUTDOWN
          ESH_Action_ESH_Sleep
            BswMAvailableActions
              BswMGenericModeSwitch: BswMGenericRequestRef=ESH_State, BswMGenericRequestModeRef=ESH_SLEEP
          INIT_Action_Read_WakeUp
            BswMAvailableActions
              BswMUserCallout: BswMUserCalloutFunction=ReadWakeUpPattern(), BswMCreateCallout=true, BswMUserCode=
        ESH_AL_A13_PostRunToWait (BswMActionList): BswMActionListExecution=BSWM_CONDITION
          5 x BswMActionListItem, all with BswMAbortOnFail=false:
            ESH_Action_WriteAllTimer_Start: BswMActionListItemIndex=1, BswMActionListItemRef=BswMModeControl/ESH_Action_WriteAllTimer_Start
            ESH_Action_NvMWriteAll: BswMActionListItemIndex=2, BswMActionListItemRef=BswMModeControl/ESH_Action_NvMWriteAll
            ESH_Action_OnEnterWaitForNvm: BswMActionListItemIndex=3, BswMActionListItemRef=BswMModeControl/ESH_Action_OnEnterWaitForNvm
            ESH_Action_ESH_WaitForNvm: BswMActionListItemIndex=4, BswMActionListItemRef=BswMModeControl/ESH_Action_ESH_WaitForNvm
            ESH_Action_DemShutdown: BswMActionListItemIndex=0, BswMActionListItemRef=BswMModeControl/ESH_Action_DemShutdown
        Action_PostSleep (BswMAction)
          BswMAvailableActions
            BswMUserCallout: BswMUserCalloutFunction=BswM_Action_PostSleep(), BswMCreateCallout=true, BswMUserCode=/*perform reset if sleep fail*/ Mcu_PerformReset();
        BswMRteModeRequestPort_ResetType (BswMRteModeRequestPort): BswMRteModeInitValue=FALSE, BswMRteModeRequestPortInterfaceRef=Power.Rc_BswM_Warm_Reset.Element
        AL_A5_FalseAction (BswMActionList): BswMActionListExecution=BSWM_CONDITION
          Action_RTE_REQUEST_BswMRteModeRequestPort_TRUE_001 (BswMActionListItem): BswMAbortOnFail=false, BswMActionListItemIndex=0, BswMActionListItemRef=BswMModeControl/Action_RTE_REQUEST_BswMRteModeRequestPort_TRUE_001
        3 x BswMAction:
          Action_RTE_REQUEST_BswMRteModeRequestPort_TRUE_001
            BswMAvailableActions
              BswMRteModeRequest: BswMRequestedMode=TRUE, BswMRteModeRequestPortRef=BswMRteModeRequestPort
          BswMCDDInitList
            BswMAvailableActions
              BswMUserCallout: BswMUserCalloutFunction=BSWMCDDInitCallout(), BswMCreateCallout=true
          INIT_Action_CanTrcv_30_Tja1040_Init
            BswMAvailableActions
              BswMUserCallout:
                BswMUserCalloutFunction = CanTrcv_30_Tja1040_Init(CanTrcv_30_Tja1040_Config_Ptr)
                BswMCreateCallout = false
                BswMUserIncludeFile = CanTrcv_30_Tja1040.h
        BswMRteModeRequestPort_WakeupReason (BswMRteModeRequestPort): BswMRteModeInitValue=value0, BswMRteModeRequestPortInterfaceRef=Power.Rc_Wakeup_Reason.WakeupSource
        BswMRteModeRequestPort_ResetReason (BswMRteModeRequestPort): BswMRteModeInitValue=init, BswMRteModeRequestPortInterfaceRef=Power.Rc_ResetReason.ResetSource
        ESH_AL_A18_ReadNvMToWakeup (BswMActionList): BswMActionListExecution=BSWM_CONDITION
          5 x BswMActionListItem, all with BswMAbortOnFail=false:
            ESH_Action_OnEnterWakeup: BswMActionListItemIndex=2, BswMActionListItemRef=BswMModeControl/ESH_Action_OnEnterWakeup
            ESH_Action_SwitchWakeup: BswMActionListItemIndex=3, BswMActionListItemRef=BswMModeControl/ESH_Action_SwitchWakeup
            ESH_Action_ESH_Wakeup: BswMActionListItemIndex=4, BswMActionListItemRef=BswMModeControl/ESH_Action_ESH_Wakeup
            ESH_Action_Cancel_ReadNVM: BswMActionListItemIndex=1, BswMActionListItemRef=BswMModeControl/ESH_Action_Cancel_ReadNVM
            ESH_Action_ReadNVM_Stop: BswMActionListItemIndex=0, BswMActionListItemRef=BswMModeControl/ESH_Action_ReadNVM_Stop
        ESH_Action_Cancel_ReadNVM (BswMAction)
          BswMAvailableActions
            BswMUserCallout: BswMUserCalloutFunction=BSWMCancelReadNVM(), BswMCreateCallout=true
        ESH_Action_ReadNVM_Stop (BswMAction)
          BswMAvailableActions
            BswMTimerControl: BswMTimerAction=BSWM_TIMER_STOP, BswMTimerValue=0, BswMTimerRef=ESH_NvM_ReadTimer
        ESH_AL_A15_WaitWriteToReadNVM (BswMActionList): BswMActionListExecution=BSWM_CONDITION
          3 x BswMActionListItem, all with BswMAbortOnFail=false:
            ESH_Action_ESH_ReadNVM: BswMActionListItemIndex=2, BswMActionListItemRef=BswMModeControl/ESH_Action_ESH_ReadNVM
            ESH_Enter_NVMRead: BswMActionListItemIndex=1, BswMActionListItemRef=BswMModeControl/ESH_Enter_NVMRead
            ESH_Start_ReadNVM_Timer: BswMActionListItemIndex=0, BswMActionListItemRef=BswMModeControl/ESH_Start_ReadNVM_Timer
        ESH_Action_ESH_ReadNVM (BswMAction)
          BswMAvailableActions
            BswMGenericModeSwitch: BswMGenericRequestRef=ESH_State, BswMGenericRequestModeRef=ESH_READ_NVM
        ESH_Enter_NVMRead (BswMAction)
          BswMAvailableActions
            BswMUserCallout: BswMUserCalloutFunction=BSWM_Enter_NVMRead(), BswMCreateCallout=true
        ESH_AL_A19_ReadNVM (BswMActionList): BswMActionListExecution=BSWM_CONDITION
          5 x BswMActionListItem, all with BswMAbortOnFail=false:
            ESH_Action_EnterExclusiveArea: BswMActionListItemIndex=1, BswMActionListItemRef=BswMModeControl/ESH_Action_EnterExclusiveArea
            ESH_Action_ExitExclusiveArea: BswMActionListItemIndex=4, BswMActionListItemRef=BswMModeControl/ESH_Action_ExitExclusiveArea
            ESH_Action_CheckNVMReadStatus: BswMActionListItemIndex=2, BswMActionListItemRef=BswMModeControl/ESH_Action_CheckNVMReadStatus
            ESH_Action_ComMCheckPendingRequests: BswMActionListItemIndex=3, BswMActionListItemRef=BswMModeControl/ESH_Action_ComMCheckPendingRequests
            ESH_Process_NVMRead: BswMActionListItemIndex=0, BswMActionListItemRef=BswMModeControl/ESH_Process_NVMRead
        10 x BswMAction:
          ESH_Action_CheckNVMReadStatus
            BswMAvailableActions
              BswMUserCallout: BswMUserCalloutFunction=BSWM_CheckNVMReadStatus(), BswMCreateCallout=true
          ESH_Start_ReadNVM_Timer
            BswMAvailableActions
              BswMTimerControl: BswMTimerAction=BSWM_TIMER_START, BswMTimerValue=60, BswMTimerRef=ESH_NvM_ReadTimer
          ESH_Process_NVMRead
            BswMAvailableActions
              BswMUserCallout: BswMUserCalloutFunction=BSWM_Process_NVMRead(), BswMCreateCallout=true
          ESH_Mode_NVM
            BswMAvailableActions
              BswMRteSwitch: BswMSwitchedMode=NVMPROCESS, BswMRteSwitchPortRef=ESH_ModeSwitch
          INIT_Action_Crypto_30_vHsm_Init
            BswMAvailableActions
              BswMUserCallout: BswMUserCalloutFunction=Crypto_30_vHsm_Init(), BswMCreateCallout=false, BswMUserIncludeFile=Crypto_30_vHsm.h, BswMUserCode=
          INIT_Action_CryIf_Init
            BswMAvailableActions
              BswMUserCallout: BswMUserCalloutFunction=CryIf_Init(), BswMCreateCallout=false, BswMUserIncludeFile=CryIf.h
          INIT_Action_Csm_Init
            BswMAvailableActions
              BswMUserCallout: BswMUserCalloutFunction=Csm_Init(), BswMCreateCallout=false, BswMUserIncludeFile=Csm.h
          INIT_Action_Fls_Init
            BswMAvailableActions
              BswMUserCallout: BswMUserCalloutFunction=Fls_Init(FlsConfigSet), BswMCreateCallout=false, BswMUserIncludeFile=Fls.h
          INIT_Action_SecOC_Init
            BswMAvailableActions
              BswMUserCallout: BswMUserCalloutFunction=SecOC_Init(SecOC_Config_Ptr), BswMCreateCallout=false, BswMUserIncludeFile=SecOC.h
          INIT_Action_FvM_Init
            BswMAvailableActions
              BswMUserCallout: BswMUserCalloutFunction=FvM_Init(FvM_Config_Ptr), BswMCreateCallout=false, BswMUserIncludeFile=FvM.h
        CC_AL_CN_B30_for_SC_CAN_V3_2_c0d6c67b_NmEnable (BswMActionList): BswMActionListExecution=BSWM_TRIGGER
          CC_NmComControl_CN_B30_for_SC_CAN_V3_2_c0d6c67b_BSWM_NM_ENABLE (BswMActionListItem):
            BswMAbortOnFail = false
            BswMActionListItemIndex = 0
            BswMActionListItemRef = BswMModeControl/CC_NmComControl_CN_B30_for_SC_CAN_V3_2_c0d6c67b_BSWM_NM_ENABLE
        CC_NmComControl_CN_B30_for_SC_CAN_V3_2_c0d6c67b_BSWM_NM_ENABLE (BswMAction)
          BswMAvailableActions
            BswMNMControl: BswMNMAction=BSWM_NM_ENABLE, BswMComMNetworkHandleRef=CN_B30_for_SC_CAN_V3_2_c0d6c67b
        CC_AL_CN_B30_for_SC_CAN_V3_2_c0d6c67b_NmDisable (BswMActionList): BswMActionListExecution=BSWM_TRIGGER
          CC_NmComControl_CN_B30_for_SC_CAN_V3_2_c0d6c67b_BSWM_NM_DISABLE (BswMActionListItem):
            BswMAbortOnFail = false
            BswMActionListItemIndex = 0
            BswMActionListItemRef = BswMModeControl/CC_NmComControl_CN_B30_for_SC_CAN_V3_2_c0d6c67b_BSWM_NM_DISABLE
        3 x BswMAction:
          CC_NmComControl_CN_B30_for_SC_CAN_V3_2_c0d6c67b_BSWM_NM_DISABLE
            BswMAvailableActions
              BswMNMControl: BswMNMAction=BSWM_NM_DISABLE, BswMComMNetworkHandleRef=CN_B30_for_SC_CAN_V3_2_c0d6c67b
          ComEx_EnableRxTimeout
            BswMAvailableActions
              BswMUserCallout: BswMUserCalloutFunction=ComEx_EnableRxTimeout(), BswMCreateCallout=false, BswMUserIncludeFile=ComEx_Cbk.h
          ComEx_DisableRxTimeout
            BswMAvailableActions
              BswMUserCallout: BswMUserCalloutFunction=ComEx_DisableRxTimeout(), BswMCreateCallout=false, BswMUserIncludeFile=ComEx_Cbk.h
        AL_NONE (BswMActionList): BswMActionListExecution=BSWM_TRIGGER
          BswMUserCallout (BswMActionListItem): BswMAbortOnFail=false, BswMActionListItemIndex=0, BswMActionListItemRef=BswMModeControl/BswMUserCallout
        BswMUserCallout (BswMAction)
          BswMAvailableActions
            BswMUserCallout: BswMUserCalloutFunction=, BswMCreateCallout=false
        4 x BswMActionList, all with BswMActionListExecution=BSWM_TRIGGER:
          CC_AL_CN_B30_for_SC_CAN_V3_2_c0d6c67b_RX_Disable_MISC
            CC_DisablePDUGroup_HUT_oB30_for_SC_CAN_V3_2_Rx_4400ad35 (BswMActionListItem): BswMAbortOnFail=false, BswMActionListItemIndex=0, BswMActionListItemRef=BswMModeControl/CC_DisablePDUGroup_HUT_oB30_for_SC_CAN_V3_2_Rx_4400ad35
          CC_AL_CN_B30_for_SC_CAN_V3_2_c0d6c67b_RX_EnableNoinit_MISC
            CC_EnablePDUGroup_HUT_oB30_for_SC_CAN_V3_2_Rx_4400ad35 (BswMActionListItem): BswMAbortOnFail=false, BswMActionListItemIndex=0, BswMActionListItemRef=BswMModeControl/CC_EnablePDUGroup_HUT_oB30_for_SC_CAN_V3_2_Rx_4400ad35
          CC_AL_CN_B30_for_SC_CAN_V3_2_c0d6c67b_TX_Disable_MISC
            CC_DisablePDUGroup_HUT_oB30_for_SC_CAN_V3_2_Tx_125a0ab3 (BswMActionListItem): BswMAbortOnFail=false, BswMActionListItemIndex=0, BswMActionListItemRef=BswMModeControl/CC_DisablePDUGroup_HUT_oB30_for_SC_CAN_V3_2_Tx_125a0ab3
          CC_AL_CN_B30_for_SC_CAN_V3_2_c0d6c67b_TX_EnableNoinit_MISC
            CC_EnablePDUGroup_HUT_oB30_for_SC_CAN_V3_2_Tx_125a0ab3 (BswMActionListItem): BswMAbortOnFail=false, BswMActionListItemIndex=0, BswMActionListItemRef=BswMModeControl/CC_EnablePDUGroup_HUT_oB30_for_SC_CAN_V3_2_Tx_125a0ab3
        CC_DisablePDUGroup_HUT_oB30_for_SC_CAN_V3_2_Tx_HEV (BswMAction)
          BswMAvailableActions
            BswMPduGroupSwitch:
              BswMPduGroupSwitchReinit = false
              BswMDisabledPduGroupRef = HUT_oB30_for_SC_CAN_V3_2_Tx_HEV
              BswMDisabledPduGroupRef = HUT_oB30_for_SC_CAN_V3_2_Tx_125a0ab3
        CC_EnablePDUGroup_HUT_oB30_for_SC_CAN_V3_2_Tx_HEV (BswMAction)
          BswMAvailableActions
            BswMPduGroupSwitch:
              BswMPduGroupSwitchReinit = false
              BswMEnabledPduGroupRef = HUT_oB30_for_SC_CAN_V3_2_Tx_HEV
              BswMDisabledPduGroupRef = HUT_oB30_for_SC_CAN_V3_2_Tx_125a0ab3
        CC_AL_CN_B30_for_SC_CAN_V3_2_c0d6c67b_TX_EnableNoinit_MISC_HEV (BswMActionList): BswMActionListExecution=BSWM_TRIGGER
          CC_EnablePDUGroup_HUT_oB30_for_SC_CAN_V3_2_Tx_HEV (BswMActionListItem): BswMAbortOnFail=false, BswMActionListItemIndex=0, BswMActionListItemRef=BswMModeControl/CC_EnablePDUGroup_HUT_oB30_for_SC_CAN_V3_2_Tx_HEV
        CC_AL_CN_B30_for_SC_CAN_V3_2_c0d6c67b_TX_Disable_MISC_HEV (BswMActionList): BswMActionListExecution=BSWM_TRIGGER
          CC_DisablePDUGroup_HUT_oB30_for_SC_CAN_V3_2_Tx_HEV (BswMActionListItem): BswMAbortOnFail=false, BswMActionListItemIndex=0, BswMActionListItemRef=BswMModeControl/CC_DisablePDUGroup_HUT_oB30_for_SC_CAN_V3_2_Tx_HEV
        ESH_VConfig_retry (BswMAction)
          BswMAvailableActions
            BswMUserCallout: BswMUserCalloutFunction=VConfig_Init(), BswMCreateCallout=false, BswMUserIncludeFile=VConfig.h
      ESH_Mode (BswMRteModeDclGroup): BswMInitMode=STARTUP
        6 x BswMRteMode:
          STARTUP: BswMModePhysicalValue=0
          RUN: BswMModePhysicalValue=1
          POSTRUN: BswMModePhysicalValue=2
          WAKEUP: BswMModePhysicalValue=3
          SHUTDOWN: BswMModePhysicalValue=4
          NVMPROCESS: BswMModePhysicalValue=5
      ESH_RunRequest (BswMRteModeDclGroup): BswMInitMode=RELEASED
        RELEASED (BswMRteMode): BswMModePhysicalValue=0
        REQUESTED (BswMRteMode): BswMModePhysicalValue=1
      BswMDataTypeMappingSets: BswMDataTypeMappingSetRef=BswMMappingSet
      4 x BswMRteModeDclGroup:
        BswMRteShutdownReqMode: BswMInitMode=BswMReqNone
          5 x BswMRteMode:
            BswMReqSleep: BswMModePhysicalValue=1
            BswMReqShutdown: BswMModePhysicalValue=3
            BswMReqShutdownEmergency: BswMModePhysicalValue=4
            BswMReqNone: BswMModePhysicalValue=0
            BswMReqSleepEmergency: BswMModePhysicalValue=5
        BswMRteVehicleTypeOptionChoose: BswMInitMode=FUEL
          FUEL (BswMRteMode): BswMModePhysicalValue=0
          EV (BswMRteMode): BswMModePhysicalValue=1
        BswMRteModeBusStateReq: BswMInitMode=BLOCK_STATE
          BLOCK_STATE (BswMRteMode): BswMModePhysicalValue=1
          UNBLOCK_STATE (BswMRteMode): BswMModePhysicalValue=0
        BswMRteModeVolEnable: BswMInitMode=Vol_Disable
          Vol_Disable (BswMRteMode): BswMModePhysicalValue=0
          Vol_Enable (BswMRteMode): BswMModePhysicalValue=1
