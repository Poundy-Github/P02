AUTOSAR XML (schema 00046)
package /ActiveEcuC
  module config NvM: implementation-config-variant=VARIANT-PRE-COMPILE, module-description=NvM_Impl
    NvMConfigBlock (NvMBlockDescriptor):
      NvMBlockCrcType = NVM_CRC16
      NvMBlockManagementType = NVM_BLOCK_REDUNDANT
      NvMInitBlockCallback = NULL_PTR
      NvMResistantToChangedSw = true
      NvMSelectBlockForReadAll = true
      NvMSelectBlockForWriteAll = true
      NvMUseInitCallback = false
      NvMUseJobendCallback = false
      NvMSingleBlockCallback = NULL_PTR
      NvMBswMBlockStatusInformation = false
      NvMBlockUseCrc = true
      NvMBlockUseSyncMechanism = false
      NvMCalcRamBlockCrc = false
      NvMUseServicePorts = false
      NvMNvramBlockIdentifier = 1
      NvMNvBlockNum = 2
      NvMNvBlockLength = 2
      NvMRomBlockDataAddress = NULL_PTR
      NvMBlockPostReadTransformCallback = NULL_PTR
      NvMBlockPreWriteTransformCallback = NULL_PTR
      NvMBlockUseSetRamBlockStatus = true
      NvMBlockJobPriority = 127
      NvMBlockWriteProt = false
      NvMWriteBlockOnce = false
      NvMBlockUseCRCCompMechanism = false
      NvMInvokeCallbacksForReadAll = true
      NvMInvokeCallbacksForWriteAll = true
      NvMTargetBlockReference
        NvMFeeRef: NvMNameOfFeeBlock=FeeStartApplication_NvMBlock1
    NvMCommon:
      NvMDevErrorDetect = true
      NvMVersionInfoApi = false
      NvMApiConfigClass = NVM_API_CONFIG_CLASS_3
      NvMBswMMultiBlockJobStatusInformation = true
      NvMCompiledConfigId = 1
      NvMCrcNumOfBytes = 64
      NvMDatasetSelectionBits = 4
      NvMDrvModeSwitch = true
      NvMDynamicConfiguration = false
      NvMJobPrioritization = false
      NvMPollingMode = true
      NvMSetRamBlockStatusApi = true
      NvMSizeStandardJobQueue = 64
      NvMMaxNoOfWriteRetries = 5
      NvMMainFunctionPeriod = 0.005
      NvMUseBlockIdCheck = false
      NvMRepairRedundantBlocksApi = false
      NvMSafeBswChecks = false
    NvMCommonVendorParams: NvMCrcIntBuffer=true, NvMKillWriteAllApi=true, NvMCfgCbkIncludeList=Dem_Cbk.h, NvMCfgCbkIncludeList=Fvm.h
    63 x NvMBlockDescriptor, all with NvMBlockCrcType=NVM_CRC16, NvMBlockManagementType=NVM_BLOCK_REDUNDANT, NvMResistantToChangedSw=true, NvMSelectBlockForReadAll=true, NvMBswMBlockStatusInformation=false, NvMBlockUseCrc=true, NvMBlockUseSyncMechanism=false, NvMCalcRamBlockCrc=false, NvMBlockJobPriority=127, NvMBlockWriteProt=false, NvMNvBlockNum=2, NvMWriteBlockOnce=false, NvMInvokeCallbacksForReadAll=true:
      DemAdminDataBlock: NvMInitBlockCallback=Dem_NvM_InitAdminData, NvMSelectBlockForWriteAll=true, NvMUseInitCallback=true, NvMUseJobendCallback=true, NvMSingleBlockCallback=Dem_NvM_JobFinished, NvMNvBlockLength=30, NvMNvramBlockIdentifier=2, NvMUseServicePorts=false, NvMBlockUseCRCCompMechanism=true, NvMBlockUseSetRamBlockStatus=true, NvMInvokeCallbacksForWriteAll=true, NvMRamBlockDataAddress=Dem_Cfg_AdminData, NvMRomBlockDataAddress=NULL_PTR, NvMAutomaticBlockLength=true, NvMBlockLengthCheck=true
        NvMTargetBlockReference
          NvMFeeRef: NvMNameOfFeeBlock=FeeDemAdminDataBlock
      DemStatusDataBlock: NvMInitBlockCallback=Dem_NvM_InitStatusData, NvMSelectBlockForWriteAll=true, NvMUseInitCallback=true, NvMUseJobendCallback=true, NvMSingleBlockCallback=Dem_NvM_JobFinished, NvMNvBlockLength=404, NvMNvramBlockIdentifier=3, NvMUseServicePorts=false, NvMBlockUseCRCCompMechanism=true, NvMBlockUseSetRamBlockStatus=true, NvMInvokeCallbacksForWriteAll=true, NvMRamBlockDataAddress=Dem_Cfg_StatusData, NvMRomBlockDataAddress=NULL_PTR, NvMAutomaticBlockLength=true, NvMBlockLengthCheck=true
        NvMTargetBlockReference
          NvMFeeRef: NvMNameOfFeeBlock=FeeDemStatusDataBlock
      DemPrimaryDataBlock0: NvMInitBlockCallback=NULL_PTR, NvMSelectBlockForWriteAll=true, NvMUseInitCallback=false, NvMUseJobendCallback=true, NvMSingleBlockCallback=Dem_NvM_JobFinished, NvMNvBlockLength=30, NvMNvramBlockIdentifier=4, NvMUseServicePorts=false, NvMBlockUseCRCCompMechanism=true, NvMBlockUseSetRamBlockStatus=true, NvMInvokeCallbacksForWriteAll=true, NvMRamBlockDataAddress=Dem_Cfg_PrimaryEntry_0, NvMRomBlockDataAddress=Dem_Cfg_MemoryEntryInit, NvMAutomaticBlockLength=true, NvMBlockLengthCheck=true
        NvMTargetBlockReference
          NvMFeeRef: NvMNameOfFeeBlock=FeeDemPrimaryDataBlock0
      DemPrimaryDataBlock1: NvMInitBlockCallback=NULL_PTR, NvMSelectBlockForWriteAll=true, NvMUseInitCallback=false, NvMUseJobendCallback=true, NvMSingleBlockCallback=Dem_NvM_JobFinished, NvMNvBlockLength=30, NvMNvramBlockIdentifier=5, NvMUseServicePorts=false, NvMBlockUseCRCCompMechanism=true, NvMBlockUseSetRamBlockStatus=true, NvMInvokeCallbacksForWriteAll=true, NvMRamBlockDataAddress=Dem_Cfg_PrimaryEntry_1, NvMRomBlockDataAddress=Dem_Cfg_MemoryEntryInit, NvMAutomaticBlockLength=true, NvMBlockLengthCheck=true
        NvMTargetBlockReference
          NvMFeeRef: NvMNameOfFeeBlock=FeeDemPrimaryDataBlock1
      DemPrimaryDataBlock2: NvMInitBlockCallback=NULL_PTR, NvMSelectBlockForWriteAll=true, NvMUseInitCallback=false, NvMUseJobendCallback=true, NvMSingleBlockCallback=Dem_NvM_JobFinished, NvMNvBlockLength=30, NvMNvramBlockIdentifier=6, NvMUseServicePorts=false, NvMBlockUseCRCCompMechanism=true, NvMBlockUseSetRamBlockStatus=true, NvMInvokeCallbacksForWriteAll=true, NvMRamBlockDataAddress=Dem_Cfg_PrimaryEntry_2, NvMRomBlockDataAddress=Dem_Cfg_MemoryEntryInit, NvMAutomaticBlockLength=true, NvMBlockLengthCheck=true
        NvMTargetBlockReference
          NvMFeeRef: NvMNameOfFeeBlock=FeeDemPrimaryDataBlock2
      DemPrimaryDataBlock3: NvMInitBlockCallback=NULL_PTR, NvMSelectBlockForWriteAll=true, NvMUseInitCallback=false, NvMUseJobendCallback=true, NvMSingleBlockCallback=Dem_NvM_JobFinished, NvMNvBlockLength=30, NvMNvramBlockIdentifier=7, NvMUseServicePorts=false, NvMBlockUseCRCCompMechanism=true, NvMBlockUseSetRamBlockStatus=true, NvMInvokeCallbacksForWriteAll=true, NvMRamBlockDataAddress=Dem_Cfg_PrimaryEntry_3, NvMRomBlockDataAddress=Dem_Cfg_MemoryEntryInit, NvMAutomaticBlockLength=true, NvMBlockLengthCheck=true
        NvMTargetBlockReference
          NvMFeeRef: NvMNameOfFeeBlock=FeeDemPrimaryDataBlock3
      DemPrimaryDataBlock4: NvMInitBlockCallback=NULL_PTR, NvMSelectBlockForWriteAll=true, NvMUseInitCallback=false, NvMUseJobendCallback=true, NvMSingleBlockCallback=Dem_NvM_JobFinished, NvMNvBlockLength=30, NvMNvramBlockIdentifier=8, NvMUseServicePorts=false, NvMBlockUseCRCCompMechanism=true, NvMBlockUseSetRamBlockStatus=true, NvMInvokeCallbacksForWriteAll=true, NvMRamBlockDataAddress=Dem_Cfg_PrimaryEntry_4, NvMRomBlockDataAddress=Dem_Cfg_MemoryEntryInit, NvMAutomaticBlockLength=true, NvMBlockLengthCheck=true
        NvMTargetBlockReference
          NvMFeeRef: NvMNameOfFeeBlock=FeeDemPrimaryDataBlock4
      DemPrimaryDataBlock5: NvMInitBlockCallback=NULL_PTR, NvMSelectBlockForWriteAll=true, NvMUseInitCallback=false, NvMUseJobendCallback=true, NvMSingleBlockCallback=Dem_NvM_JobFinished, NvMNvBlockLength=30, NvMNvramBlockIdentifier=9, NvMUseServicePorts=false, NvMBlockUseCRCCompMechanism=true, NvMBlockUseSetRamBlockStatus=true, NvMInvokeCallbacksForWriteAll=true, NvMRamBlockDataAddress=Dem_Cfg_PrimaryEntry_5, NvMRomBlockDataAddress=Dem_Cfg_MemoryEntryInit, NvMAutomaticBlockLength=true, NvMBlockLengthCheck=true
        NvMTargetBlockReference
          NvMFeeRef: NvMNameOfFeeBlock=FeeDemPrimaryDataBlock5
      DemPrimaryDataBlock6: NvMInitBlockCallback=NULL_PTR, NvMSelectBlockForWriteAll=true, NvMUseInitCallback=false, NvMUseJobendCallback=true, NvMSingleBlockCallback=Dem_NvM_JobFinished, NvMNvBlockLength=30, NvMNvramBlockIdentifier=10, NvMUseServicePorts=false, NvMBlockUseCRCCompMechanism=true, NvMBlockUseSetRamBlockStatus=true, NvMInvokeCallbacksForWriteAll=true, NvMRamBlockDataAddress=Dem_Cfg_PrimaryEntry_6, NvMRomBlockDataAddress=Dem_Cfg_MemoryEntryInit, NvMAutomaticBlockLength=true, NvMBlockLengthCheck=true
        NvMTargetBlockReference
          NvMFeeRef: NvMNameOfFeeBlock=FeeDemPrimaryDataBlock6
      DemPrimaryDataBlock7: NvMInitBlockCallback=NULL_PTR, NvMSelectBlockForWriteAll=true, NvMUseInitCallback=false, NvMUseJobendCallback=true, NvMSingleBlockCallback=Dem_NvM_JobFinished, NvMNvBlockLength=30, NvMNvramBlockIdentifier=11, NvMUseServicePorts=false, NvMBlockUseCRCCompMechanism=true, NvMBlockUseSetRamBlockStatus=true, NvMInvokeCallbacksForWriteAll=true, NvMRamBlockDataAddress=Dem_Cfg_PrimaryEntry_7, NvMRomBlockDataAddress=Dem_Cfg_MemoryEntryInit, NvMAutomaticBlockLength=true, NvMBlockLengthCheck=true
        NvMTargetBlockReference
          NvMFeeRef: NvMNameOfFeeBlock=FeeDemPrimaryDataBlock7
      Common_NormalNvBlockNeed_Block_ODO_1: NvMInitBlockCallback=NULL_PTR, NvMSelectBlockForWriteAll=false, NvMUseInitCallback=false, NvMUseJobendCallback=true, NvMSingleBlockCallback=NULL_PTR, NvMNvramBlockIdentifier=13, NvMUseServicePorts=true, NvMBlockUseCRCCompMechanism=false, NvMBlockUseSetRamBlockStatus=true, NvMInvokeCallbacksForWriteAll=true, NvMRamBlockDataAddress=Rte_Common_Normal_NvBlockNeed_Block_ODO_1_MirrorBlock, NvMRomBlockDataAddress=Rte_Common_Normal_NvBlockNeed_Block_ODO_1_DefaultValue, NvMNvBlockLength=16  # UC:Derived from NvBlockNeeds
        NvMTargetBlockReference
          NvMFeeRef: NvMNameOfFeeBlock=FeeNvBlockNeed_Block_ODO_1
      Common_NormalNvBlockNeed_Block_ODO_2: NvMInitBlockCallback=NULL_PTR, NvMSelectBlockForWriteAll=false, NvMUseInitCallback=false, NvMUseJobendCallback=true, NvMSingleBlockCallback=NULL_PTR, NvMNvramBlockIdentifier=15, NvMUseServicePorts=true, NvMBlockUseCRCCompMechanism=false, NvMBlockUseSetRamBlockStatus=true, NvMInvokeCallbacksForWriteAll=true, NvMRamBlockDataAddress=Rte_Common_Normal_NvBlockNeed_Block_ODO_2_MirrorBlock, NvMRomBlockDataAddress=Rte_Common_Normal_NvBlockNeed_Block_ODO_2_DefaultValue, NvMNvBlockLength=16  # UC:Derived from NvBlockNeeds
        NvMTargetBlockReference
          NvMFeeRef: NvMNameOfFeeBlock=FeeNvBlockNeed_Block_ODO_2
      Common_NormalNvBlockNeed_Block_ODO_3: NvMInitBlockCallback=NULL_PTR, NvMSelectBlockForWriteAll=false, NvMUseInitCallback=false, NvMUseJobendCallback=true, NvMSingleBlockCallback=NULL_PTR, NvMNvramBlockIdentifier=17, NvMUseServicePorts=true, NvMBlockUseCRCCompMechanism=false, NvMBlockUseSetRamBlockStatus=true, NvMInvokeCallbacksForWriteAll=true, NvMRamBlockDataAddress=Rte_Common_Normal_NvBlockNeed_Block_ODO_3_MirrorBlock, NvMRomBlockDataAddress=Rte_Common_Normal_NvBlockNeed_Block_ODO_3_DefaultValue, NvMNvBlockLength=16  # UC:Derived from NvBlockNeeds
        NvMTargetBlockReference
          NvMFeeRef: NvMNameOfFeeBlock=FeeNvBlockNeed_Block_ODO_3
      Common_NormalNvBlockNeed_Block_ODO_4: NvMInitBlockCallback=NULL_PTR, NvMSelectBlockForWriteAll=false, NvMUseInitCallback=false, NvMUseJobendCallback=true, NvMSingleBlockCallback=NULL_PTR, NvMNvramBlockIdentifier=19, NvMUseServicePorts=true, NvMBlockUseCRCCompMechanism=false, NvMBlockUseSetRamBlockStatus=true, NvMInvokeCallbacksForWriteAll=true, NvMRamBlockDataAddress=Rte_Common_Normal_NvBlockNeed_Block_ODO_4_MirrorBlock, NvMRomBlockDataAddress=Rte_Common_Normal_NvBlockNeed_Block_ODO_4_DefaultValue, NvMNvBlockLength=16  # UC:Derived from NvBlockNeeds
        NvMTargetBlockReference
          NvMFeeRef: NvMNameOfFeeBlock=FeeNvBlockNeed_Block_ODO_4
      Common_NormalNvBlockNeed_Block_ODO_5: NvMInitBlockCallback=NULL_PTR, NvMSelectBlockForWriteAll=false, NvMUseInitCallback=false, NvMUseJobendCallback=true, NvMSingleBlockCallback=NULL_PTR, NvMNvramBlockIdentifier=21, NvMUseServicePorts=true, NvMBlockUseCRCCompMechanism=false, NvMBlockUseSetRamBlockStatus=true, NvMInvokeCallbacksForWriteAll=true, NvMRamBlockDataAddress=Rte_Common_Normal_NvBlockNeed_Block_ODO_5_MirrorBlock, NvMRomBlockDataAddress=Rte_Common_Normal_NvBlockNeed_Block_ODO_5_DefaultValue, NvMNvBlockLength=16  # UC:Derived from NvBlockNeeds
        NvMTargetBlockReference
          NvMFeeRef: NvMNameOfFeeBlock=FeeNvBlockNeed_Block_ODO_5
      Common_NormalNvBlockNeed_Block_MaintainOdo: NvMInitBlockCallback=NULL_PTR, NvMSelectBlockForWriteAll=false, NvMUseInitCallback=false, NvMUseJobendCallback=true, NvMSingleBlockCallback=NULL_PTR, NvMNvBlockLength=80, NvMNvramBlockIdentifier=23, NvMUseServicePorts=true, NvMBlockUseCRCCompMechanism=false, NvMBlockUseSetRamBlockStatus=true, NvMInvokeCallbacksForWriteAll=true, NvMRamBlockDataAddress=Rte_Common_Normal_NvBlockNeed_Block_MaintainOdo_MirrorBlock, NvMRomBlockDataAddress=Rte_Common_Normal_NvBlockNeed_Block_MaintainOdo_DefaultValue  # UC:Derived from NvBlockNeeds
        NvMTargetBlockReference
          NvMFeeRef: NvMNameOfFeeBlock=FeeODO_NvBlockNeed_Block_MaintainOdo
      Common_NormalNvBlockNeed_Block_Trip: NvMInitBlockCallback=NULL_PTR, NvMSelectBlockForWriteAll=false, NvMUseInitCallback=false, NvMUseJobendCallback=true, NvMSingleBlockCallback=NULL_PTR, NvMNvBlockLength=20, NvMNvramBlockIdentifier=25, NvMUseServicePorts=true, NvMBlockUseCRCCompMechanism=false, NvMBlockUseSetRamBlockStatus=true, NvMInvokeCallbacksForWriteAll=true, NvMRamBlockDataAddress=Rte_Common_Normal_NvBlockNeed_Block_Trip_MirrorBlock, NvMRomBlockDataAddress=Rte_Common_Normal_NvBlockNeed_Block_Trip_DefaultValue  # UC:Derived from NvBlockNeeds
        NvMTargetBlockReference
          NvMFeeRef: NvMNameOfFeeBlock=FeeODO_NvBlockNeed_Block_Trip
      DidDataProcessNvBlockNeed_FactoryMode: NvMInitBlockCallback=NULL_PTR, NvMSelectBlockForWriteAll=false, NvMUseInitCallback=false, NvMUseJobendCallback=true, NvMSingleBlockCallback=NULL_PTR, NvMNvBlockLength=1, NvMNvramBlockIdentifier=29, NvMUseServicePorts=true, NvMBlockUseCRCCompMechanism=false, NvMBlockUseSetRamBlockStatus=true, NvMInvokeCallbacksForWriteAll=true, NvMRamBlockDataAddress=Rte_DidDataProcess_NvBlockNeed_FactoryMode_MirrorBlock, NvMRomBlockDataAddress=Rte_DidDataProcess_NvBlockNeed_FactoryMode_DefaultValue  # UC:Derived from NvBlockNeeds
        NvMTargetBlockReference
          NvMFeeRef: NvMNameOfFeeBlock=FeeDidDataProcessNvBlockNeed_FactoryMode
      DidDataProcessNvBlockNeed_VIN: NvMInitBlockCallback=NULL_PTR, NvMSelectBlockForWriteAll=false, NvMUseInitCallback=false, NvMUseJobendCallback=true, NvMSingleBlockCallback=NULL_PTR, NvMNvBlockLength=17, NvMNvramBlockIdentifier=33, NvMUseServicePorts=true, NvMBlockUseCRCCompMechanism=false, NvMBlockUseSetRamBlockStatus=true, NvMInvokeCallbacksForWriteAll=true, NvMRamBlockDataAddress=Rte_DidDataProcess_NvBlockNeed_VIN_MirrorBlock, NvMRomBlockDataAddress=Rte_DidDataProcess_NvBlockNeed_VIN_DefaultValue  # UC:Derived from NvBlockNeeds
        NvMTargetBlockReference
          NvMFeeRef: NvMNameOfFeeBlock=FeeDidDataProcessNvBlockNeed_VIN
      DidDataProcessNvBlockNeed_VehicleMode: NvMInitBlockCallback=NULL_PTR, NvMSelectBlockForWriteAll=false, NvMUseInitCallback=false, NvMUseJobendCallback=true, NvMSingleBlockCallback=NULL_PTR, NvMNvBlockLength=20, NvMNvramBlockIdentifier=34, NvMUseServicePorts=true, NvMBlockUseCRCCompMechanism=false, NvMBlockUseSetRamBlockStatus=true, NvMInvokeCallbacksForWriteAll=true, NvMRamBlockDataAddress=Rte_DidDataProcess_NvBlockNeed_VehicleMode_MirrorBlock, NvMRomBlockDataAddress=Rte_DidDataProcess_NvBlockNeed_VehicleMode_DefaultValue  # UC:Derived from NvBlockNeeds
        NvMTargetBlockReference
          NvMFeeRef: NvMNameOfFeeBlock=FeeDidDataProcessNvBlockNeed_VehicleMode
      DidDataProcessNvBlockNeed_ECUlevelNetworkConfigurationData: NvMInitBlockCallback=NULL_PTR, NvMSelectBlockForWriteAll=false, NvMUseInitCallback=false, NvMUseJobendCallback=true, NvMSingleBlockCallback=NULL_PTR, NvMNvBlockLength=200, NvMNvramBlockIdentifier=31, NvMUseServicePorts=true, NvMBlockUseCRCCompMechanism=false, NvMBlockUseSetRamBlockStatus=true, NvMInvokeCallbacksForWriteAll=true, NvMRamBlockDataAddress=Rte_DidDataProcess_NvBlockNeed_ECUlevelNetworkConfigurationData_MirrorBlock, NvMRomBlockDataAddress=Rte_DidDataProcess_NvBlockNeed_ECUlevelNetworkConfigurationData_DefaultValue  # UC:Derived from NvBlockNeeds
        NvMTargetBlockReference
          NvMFeeRef: NvMNameOfFeeBlock=FeeDidDataProcessNvBlockNeed_ECUlevelNetworkConfigurationData
      EOL_NvBlockNeed_0xF18C: NvMInitBlockCallback=NULL_PTR, NvMSelectBlockForWriteAll=false, NvMUseInitCallback=false, NvMUseJobendCallback=true, NvMSingleBlockCallback=NULL_PTR, NvMNvBlockLength=20, NvMNvramBlockIdentifier=35, NvMUseServicePorts=true, NvMBlockUseCRCCompMechanism=false, NvMBlockUseSetRamBlockStatus=true, NvMInvokeCallbacksForWriteAll=true, NvMRamBlockDataAddress=Rte_EOL_NvBlockNeed_0xF18C_MirrorBlock, NvMRomBlockDataAddress=Rte_EOL_NvBlockNeed_0xF18C_DefaultValue  # UC:Derived from NvBlockNeeds
        NvMTargetBlockReference
          NvMFeeRef: NvMNameOfFeeBlock=FeeEOL_NvBlockNeed_0xF18C
      EOL_NvBlockNeed_0xF193: NvMInitBlockCallback=NULL_PTR, NvMSelectBlockForWriteAll=false, NvMUseInitCallback=false, NvMUseJobendCallback=true, NvMSingleBlockCallback=NULL_PTR, NvMNvBlockLength=15, NvMNvramBlockIdentifier=36, NvMUseServicePorts=true, NvMBlockUseCRCCompMechanism=false, NvMBlockUseSetRamBlockStatus=true, NvMInvokeCallbacksForWriteAll=true, NvMRamBlockDataAddress=Rte_EOL_NvBlockNeed_0xF193_MirrorBlock, NvMRomBlockDataAddress=Rte_EOL_NvBlockNeed_0xF193_DefaultValue  # UC:Derived from NvBlockNeeds
        NvMTargetBlockReference
          NvMFeeRef: NvMNameOfFeeBlock=FeeEOL_NvBlockNeed_0xF193
      EOL_NvBlockNeed_0xF195: NvMInitBlockCallback=NULL_PTR, NvMSelectBlockForWriteAll=false, NvMUseInitCallback=false, NvMUseJobendCallback=true, NvMSingleBlockCallback=NULL_PTR, NvMNvBlockLength=17, NvMNvramBlockIdentifier=37, NvMUseServicePorts=true, NvMBlockUseCRCCompMechanism=false, NvMBlockUseSetRamBlockStatus=true, NvMInvokeCallbacksForWriteAll=true, NvMRamBlockDataAddress=Rte_EOL_NvBlockNeed_0xF195_MirrorBlock, NvMRomBlockDataAddress=Rte_EOL_NvBlockNeed_0xF195_DefaultValue  # UC:Derived from NvBlockNeeds
        NvMTargetBlockReference
          NvMFeeRef: NvMNameOfFeeBlock=FeeEOL_NvBlockNeed_0xF195
      EOL_NvBlockNeed_0xFD00: NvMInitBlockCallback=NULL_PTR, NvMSelectBlockForWriteAll=false, NvMUseInitCallback=false, NvMUseJobendCallback=true, NvMSingleBlockCallback=NULL_PTR, NvMNvBlockLength=4, NvMNvramBlockIdentifier=38, NvMUseServicePorts=true, NvMBlockUseCRCCompMechanism=false, NvMBlockUseSetRamBlockStatus=true, NvMInvokeCallbacksForWriteAll=true, NvMRamBlockDataAddress=Rte_EOL_NvBlockNeed_0xFD00_MirrorBlock, NvMRomBlockDataAddress=Rte_EOL_NvBlockNeed_0xFD00_DefaultValue  # UC:Derived from NvBlockNeeds
        NvMTargetBlockReference
          NvMFeeRef: NvMNameOfFeeBlock=FeeEOL_NvBlockNeed_0xFD00
      EOL_NvBlockNeed_0xFD19: NvMInitBlockCallback=NULL_PTR, NvMSelectBlockForWriteAll=false, NvMUseInitCallback=false, NvMUseJobendCallback=true, NvMSingleBlockCallback=NULL_PTR, NvMNvBlockLength=1, NvMNvramBlockIdentifier=39, NvMUseServicePorts=true, NvMBlockUseCRCCompMechanism=false, NvMBlockUseSetRamBlockStatus=true, NvMInvokeCallbacksForWriteAll=true, NvMRamBlockDataAddress=Rte_EOL_NvBlockNeed_0xFD19_MirrorBlock, NvMRomBlockDataAddress=Rte_EOL_NvBlockNeed_0xFD19_DefaultValue  # UC:Derived from NvBlockNeeds
        NvMTargetBlockReference
          NvMFeeRef: NvMNameOfFeeBlock=FeeEOL_NvBlockNeed_0xFD19
      EOL_NvBlockNeed_0xFE20: NvMInitBlockCallback=NULL_PTR, NvMSelectBlockForWriteAll=false, NvMUseInitCallback=false, NvMUseJobendCallback=true, NvMSingleBlockCallback=NULL_PTR, NvMNvBlockLength=1, NvMNvramBlockIdentifier=40, NvMUseServicePorts=true, NvMBlockUseCRCCompMechanism=false, NvMBlockUseSetRamBlockStatus=true, NvMInvokeCallbacksForWriteAll=true, NvMRamBlockDataAddress=Rte_EOL_NvBlockNeed_0xFE20_MirrorBlock, NvMRomBlockDataAddress=Rte_EOL_NvBlockNeed_0xFE20_DefaultValue  # UC:Derived from NvBlockNeeds
        NvMTargetBlockReference
          NvMFeeRef: NvMNameOfFeeBlock=FeeEOL_NvBlockNeed_0xFE20
      EOL_NvBlockNeed_0xFE21: NvMInitBlockCallback=NULL_PTR, NvMSelectBlockForWriteAll=false, NvMUseInitCallback=false, NvMUseJobendCallback=true, NvMSingleBlockCallback=NULL_PTR, NvMNvBlockLength=1, NvMNvramBlockIdentifier=41, NvMUseServicePorts=true, NvMBlockUseCRCCompMechanism=false, NvMBlockUseSetRamBlockStatus=true, NvMInvokeCallbacksForWriteAll=true, NvMRamBlockDataAddress=Rte_EOL_NvBlockNeed_0xFE21_MirrorBlock, NvMRomBlockDataAddress=Rte_EOL_NvBlockNeed_0xFE21_DefaultValue  # UC:Derived from NvBlockNeeds
        NvMTargetBlockReference
          NvMFeeRef: NvMNameOfFeeBlock=FeeEOL_NvBlockNeed_0xFE21
      EOL_NvBlockNeed_0xFE22: NvMInitBlockCallback=NULL_PTR, NvMSelectBlockForWriteAll=false, NvMUseInitCallback=false, NvMUseJobendCallback=true, NvMSingleBlockCallback=NULL_PTR, NvMNvBlockLength=1, NvMNvramBlockIdentifier=42, NvMUseServicePorts=true, NvMBlockUseCRCCompMechanism=false, NvMBlockUseSetRamBlockStatus=true, NvMInvokeCallbacksForWriteAll=true, NvMRamBlockDataAddress=Rte_EOL_NvBlockNeed_0xFE22_MirrorBlock, NvMRomBlockDataAddress=Rte_EOL_NvBlockNeed_0xFE22_DefaultValue  # UC:Derived from NvBlockNeeds
        NvMTargetBlockReference
          NvMFeeRef: NvMNameOfFeeBlock=FeeEOL_NvBlockNeed_0xFE22
      EOL_NvBlockNeed_0xFE23: NvMInitBlockCallback=NULL_PTR, NvMSelectBlockForWriteAll=false, NvMUseInitCallback=false, NvMUseJobendCallback=true, NvMSingleBlockCallback=NULL_PTR, NvMNvramBlockIdentifier=43, NvMUseServicePorts=true, NvMBlockUseCRCCompMechanism=false, NvMBlockUseSetRamBlockStatus=true, NvMInvokeCallbacksForWriteAll=true, NvMRamBlockDataAddress=Rte_EOL_NvBlockNeed_0xFE23_MirrorBlock, NvMRomBlockDataAddress=Rte_EOL_NvBlockNeed_0xFE23_DefaultValue, NvMNvBlockLength=2  # UC:Derived from NvBlockNeeds
        NvMTargetBlockReference
          NvMFeeRef: NvMNameOfFeeBlock=FeeEOL_NvBlockNeed_0xFE23
      EOL_NvBlockNeed_0xFE24: NvMInitBlockCallback=NULL_PTR, NvMSelectBlockForWriteAll=false, NvMUseInitCallback=false, NvMUseJobendCallback=true, NvMSingleBlockCallback=NULL_PTR, NvMNvBlockLength=1, NvMNvramBlockIdentifier=44, NvMUseServicePorts=true, NvMBlockUseCRCCompMechanism=false, NvMBlockUseSetRamBlockStatus=true, NvMInvokeCallbacksForWriteAll=true, NvMRamBlockDataAddress=Rte_EOL_NvBlockNeed_0xFE24_MirrorBlock, NvMRomBlockDataAddress=Rte_EOL_NvBlockNeed_0xFE24_DefaultValue  # UC:Derived from NvBlockNeeds
        NvMTargetBlockReference
          NvMFeeRef: NvMNameOfFeeBlock=FeeEOL_NvBlockNeed_0xFE24
      EOL_NvBlockNeed_0xFE25: NvMInitBlockCallback=NULL_PTR, NvMSelectBlockForWriteAll=false, NvMUseInitCallback=false, NvMUseJobendCallback=true, NvMSingleBlockCallback=NULL_PTR, NvMNvBlockLength=2, NvMNvramBlockIdentifier=45, NvMUseServicePorts=true, NvMBlockUseCRCCompMechanism=false, NvMBlockUseSetRamBlockStatus=true, NvMInvokeCallbacksForWriteAll=true, NvMRamBlockDataAddress=Rte_EOL_NvBlockNeed_0xFE25_MirrorBlock, NvMRomBlockDataAddress=Rte_EOL_NvBlockNeed_0xFE25_DefaultValue  # UC:Derived from NvBlockNeeds
        NvMTargetBlockReference
          NvMFeeRef: NvMNameOfFeeBlock=FeeEOL_NvBlockNeed_0xFE25
      DemPrimaryDataBlock10: NvMInitBlockCallback=NULL_PTR, NvMSelectBlockForWriteAll=true, NvMUseInitCallback=false, NvMUseJobendCallback=true, NvMSingleBlockCallback=Dem_NvM_JobFinished, NvMNvBlockLength=30, NvMNvramBlockIdentifier=16, NvMUseServicePorts=false, NvMBlockUseCRCCompMechanism=true, NvMBlockUseSetRamBlockStatus=true, NvMInvokeCallbacksForWriteAll=true, NvMRamBlockDataAddress=Dem_Cfg_PrimaryEntry_10, NvMRomBlockDataAddress=Dem_Cfg_MemoryEntryInit, NvMAutomaticBlockLength=true, NvMBlockLengthCheck=true
        NvMTargetBlockReference
          NvMFeeRef: NvMNameOfFeeBlock=FeeDemPrimaryDataBlock10
      DemPrimaryDataBlock11: NvMInitBlockCallback=NULL_PTR, NvMSelectBlockForWriteAll=true, NvMUseInitCallback=false, NvMUseJobendCallback=true, NvMSingleBlockCallback=Dem_NvM_JobFinished, NvMNvBlockLength=30, NvMNvramBlockIdentifier=18, NvMUseServicePorts=false, NvMBlockUseCRCCompMechanism=true, NvMBlockUseSetRamBlockStatus=true, NvMInvokeCallbacksForWriteAll=true, NvMRamBlockDataAddress=Dem_Cfg_PrimaryEntry_11, NvMRomBlockDataAddress=Dem_Cfg_MemoryEntryInit, NvMAutomaticBlockLength=true, NvMBlockLengthCheck=true
        NvMTargetBlockReference
          NvMFeeRef: NvMNameOfFeeBlock=FeeDemPrimaryDataBlock11
      DemPrimaryDataBlock12: NvMInitBlockCallback=NULL_PTR, NvMSelectBlockForWriteAll=true, NvMUseInitCallback=false, NvMUseJobendCallback=true, NvMSingleBlockCallback=Dem_NvM_JobFinished, NvMNvBlockLength=30, NvMNvramBlockIdentifier=20, NvMUseServicePorts=false, NvMBlockUseCRCCompMechanism=true, NvMBlockUseSetRamBlockStatus=true, NvMInvokeCallbacksForWriteAll=true, NvMRamBlockDataAddress=Dem_Cfg_PrimaryEntry_12, NvMRomBlockDataAddress=Dem_Cfg_MemoryEntryInit, NvMAutomaticBlockLength=true, NvMBlockLengthCheck=true
        NvMTargetBlockReference
          NvMFeeRef: NvMNameOfFeeBlock=FeeDemPrimaryDataBlock12
      DemPrimaryDataBlock13: NvMInitBlockCallback=NULL_PTR, NvMSelectBlockForWriteAll=true, NvMUseInitCallback=false, NvMUseJobendCallback=true, NvMSingleBlockCallback=Dem_NvM_JobFinished, NvMNvBlockLength=30, NvMNvramBlockIdentifier=22, NvMUseServicePorts=false, NvMBlockUseCRCCompMechanism=true, NvMBlockUseSetRamBlockStatus=true, NvMInvokeCallbacksForWriteAll=true, NvMRamBlockDataAddress=Dem_Cfg_PrimaryEntry_13, NvMRomBlockDataAddress=Dem_Cfg_MemoryEntryInit, NvMAutomaticBlockLength=true, NvMBlockLengthCheck=true
        NvMTargetBlockReference
          NvMFeeRef: NvMNameOfFeeBlock=FeeDemPrimaryDataBlock13
      DemPrimaryDataBlock14: NvMInitBlockCallback=NULL_PTR, NvMSelectBlockForWriteAll=true, NvMUseInitCallback=false, NvMUseJobendCallback=true, NvMSingleBlockCallback=Dem_NvM_JobFinished, NvMNvBlockLength=30, NvMNvramBlockIdentifier=24, NvMUseServicePorts=false, NvMBlockUseCRCCompMechanism=true, NvMBlockUseSetRamBlockStatus=true, NvMInvokeCallbacksForWriteAll=true, NvMRamBlockDataAddress=Dem_Cfg_PrimaryEntry_14, NvMRomBlockDataAddress=Dem_Cfg_MemoryEntryInit, NvMAutomaticBlockLength=true, NvMBlockLengthCheck=true
        NvMTargetBlockReference
          NvMFeeRef: NvMNameOfFeeBlock=FeeDemPrimaryDataBlock14
      DemPrimaryDataBlock15: NvMInitBlockCallback=NULL_PTR, NvMSelectBlockForWriteAll=true, NvMUseInitCallback=false, NvMUseJobendCallback=true, NvMSingleBlockCallback=Dem_NvM_JobFinished, NvMNvBlockLength=30, NvMNvramBlockIdentifier=26, NvMUseServicePorts=false, NvMBlockUseCRCCompMechanism=true, NvMBlockUseSetRamBlockStatus=true, NvMInvokeCallbacksForWriteAll=true, NvMRamBlockDataAddress=Dem_Cfg_PrimaryEntry_15, NvMRomBlockDataAddress=Dem_Cfg_MemoryEntryInit, NvMAutomaticBlockLength=true, NvMBlockLengthCheck=true
        NvMTargetBlockReference
          NvMFeeRef: NvMNameOfFeeBlock=FeeDemPrimaryDataBlock15
      DemPrimaryDataBlock16: NvMInitBlockCallback=NULL_PTR, NvMSelectBlockForWriteAll=true, NvMUseInitCallback=false, NvMUseJobendCallback=true, NvMSingleBlockCallback=Dem_NvM_JobFinished, NvMNvBlockLength=30, NvMNvramBlockIdentifier=27, NvMUseServicePorts=false, NvMBlockUseCRCCompMechanism=true, NvMBlockUseSetRamBlockStatus=true, NvMInvokeCallbacksForWriteAll=true, NvMRamBlockDataAddress=Dem_Cfg_PrimaryEntry_16, NvMRomBlockDataAddress=Dem_Cfg_MemoryEntryInit, NvMAutomaticBlockLength=true, NvMBlockLengthCheck=true
        NvMTargetBlockReference
          NvMFeeRef: NvMNameOfFeeBlock=FeeDemPrimaryDataBlock16
      DemPrimaryDataBlock17: NvMInitBlockCallback=NULL_PTR, NvMSelectBlockForWriteAll=true, NvMUseInitCallback=false, NvMUseJobendCallback=true, NvMSingleBlockCallback=Dem_NvM_JobFinished, NvMNvBlockLength=30, NvMNvramBlockIdentifier=28, NvMUseServicePorts=false, NvMBlockUseCRCCompMechanism=true, NvMBlockUseSetRamBlockStatus=true, NvMInvokeCallbacksForWriteAll=true, NvMRamBlockDataAddress=Dem_Cfg_PrimaryEntry_17, NvMRomBlockDataAddress=Dem_Cfg_MemoryEntryInit, NvMAutomaticBlockLength=true, NvMBlockLengthCheck=true
        NvMTargetBlockReference
          NvMFeeRef: NvMNameOfFeeBlock=FeeDemPrimaryDataBlock17
      DemPrimaryDataBlock18: NvMInitBlockCallback=NULL_PTR, NvMSelectBlockForWriteAll=true, NvMUseInitCallback=false, NvMUseJobendCallback=true, NvMSingleBlockCallback=Dem_NvM_JobFinished, NvMNvBlockLength=30, NvMNvramBlockIdentifier=32, NvMUseServicePorts=false, NvMBlockUseCRCCompMechanism=true, NvMBlockUseSetRamBlockStatus=true, NvMInvokeCallbacksForWriteAll=true, NvMRamBlockDataAddress=Dem_Cfg_PrimaryEntry_19, NvMRomBlockDataAddress=Dem_Cfg_MemoryEntryInit, NvMAutomaticBlockLength=true, NvMBlockLengthCheck=true
        NvMTargetBlockReference
          NvMFeeRef: NvMNameOfFeeBlock=FeeDemPrimaryDataBlock18
      DemPrimaryDataBlock19: NvMInitBlockCallback=NULL_PTR, NvMSelectBlockForWriteAll=true, NvMUseInitCallback=false, NvMUseJobendCallback=true, NvMSingleBlockCallback=Dem_NvM_JobFinished, NvMNvBlockLength=30, NvMNvramBlockIdentifier=30, NvMUseServicePorts=false, NvMBlockUseCRCCompMechanism=true, NvMBlockUseSetRamBlockStatus=true, NvMInvokeCallbacksForWriteAll=true, NvMRamBlockDataAddress=Dem_Cfg_PrimaryEntry_18, NvMRomBlockDataAddress=Dem_Cfg_MemoryEntryInit, NvMAutomaticBlockLength=true, NvMBlockLengthCheck=true
        NvMTargetBlockReference
          NvMFeeRef: NvMNameOfFeeBlock=FeeDemPrimaryDataBlock19
      DemPrimaryDataBlock8: NvMInitBlockCallback=NULL_PTR, NvMSelectBlockForWriteAll=true, NvMUseInitCallback=false, NvMUseJobendCallback=true, NvMSingleBlockCallback=Dem_NvM_JobFinished, NvMNvBlockLength=30, NvMNvramBlockIdentifier=12, NvMUseServicePorts=false, NvMBlockUseCRCCompMechanism=true, NvMBlockUseSetRamBlockStatus=true, NvMInvokeCallbacksForWriteAll=true, NvMRamBlockDataAddress=Dem_Cfg_PrimaryEntry_8, NvMRomBlockDataAddress=Dem_Cfg_MemoryEntryInit, NvMAutomaticBlockLength=true, NvMBlockLengthCheck=true
        NvMTargetBlockReference
          NvMFeeRef: NvMNameOfFeeBlock=FeeDemPrimaryDataBlock8
      DemPrimaryDataBlock9: NvMInitBlockCallback=NULL_PTR, NvMSelectBlockForWriteAll=true, NvMUseInitCallback=false, NvMUseJobendCallback=true, NvMSingleBlockCallback=Dem_NvM_JobFinished, NvMNvBlockLength=30, NvMNvramBlockIdentifier=14, NvMUseServicePorts=false, NvMBlockUseCRCCompMechanism=true, NvMBlockUseSetRamBlockStatus=true, NvMInvokeCallbacksForWriteAll=true, NvMRamBlockDataAddress=Dem_Cfg_PrimaryEntry_9, NvMRomBlockDataAddress=Dem_Cfg_MemoryEntryInit, NvMAutomaticBlockLength=true, NvMBlockLengthCheck=true
        NvMTargetBlockReference
          NvMFeeRef: NvMNameOfFeeBlock=FeeDemPrimaryDataBlock9
      EOL_NvBlockNeed_0xF187: NvMInitBlockCallback=NULL_PTR, NvMSelectBlockForWriteAll=false, NvMUseInitCallback=false, NvMUseJobendCallback=true, NvMSingleBlockCallback=NULL_PTR, NvMNvBlockLength=13, NvMNvramBlockIdentifier=46, NvMUseServicePorts=true, NvMBlockUseCRCCompMechanism=false, NvMBlockUseSetRamBlockStatus=true, NvMInvokeCallbacksForWriteAll=true, NvMRamBlockDataAddress=Rte_EOL_NvBlockNeed_0xF187_MirrorBlock, NvMRomBlockDataAddress=Rte_EOL_NvBlockNeed_0xF187_DefaultValue  # UC:Derived from NvBlockNeeds
        NvMTargetBlockReference
          NvMFeeRef: NvMNameOfFeeBlock=FeeEOL_NvBlockNeed_0xF187
      Common_GateWayNvBlockNeed_Block_IPC_Config_Data: NvMInitBlockCallback=NULL_PTR, NvMSelectBlockForWriteAll=false, NvMUseInitCallback=false, NvMUseJobendCallback=true, NvMSingleBlockCallback=NULL_PTR, NvMNvBlockLength=60, NvMNvramBlockIdentifier=47, NvMUseServicePorts=true, NvMBlockUseCRCCompMechanism=false, NvMBlockUseSetRamBlockStatus=true, NvMInvokeCallbacksForWriteAll=true, NvMRamBlockDataAddress=Rte_Common_GateWay_NvBlockNeed_Block_IPC_Config_Data_MirrorBlock, NvMRomBlockDataAddress=Rte_Common_GateWay_NvBlockNeed_Block_IPC_Config_Data_DefaultValue  # UC:Derived from NvBlockNeeds
        NvMTargetBlockReference
          NvMFeeRef: NvMNameOfFeeBlock=FeeCommon_GateWayNvBlockNeed_Block_IPC_Config_Data
      Common_GateWayNvBlockNeed_Block_IPC_CAN_Data: NvMInitBlockCallback=NULL_PTR, NvMSelectBlockForWriteAll=false, NvMUseInitCallback=false, NvMUseJobendCallback=true, NvMSingleBlockCallback=NULL_PTR, NvMNvBlockLength=120, NvMNvramBlockIdentifier=48, NvMUseServicePorts=true, NvMBlockUseCRCCompMechanism=false, NvMBlockUseSetRamBlockStatus=true, NvMInvokeCallbacksForWriteAll=true, NvMRamBlockDataAddress=Rte_Common_GateWay_NvBlockNeed_Block_IPC_CAN_Data_MirrorBlock, NvMRomBlockDataAddress=Rte_Common_GateWay_NvBlockNeed_Block_IPC_CAN_Data_DefaultValue  # UC:Derived from NvBlockNeeds
        NvMTargetBlockReference
          NvMFeeRef: NvMNameOfFeeBlock=FeeCommon_GateWayNvBlockNeed_Block_IPC_CAN_Data
      MiscNvBlockNeed_ResetInfomation: NvMInitBlockCallback=NULL_PTR, NvMSelectBlockForWriteAll=false, NvMUseInitCallback=false, NvMUseJobendCallback=false, NvMSingleBlockCallback=NULL_PTR, NvMNvBlockLength=63, NvMNvramBlockIdentifier=49, NvMUseServicePorts=true, NvMBlockUseCRCCompMechanism=true, NvMBlockUseSetRamBlockStatus=true, NvMInvokeCallbacksForWriteAll=true, NvMRamBlockDataAddress=Rte_Misc_NvBlockNeed_ResetInfomation_MirrorBlock, NvMRomBlockDataAddress=Rte_Misc_NvBlockNeed_ResetInfomation_DefaultValue  # UC:Derived from NvBlockNeeds
        NvMTargetBlockReference
          NvMFeeRef: NvMNameOfFeeBlock=FeeMiscNvBlockNeed_ResetInfomation
      DCM_ServerNvBlockNeedSecAttemptCount: NvMInitBlockCallback=NULL_PTR, NvMUseInitCallback=false, NvMUseJobendCallback=false, NvMSingleBlockCallback=NULL_PTR, NvMNvBlockLength=1, NvMNvramBlockIdentifier=50, NvMUseServicePorts=true, NvMBlockUseCRCCompMechanism=false, NvMBlockUseSetRamBlockStatus=true, NvMInvokeCallbacksForWriteAll=true, NvMRamBlockDataAddress=Rte_DCM_Server_NvBlockNeedSecAttemptCount_MirrorBlock, NvMRomBlockDataAddress=Rte_DCM_Server_NvBlockNeedSecAttemptCount_DefaultValue, NvMSelectBlockForWriteAll=false  # UC:Derived from NvBlockNeeds
        NvMTargetBlockReference
          NvMFeeRef: NvMNameOfFeeBlock=FeeDCM_ServerNvBlockNeedSecAttemptCount
      DCM_ServerNvBlockNeed_EOLUnlockCnt: NvMInitBlockCallback=NULL_PTR, NvMUseInitCallback=false, NvMUseJobendCallback=false, NvMSingleBlockCallback=NULL_PTR, NvMNvBlockLength=1, NvMNvramBlockIdentifier=51, NvMUseServicePorts=true, NvMBlockUseCRCCompMechanism=false, NvMBlockUseSetRamBlockStatus=true, NvMInvokeCallbacksForWriteAll=true, NvMRamBlockDataAddress=Rte_DCM_Server_NvBlockNeed_EOLUnlockCnt_MirrorBlock, NvMRomBlockDataAddress=Rte_DCM_Server_NvBlockNeed_EOLUnlockCnt_DefaultValue, NvMSelectBlockForWriteAll=false  # UC:Derived from NvBlockNeeds
        NvMTargetBlockReference
          NvMFeeRef: NvMNameOfFeeBlock=FeeDCM_ServerNvBlockNeed_EOLUnlockCnt
      DidDataProcessNvBlockNeed_ClusterInternalConfiguration: NvMInitBlockCallback=NULL_PTR, NvMUseInitCallback=false, NvMUseJobendCallback=true, NvMSingleBlockCallback=NULL_PTR, NvMNvBlockLength=300, NvMNvramBlockIdentifier=52, NvMUseServicePorts=true, NvMBlockUseCRCCompMechanism=true, NvMBlockUseSetRamBlockStatus=true, NvMInvokeCallbacksForWriteAll=true, NvMRamBlockDataAddress=Rte_DidDataProcess_NvBlockNeed_ClusterInternalConfiguration_MirrorBlock, NvMRomBlockDataAddress=Rte_DidDataProcess_NvBlockNeed_ClusterInternalConfiguration_DefaultValue  # UC:Derived from NvBlockNeeds
        NvMTargetBlockReference
          NvMFeeRef: NvMNameOfFeeBlock=FeeDidDataProcessNvBlockNeed_ClusterInternalConfiguration
      AMP_NvBlockNeed_LC_Calibration: NvMInitBlockCallback=NULL_PTR, NvMSelectBlockForWriteAll=false, NvMUseInitCallback=false, NvMUseJobendCallback=true, NvMSingleBlockCallback=NULL_PTR, NvMNvBlockLength=20, NvMNvramBlockIdentifier=53, NvMUseServicePorts=true, NvMBlockUseCRCCompMechanism=false, NvMBlockUseSetRamBlockStatus=false, NvMInvokeCallbacksForWriteAll=true, NvMRamBlockDataAddress=Rte_AMP_NvBlockNeed_LC_Calibration_MirrorBlock, NvMRomBlockDataAddress=Rte_AMP_NvBlockNeed_LC_Calibration_DefaultValue  # UC:Derived from NvBlockNeeds
        NvMTargetBlockReference
          NvMFeeRef: NvMNameOfFeeBlock=FeeAMP_NvBlockNeed_LC_Calibration
      DidDataProcessNvBlockNeed_E2ESwitch: NvMInitBlockCallback=NULL_PTR, NvMSelectBlockForWriteAll=false, NvMUseInitCallback=false, NvMUseJobendCallback=true, NvMSingleBlockCallback=NULL_PTR, NvMNvBlockLength=1, NvMNvramBlockIdentifier=54, NvMUseServicePorts=true, NvMBlockUseCRCCompMechanism=false, NvMBlockUseSetRamBlockStatus=true, NvMInvokeCallbacksForWriteAll=true, NvMRamBlockDataAddress=Rte_DidDataProcess_NvBlockNeed_E2ESwitch_MirrorBlock, NvMRomBlockDataAddress=Rte_DidDataProcess_NvBlockNeed_E2ESwitch_DefaultValue  # UC:Derived from NvBlockNeeds
        NvMTargetBlockReference
          NvMFeeRef: NvMNameOfFeeBlock=FeeDidDataProcessNvBlockNeed_E2ESwitch
      DidDataProcessNvBlockNeed_SecOcSwitch: NvMInitBlockCallback=NULL_PTR, NvMSelectBlockForWriteAll=false, NvMUseInitCallback=false, NvMUseJobendCallback=true, NvMSingleBlockCallback=NULL_PTR, NvMNvBlockLength=1, NvMNvramBlockIdentifier=55, NvMUseServicePorts=true, NvMBlockUseCRCCompMechanism=false, NvMBlockUseSetRamBlockStatus=true, NvMInvokeCallbacksForWriteAll=true, NvMRamBlockDataAddress=Rte_DidDataProcess_NvBlockNeed_SecOcSwitch_MirrorBlock, NvMRomBlockDataAddress=Rte_DidDataProcess_NvBlockNeed_SecOcSwitch_DefaultValue  # UC:Derived from NvBlockNeeds
        NvMTargetBlockReference
          NvMFeeRef: NvMNameOfFeeBlock=FeeDidDataProcessNvBlockNeed_SecOcSwitch
      NvBlockNeed_UpgradeResetFlag: NvMInitBlockCallback=NULL_PTR, NvMSelectBlockForWriteAll=false, NvMUseInitCallback=false, NvMUseJobendCallback=false, NvMSingleBlockCallback=NULL_PTR, NvMNvBlockLength=4, NvMNvramBlockIdentifier=56, NvMUseServicePorts=true, NvMBlockUseCRCCompMechanism=false, NvMBlockUseSetRamBlockStatus=true, NvMInvokeCallbacksForWriteAll=true, NvMRamBlockDataAddress=Rte_Upgrade_NvBlockNeed_UpgradeResetFlag_MirrorBlock, NvMRomBlockDataAddress=Rte_Upgrade_NvBlockNeed_UpgradeResetFlag_DefaultValue  # UC:Derived from NvBlockNeeds
        NvMTargetBlockReference
          NvMFeeRef: NvMNameOfFeeBlock=FeeNvBlockNeed_UpgradeResetFlag
      NvMBlockDescriptor_Fvm_TripCount: NvMInitBlockCallback=NULL_PTR, NvMSelectBlockForWriteAll=false, NvMUseInitCallback=false, NvMUseJobendCallback=true, NvMSingleBlockCallback=NULL_PTR, NvMNvBlockLength=4, NvMNvramBlockIdentifier=57, NvMUseServicePorts=true, NvMBlockUseCRCCompMechanism=false, NvMBlockUseSetRamBlockStatus=false, NvMInvokeCallbacksForWriteAll=true, NvMRamBlockDataAddress=FvM_LatestTripCounter, NvMRomBlockDataAddress=FvM_LatestTripCounterInit
        NvMTargetBlockReference
          NvMFeeRef: NvMNameOfFeeBlock=FeeBlockConfiguration_Fvm_TripCount
      Common_NormalNvBlockNeed_Menu: NvMInitBlockCallback=NULL_PTR, NvMSelectBlockForWriteAll=false, NvMUseInitCallback=false, NvMUseJobendCallback=true, NvMSingleBlockCallback=NULL_PTR, NvMNvBlockLength=20, NvMNvramBlockIdentifier=58, NvMBlockUseCRCCompMechanism=false, NvMBlockUseSetRamBlockStatus=false, NvMInvokeCallbacksForWriteAll=true, NvMRamBlockDataAddress=Rte_Common_Normal_NvBlockNeed_Menu_MirrorBlock, NvMUseServicePorts=true, NvMRomBlockDataAddress=Rte_Common_Normal_NvBlockNeed_MENU_Data_DefaultValue  # UC:Derived from NvBlockNeeds
        NvMTargetBlockReference
          NvMFeeRef: NvMNameOfFeeBlock=FeeCommon_NormalNvBlockNeed_Menu
      DidDataProcessNvBlockNeed_VehicleSoftwareVersion: NvMInitBlockCallback=NULL_PTR, NvMSelectBlockForWriteAll=false, NvMUseInitCallback=false, NvMUseJobendCallback=true, NvMSingleBlockCallback=NULL_PTR, NvMNvBlockLength=30, NvMNvramBlockIdentifier=59, NvMUseServicePorts=true, NvMBlockUseCRCCompMechanism=false, NvMBlockUseSetRamBlockStatus=true, NvMInvokeCallbacksForWriteAll=true, NvMRamBlockDataAddress=Rte_DidDataProcess_NvBlockNeed_VehicleSoftwareVersion_MirrorBlock, NvMRomBlockDataAddress=Rte_DidDataProcess_NvBlockNeed_VehicleSoftwareVersion_DefaultValue  # UC:Derived from NvBlockNeeds
        NvMTargetBlockReference
          NvMFeeRef: NvMNameOfFeeBlock=FeeDidDataProcessNvBlockNeed_VehicleSoftwareVersion
      AMP_NvBlockNeed_LC_Calibration2: NvMInitBlockCallback=NULL_PTR, NvMSelectBlockForWriteAll=false, NvMUseInitCallback=false, NvMUseJobendCallback=true, NvMSingleBlockCallback=NULL_PTR, NvMNvBlockLength=20, NvMNvramBlockIdentifier=60, NvMUseServicePorts=true, NvMBlockUseCRCCompMechanism=false, NvMBlockUseSetRamBlockStatus=false, NvMInvokeCallbacksForWriteAll=true, NvMRamBlockDataAddress=Rte_AMP_NvBlockNeed_LC_Calibration2_MirrorBlock, NvMRomBlockDataAddress=Rte_AMP_NvBlockNeed_LC_Calibration2_DefaultValue  # UC:Derived from NvBlockNeeds
        NvMTargetBlockReference
          NvMFeeRef: NvMNameOfFeeBlock=FeeAMP_NvBlockNeed_LC_Calibration2
      SOCManagerNvBlockNeed_HealthSwitch: NvMInitBlockCallback=NULL_PTR, NvMSelectBlockForWriteAll=false, NvMUseInitCallback=false, NvMUseJobendCallback=true, NvMSingleBlockCallback=NULL_PTR, NvMNvBlockLength=1, NvMNvramBlockIdentifier=61, NvMUseServicePorts=true, NvMBlockUseCRCCompMechanism=false, NvMBlockUseSetRamBlockStatus=true, NvMInvokeCallbacksForWriteAll=false, NvMRamBlockDataAddress=Rte_SOCManager_NvBlockNeed_HealthSwitch_MirrorBlock, NvMRomBlockDataAddress=Rte_SOCManager_NvBlockNeed_HealthSwitch_DefaultValue  # UC:Derived from NvBlockNeeds
        NvMTargetBlockReference
          NvMFeeRef: NvMNameOfFeeBlock=FeeSOCManagerNvBlockNeed_HealthSwitch
      DidDataProcessNvBlockNeed_ClusterDisplayHMIAdjustmentOffset: NvMInitBlockCallback=NULL_PTR, NvMUseInitCallback=false, NvMUseJobendCallback=true, NvMSingleBlockCallback=NULL_PTR, NvMNvBlockLength=8, NvMNvramBlockIdentifier=62, NvMUseServicePorts=true, NvMBlockUseCRCCompMechanism=true, NvMBlockUseSetRamBlockStatus=true, NvMRamBlockDataAddress=Rte_DidDataProcess_NvBlockNeed_ClusterDisplayHMIAdjustmentOffset_MirrorBlock, NvMRomBlockDataAddress=Rte_DidDataProcess_NvBlockNeed_ClusterDisplayHMIAdjustmentOffset_DefaultValue, NvMInvokeCallbacksForWriteAll=true, NvMSelectBlockForWriteAll=false  # UC:Derived from NvBlockNeeds
        NvMTargetBlockReference
          NvMFeeRef: NvMNameOfFeeBlock=FeeDidDataProcessNvBlockNeed_ClusterDisplayHMIAdjustmentOffset
      Can_ServerNvBlockNeed_AbnormalWakeupSleepRecords: NvMInitBlockCallback=NULL_PTR, NvMUseInitCallback=false, NvMUseJobendCallback=true, NvMSingleBlockCallback=NULL_PTR, NvMNvBlockLength=80, NvMNvramBlockIdentifier=63, NvMUseServicePorts=true, NvMBlockUseCRCCompMechanism=false, NvMBlockUseSetRamBlockStatus=true, NvMInvokeCallbacksForWriteAll=true, NvMRamBlockDataAddress=Rte_Can_Server_NvBlockNeed_AbnormalWakeupSleepRecords_MirrorBlock, NvMRomBlockDataAddress=Rte_Can_Server_NvBlockNeed_AbnormalWakeupSleepRecords_DefaultValue, NvMSelectBlockForWriteAll=false  # UC:Derived from NvBlockNeeds
        NvMTargetBlockReference
          NvMFeeRef: NvMNameOfFeeBlock=FeeCan_ServerNvBlockNeed_AbnormalWakeupSleepRecords
      Can_ServerNvBlockNeed_ActiveWUCounter: NvMInitBlockCallback=NULL_PTR, NvMUseInitCallback=false, NvMUseJobendCallback=true, NvMSingleBlockCallback=NULL_PTR, NvMNvBlockLength=1, NvMNvramBlockIdentifier=64, NvMUseServicePorts=true, NvMBlockUseCRCCompMechanism=false, NvMBlockUseSetRamBlockStatus=true, NvMRamBlockDataAddress=Rte_Can_Server_NvBlockNeed_ActiveWUCounter_MirrorBlock, NvMRomBlockDataAddress=Rte_Can_Server_NvBlockNeed_ActiveWUCounter_DefaultValue, NvMInvokeCallbacksForWriteAll=true, NvMSelectBlockForWriteAll=false  # UC:Derived from NvBlockNeeds
        NvMTargetBlockReference
          NvMFeeRef: NvMNameOfFeeBlock=FeeCan_ServerNvBlockNeed_ActiveWUCounter
