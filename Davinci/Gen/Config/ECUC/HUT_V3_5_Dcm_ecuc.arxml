AUTOSAR XML (schema 00046)
package /ActiveEcuC
  module config Dcm: implementation-config-variant=VARIANT-PRE-COMPILE, module-description=Dcm_Impl
    DcmConfigSet
      DcmDsl
        DcmDslProtocol
          DcmDslProtocolRow_29812fbf (DcmDslProtocolRow):
            DcmDslProtocolEndiannessConvEnabled = false
            DcmDslProtocolID = DCM_UDS_ON_CAN
            DcmDslProtocolPreemptTimeout = 0
            DcmDslProtocolPriority = 0
            DcmSendRespPendOnTransToBoot = true
            DcmTimStrP2ServerAdjust = 0.01
            DcmTimStrP2StarServerAdjust = 0.01
            DcmDslProtocolMaximumResponseSize = 4095
            DcmDslProtocolRxBufferID = DcmDslBuffer
            DcmDslProtocolSIDTable = DcmDsdServiceTable
            DcmDslProtocolTxBufferID = DcmDslBuffer
            DcmDemClientRef = DemClient
            DcmDslConnection
              DcmDslMainConnection: DcmDslProtocolRxTesterSourceAddr=225, DcmDslProtocolRxConnectionId=1
                DcmDslProtocolRx_Fun (DcmDslProtocolRx):
                  DcmDslProtocolRxAddrType = DCM_FUNCTIONAL_TYPE
                  DcmDslProtocolRxChannelId = 0
                  DcmDslProtocolRxPduId = 0
                  DcmDslProtocolRxPduRef = DiagFuncReq_oB30_for_SC_CAN_V3_2_92cf4cbf_Rx
                  DcmDslProtocolRxComMChannelRef = CN_B30_for_SC_CAN_V3_2_c0d6c67b
                DcmDslProtocolRx_Phy (DcmDslProtocolRx):
                  DcmDslProtocolRxAddrType = DCM_PHYSICAL_TYPE
                  DcmDslProtocolRxChannelId = 0
                  DcmDslProtocolRxPduId = 1
                  DcmDslProtocolRxPduRef = HUT_Phy_Req_oB30_for_SC_CAN_V3_2_c7e62b5b_Rx
                  DcmDslProtocolRxComMChannelRef = CN_B30_for_SC_CAN_V3_2_c0d6c67b
                DcmDslProtocolTx: DcmDslTxConfirmationPduId=0, DcmDslProtocolTxPduRef=HUT_Phy_Resp_oB30_for_SC_CAN_V3_2_9074f696_Tx
            DcmDslConnection_CANFD (DcmDslConnection)
              DcmDslMainConnection: DcmDslProtocolRxTesterSourceAddr=225, DcmDslProtocolRxConnectionId=2
                DcmDslProtocolRx_Fun_CANFD (DcmDslProtocolRx):
                  DcmDslProtocolRxAddrType = DCM_FUNCTIONAL_TYPE
                  DcmDslProtocolRxChannelId = 0
                  DcmDslProtocolRxPduId = 2
                  DcmDslProtocolRxPduRef = DiagFuncReq_oB30_for_SC_CAN_V3_2_20_ca1db2d5_Rx
                  DcmDslProtocolRxComMChannelRef = CN_B30_for_SC_CAN_V3_2_c0d6c67b
                DcmDslProtocolRx_Phy_CANFD (DcmDslProtocolRx):
                  DcmDslProtocolRxAddrType = DCM_PHYSICAL_TYPE
                  DcmDslProtocolRxChannelId = 0
                  DcmDslProtocolRxPduId = 3
                  DcmDslProtocolRxPduRef = HUT_Phy_Req_oB30_for_SC_CAN_V3_2_20_0cf8aff0_Rx
                  DcmDslProtocolRxComMChannelRef = CN_B30_for_SC_CAN_V3_2_c0d6c67b
                DcmDslProtocolTx_CANFD (DcmDslProtocolTx): DcmDslTxConfirmationPduId=1, DcmDslProtocolTxPduRef=HUT_Phy_Resp_oB30_for_SC_CAN_V3_2_20_bf18e38e_Tx
        DcmDslDiagResp: DcmDslDiagRespMaxNumRespPend=6, DcmDslDiagRespOnSecondDeclinedRequest=false, DcmDslDiagRespMaxNumOfDeclinedRequests=3
        DcmDslBuffer: DcmDslBufferSize=4095
        DcmDslServiceRequestGWMNotification (DcmDslServiceRequestManufacturerNotification): DcmDslServiceRequestManufacturerNotificationUsePort=true
      DcmGeneral:
        DcmDevErrorDetect = true
        DcmRequestManufacturerNotificationEnabled = true
        DcmRequestSupplierNotificationEnabled = false
        DcmRespondAllRequest = true
        DcmTaskTime = 0.01
        DcmVersionInfoApi = false
        DcmDspDataDefaultEndianness = LITTLE_ENDIAN
        DcmSafeBswChecks = false
        DcmSupportedIDCalculationSuppressionEnabled = false
        DcmDtrDataProvisionViaDemEnabled = true
        DcmForeignDiagnosticRequestDetectionEnabled = false
        DcmSuppressResponseOnCanTpFuncMixedAddrRequests = false
        DcmSenderReceiverPRPortsEnabled = false
      DcmDsd
        DcmDsdServiceTable
          12 x DcmDsdService:
            ReadDtcInfo: DcmDsdSidTabServiceId=25, DcmDsdSidTabSubfuncAvail=true, DcmDsdSidTabSessionLevelRef=DcmDspSession/Default, DcmDsdSidTabSessionLevelRef=DcmDspSession/Extended, DcmDsdSidTabSessionLevelRef=EOLDiagnosticSession  # RDTCSSI
              5 x DcmDsdSubService, all with DcmDsdSubServiceSessionLevelRef=DcmDspSession/Default, DcmDsdSubServiceSessionLevelRef=DcmDspSession/Extended, DcmDsdSubServiceSessionLevelRef=EOLDiagnosticSession:
                RDTCEDRBDN: DcmDsdSubServiceId=6
                RSUPDTC: DcmDsdSubServiceId=10
                RDTCBSM: DcmDsdSubServiceId=2
                RNODTCBSM: DcmDsdSubServiceId=1
                RDTCSSBDTC: DcmDsdSubServiceId=4
            ClearDiagInfo: DcmDsdSidTabServiceId=20, DcmDsdSidTabSubfuncAvail=false, DcmDsdSidTabSessionLevelRef=DcmDspSession/Default, DcmDsdSidTabSessionLevelRef=DcmDspSession/Extended, DcmDsdSidTabSessionLevelRef=EOLDiagnosticSession, DcmDsdSidTabModeRuleRef=DcmModeRule
            EcuReset: DcmDsdSidTabServiceId=17, DcmDsdSidTabSubfuncAvail=true, DcmDsdSidTabSessionLevelRef=DcmDspSession/Default, DcmDsdSidTabSessionLevelRef=DcmDspSession/Extended, DcmDsdSidTabSessionLevelRef=EOLDiagnosticSession, DcmDsdSidTabSessionLevelRef=UFSKeepProgrammingSession
              Soft (DcmDsdSubService):
                DcmDsdSubServiceId = 3
                DcmDsdSubServiceSessionLevelRef = DcmDspSession/Default
                DcmDsdSubServiceSessionLevelRef = DcmDspSession/Extended
                DcmDsdSubServiceSessionLevelRef = EOLDiagnosticSession
                DcmDsdSubServiceModeRuleRef = DcmModeRule
                DcmDsdSubServiceSessionLevelRef = UFSKeepProgrammingSession
              Hard (DcmDsdSubService):
                DcmDsdSubServiceId = 1
                DcmDsdSubServiceSessionLevelRef = DcmDspSession/Default
                DcmDsdSubServiceSessionLevelRef = DcmDspSession/Extended
                DcmDsdSubServiceSessionLevelRef = EOLDiagnosticSession
                DcmDsdSubServiceModeRuleRef = DcmModeRule
                DcmDsdSubServiceSessionLevelRef = UFSKeepProgrammingSession
            ControlDtcSetting: DcmDsdSidTabServiceId=133, DcmDsdSidTabSubfuncAvail=true, DcmDsdSidTabSessionLevelRef=DcmDspSession/Extended, DcmDsdSidTabSessionLevelRef=UFSKeepProgrammingSession
              Disable (DcmDsdSubService):
                DcmDsdSubServiceId = 2
                DcmDsdSubServiceSessionLevelRef = DcmDspSession/Extended
                DcmDsdSubServiceSessionLevelRef = UFSKeepProgrammingSession
                DcmDsdSubServiceModeRuleRef = DcmModeRule
              Enable (DcmDsdSubService):
                DcmDsdSubServiceId = 1
                DcmDsdSubServiceSessionLevelRef = DcmDspSession/Extended
                DcmDsdSubServiceSessionLevelRef = UFSKeepProgrammingSession
                DcmDsdSubServiceModeRuleRef = DcmModeRule
            TesterPresent: DcmDsdSidTabServiceId=62, DcmDsdSidTabSubfuncAvail=true, DcmDsdSidTabSessionLevelRef=EOLDiagnosticSession, DcmDsdSidTabSessionLevelRef=DcmDspSession/Extended, DcmDsdSidTabSessionLevelRef=DcmDspSession/Default
              TesterPresent (DcmDsdSubService): DcmDsdSubServiceId=0
            WriteDataById: DcmDsdSidTabServiceId=46, DcmDsdSidTabSubfuncAvail=false, DcmDsdSidTabSessionLevelRef=DcmDspSession/Extended, DcmDsdSidTabSessionLevelRef=EOLDiagnosticSession
            ReadDataById: DcmDsdSidTabServiceId=34, DcmDsdSidTabSubfuncAvail=false, DcmDsdSidTabSessionLevelRef=DcmDspSession/Default, DcmDsdSidTabSessionLevelRef=DcmDspSession/Extended, DcmDsdSidTabSessionLevelRef=EOLDiagnosticSession
            CommunicationControl: DcmDsdSidTabServiceId=40, DcmDsdSidTabSubfuncAvail=true, DcmDsdSidTabSessionLevelRef=DcmDspSession/Extended, DcmDsdSidTabSessionLevelRef=EOLDiagnosticSession
              DisableRxAndTx (DcmDsdSubService): DcmDsdSubServiceId=3, DcmDsdSubServiceSessionLevelRef=DcmDspSession/Extended, DcmDsdSubServiceModeRuleRef=DcmModeRule
              EnableRxAndTx (DcmDsdSubService): DcmDsdSubServiceId=0, DcmDsdSubServiceSessionLevelRef=DcmDspSession/Extended, DcmDsdSubServiceModeRuleRef=DcmModeRule
            SecurityAccess: DcmDsdSidTabServiceId=39, DcmDsdSidTabSubfuncAvail=true, DcmDsdSidTabSessionLevelRef=DcmDspSession/Extended, DcmDsdSidTabSessionLevelRef=EOLDiagnosticSession
              4 x DcmDsdSubService:
                SeedLevel1_Request: DcmDsdSubServiceId=1, DcmDsdSubServiceSessionLevelRef=DcmDspSession/Extended
                KeyLevel1_Send: DcmDsdSubServiceId=2, DcmDsdSubServiceSessionLevelRef=DcmDspSession/Extended
                EOLrequestSeed_Request: DcmDsdSubServiceId=97, DcmDsdSubServiceSessionLevelRef=EOLDiagnosticSession, DcmDsdSubServiceSessionLevelRef=(unset)
                EOLrequestSeed_Key_Send: DcmDsdSubServiceId=98, DcmDsdSubServiceSessionLevelRef=EOLDiagnosticSession, DcmDsdSubServiceSessionLevelRef=(unset)
            RoutineControl: DcmDsdSidTabServiceId=49, DcmDsdSidTabSubfuncAvail=true, DcmDsdSidTabSessionLevelRef=DcmDspSession/Extended, DcmDsdSidTabSessionLevelRef=EOLDiagnosticSession
            DiagSessionControl: DcmDsdSidTabServiceId=16, DcmDsdSidTabSubfuncAvail=true
              4 x DcmDsdSubService, all with DcmDsdSubServiceSessionLevelRef=DcmDspSession/Default:
                Default: DcmDsdSubServiceId=1, DcmDsdSubServiceSessionLevelRef=EOLDiagnosticSession, DcmDsdSubServiceSessionLevelRef=DcmDspSession/Extended, DcmDsdSubServiceSessionLevelRef=UFSKeepProgrammingSession
                Extended: DcmDsdSubServiceId=3, DcmDsdSubServiceSessionLevelRef=DcmDspSession/Extended
                EOLDiagnosticSession_Start: DcmDsdSubServiceId=96, DcmDsdSubServiceSessionLevelRef=EOLDiagnosticSession, DcmDsdSubServiceSessionLevelRef=DcmDspSession/Extended
                UFSKeepProgrammingSession_Start: DcmDsdSubServiceId=111, DcmDsdSubServiceSessionLevelRef=UFSKeepProgrammingSession
            ReadMemoryByAddress: DcmDsdSidTabServiceId=35, DcmDsdSidTabSubfuncAvail=false, DcmDsdSidTabSecurityLevelRef=UnlockedL1, DcmDsdSidTabSessionLevelRef=DcmDspSession/Extended
      DcmDsp: DcmDspMaxDidToRead=1, DcmDspReadDIDReportsNODIByte=false
        DcmDspSession
          4 x DcmDspSessionRow, all with DcmDspSessionP2ServerMax=0.05, DcmDspSessionP2StarServerMax=5, DcmDspSessionForBoot=DCM_NO_BOOT:
            Default: DcmDspSessionLevel=1
            Extended: DcmDspSessionLevel=3
            EOLDiagnosticSession: DcmDspSessionLevel=96
            UFSKeepProgrammingSession: DcmDspSessionLevel=111
        DcmDspSecurity: DcmDspSecurityResetAttemptCounterOnTimeout=true
          UnlockedL1 (DcmDspSecurityRow):
            DcmDspSecurityDelayTime = 10
            DcmDspSecurityDelayTimeOnBoot = 0
            DcmDspSecurityKeySize = 4
            DcmDspSecurityLevel = 1
            DcmDspSecurityNumAttDelay = 3
            DcmDspSecuritySeedSize = 4
            DcmDspSecurityAttemptCounterEnabled = true
            DcmDspSecurityUsePort = USE_ASYNCH_CLIENT_SERVER
          Level_EOL_Unlocked (DcmDspSecurityRow):
            DcmDspSecurityDelayTime = 20
            DcmDspSecurityDelayTimeOnBoot = 0
            DcmDspSecurityKeySize = 8
            DcmDspSecurityLevel = 49
            DcmDspSecurityNumAttDelay = 2
            DcmDspSecuritySeedSize = 4
            DcmDspSecurityAttemptCounterEnabled = true
            DcmDspSecurityUsePort = USE_ASYNCH_CLIENT_SERVER
        RoutineInfo_PhyTestMode (DcmDspRoutineInfo)  # DcmDspStartRoutineOut
          DcmDspStartRoutineIn
            In_PortNumber (DcmDspStartRoutineInSignal): DcmDspRoutineSignalLength=8, DcmDspRoutineSignalType=UINT8, DcmDspRoutineSignalEndianness=opaque, DcmDspRoutineSignalPos=0
            In_TestMode (DcmDspStartRoutineInSignal): DcmDspRoutineSignalLength=8, DcmDspRoutineSignalType=UINT8, DcmDspRoutineSignalEndianness=opaque, DcmDspRoutineSignalPos=8
          DcmDspRoutineAuthorization: DcmDspRoutineSessionRef=DcmDspSession/Extended, DcmDspRoutineSecurityLevelRef=UnlockedL1
        VehicleModel (DcmDspDid): DcmDspDidIdentifier=61714, DcmDspDidUsed=true, DcmDspDidUsePort=USE_DATA_ELEMENT_SPECIFIC_INTERFACES, DcmDspDidInfoRef=DidInfo_VehicleModel
          VehicleModel (DcmDspDidSignal): DcmDspDidDataPos=0, DcmDspDidDataRef=VehicleModel_VehicleModel
        VehicleModel_VehicleModel (DcmDspData):
          DcmDspDataSize = 160
          DcmDspDataType = UINT8_N
          DcmDspDataUsePort = USE_DATA_ASYNCH_CLIENT_SERVER
          DcmDspDataTypedClientServerPortEnabled = true
          DcmDspDataInfoRef = DataInfo_VehicleModel_VehicleModel
        CableDiagnostics (DcmDspRoutine):
          DcmDspRequestResultsRoutineSupported = false
          DcmDspStopRoutineSupported = false
          DcmDspRoutineIdentifier = 41378
          DcmDspRoutineFixedLength = true
          DcmDspRoutineUsePort = true
          DcmDspRoutineUsed = true
          DcmDspRoutineInfoRef = RoutineInfo_CableDiagnostics_001
        PhyTestMode (DcmDspRoutine):
          DcmDspRequestResultsRoutineSupported = false
          DcmDspStopRoutineSupported = false
          DcmDspRoutineIdentifier = 41377
          DcmDspRoutineFixedLength = true
          DcmDspRoutineUsePort = true
          DcmDspRoutineUsed = true
          DcmDspRoutineInfoRef = RoutineInfo_PhyTestMode
        DataInfo_VehicleModel_VehicleModel (DcmDspDataInfo): DcmDspDataFixedLength=true
        ComControl (DcmDspComControl)
          DspComContolAllChannel (DcmDspComControlAllChannel): DcmDspAllComMChannelRef=CN_B30_for_SC_CAN_V3_2_c0d6c67b
        ResetSwitchStatistics (DcmDspRoutine):
          DcmDspRequestResultsRoutineSupported = false
          DcmDspStopRoutineSupported = false
          DcmDspRoutineIdentifier = 41379
          DcmDspRoutineFixedLength = true
          DcmDspRoutineUsePort = true
          DcmDspRoutineUsed = true
          DcmDspRoutineInfoRef = RoutineInfo_ResetSwitchStatistics
        DidInfo_VehicleModel (DcmDspDidInfo)
          DcmDspDidAccess
            DcmDspDidWrite: DcmDspDidWriteSessionRef=(unset), DcmDspDidWriteSessionRef=DcmDspSession/Extended, DcmDspDidWriteSecurityLevelRef=UnlockedL1
            DcmDspDidRead: DcmDspDidReadSessionRef=DcmDspSession/Default, DcmDspDidReadSessionRef=DcmDspSession/Extended
        RoutineInfo_ResetSwitchStatistics (DcmDspRoutineInfo)  # DcmDspStartRoutineOut
          DcmDspRoutineAuthorization: DcmDspRoutineSessionRef=DcmDspSession/Extended, DcmDspRoutineSecurityLevelRef=UnlockedL1
        ODOReset (DcmDspRoutine):
          DcmDspRequestResultsRoutineSupported = true
          DcmDspStopRoutineSupported = false
          DcmDspRoutineIdentifier = 64801
          DcmDspRoutineFixedLength = true
          DcmDspRoutineUsePort = true
          DcmDspRoutineUsed = true
          DcmDspRoutineInfoRef = RoutineInfo_ODOReset
        AVMEnvironmentCheck (DcmDspRoutine):
          DcmDspRequestResultsRoutineSupported = true
          DcmDspStopRoutineSupported = false
          DcmDspRoutineIdentifier = 61488
          DcmDspRoutineFixedLength = true
          DcmDspRoutineUsePort = true
          DcmDspRoutineUsed = true
          DcmDspRoutineInfoRef = RoutineInfo_AVMEnvironmentCheck
        RoutineInfo_AVMEnvironmentCheck (DcmDspRoutineInfo)
          DcmDspRoutineRequestResOut
            Out_AVMEnvironmentCheckResult (DcmDspRoutineRequestResOutSignal): DcmDspRoutineSignalLength=8, DcmDspRoutineSignalType=UINT8, DcmDspRoutineSignalPos=0
          DcmDspRoutineAuthorization: DcmDspRoutineSessionRef=DcmDspSession/Extended, DcmDspRoutineSessionRef=EOLDiagnosticSession, DcmDspRoutineSecurityLevelRef=UnlockedL1
        RoutineInfo_ODOReset (DcmDspRoutineInfo)  # DcmDspStartRoutineOut
          DcmDspRoutineAuthorization: DcmDspRoutineSessionRef=DcmDspSession/Extended, DcmDspRoutineSecurityLevelRef=UnlockedL1
          DcmDspRoutineRequestResOut
            Out_OdoResetResult (DcmDspRoutineRequestResOutSignal): DcmDspRoutineSignalLength=8, DcmDspRoutineSignalPos=0, DcmDspRoutineSignalType=UINT8
        6 x DcmDspRoutine, all with DcmDspRequestResultsRoutineSupported=true, DcmDspRoutineFixedLength=true, DcmDspRoutineUsePort=true, DcmDspRoutineUsed=true:
          AVMManualCalibration: DcmDspStopRoutineSupported=true, DcmDspRoutineIdentifier=61491, DcmDspRoutineInfoRef=RoutineInfo_AVMManualCalibration
          AVMManualViewSelect: DcmDspStopRoutineSupported=false, DcmDspRoutineIdentifier=61493, DcmDspRoutineInfoRef=RoutineInfo_AVMManualViewSelect
          AVMManualConerSelect: DcmDspStopRoutineSupported=false, DcmDspRoutineIdentifier=61494, DcmDspRoutineInfoRef=RoutineInfo_AVMManualConerSelect
          AVMManualConerMove: DcmDspStopRoutineSupported=false, DcmDspRoutineIdentifier=61495, DcmDspRoutineInfoRef=RoutineInfo_AVMManualConerMove
          AVMManualCorrectValue: DcmDspStopRoutineSupported=false, DcmDspRoutineIdentifier=61496, DcmDspRoutineInfoRef=RoutineInfo_AVMManualCorrectValue
          AVMAutoCalibration: DcmDspStopRoutineSupported=false, DcmDspRoutineIdentifier=61489, DcmDspRoutineInfoRef=RoutineInfo_AVMAutoCalibration
        7 x DcmDspRoutineInfo:
          RoutineInfo_AVMManualCalibration
            DcmDspRoutineRequestResOut
              Out_ManualCalibrationResult (DcmDspRoutineRequestResOutSignal): DcmDspRoutineSignalLength=8, DcmDspRoutineSignalType=UINT8, DcmDspRoutineSignalPos=0
            DcmDspRoutineAuthorization: DcmDspRoutineSessionRef=DcmDspSession/Extended, DcmDspRoutineSessionRef=EOLDiagnosticSession, DcmDspRoutineSecurityLevelRef=UnlockedL1
          RoutineInfo_AVMManualConerMove
            DcmDspRoutineRequestResOut
              Out_AVMManualConerMoveResult (DcmDspRoutineRequestResOutSignal): DcmDspRoutineSignalLength=8, DcmDspRoutineSignalType=UINT8, DcmDspRoutineSignalPos=0
            DcmDspRoutineAuthorization: DcmDspRoutineSessionRef=DcmDspSession/Extended, DcmDspRoutineSessionRef=EOLDiagnosticSession, DcmDspRoutineSecurityLevelRef=UnlockedL1
            DcmDspStartRoutineIn
              In_AVMManualConerMove (DcmDspStartRoutineInSignal): DcmDspRoutineSignalLength=8, DcmDspRoutineSignalPos=0, DcmDspRoutineSignalType=UINT8
          RoutineInfo_AVMManualConerSelect
            DcmDspRoutineRequestResOut
              Out_AVMEnvironmentCheckResult (DcmDspRoutineRequestResOutSignal): DcmDspRoutineSignalLength=8, DcmDspRoutineSignalType=UINT8, DcmDspRoutineSignalPos=0
            DcmDspRoutineAuthorization: DcmDspRoutineSessionRef=DcmDspSession/Extended, DcmDspRoutineSessionRef=EOLDiagnosticSession, DcmDspRoutineSecurityLevelRef=UnlockedL1
            DcmDspStartRoutineIn
              In_AVMManualConerSelect (DcmDspStartRoutineInSignal): DcmDspRoutineSignalLength=8, DcmDspRoutineSignalPos=0, DcmDspRoutineSignalType=UINT8
          RoutineInfo_AVMManualCorrectValue
            DcmDspRoutineRequestResOut
              Out_AVMManualCorrectValue (DcmDspRoutineRequestResOutSignal): DcmDspRoutineSignalLength=8, DcmDspRoutineSignalType=UINT8, DcmDspRoutineSignalPos=0
            DcmDspRoutineAuthorization: DcmDspRoutineSessionRef=DcmDspSession/Extended, DcmDspRoutineSessionRef=EOLDiagnosticSession, DcmDspRoutineSecurityLevelRef=UnlockedL1
          RoutineInfo_AVMManualViewSelect
            DcmDspRoutineRequestResOut
              Out_AVMEnvironmentCheckResult (DcmDspRoutineRequestResOutSignal): DcmDspRoutineSignalLength=8, DcmDspRoutineSignalType=UINT8, DcmDspRoutineSignalPos=0
            DcmDspRoutineAuthorization: DcmDspRoutineSessionRef=DcmDspSession/Extended, DcmDspRoutineSessionRef=EOLDiagnosticSession, DcmDspRoutineSecurityLevelRef=UnlockedL1
            DcmDspStartRoutineIn
              In_AVMManualViewSelect (DcmDspStartRoutineInSignal): DcmDspRoutineSignalLength=8, DcmDspRoutineSignalPos=0, DcmDspRoutineSignalType=UINT8
          RoutineInfo_AVMAutoCalibration
            DcmDspRoutineRequestResOut
              Out_AVMCalibrationResult (DcmDspRoutineRequestResOutSignal): DcmDspRoutineSignalLength=8, DcmDspRoutineSignalType=UINT8, DcmDspRoutineSignalPos=0
            DcmDspRoutineAuthorization: DcmDspRoutineSessionRef=DcmDspSession/Extended, DcmDspRoutineSessionRef=EOLDiagnosticSession, DcmDspRoutineSecurityLevelRef=UnlockedL1
          RoutineInfo_CableDiagnostics_001
            DcmDspStartRoutineIn
              In_CableDiagnosticsControl (DcmDspStartRoutineInSignal): DcmDspRoutineSignalLength=8, DcmDspRoutineSignalType=UINT8, DcmDspRoutineSignalEndianness=opaque, DcmDspRoutineSignalPos=0
            DcmDspRoutineAuthorization: DcmDspRoutineSessionRef=DcmDspSession/Extended, DcmDspRoutineSecurityLevelRef=UnlockedL1
            DcmDspStartRoutineOut
              Out_Result (DcmDspStartRoutineOutSignal): DcmDspRoutineSignalLength=8, DcmDspRoutineSignalPos=0, DcmDspRoutineSignalType=UINT8, DcmDspRoutineSignalEndianness=opaque
        3 x DcmDspRoutine, all with DcmDspRequestResultsRoutineSupported=true, DcmDspStopRoutineSupported=false, DcmDspRoutineFixedLength=true, DcmDspRoutineUsePort=true, DcmDspRoutineUsed=true:
          AVMRegister: DcmDspRoutineIdentifier=1026, DcmDspRoutineInfoRef=RoutineInfo_AVMRegister
          CheckEthernetIPPINGFunction: DcmDspRoutineIdentifier=1024, DcmDspRoutineInfoRef=RoutineInfo_CheckEthernetIPPINGFunction
          IVITouchTest: DcmDspRoutineIdentifier=1025, DcmDspRoutineInfoRef=RoutineInfo_IVITouchTest
        3 x DcmDspRoutineInfo:
          RoutineInfo_AVMRegister
            DcmDspRoutineRequestResOut
              Out_AVMRegister (DcmDspRoutineRequestResOutSignal): DcmDspRoutineSignalLength=8, DcmDspRoutineSignalType=UINT8, DcmDspRoutineSignalPos=0
            DcmDspStartRoutineOut
              Out_AVMRegister (DcmDspStartRoutineOutSignal): DcmDspRoutineSignalLength=8, DcmDspRoutineSignalType=UINT8, DcmDspRoutineSignalPos=0
            DcmDspRoutineAuthorization: DcmDspRoutineSessionRef=DcmDspSession/Extended, DcmDspRoutineSessionRef=EOLDiagnosticSession, DcmDspRoutineSecurityLevelRef=Level_EOL_Unlocked
          RoutineInfo_CheckEthernetIPPINGFunction
            DcmDspRoutineRequestResOut
              Out_0xF003 (DcmDspRoutineRequestResOutSignal): DcmDspRoutineSignalLength=8, DcmDspRoutineSignalType=UINT8, DcmDspRoutineSignalPos=0
            DcmDspRoutineAuthorization: DcmDspRoutineSessionRef=EOLDiagnosticSession, DcmDspRoutineSecurityLevelRef=Level_EOL_Unlocked
            DcmDspStartRoutineIn
              In_Start (DcmDspStartRoutineInSignal): DcmDspRoutineSignalLength=32, DcmDspRoutineSignalType=UINT32, DcmDspRoutineSignalEndianness=BIG_ENDIAN, DcmDspRoutineSignalPos=0
          RoutineInfo_IVITouchTest
            DcmDspRoutineRequestResOut
              Out_0xF004 (DcmDspRoutineRequestResOutSignal): DcmDspRoutineSignalLength=160, DcmDspRoutineSignalType=UINT8, DcmDspRoutineSignalEndianness=opaque, DcmDspRoutineSignalPos=0
            DcmDspStartRoutineOut
              Out_0xF004 (DcmDspStartRoutineOutSignal): DcmDspRoutineSignalLength=8, DcmDspRoutineSignalType=UINT8, DcmDspRoutineSignalPos=0
            DcmDspRoutineAuthorization: DcmDspRoutineSessionRef=DcmDspSession/Extended, DcmDspRoutineSessionRef=EOLDiagnosticSession, DcmDspRoutineSecurityLevelRef=Level_EOL_Unlocked
        AMPCalibration (DcmDspRoutine):
          DcmDspRequestResultsRoutineSupported = true
          DcmDspStopRoutineSupported = false
          DcmDspRoutineIdentifier = 1027
          DcmDspRoutineFixedLength = true
          DcmDspRoutineUsePort = true
          DcmDspRoutineUsed = true
          DcmDspRoutineInfoRef = RoutineInfo_AMPCalibration
        RoutineInfo_AMPCalibration (DcmDspRoutineInfo)
          DcmDspRoutineRequestResOut
            Out_AmpValue (DcmDspRoutineRequestResOutSignal): DcmDspRoutineSignalLength=80, DcmDspRoutineSignalType=UINT8, DcmDspRoutineSignalEndianness=opaque, DcmDspRoutineSignalPos=0
          DcmDspRoutineAuthorization: DcmDspRoutineSessionRef=EOLDiagnosticSession, DcmDspRoutineSecurityLevelRef=Level_EOL_Unlocked
          DcmDspStartRoutineOut
            Out_RoutineStatusRecord (DcmDspStartRoutineOutSignal): DcmDspRoutineSignalLength=8, DcmDspRoutineSignalType=UINT8, DcmDspRoutineSignalPos=0
        RoutineInfo_SystemRecovery (DcmDspRoutineInfo)
          DcmDspRoutineAuthorization:
            DcmDspRoutineSessionRef = DcmDspSession/Extended
            DcmDspRoutineSessionRef = EOLDiagnosticSession
            DcmDspRoutineSecurityLevelRef = UnlockedL1
            DcmDspRoutineSecurityLevelRef = Level_EOL_Unlocked
          DcmDspStartRoutineOut
            Out_SystemRcvrySts (DcmDspStartRoutineOutSignal): DcmDspRoutineSignalLength=8, DcmDspRoutineSignalPos=0, DcmDspRoutineSignalType=UINT8
        SystemRecovery (DcmDspRoutine):
          DcmDspRequestResultsRoutineSupported = false
          DcmDspStopRoutineSupported = false
          DcmDspRoutineIdentifier = 64800
          DcmDspRoutineFixedLength = true
          DcmDspRoutineUsePort = true
          DcmDspRoutineUsed = true
          DcmDspRoutineInfoRef = RoutineInfo_SystemRecovery
        DcmDspMemory: DcmDspUseMemoryId=false
          DcmDspMemoryIdInfo
            DcmDspReadMemoryRangeInfoRAM_1 (DcmDspReadMemoryRangeInfo): DcmDspReadMemoryRangeHigh=4273995775, DcmDspReadMemoryRangeLow=4273733632
            DcmDspReadMemoryRangeInfoRAM_2 (DcmDspReadMemoryRangeInfo): DcmDspReadMemoryRangeHigh=4277207039, DcmDspReadMemoryRangeLow=4277141504
          DcmDspMemoryAddressAndLengthFormatIdentifier: DcmDspMemorySupportedAddressAndLengthFormatIdentifier=36, DcmDspMemorySupportedAddressAndLengthFormatIdentifier=20
        4 x DcmDspRoutineInfo:
          RoutineInfo_ConfigureFrontCamerParameters
            DcmDspRoutineAuthorization: DcmDspRoutineSecurityLevelRef=UnlockedL1, DcmDspRoutineSessionRef=DcmDspSession/Extended
            DcmDspRoutineRequestResOut
              DcmDspRoutineRequestResOutSignal: DcmDspRoutineSignalLength=8, DcmDspRoutineSignalPos=0, DcmDspRoutineSignalType=UINT8
          RoutineInfo_ConfigureRightCamerParameters
            DcmDspRoutineAuthorization: DcmDspRoutineSecurityLevelRef=UnlockedL1, DcmDspRoutineSessionRef=DcmDspSession/Extended
            DcmDspRoutineRequestResOut
              DcmDspRoutineRequestResOutSignal: DcmDspRoutineSignalLength=8, DcmDspRoutineSignalPos=0, DcmDspRoutineSignalType=UINT8
          RoutineInfo_ConfigureLeftCamerParameters
            DcmDspRoutineAuthorization: DcmDspRoutineSecurityLevelRef=UnlockedL1, DcmDspRoutineSessionRef=DcmDspSession/Extended
            DcmDspRoutineRequestResOut
              DcmDspRoutineRequestResOutSignal: DcmDspRoutineSignalLength=8, DcmDspRoutineSignalPos=0, DcmDspRoutineSignalType=UINT8
          RoutineInfo_ConfigureRearCamerParameters
            DcmDspRoutineAuthorization: DcmDspRoutineSecurityLevelRef=UnlockedL1, DcmDspRoutineSessionRef=DcmDspSession/Extended
            DcmDspRoutineRequestResOut
              DcmDspRoutineRequestResOutSignal: DcmDspRoutineSignalLength=8, DcmDspRoutineSignalPos=0, DcmDspRoutineSignalType=UINT8
        4 x DcmDspRoutine, all with DcmDspRequestResultsRoutineSupported=true, DcmDspRoutineFixedLength=false, DcmDspRoutineUsePort=true, DcmDspRoutineUsed=true, DcmDspStopRoutineSupported=false:
          ConfigureFrontCamerParameters: DcmDspRoutineIdentifier=61472, DcmDspRoutineInfoRef=RoutineInfo_ConfigureFrontCamerParameters
          ConfigureRearCamerParameters: DcmDspRoutineIdentifier=61473, DcmDspRoutineInfoRef=RoutineInfo_ConfigureRearCamerParameters
          ConfigureRightCamerParameters: DcmDspRoutineIdentifier=61475, DcmDspRoutineInfoRef=RoutineInfo_ConfigureRightCamerParameters
          ConfigureLeftCamerParameters: DcmDspRoutineIdentifier=61474, DcmDspRoutineInfoRef=RoutineInfo_ConfigureLeftCamerParameters
        DidRangeEol1 (DcmDspDidRange):
          DcmDspDidRangeHasGaps = true
          DcmDspDidRangeIdentifierLowerLimit = 45056
          DcmDspDidRangeIdentifierUpperLimit = 49151
          DcmDspDidRangeMaxDataLength = 4000
          DcmDspDidRangeUsePort = true
          DcmDspDidRangeInfoRef = DcmDsp_RangeEol1
        3 x DcmDspDidInfo:
          DcmDsp_RangeEol1
            DcmDspDidAccess
              DcmDspDidRead: DcmDspDidReadSessionRef=DcmDspSession/Default, DcmDspDidReadSessionRef=DcmDspSession/Extended, DcmDspDidReadSessionRef=EOLDiagnosticSession
              DcmDspDidWrite: DcmDspDidWriteSessionRef=DcmDspSession/Extended, DcmDspDidWriteSessionRef=EOLDiagnosticSession
          DcmDsp_RangeDiag1
            DcmDspDidAccess
              DcmDspDidRead: DcmDspDidReadSessionRef=DcmDspSession/Default, DcmDspDidReadSessionRef=DcmDspSession/Extended, DcmDspDidReadSessionRef=EOLDiagnosticSession
              DcmDspDidWrite: DcmDspDidWriteSessionRef=DcmDspSession/Extended, DcmDspDidWriteSessionRef=EOLDiagnosticSession
          DcmDsp_RangeDiag2
            DcmDspDidAccess
              DcmDspDidRead: DcmDspDidReadSessionRef=DcmDspSession/Default, DcmDspDidReadSessionRef=DcmDspSession/Extended, DcmDspDidReadSessionRef=EOLDiagnosticSession
              DcmDspDidWrite: DcmDspDidWriteSessionRef=DcmDspSession/Extended, DcmDspDidWriteSessionRef=EOLDiagnosticSession
        DidRangeDiag1 (DcmDspDidRange):
          DcmDspDidRangeHasGaps = true
          DcmDspDidRangeIdentifierLowerLimit = 61715
          DcmDspDidRangeIdentifierUpperLimit = 61951
          DcmDspDidRangeMaxDataLength = 4000
          DcmDspDidRangeUsePort = true
          DcmDspDidRangeInfoRef = DcmDsp_RangeDiag1
        DidRangeDiag2 (DcmDspDidRange):
          DcmDspDidRangeHasGaps = true
          DcmDspDidRangeIdentifierLowerLimit = 62464
          DcmDspDidRangeIdentifierUpperLimit = 65535
          DcmDspDidRangeMaxDataLength = 300
          DcmDspDidRangeUsePort = true
          DcmDspDidRangeInfoRef = DcmDsp_RangeDiag2
        RoutineInfo_RequestCertificateStatus (DcmDspRoutineInfo)
          DcmDspRoutineAuthorization: DcmDspRoutineSecurityLevelRef=UnlockedL1, DcmDspRoutineSessionRef=DcmDspSession/Extended
          DcmDspRoutineRequestResOut
            DcmDspRoutineRequestResOutSignal: DcmDspRoutineSignalLength=8, DcmDspRoutineSignalPos=0, DcmDspRoutineSignalType=UINT8
        RequestCertificateStatus (DcmDspRoutine):
          DcmDspRequestResultsRoutineSupported = true
          DcmDspRoutineFixedLength = false
          DcmDspRoutineIdentifier = 52737
          DcmDspRoutineUsePort = true
          DcmDspRoutineUsed = true
          DcmDspStopRoutineSupported = false
          DcmDspRoutineInfoRef = RoutineInfo_RequestCertificateStatus
      DcmPageBufferCfg: DcmPagedBufferEnabled=true
      DcmProcessingConditions
        DcmModeCondition: DcmConditionType=DCM_EQUALS, DcmSwcModeRef=COMPOSITIONTYPE.DCM_Server.PiDcmUserCondition.Mode.DCM_USER_CONDITION_OK
        DcmModeRule: DcmLogicalOperator=DCM_OR, DcmModeRuleNrcValue=34, DcmArgumentRef=DcmModeCondition
