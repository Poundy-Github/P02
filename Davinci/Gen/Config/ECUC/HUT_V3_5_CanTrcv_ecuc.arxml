AUTOSAR XML (schema 00046)
package /ActiveEcuC
  module config CanTrcv: implementation-config-variant=VARIANT-PRE-COMPILE, module-description=CanTrcv_Impl
    CanTrcvConfigSet
      3 x CanTrcvChannel, all with CanTrcvInitState=CANTRCV_OP_MODE_NORMAL, CanTrcvChannelUsed=true, CanTrcvControlsPowerSupply=false, CanTrcvHwPnSupport=false, CanTrcvMaxBaudrate=1000:
        CanTrcvChannel_CAN0: CanTrcvChannelId=0, CanTrcvWakeupByBusUsed=false
          CanTrcvAccess
            CanTrcvDioAccess
              PinSTB (CanTrcvDioChannelAccess): CanTrcvHardwareInterfaceName=PinSTB, CanTrcvDioSymNameRef=VIP_CAN0_STB
              PinRXD (CanTrcvDioChannelAccess): CanTrcvHardwareInterfaceName=PinRXD, CanTrcvDioSymNameRef=VIP_CAN0_RXD
        CanTrcvChannel_CAN1: CanTrcvChannelId=1, CanTrcvWakeupByBusUsed=false
          CanTrcvAccess
            CanTrcvDioAccess
              PinSTB (CanTrcvDioChannelAccess): CanTrcvHardwareInterfaceName=PinSTB, CanTrcvDioSymNameRef=VIP_CAN1_STB
              PinRXD (CanTrcvDioChannelAccess): CanTrcvHardwareInterfaceName=PinRXD, CanTrcvDioSymNameRef=VIP_CAN1_RXD
        CanTrcvChannel_CAN3: CanTrcvChannelId=2, CanTrcvWakeupByBusUsed=true, CanTrcvWakeupSourceRef=CN_B30_for_SC_CAN_V3_2_c0d6c67b
          CanTrcvAccess
            CanTrcvDioAccess
              PinSTB (CanTrcvDioChannelAccess): CanTrcvHardwareInterfaceName=PinSTB, CanTrcvDioSymNameRef=VIP_CAN3_STB
              PinRXD (CanTrcvDioChannelAccess): CanTrcvHardwareInterfaceName=PinRXD, CanTrcvDioSymNameRef=VIP_CAN3_RXD
    CanTrcvGeneral:
      CanTrcvDevErrorDetect = true
      CanTrcvGetVersionInfo = false
      CanTrcvWakeUpSupport = CANTRCV_WAKEUP_BY_POLLING
      CanTrcvIndex = 0
      CanTrcvMainFunctionPeriod = 0.01
      CanTrcvSafeBswChecks = false
