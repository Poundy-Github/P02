AUTOSAR XML (schema 00046)
package /ActiveEcuC
  module config Icu: implementation-config-variant=VARIANT-POST-BUILD, module-description=Icu_Impl
    IcuGeneral:
      IcuDevErrorDetect = false
      IcuIndex = 0
      IcuReportWakeupSource = true
      IcuCriticalSectionProtection = true
      IcuClearPendingInterrupts = true
      IcuVersionCheckExternalModules = false
      IcuDeviceName = R7F701651
      IcuAlreadyInitDetCheck = true
      IcuWakeUpFactorClearIsr = false
      IcuAlreadyEnableDisableDetCheck = true
      IcuNotifyWakeupInterrupt = true
      IcuFCLARamMirror = DISABLE
      IcuFCLAWriteVerify = WV_DISABLE
      IcuTAUDBRamMirror = DISABLE
      IcuTAUDBWriteVerify = WV_DISABLE
      IcuTAUJRamMirror = DISABLE
      IcuTAUJWriteVerify = WV_DISABLE
      IcuUseWriteVerifyErrorInterface = false
      IcuWUFWriteVerify = WV_DISABLE
      IcuWriteVerifyErrorInterface = NULL
      IcuBusyOperationDETCheck = false
    IcuOptionalApis:
      IcuDeInitApi = true
      IcuDisableWakeupApi = true
      IcuEdgeCountApi = true
      IcuEdgeDetectApi = true
      IcuEnableWakeupApi = true
      IcuGetDutyCycleValuesApi = true
      IcuGetInputStateApi = true
      IcuGetTimeElapsedApi = true
      IcuGetVersionInfoApi = true
      IcuSetModeApi = true
      IcuSignalMeasurementApi = true
      IcuTimestampApi = true
      IcuWakeupFunctionalityApi = true
      IcuGetInputLevelApi = true
      IcuGetCountValueApi = true
      IcuSyncSupportApi = false
    IcuDemEventParameterRefs
    IcuConfigSet: IcuMaxChannel=15
      IcuTaUnitTAUD0 (IcuTaUnit):
        IcuPrescalerCk0 = PCLK_DIVBY_2_POWOF_06
        IcuPrescalerCk1 = PCLK_DIVBY_2_POWOF_02
        IcuPrescalerCk2 = PCLK_DIVBY_2_POWOF_15
        IcuPrescalerCk3BaudRate = 20
        IcuPrescalerCk3Pre = PCLK_DIVBY_2_POWOF_15
        IcuTaUnitSelection = TAUD0
      15 x IcuChannel, all with IcuMeasurementMode=ICU_MODE_SIGNAL_EDGE_DETECT, IcuSyncStartReq=false, IcuUsePreviousInput=false:
        SOC_VIP_CSIH1_CS: IcuChannelId=0, IcuDefaultStartEdge=ICU_BOTH_EDGES, IcuWakeupCapability=false, IcuChannelClkSrc=1, IcuChannelInputSelection=TAUD0I13, IcuDisableEcumWakeupNotification=true, IcuPortPinUsed=PORT10_06
          IcuSignalEdgeDetection: IcuSignalNotification=IPC_IsrCsDetect
        SOC_VIP_CSIH2_CS: IcuChannelId=1, IcuDefaultStartEdge=ICU_BOTH_EDGES, IcuWakeupCapability=false, IcuChannelClkSrc=1, IcuChannelInputSelection=TAUD0I15, IcuDisableEcumWakeupNotification=true, IcuPortPinUsed=PORT10_07
          IcuSignalEdgeDetection: IcuSignalNotification=IPC_IsrCsDetect_Standby
        VIP_CAN0_RXD: IcuChannelId=2, IcuDefaultStartEdge=ICU_RISING_EDGE, IcuWakeupCapability=false, IcuChannelClkSrc=0, IcuChannelInputSelection=INTP0, IcuDisableEcumWakeupNotification=true, IcuPortPinUsed=PORT00_01
        VIP_RLIN32_RXD: IcuChannelId=8, IcuDefaultStartEdge=ICU_RISING_EDGE, IcuWakeupCapability=false, IcuChannelClkSrc=0, IcuChannelInputSelection=INTP12, IcuDisableEcumWakeupNotification=true, IcuPortPinUsed=PORT00_13
        VIP_CAN1_RXD: IcuChannelId=3, IcuDefaultStartEdge=ICU_RISING_EDGE, IcuWakeupCapability=false, IcuChannelClkSrc=0, IcuChannelInputSelection=INTP1, IcuDisableEcumWakeupNotification=true, IcuPortPinUsed=PORT00_02
        VIP_RLIN31_RXD: IcuChannelId=7, IcuDefaultStartEdge=ICU_RISING_EDGE, IcuWakeupCapability=false, IcuChannelClkSrc=0, IcuChannelInputSelection=INTP11, IcuDisableEcumWakeupNotification=true, IcuPortPinUsed=PORT00_04
        VIP_CAN3_RXD: IcuChannelId=4, IcuDefaultStartEdge=ICU_FALLING_EDGE, IcuWakeupCapability=true, IcuChannelClkSrc=0, IcuChannelInputSelection=INTP3, IcuDisableEcumWakeupNotification=false, IcuPortPinUsed=PORT00_07
          IcuWakeup: IcuChannelWakeupInfo=CN_B30_for_SC_CAN_V3_2_c0d6c67b
          IcuSignalEdgeDetection: IcuSignalNotification=Icu_EOL_CAN3Rx_WakeupNotifactionFunc
        VIP_LVI_IDL: IcuChannelId=12, IcuDefaultStartEdge=ICU_BOTH_EDGES, IcuWakeupCapability=false, IcuChannelClkSrc=0, IcuChannelInputSelection=INTP21, IcuDisableEcumWakeupNotification=true, IcuPortPinUsed=PORT01_09
          IcuSignalEdgeDetection: IcuSignalNotification=POWER_IsrLVI_IDL
        VIP_SI_IDH: IcuChannelId=9, IcuDefaultStartEdge=ICU_RISING_EDGE, IcuWakeupCapability=false, IcuChannelClkSrc=0, IcuChannelInputSelection=INTP13, IcuDisableEcumWakeupNotification=true, IcuPortPinUsed=PORT01_00
        SOC_VIP_CSIH1_REQ2: IcuChannelId=5, IcuDefaultStartEdge=ICU_RISING_EDGE, IcuWakeupCapability=false, IcuChannelClkSrc=0, IcuChannelInputSelection=INTP4, IcuDisableEcumWakeupNotification=true, IcuPortPinUsed=PORT08_00
          IcuSignalEdgeDetection: IcuSignalNotification=IPC_IsrSocReqDetect
        SOC_VIP_CSIH2_REQ2: IcuChannelId=6, IcuDefaultStartEdge=ICU_RISING_EDGE, IcuWakeupCapability=false, IcuChannelClkSrc=0, IcuChannelInputSelection=INTP5, IcuDisableEcumWakeupNotification=true, IcuPortPinUsed=PORT08_01
          IcuSignalEdgeDetection: IcuSignalNotification=IPC_IsrSocReqDetect2
        VIP_RLIN31_INH: IcuChannelId=10, IcuDefaultStartEdge=ICU_FALLING_EDGE, IcuWakeupCapability=false, IcuChannelClkSrc=0, IcuChannelInputSelection=INTP18, IcuDisableEcumWakeupNotification=true, IcuPortPinUsed=PORT01_01
        VIP_RLIN32_INH: IcuChannelId=11, IcuDefaultStartEdge=ICU_FALLING_EDGE, IcuWakeupCapability=false, IcuChannelClkSrc=0, IcuChannelInputSelection=INTP19, IcuDisableEcumWakeupNotification=true, IcuPortPinUsed=PORT01_03
        VIP_8532_DIAG3: IcuChannelId=13, IcuDefaultStartEdge=ICU_BOTH_EDGES, IcuWakeupCapability=false, IcuChannelClkSrc=0, IcuChannelInputSelection=INTP9, IcuDisableEcumWakeupNotification=true, IcuPortPinUsed=PORT08_05
          IcuSignalEdgeDetection: IcuSignalNotification=AMP_IsrVIP_8532_DIAG3
        VIP_AMP8532_DIAG3: IcuChannelId=14, IcuDefaultStartEdge=ICU_BOTH_EDGES, IcuWakeupCapability=false, IcuChannelClkSrc=0, IcuChannelInputSelection=INTP20, IcuDisableEcumWakeupNotification=true, IcuPortPinUsed=PORT11_01
          IcuSignalEdgeDetection: IcuSignalNotification=AMP_IsrVIP_AMP8532_DIAG3
