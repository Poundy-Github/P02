AUTOSAR XML (schema 00046)
package /ActiveEcuC
  module config SecOC: implementation-config-variant=VARIANT-PRE-COMPILE, module-description=SecOC_Impl
    SecOCGeneral:
      SecOCDevErrorDetect = true
      SecOCEnableForcedPassOverride = true
      SecOcIgnoreVerificationResult = false
      SecOCMainFunctionPeriodRx = 0.002
      SecOCMainFunctionPeriodTx = 0.002
      SecOCMaxAlignScalarType = 
      SecOCQueryFreshnessValue = CFUNC
      SecOCVersionInfoApi = true
      SecOCMaxMessageLinkerSizeOfRxPdus = 0
      SecOCSafeBswChecks = false
      SecOCPropagateOnlyFinalVerificationStatus = false
      SecOCEnableDevelopmentMode = true
      SecOCUseGetRxFreshness = true
      SecOCUseGetRxFreshnessAuthData = false
      SecOCUseGetTxFreshness = false
      SecOCUseGetTxFreshnessTruncData = true
      SecOCUseSPduTxConfirmation = true
      SecOCEnableCustomAuthenticationAPI = false
      SecOCCanFdPadding = false
      SecOCRetryFailedTransmitRequest = false
      SecOCUseMSBAlignedTruncatedFreshnessValueInFvM = false
      SecOCVerificationStatusCallout = FvM_VerificationStatusCallout
      SecOCVerificationStatusCalloutWithSecuredPdu = SecOc_Verification_Status_Callout_With_Secured_Pdu
      SecOCDefaultAuthenticationInformationPattern = 255
    SecOCGeneration:
      SecOCOutOfBoundsWriteProtectionStrategy = NONE
      SecOCOutOfBoundsWriteSanitizer = false
      SecOCOutOfBoundsReadSanitizer = false
      SecOCShortSymbols = false
      SecOCInterfacesForDeactivatedData = false
      SecOCReferringKeysInComments = false
    3 x SecOCRxPduProcessing, all with SecOCAuthInfoTxLength=48, SecOCFreshnessValueLength=64, SecOCFreshnessValueTxLength=16, SecOCAuthenticationBuildAttempts=3, SecOCAuthenticationVerifyAttempts=3, SecOCReceptionOverflowStrategy=REJECT, SecOCUseAuthDataFreshness=false, SecOCVerificationStatusPropagationMode=BOTH, SecOCVerificationStatusWithSecuredPduPropagationMode=BOTH, SecOCImmediateProcessingOfCsmCallback=false, SecOCPduProcessing=DEFERRED:
      TPMS2_Sc_oB30_for_SC_CAN_V3_2_c8a12d62_Rx: SecOCDataId=917, SecOCFreshnessValueId=11, SecOCRxAuthServiceConfigRef=CsmJob_CMAC_Verify_TPMS2
        SecOCRxSecuredPduLayer
          TPMS2_Sc_oB30_for_SC_CAN_V3_2_c8a12d62_Rx (SecOCRxSecuredPdu): SecOCSecuredRxPduVerification=true, SecOCRxSecuredLayerPduId=11, SecOCRxSecuredLayerPduRef=TPMS2_Sc_oB30_for_SC_CAN_V3_2_c8a12d62_Rx
        TPMS2_oB30_for_SC_CAN_V3_2_fc97042f_Rx (SecOCRxAuthenticPduLayer): SecOCPduType=SECOC_IFPDU, SecOCRxAuthenticLayerPduRef=TPMS2_oB30_for_SC_CAN_V3_2_fc97042f_Rx
      ABM1_Sc_oB30_for_SC_CAN_V3_2_a346d8c1_Rx: SecOCDataId=849, SecOCFreshnessValueId=0, SecOCRxAuthServiceConfigRef=CsmJob_CMAC_Verify_ABM1
        ABM1_oB30_for_SC_CAN_V3_2_d004cc2e_Rx (SecOCRxAuthenticPduLayer): SecOCPduType=SECOC_IFPDU, SecOCRxAuthenticLayerPduRef=ABM1_oB30_for_SC_CAN_V3_2_d004cc2e_Rx
        SecOCRxSecuredPduLayer
          ABM1_Sc_oB30_for_SC_CAN_V3_2_a346d8c1_Rx (SecOCRxSecuredPdu): SecOCSecuredRxPduVerification=true, SecOCRxSecuredLayerPduId=0, SecOCRxSecuredLayerPduRef=ABM1_Sc_oB30_for_SC_CAN_V3_2_a346d8c1_Rx
      BCM1_Sc_oB30_for_SC_CAN_V3_2_cf14c4a7_Rx: SecOCDataId=793, SecOCFreshnessValueId=4, SecOCRxAuthServiceConfigRef=CsmJob_CMAC_Verify_BCM1
        BCM1_oB30_for_SC_CAN_V3_2_64cc1f5a_Rx (SecOCRxAuthenticPduLayer): SecOCPduType=SECOC_IFPDU, SecOCRxAuthenticLayerPduRef=BCM1_oB30_for_SC_CAN_V3_2_64cc1f5a_Rx
        SecOCRxSecuredPduLayer
          BCM1_Sc_oB30_for_SC_CAN_V3_2_cf14c4a7_Rx (SecOCRxSecuredPdu): SecOCSecuredRxPduVerification=true, SecOCRxSecuredLayerPduId=4, SecOCRxSecuredLayerPduRef=BCM1_Sc_oB30_for_SC_CAN_V3_2_cf14c4a7_Rx
    HUT15_Sc_oB30_for_SC_CAN_V3_2_d2d608b6_Tx (SecOCTxPduProcessing):
      SecOCAuthInfoTxLength = 48
      SecOCDataId = 494
      SecOCFreshnessValueLength = 64
      SecOCFreshnessValueTxLength = 16
      SecOCAuthenticationBuildAttempts = 3
      SecOCFreshnessValueId = 0
      SecOCProvideTxTruncatedFreshnessValue = true
      SecOCUseTxConfirmation = true
      SecOCAddCANFDContainerPduPadding = false
      SecOCImmediateProcessingOfCsmCallback = false
      SecOCPduProcessing = DEFERRED
      SecOCTxAuthServiceConfigRef = CsmJob_CMAC_Generate_HUT15
      HUT15_oB30_for_SC_CAN_V3_2_d46de065_Tx (SecOCTxAuthenticPduLayer): SecOCPduType=SECOC_IFPDU, SecOCTxAuthenticLayerPduId=0, SecOCTxAuthenticLayerPduRef=HUT15_oB30_for_SC_CAN_V3_2_d46de065_Tx
      SecOCTxSecuredPduLayer
        HUT15_Sc_oB30_for_SC_CAN_V3_2_d2d608b6_Tx (SecOCTxSecuredPdu): SecOCTxSecuredLayerPduId=0, SecOCPduType=SECOC_IFPDU, SecOCTxSecuredLayerPduRef=HUT15_Sc_oB30_for_SC_CAN_V3_2_d2d608b6_Tx
    HUT_FD1_Sc_oB30_for_SC_CAN_V3_2_e0e5cc6a_Tx (SecOCTxPduProcessing):
      SecOCAuthInfoTxLength = 48
      SecOCDataId = 707
      SecOCFreshnessValueLength = 64
      SecOCFreshnessValueTxLength = 16
      SecOCAuthenticationBuildAttempts = 3
      SecOCFreshnessValueId = 1
      SecOCProvideTxTruncatedFreshnessValue = true
      SecOCUseTxConfirmation = true
      SecOCAddCANFDContainerPduPadding = false
      SecOCImmediateProcessingOfCsmCallback = false
      SecOCPduProcessing = DEFERRED
      SecOCTxAuthServiceConfigRef = CsmJob_CMAC_Generate_HUT_FD1
      HUT_FD1_oB30_for_SC_CAN_V3_2_612942c0_Tx (SecOCTxAuthenticPduLayer): SecOCPduType=SECOC_IFPDU, SecOCTxAuthenticLayerPduId=1, SecOCTxAuthenticLayerPduRef=HUT_FD1_oB30_for_SC_CAN_V3_2_612942c0_Tx
      SecOCTxSecuredPduLayer
        HUT_FD1_Sc_oB30_for_SC_CAN_V3_2_e0e5cc6a_Tx (SecOCTxSecuredPdu): SecOCTxSecuredLayerPduId=1, SecOCPduType=SECOC_IFPDU, SecOCTxSecuredLayerPduRef=HUT_FD1_Sc_oB30_for_SC_CAN_V3_2_e0e5cc6a_Tx
    6 x SecOCRxPduProcessing, all with SecOCAuthInfoTxLength=48, SecOCFreshnessValueLength=64, SecOCFreshnessValueTxLength=16, SecOCAuthenticationBuildAttempts=3, SecOCAuthenticationVerifyAttempts=3, SecOCReceptionOverflowStrategy=REJECT, SecOCUseAuthDataFreshness=false, SecOCVerificationStatusPropagationMode=BOTH, SecOCVerificationStatusWithSecuredPduPropagationMode=BOTH, SecOCImmediateProcessingOfCsmCallback=false, SecOCPduProcessing=DEFERRED:
      IFC_FD2_Sc_oB30_for_SC_CAN_V3_2_9b0c0f4a_Rx: SecOCDataId=573, SecOCFreshnessValueId=8, SecOCRxAuthServiceConfigRef=CsmJob_CMAC_Verify_IFC_FD2
        IFC_FD2_oB30_for_SC_CAN_V3_2_c695b455_Rx (SecOCRxAuthenticPduLayer): SecOCPduType=SECOC_IFPDU, SecOCRxAuthenticLayerPduRef=IFC_FD2_oB30_for_SC_CAN_V3_2_c695b455_Rx
        SecOCRxSecuredPduLayer
          IFC_FD2_Sc_oB30_for_SC_CAN_V3_2_9b0c0f4a_Rx (SecOCRxSecuredPdu): SecOCSecuredRxPduVerification=true, SecOCRxSecuredLayerPduId=8, SecOCRxSecuredLayerPduRef=IFC_FD2_Sc_oB30_for_SC_CAN_V3_2_9b0c0f4a_Rx
      AMP2_Sc_oB30_for_SC_CAN_V3_2_b40eb813_Rx: SecOCDataId=995, SecOCFreshnessValueId=3, SecOCRxAuthServiceConfigRef=CsmJob_CMAC_Verify_AMP2
        AMP2_oB30_for_SC_CAN_V3_2_908de48a_Rx (SecOCRxAuthenticPduLayer): SecOCPduType=SECOC_IFPDU, SecOCRxAuthenticLayerPduRef=AMP2_oB30_for_SC_CAN_V3_2_908de48a_Rx
        SecOCRxSecuredPduLayer
          AMP2_Sc_oB30_for_SC_CAN_V3_2_b40eb813_Rx (SecOCRxSecuredPdu): SecOCSecuredRxPduVerification=true, SecOCRxSecuredLayerPduId=3, SecOCRxSecuredLayerPduRef=AMP2_Sc_oB30_for_SC_CAN_V3_2_b40eb813_Rx
      TPMS1_Sc_oB30_for_SC_CAN_V3_2_fd4c9b31_Rx: SecOCDataId=833, SecOCFreshnessValueId=10, SecOCRxAuthServiceConfigRef=CsmJob_CMAC_Verify_TPMS1
        TPMS1_oB30_for_SC_CAN_V3_2_c5efa96f_Rx (SecOCRxAuthenticPduLayer): SecOCPduType=SECOC_IFPDU, SecOCRxAuthenticLayerPduRef=TPMS1_oB30_for_SC_CAN_V3_2_c5efa96f_Rx
        SecOCRxSecuredPduLayer
          TPMS1_Sc_oB30_for_SC_CAN_V3_2_fd4c9b31_Rx (SecOCRxSecuredPdu): SecOCSecuredRxPduVerification=true, SecOCRxSecuredLayerPduId=10, SecOCRxSecuredLayerPduRef=TPMS1_Sc_oB30_for_SC_CAN_V3_2_fd4c9b31_Rx
      ACC_FD2_Sc_oB30_for_SC_CAN_V3_2_21d026ea_Rx: SecOCDataId=683, SecOCFreshnessValueId=1, SecOCRxAuthServiceConfigRef=CsmJob_CMAC_Verify_ACC_FD2
        ACC_FD2_oB30_for_SC_CAN_V3_2_c4f72cb9_Rx (SecOCRxAuthenticPduLayer): SecOCPduType=SECOC_IFPDU, SecOCRxAuthenticLayerPduRef=ACC_FD2_oB30_for_SC_CAN_V3_2_c4f72cb9_Rx
        SecOCRxSecuredPduLayer
          ACC_FD2_Sc_oB30_for_SC_CAN_V3_2_21d026ea_Rx (SecOCRxSecuredPdu): SecOCSecuredRxPduVerification=true, SecOCRxSecuredLayerPduId=1, SecOCRxSecuredLayerPduRef=ACC_FD2_Sc_oB30_for_SC_CAN_V3_2_21d026ea_Rx
      AEB_FD2_Sc_oB30_for_SC_CAN_V3_2_cb95b5fe_Rx: SecOCDataId=551, SecOCFreshnessValueId=2, SecOCRxAuthServiceConfigRef=CsmJob_CMAC_Verify_AEB_FD2
        AEB_FD2_oB30_for_SC_CAN_V3_2_9fb3d7e9_Rx (SecOCRxAuthenticPduLayer): SecOCPduType=SECOC_IFPDU, SecOCRxAuthenticLayerPduRef=AEB_FD2_oB30_for_SC_CAN_V3_2_9fb3d7e9_Rx
        SecOCRxSecuredPduLayer
          AEB_FD2_Sc_oB30_for_SC_CAN_V3_2_cb95b5fe_Rx (SecOCRxSecuredPdu): SecOCSecuredRxPduVerification=true, SecOCRxSecuredLayerPduId=2, SecOCRxSecuredLayerPduRef=AEB_FD2_Sc_oB30_for_SC_CAN_V3_2_cb95b5fe_Rx
      BCM3_Sc_oB30_for_SC_CAN_V3_2_5f72e2fa_Rx: SecOCDataId=837, SecOCFreshnessValueId=5, SecOCRxAuthServiceConfigRef=CsmJob_CMAC_Verify_BCM3
        SecOCRxSecuredPduLayer
          BCM3_Sc_oB30_for_SC_CAN_V3_2_5f72e2fa_Rx (SecOCRxSecuredPdu): SecOCSecuredRxPduVerification=true, SecOCRxSecuredLayerPduId=5, SecOCRxSecuredLayerPduRef=BCM3_Sc_oB30_for_SC_CAN_V3_2_5f72e2fa_Rx
        BCM3_oB30_for_SC_CAN_V3_2_4a9cd6da_Rx (SecOCRxAuthenticPduLayer): SecOCPduType=SECOC_IFPDU, SecOCRxAuthenticLayerPduRef=BCM3_oB30_for_SC_CAN_V3_2_4a9cd6da_Rx
    IP2_Sc_oB30_for_SC_CAN_V3_2_bf1dcb66_Tx (SecOCTxPduProcessing):
      SecOCAuthInfoTxLength = 48
      SecOCDataId = 639
      SecOCFreshnessValueLength = 64
      SecOCFreshnessValueTxLength = 16
      SecOCAuthenticationBuildAttempts = 1
      SecOCFreshnessValueId = 2
      SecOCProvideTxTruncatedFreshnessValue = true
      SecOCUseTxConfirmation = true
      SecOCAddCANFDContainerPduPadding = false
      SecOCImmediateProcessingOfCsmCallback = false
      SecOCPduProcessing = DEFERRED
      SecOCTxAuthServiceConfigRef = CsmJob_CMAC_Generate_HUT_IP2
      IP2_oB30_for_SC_CAN_V3_2_24e97840_Tx (SecOCTxAuthenticPduLayer): SecOCPduType=SECOC_IFPDU, SecOCTxAuthenticLayerPduId=2, SecOCTxAuthenticLayerPduRef=IP2_oB30_for_SC_CAN_V3_2_24e97840_Tx
      SecOCTxSecuredPduLayer
        IP2_Sc_oB30_for_SC_CAN_V3_2_bf1dcb66_Tx (SecOCTxSecuredPdu): SecOCTxSecuredLayerPduId=2, SecOCPduType=SECOC_IFPDU, SecOCTxSecuredLayerPduRef=IP2_Sc_oB30_for_SC_CAN_V3_2_bf1dcb66_Tx
    5 x SecOCRxPduProcessing, all with SecOCReceptionOverflowStrategy=REJECT, SecOCUseAuthDataFreshness=false, SecOCVerificationStatusPropagationMode=BOTH, SecOCVerificationStatusWithSecuredPduPropagationMode=BOTH, SecOCImmediateProcessingOfCsmCallback=false, SecOCPduProcessing=DEFERRED:
      GW_Sync_Req_Sc_oB30_for_SC_CAN_V3_2_922ee695_Rx: SecOCAuthInfoTxLength=88, SecOCDataId=1121, SecOCFreshnessValueLength=40, SecOCFreshnessValueTxLength=40, SecOCAuthenticationBuildAttempts=10, SecOCAuthenticationVerifyAttempts=10, SecOCFreshnessValueId=7, SecOCRxAuthServiceConfigRef=CsmJob_CMAC_Verify_GW_SYNC_REQ
        GW_Sync_Req_oB30_for_SC_CAN_V3_2_6800966b_Rx (SecOCRxAuthenticPduLayer): SecOCPduType=SECOC_IFPDU, SecOCRxAuthenticLayerPduRef=GW_Sync_Req_oB30_for_SC_CAN_V3_2_6800966b_Rx
        SecOCRxSecuredPduLayer
          GW_Sync_Req_Sc_oB30_for_SC_CAN_V3_2_922ee695_Rx (SecOCRxSecuredPdu): SecOCSecuredRxPduVerification=true, SecOCRxSecuredLayerPduId=7, SecOCRxSecuredLayerPduRef=GW_Sync_Req_Sc_oB30_for_SC_CAN_V3_2_922ee695_Rx
      ESP_FD2_Sc_oB30_for_SC_CAN_V3_2_49635fc5_Rx: SecOCAuthInfoTxLength=48, SecOCDataId=311, SecOCFreshnessValueLength=64, SecOCFreshnessValueTxLength=16, SecOCAuthenticationBuildAttempts=3, SecOCAuthenticationVerifyAttempts=3, SecOCFreshnessValueId=6, SecOCRxAuthServiceConfigRef=CsmJob_CMAC_Verify_ESP_FD2
        ESP_FD2_oB30_for_SC_CAN_V3_2_c451c518_Rx (SecOCRxAuthenticPduLayer): SecOCPduType=SECOC_IFPDU, SecOCRxAuthenticLayerPduRef=ESP_FD2_oB30_for_SC_CAN_V3_2_c451c518_Rx
        SecOCRxSecuredPduLayer
          ESP_FD2_Sc_oB30_for_SC_CAN_V3_2_49635fc5_Rx (SecOCRxSecuredPdu): SecOCSecuredRxPduVerification=true, SecOCRxSecuredLayerPduId=6, SecOCRxSecuredLayerPduRef=ESP_FD2_Sc_oB30_for_SC_CAN_V3_2_49635fc5_Rx
      T_BOX_FD3_Sc_oB30_for_SC_CAN_V3_2_5339a08e_Rx: SecOCAuthInfoTxLength=48, SecOCDataId=1001, SecOCFreshnessValueLength=64, SecOCFreshnessValueTxLength=16, SecOCAuthenticationBuildAttempts=3, SecOCAuthenticationVerifyAttempts=3, SecOCFreshnessValueId=13, SecOCRxAuthServiceConfigRef=CsmJob_CMAC_Verify_T_Box_FD3
        T_BOX_FD3_oB30_for_SC_CAN_V3_2_910d04fa_Rx (SecOCRxAuthenticPduLayer): SecOCPduType=SECOC_IFPDU, SecOCRxAuthenticLayerPduRef=T_BOX_FD3_oB30_for_SC_CAN_V3_2_910d04fa_Rx
        SecOCRxSecuredPduLayer
          T_BOX_FD3_Sc_oB30_for_SC_CAN_V3_2_5339a08e_Rx (SecOCRxSecuredPdu): SecOCSecuredRxPduVerification=true, SecOCRxSecuredLayerPduId=13, SecOCRxSecuredLayerPduRef=T_BOX_FD3_Sc_oB30_for_SC_CAN_V3_2_5339a08e_Rx
      T_BOX_FD1_Sc_oB30_for_SC_CAN_V3_2_c35f86d3_Rx: SecOCAuthInfoTxLength=48, SecOCDataId=51, SecOCFreshnessValueLength=64, SecOCFreshnessValueTxLength=16, SecOCAuthenticationBuildAttempts=3, SecOCAuthenticationVerifyAttempts=3, SecOCFreshnessValueId=12, SecOCRxAuthServiceConfigRef=CsmJob_CMAC_Verify_T_Box_FD1
        T_BOX_FD1_oB30_for_SC_CAN_V3_2_bf5dcd7a_Rx (SecOCRxAuthenticPduLayer): SecOCPduType=SECOC_IFPDU, SecOCRxAuthenticLayerPduRef=T_BOX_FD1_oB30_for_SC_CAN_V3_2_bf5dcd7a_Rx
        SecOCRxSecuredPduLayer
          T_BOX_FD1_Sc_oB30_for_SC_CAN_V3_2_c35f86d3_Rx (SecOCRxSecuredPdu): SecOCSecuredRxPduVerification=true, SecOCRxSecuredLayerPduId=12, SecOCRxSecuredLayerPduRef=T_BOX_FD1_Sc_oB30_for_SC_CAN_V3_2_c35f86d3_Rx
      R_PBOX1_Sc_oB30_for_SC_CAN_V3_2_1bc17110_Rx: SecOCAuthInfoTxLength=48, SecOCDataId=412, SecOCFreshnessValueLength=64, SecOCFreshnessValueTxLength=16, SecOCAuthenticationBuildAttempts=1, SecOCAuthenticationVerifyAttempts=1, SecOCFreshnessValueId=9, SecOCRxAuthServiceConfigRef=CsmJob_CMAC_Verify_R_PBox1
        SecOCRxSecuredPduLayer
          R_PBOX1_Sc_oB30_for_SC_CAN_V3_2_1bc17110_Rx (SecOCRxSecuredPdu): SecOCSecuredRxPduVerification=true, SecOCRxSecuredLayerPduId=9, SecOCRxSecuredLayerPduRef=R_PBOX1_Sc_oB30_for_SC_CAN_V3_2_1bc17110_Rx
        R_PBOX1_oB30_for_SC_CAN_V3_2_3929a458_Rx (SecOCRxAuthenticPduLayer): SecOCPduType=SECOC_IFPDU, SecOCRxAuthenticLayerPduRef=R_PBOX1_oB30_for_SC_CAN_V3_2_3929a458_Rx
