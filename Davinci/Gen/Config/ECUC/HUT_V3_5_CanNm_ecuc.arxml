AUTOSAR XML (schema 00046)
package /ActiveEcuC
  module config CanNm: implementation-config-variant=VARIANT-PRE-COMPILE, module-description=CanNm_Impl
    CanNmGlobalConfig:
      CanNmComUserDataSupport = true
      CanNmPnEiraCalcEnabled = false
      CanNmUserDataEnabled = true
      CanNmBusLoadReductionEnabled = false
      CanNmBusSynchronizationEnabled = false
      CanNmCoordinatorSyncSupport = false
      CanNmDevErrorDetect = true
      CanNmImmediateTxconfEnabled = false
      CanNmMainFunctionPeriod = 0.005
      CanNmPassiveModeEnabled = false
      CanNmPduRxIndicationEnabled = false
      CanNmRemoteSleepIndEnabled = false
      CanNmStateChangeIndEnabled = true
      CanNmVersionInfoApi = false
      CanNmDisableTxErrReport = false
      CanNmApiOptimization = false
      CanNmCanIfRangeConfigDLCCheck = true
      CanNmRuntimeMeasurementSupport = false
      CanNmSafeBswChecks = false
      CanNmRepeatMsgIndEnabled = true
      CanNmGeneration: CanNmOutOfBoundsWriteSanitizer=false, CanNmOutOfBoundsReadSanitizer=false, CanNmInterfacesForDeactivatedData=false
      CanNmChannelConfig:
        CanNmBusLoadReductionActive = false
        CanNmCarWakeUpRxEnabled = false
        CanNmImmediateNmTransmissions = 5
        CanNmMsgCycleOffset = 0
        CanNmMsgCycleTime = 0.5
        CanNmMsgReducedTime = 0.08
        CanNmMsgTimeoutTime = 0.06
        CanNmNodeId = 9
        CanNmPduCbvPosition = CANNM_PDU_BYTE_1
        CanNmPduNidPosition = CANNM_PDU_BYTE_0
        CanNmRemoteSleepIndTime = 0.5
        CanNmRepeatMessageTime = 1.55
        CanNmTimeoutTime = 2
        CanNmUserDataLength = 6
        CanNmWaitBusSleepTime = 5
        CanNmActiveWakeupBitEnabled = false
        CanNmNodeIdEnabled = true
        CanNmNodeDetectionEnabled = true
        CanNmRepeatMsgIndEnabled = true
        CanNmImmediateRestartEnabled = false
        CanNmComControlEnabled = true
        CanNmCriBitAlwaysEnabled = false
        CanNmRetryFirstMessageRequest = true
        CanNmImmediateNmCycleTime = 0.02
        CanNmAllNmMessagesKeepAwake = true
        CanNmComMNetworkHandleRef = CN_B30_for_SC_CAN_V3_2_c0d6c67b
        HUT_NM_oB30_tx (CanNmTxPdu): CanNmTxConfirmationPduId=0, CanNmTxPduRef=HUT_NM_oB30_for_SC_CAN_V3_2_00cca29e_Tx
        CanNmUserDataTxPdu: CanNmTxUserDataPduId=0, CanNmTxUserDataPduRef=Pdu_Nm_userData_Tx
        CanNmRxPduRange_oB30_Rx (CanNmRxPdu): CanNmRxPduId=0, CanNmRxPduRef=NMRange_oB30_for_SC_CAN_V3_2_ac4231d8_Rx
