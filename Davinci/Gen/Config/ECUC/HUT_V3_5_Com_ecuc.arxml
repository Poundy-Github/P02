AUTOSAR XML (schema 00046)
package /ActiveEcuC
  module config Com: implementation-config-variant=VARIANT-PRE-COMPILE, module-description=Com_Impl
    ComGeneration:
      ComOutOfBoundsWriteProtectionStrategy = NONE
      ComOutOfBoundsWriteSanitizer = false
      ComOutOfBoundsReadSanitizer = false
      ComReduceConstantData2Define = false
      ComBoolDataInArrayOfStructStrategy = BOOLEAN
      ComDeduplicateIndirectedData = true
      ComDataDeduplicationStrategy = WITH_CAST
      ComReduceBoolDataByNegationThreshold = 2
      ComReduceBoolDataByNumericalComparisonThreshold = 2
      ComReduceBoolDataByNumericalRelationThreshold = 2
      ComReduceBoolDataByNumericalOperandStrategy = WITH_ANY_VALUE
      ComReduceNumericalDataByOffsetThreshold = 2
      ComReduceNumericalDataByArraySubtractionThreshold = 2
      ComReduceDataByStreaming = false
      ComShortSymbols = false
      ComInterfacesForDeactivatedData = false
      ComReferringKeysInComments = false
    ComOptimization:
      ComTxCyclicProcessingISRLockThreshold = 1
      ComTxDeadlineMonitoringISRLockThreshold = 1
      ComTxProcessingISRLockThreshold = 1
      ComRxDeadlineMonitoringISRLockThreshold = 1
      ComRxDeferredProcessingISRLockThreshold = 1
      ComGatewayProcessingISRLockThreshold = 1
      ComGatewayDescriptionProcessingISRLockThreshold = 1
      ComIPduGroupISRLockThreshold = 1
    ComConfig: ComConfigurationId=0, ComRxDeferredNotificationCacheSize=1, ComRxImmediateNotificationCacheSize=0
      CSA3_oB30_for_SC_CAN_V3_2_9099db5c_Rx (ComIPdu):
        ComIPduDirection = RECEIVE
        ComIPduType = NORMAL
        ComIPduHandleId = 46
        ComIPduSignalProcessing = DEFERRED
        ComIPduCancellationSupport = false
        ComIPduCallout = ComEx_ReceivePduCallout
        ComIPduGroupRef = HUT_oB30_for_SC_CAN_V3_2_Rx_4400ad35
        ComIPduSignalRef = CSA3_0x244_oCSA3_oB30_for_SC_CAN_V3_2_a76b1812_Rx
        ComPduIdRef = CSA3_oB30_for_SC_CAN_V3_2_eb741019_Rx
        ComIPduGroupRef = ComIPduGroup
      HUT23_oB30_for_SC_CAN_V3_2_d07983d8_Tx (ComIPdu):
        ComIPduDirection = SEND
        ComIPduType = NORMAL
        ComIPduHandleId = 19
        ComIPduSignalProcessing = DEFERRED
        ComIPduCancellationSupport = false
        ComIPduCallout = ComEx_TransmitPduCallout
        ComIPduGroupRef = HUT_oB30_for_SC_CAN_V3_2_Tx_125a0ab3
        ComIPduSignalRef = HUT23_0x2D8_oHUT23_oB30_for_SC_CAN_V3_2_f39d4000_Tx
        ComPduIdRef = HUT23_oB30_for_SC_CAN_V3_2_6e51bbe9_Tx
        ComIPduGroupRef = HUT_oB30_for_SC_CAN_V3_2_Tx_HEV
        ComTxIPdu: ComMinimumDelayTime=0.015, ComTxIPduUnusedAreasDefault=0
          ComTxModeTrue
            ComTxMode: ComTxModeMode=NONE, ComTxModeNumberOfRepetitions=0, ComTxModeRepetitionPeriod=0
          ComTxModeFalse
            ComTxMode: ComTxModeMode=NONE, ComTxModeNumberOfRepetitions=0, ComTxModeRepetitionPeriod=0
      HUT_oB30_for_SC_CAN_V3_2_Rx_4400ad35 (ComIPduGroup): ComIPduGroupHandleId=2
      18 x ComIPdu, all with ComIPduType=NORMAL, ComIPduSignalProcessing=DEFERRED, ComIPduCancellationSupport=false:
        EPB1_oB30_for_SC_CAN_V3_2_fbe9ee6f_Rx: ComIPduDirection=RECEIVE, ComIPduHandleId=74, ComIPduCallout=ComEx_ReceivePduCallout, ComIPduGroupRef=HUT_oB30_for_SC_CAN_V3_2_Rx_4400ad35, ComIPduSignalRef=EPB1_0x16B_oEPB1_oB30_for_SC_CAN_V3_2_19631844_Rx, ComPduIdRef=EPB1_oB30_for_SC_CAN_V3_2_9899d01e_Rx
        ABS2_oB30_for_SC_CAN_V3_2_057dd67e_Rx: ComIPduDirection=RECEIVE, ComIPduHandleId=3, ComIPduCallout=ComEx_ReceivePduCallout, ComIPduGroupRef=HUT_oB30_for_SC_CAN_V3_2_Rx_4400ad35, ComIPduSignalRef=ABS2_0x246_oABS2_oB30_for_SC_CAN_V3_2_b0714d10_Rx, ComPduIdRef=ABS2_oB30_for_SC_CAN_V3_2_25753a3c_Rx
        HUT32_oB30_for_SC_CAN_V3_2_5c220dcc_Tx: ComIPduDirection=SEND, ComIPduHandleId=25, ComIPduCallout=ComEx_TransmitPduCallout, ComIPduGroupRef=HUT_oB30_for_SC_CAN_V3_2_Tx_125a0ab3, ComIPduSignalRef=HUT32_0x26F_oHUT32_oB30_for_SC_CAN_V3_2_cd38c3b4_Tx, ComPduIdRef=HUT32_oB30_for_SC_CAN_V3_2_cda3b477_Tx, ComIPduGroupRef=HUT_oB30_for_SC_CAN_V3_2_Tx_HEV
          ComTxIPdu: ComMinimumDelayTime=0, ComTxIPduUnusedAreasDefault=0
            ComTxModeTrue
              ComTxMode: ComTxModeMode=PERIODIC, ComTxModeTimePeriod=0.05, ComTxModeTimeOffset=0
            ComTxModeFalse
              ComTxMode: ComTxModeMode=PERIODIC, ComTxModeTimePeriod=0.05, ComTxModeTimeOffset=0
        ABM2_oB30_for_SC_CAN_V3_2_e97c616e_Rx: ComIPduDirection=RECEIVE, ComIPduHandleId=1, ComIPduCallout=ComEx_ReceivePduCallout, ComIPduGroupRef=HUT_oB30_for_SC_CAN_V3_2_Rx_4400ad35, ComIPduSignalRef=ABM2_0x245_oABM2_oB30_for_SC_CAN_V3_2_17c6621a_Rx, ComPduIdRef=ABM2_oB30_for_SC_CAN_V3_2_5851072c_Rx
        HCU_PT4_oB30_for_SC_CAN_V3_2_e1b44e24_Rx: ComIPduDirection=RECEIVE, ComIPduHandleId=106, ComIPduCallout=ComEx_ReceivePduCallout, ComIPduGroupRef=HUT_oB30_for_SC_CAN_V3_2_Rx_4400ad35, ComIPduSignalRef=HCU_PT4_0x2FA_oHCU_PT4_oB30_for_SC_CAN_V3_2_a6c96633_Rx, ComPduIdRef=HCU_PT4_oB30_for_SC_CAN_V3_2_d214f642_Rx
        BMS4_oB30_for_SC_CAN_V3_2_a1743164_Rx: ComIPduDirection=RECEIVE, ComIPduHandleId=33, ComIPduCallout=ComEx_ReceivePduCallout, ComIPduGroupRef=HUT_oB30_for_SC_CAN_V3_2_Rx_4400ad35, ComIPduSignalRef=BMS4_0xF1_oBMS4_oB30_for_SC_CAN_V3_2_ad291777_Rx, ComPduIdRef=BMS4_oB30_for_SC_CAN_V3_2_15d37a43_Rx
        ECM11_oB30_for_SC_CAN_V3_2_0fe303fc_Rx: ComIPduDirection=RECEIVE, ComIPduHandleId=64, ComIPduCallout=ComEx_ReceivePduCallout, ComIPduGroupRef=HUT_oB30_for_SC_CAN_V3_2_Rx_4400ad35, ComIPduSignalRef=ECM11_0x2D3_oECM11_oB30_for_SC_CAN_V3_2_a1715d7d_Rx, ComPduIdRef=ECM11_oB30_for_SC_CAN_V3_2_5b5ef203_Rx
        IFC_FD3_oB30_for_SC_CAN_V3_2_d1bdd095_Rx: ComIPduDirection=RECEIVE, ComIPduHandleId=113, ComIPduCallout=ComEx_ReceivePduCallout, ComIPduGroupRef=HUT_oB30_for_SC_CAN_V3_2_Rx_4400ad35, ComIPduSignalRef=IFC_FD3_0x2CF_oIFC_FD3_oB30_for_SC_CAN_V3_2_b81a4d55_Rx, ComPduIdRef=IFC_FD3_oB30_for_SC_CAN_V3_2_4c625c72_Rx
        HUT16_oB30_for_SC_CAN_V3_2_ed154d25_Tx: ComIPduDirection=SEND, ComIPduHandleId=13, ComIPduCallout=ComEx_TransmitPduCallout, ComIPduGroupRef=HUT_oB30_for_SC_CAN_V3_2_Tx_125a0ab3, ComIPduSignalRef=HUT16_0x348_oHUT16_oB30_for_SC_CAN_V3_2_6a07ebf7_Tx, ComPduIdRef=HUT16_oB30_for_SC_CAN_V3_2_80238ea3_Tx, ComIPduGroupRef=HUT_oB30_for_SC_CAN_V3_2_Tx_HEV
          ComTxIPdu: ComMinimumDelayTime=0, ComTxIPduUnusedAreasDefault=0
            ComTxModeTrue
              ComTxMode: ComTxModeMode=PERIODIC, ComTxModeTimePeriod=0.5, ComTxModeTimeOffset=0
            ComTxModeFalse
              ComTxMode: ComTxModeMode=PERIODIC, ComTxModeTimePeriod=0.5, ComTxModeTimeOffset=0
        HUT30_oB30_for_SC_CAN_V3_2_7272c44c_Tx: ComIPduDirection=SEND, ComIPduHandleId=23, ComIPduCallout=ComEx_TransmitPduCallout, ComIPduGroupRef=HUT_oB30_for_SC_CAN_V3_2_Tx_125a0ab3, ComIPduSignalRef=HUT30_0x1E9_oHUT30_oB30_for_SC_CAN_V3_2_037aee47_Tx, ComPduIdRef=HUT30_oB30_for_SC_CAN_V3_2_82af5510_Tx, ComIPduGroupRef=HUT_oB30_for_SC_CAN_V3_2_Tx_HEV
          ComTxIPdu: ComMinimumDelayTime=0.045, ComTxIPduUnusedAreasDefault=0
            ComTxModeTrue
              ComTxMode: ComTxModeMode=NONE, ComTxModeNumberOfRepetitions=0, ComTxModeRepetitionPeriod=0
            ComTxModeFalse
              ComTxMode: ComTxModeMode=NONE, ComTxModeNumberOfRepetitions=0, ComTxModeRepetitionPeriod=0
        HUD1_oB30_for_SC_CAN_V3_2_8c3d2e2f_Rx: ComIPduDirection=RECEIVE, ComIPduHandleId=110, ComIPduCallout=ComEx_ReceivePduCallout, ComIPduGroupRef=HUT_oB30_for_SC_CAN_V3_2_Rx_4400ad35, ComIPduSignalRef=HUD1_0x325_oHUD1_oB30_for_SC_CAN_V3_2_567ca009_Rx, ComPduIdRef=HUD1_oB30_for_SC_CAN_V3_2_6397ebab_Rx
        HUT21_oB30_for_SC_CAN_V3_2_fe294a58_Tx: ComIPduDirection=SEND, ComIPduHandleId=17, ComIPduCallout=ComEx_TransmitPduCallout, ComIPduGroupRef=HUT_oB30_for_SC_CAN_V3_2_Tx_125a0ab3, ComIPduSignalRef=HUT21_0x2DD_oHUT21_oB30_for_SC_CAN_V3_2_46aba8bb_Tx, ComPduIdRef=HUT21_oB30_for_SC_CAN_V3_2_215d5a8e_Tx, ComIPduGroupRef=HUT_oB30_for_SC_CAN_V3_2_Tx_HEV
          ComTxIPdu: ComMinimumDelayTime=0.015, ComTxIPduUnusedAreasDefault=0
            ComTxModeTrue
              ComTxMode: ComTxModeMode=NONE, ComTxModeNumberOfRepetitions=0, ComTxModeRepetitionPeriod=0
            ComTxModeFalse
              ComTxMode: ComTxModeMode=NONE, ComTxModeNumberOfRepetitions=0, ComTxModeRepetitionPeriod=0
        HUT25_oB30_for_SC_CAN_V3_2_a288d958_Tx: ComIPduDirection=SEND, ComIPduHandleId=20, ComIPduCallout=ComEx_TransmitPduCallout, ComIPduGroupRef=HUT_oB30_for_SC_CAN_V3_2_Tx_125a0ab3, ComIPduSignalRef=HUT25_0x339_oHUT25_oB30_for_SC_CAN_V3_2_1c8c4a71_Tx, ComPduIdRef=HUT25_oB30_for_SC_CAN_V3_2_bf449840_Tx, ComIPduGroupRef=HUT_oB30_for_SC_CAN_V3_2_Tx_HEV
          ComTxIPdu: ComMinimumDelayTime=0.045, ComTxIPduUnusedAreasDefault=0
            ComTxModeTrue
              ComTxMode: ComTxModeMode=NONE, ComTxModeNumberOfRepetitions=0, ComTxModeRepetitionPeriod=0
            ComTxModeFalse
              ComTxMode: ComTxModeMode=NONE, ComTxModeNumberOfRepetitions=0, ComTxModeRepetitionPeriod=0
        ECM3_oB30_for_SC_CAN_V3_2_84cc2a72_Rx: ComIPduDirection=RECEIVE, ComIPduHandleId=60, ComIPduCallout=ComEx_ReceivePduCallout, ComIPduGroupRef=HUT_oB30_for_SC_CAN_V3_2_Rx_4400ad35, ComIPduSignalRef=ECM3_0x371_oECM3_oB30_for_SC_CAN_V3_2_3a68860a_Rx, ComPduIdRef=ECM3_oB30_for_SC_CAN_V3_2_ea21e226_Rx
        HUT4_oB30_for_SC_CAN_V3_2_c6c65fa3_Tx: ComIPduDirection=SEND, ComIPduHandleId=6, ComIPduCallout=ComEx_TransmitPduCallout, ComIPduGroupRef=HUT_oB30_for_SC_CAN_V3_2_Tx_125a0ab3, ComIPduSignalRef=HUT4_0x36D_oHUT4_oB30_for_SC_CAN_V3_2_f3b22adc_Tx, ComPduIdRef=HUT4_oB30_for_SC_CAN_V3_2_1dca0563_Tx, ComIPduGroupRef=HUT_oB30_for_SC_CAN_V3_2_Tx_HEV
          ComTxIPdu: ComMinimumDelayTime=0.045, ComTxIPduUnusedAreasDefault=0
            ComTxModeTrue
              ComTxMode: ComTxModeMode=NONE, ComTxModeNumberOfRepetitions=0, ComTxModeRepetitionPeriod=0
            ComTxModeFalse
              ComTxMode: ComTxModeMode=NONE, ComTxModeNumberOfRepetitions=0, ComTxModeRepetitionPeriod=0
        PDCM1_oB30_for_SC_CAN_V3_2_c2e08bda_Rx: ComIPduDirection=RECEIVE, ComIPduHandleId=121, ComIPduCallout=ComEx_ReceivePduCallout, ComIPduGroupRef=HUT_oB30_for_SC_CAN_V3_2_Rx_4400ad35, ComIPduSignalRef=PDCM1_0x2CD_oPDCM1_oB30_for_SC_CAN_V3_2_6c5cb461_Rx, ComPduIdRef=PDCM1_oB30_for_SC_CAN_V3_2_76a5c7ab_Rx
        DSM1_oB30_for_SC_CAN_V3_2_707c0cc1_Rx: ComIPduDirection=RECEIVE, ComIPduHandleId=55, ComIPduCallout=ComEx_ReceivePduCallout, ComIPduGroupRef=HUT_oB30_for_SC_CAN_V3_2_Rx_4400ad35, ComIPduSignalRef=DSM1_0x2C1_oDSM1_oB30_for_SC_CAN_V3_2_abfa59d6_Rx, ComPduIdRef=DSM1_oB30_for_SC_CAN_V3_2_24c7b7e3_Rx
        HAP_FD1_oB30_for_SC_CAN_V3_2_7488140e_Rx: ComIPduDirection=RECEIVE, ComIPduHandleId=88, ComIPduCallout=ComEx_ReceivePduCallout, ComIPduGroupRef=HUT_oB30_for_SC_CAN_V3_2_Rx_4400ad35, ComIPduSignalRef=HAP_FD1_0x15B_oHAP_FD1_oB30_for_SC_CAN_V3_2_93124709_Rx, ComPduIdRef=HAP_FD1_oB30_for_SC_CAN_V3_2_6083faa7_Rx
      HUT_oCAN_Rx_f5814658 (ComIPduGroup): ComIPduGroupHandleId=4
      ECM19_oB30_for_SC_CAN_V3_2_b6a025fc_Rx (ComIPdu):
        ComIPduDirection = RECEIVE
        ComIPduType = NORMAL
        ComIPduHandleId = 66
        ComIPduSignalProcessing = DEFERRED
        ComIPduCancellationSupport = false
        ComIPduCallout = ComEx_ReceivePduCallout
        ComIPduGroupRef = HUT_oB30_for_SC_CAN_V3_2_Rx_4400ad35
        ComIPduSignalRef = ECM19_0x3B5_oECM19_oB30_for_SC_CAN_V3_2_c4b3a800_Rx
        ComPduIdRef = ECM19_oB30_for_SC_CAN_V3_2_bc1c71de_Rx
      HCU_HC7_oB30_for_SC_CAN_V3_2_0261be05_Rx (ComIPdu):
        ComIPduDirection = RECEIVE
        ComIPduType = NORMAL
        ComIPduHandleId = 100
        ComIPduSignalProcessing = DEFERRED
        ComIPduCancellationSupport = false
        ComIPduCallout = ComEx_ReceivePduCallout
        ComIPduGroupRef = HUT_oB30_for_SC_CAN_V3_2_Rx_4400ad35
        ComIPduSignalRef = HCU_HC7_0x3C2_oHCU_HC7_oB30_for_SC_CAN_V3_2_d59a401d_Rx
        ComPduIdRef = HCU_HC7_oB30_for_SC_CAN_V3_2_7b235adf_Rx
      HUT_oLIN00_Rx_27d7c1e5 (ComIPduGroup): ComIPduGroupHandleId=6
      4 x ComIPdu, all with ComIPduType=NORMAL, ComIPduSignalProcessing=DEFERRED, ComIPduCancellationSupport=false:
        DCT5_oB30_for_SC_CAN_V3_2_c90ecf42_Rx: ComIPduDirection=RECEIVE, ComIPduHandleId=48, ComIPduCallout=ComEx_ReceivePduCallout, ComIPduGroupRef=HUT_oB30_for_SC_CAN_V3_2_Rx_4400ad35, ComIPduSignalRef=DCT5_0x221_oDCT5_oB30_for_SC_CAN_V3_2_6e7f38ea_Rx, ComPduIdRef=DCT5_oB30_for_SC_CAN_V3_2_81a2a74b_Rx
        HUT3_oB30_for_SC_CAN_V3_2_a31f61e3_Tx: ComIPduDirection=SEND, ComIPduHandleId=5, ComIPduCallout=ComEx_TransmitPduCallout, ComIPduGroupRef=HUT_oB30_for_SC_CAN_V3_2_Tx_125a0ab3, ComIPduSignalRef=HUT3_0x36B_oHUT3_oB30_for_SC_CAN_V3_2_6c58ad50_Tx, ComPduIdRef=HUT3_oB30_for_SC_CAN_V3_2_06e1d559_Tx, ComIPduGroupRef=HUT_oB30_for_SC_CAN_V3_2_Tx_HEV
          ComTxIPdu: ComMinimumDelayTime=0.045, ComTxIPduUnusedAreasDefault=0
            ComTxModeTrue
              ComTxMode: ComTxModeMode=NONE, ComTxModeNumberOfRepetitions=0, ComTxModeRepetitionPeriod=0
            ComTxModeFalse
              ComTxMode: ComTxModeMode=NONE, ComTxModeNumberOfRepetitions=0, ComTxModeRepetitionPeriod=0
        ECM7_oB30_for_SC_CAN_V3_2_d86db972_Rx: ComIPduDirection=RECEIVE, ComIPduHandleId=62, ComIPduCallout=ComEx_ReceivePduCallout, ComIPduGroupRef=HUT_oB30_for_SC_CAN_V3_2_Rx_4400ad35, ComIPduSignalRef=ECM7_0x84_oECM7_oB30_for_SC_CAN_V3_2_ca9b1546_Rx, ComPduIdRef=ECM7_oB30_for_SC_CAN_V3_2_743820e8_Rx
        HUT33_oB30_for_SC_CAN_V3_2_4b0a690c_Tx: ComIPduDirection=SEND, ComIPduHandleId=26, ComIPduCallout=ComEx_TransmitPduCallout, ComIPduGroupRef=HUT_oB30_for_SC_CAN_V3_2_Tx_125a0ab3, ComIPduSignalRef=HUT33_0x1ED_oHUT33_oB30_for_SC_CAN_V3_2_0dfdacd0_Tx, ComPduIdRef=HUT33_oB30_for_SC_CAN_V3_2_079d47e4_Tx, ComIPduGroupRef=HUT_oB30_for_SC_CAN_V3_2_Tx_HEV
          ComTxIPdu: ComMinimumDelayTime=0.045, ComTxIPduUnusedAreasDefault=0
            ComTxModeTrue
              ComTxMode: ComTxModeMode=NONE, ComTxModeNumberOfRepetitions=0, ComTxModeRepetitionPeriod=0
            ComTxModeFalse
              ComTxMode: ComTxModeMode=NONE, ComTxModeNumberOfRepetitions=0, ComTxModeRepetitionPeriod=0
      HUT_oCAN_Tx_a3dbe1de (ComIPduGroup): ComIPduGroupHandleId=5
      11 x ComIPdu, all with ComIPduType=NORMAL, ComIPduSignalProcessing=DEFERRED, ComIPduCancellationSupport=false:
        HUT6_oB30_for_SC_CAN_V3_2_e8969623_Tx: ComIPduDirection=SEND, ComIPduHandleId=7, ComIPduCallout=ComEx_TransmitPduCallout, ComIPduGroupRef=HUT_oB30_for_SC_CAN_V3_2_Tx_125a0ab3, ComIPduSignalRef=HUT6_0x4A_oHUT6_oB30_for_SC_CAN_V3_2_d227f5be_Tx, ComPduIdRef=HUT6_oB30_for_SC_CAN_V3_2_52c6e404_Tx, ComIPduGroupRef=HUT_oB30_for_SC_CAN_V3_2_Tx_HEV
          ComTxIPdu: ComMinimumDelayTime=0.045, ComTxIPduUnusedAreasDefault=0
            ComTxModeTrue
              ComTxMode: ComTxModeMode=NONE, ComTxModeNumberOfRepetitions=0, ComTxModeRepetitionPeriod=0
            ComTxModeFalse
              ComTxMode: ComTxModeMode=NONE, ComTxModeNumberOfRepetitions=0, ComTxModeRepetitionPeriod=0
        HUT19_oB30_for_SC_CAN_V3_2_318f5565_Tx: ComIPduDirection=SEND, ComIPduHandleId=15, ComIPduCallout=ComEx_TransmitPduCallout, ComIPduGroupRef=HUT_oB30_for_SC_CAN_V3_2_Tx_125a0ab3, ComIPduSignalRef=HUT19_0x415_oHUT19_oB30_for_SC_CAN_V3_2_0070b441_Tx, ComPduIdRef=HUT19_oB30_for_SC_CAN_V3_2_7c4add44_Tx, ComIPduGroupRef=HUT_oB30_for_SC_CAN_V3_2_Tx_HEV
          ComTxIPdu: ComMinimumDelayTime=0, ComTxIPduUnusedAreasDefault=0
            ComTxModeTrue
              ComTxMode: ComTxModeMode=PERIODIC, ComTxModeTimePeriod=5, ComTxModeTimeOffset=0
            ComTxModeFalse
              ComTxMode: ComTxModeMode=PERIODIC, ComTxModeTimePeriod=5, ComTxModeTimeOffset=0
        HUT17_oB30_for_SC_CAN_V3_2_fa3d29e5_Tx: ComIPduDirection=SEND, ComIPduHandleId=14, ComIPduCallout=ComEx_TransmitPduCallout, ComIPduGroupRef=HUT_oB30_for_SC_CAN_V3_2_Tx_125a0ab3, ComIPduSignalRef=HUT17_0x33B_oHUT17_oB30_for_SC_CAN_V3_2_49d9e9b4_Tx, ComPduIdRef=HUT17_oB30_for_SC_CAN_V3_2_4a1d7d30_Tx, ComIPduGroupRef=HUT_oB30_for_SC_CAN_V3_2_Tx_HEV
          ComTxIPdu: ComMinimumDelayTime=0.045, ComTxIPduUnusedAreasDefault=0
            ComTxModeTrue
              ComTxMode: ComTxModeMode=NONE, ComTxModeNumberOfRepetitions=0, ComTxModeRepetitionPeriod=0
            ComTxModeFalse
              ComTxMode: ComTxModeMode=NONE, ComTxModeNumberOfRepetitions=0, ComTxModeRepetitionPeriod=0
        AC2_oB30_for_SC_CAN_V3_2_8173fb8f_Rx: ComIPduDirection=RECEIVE, ComIPduHandleId=5, ComIPduCallout=ComEx_ReceivePduCallout, ComIPduGroupRef=HUT_oB30_for_SC_CAN_V3_2_Rx_4400ad35, ComIPduSignalRef=AC2_0x385_oAC2_oB30_for_SC_CAN_V3_2_0cf77687_Rx, ComPduIdRef=AC2_oB30_for_SC_CAN_V3_2_b771a69a_Rx
        PEPS4_oB30_for_SC_CAN_V3_2_e7968d11_Rx: ComIPduDirection=RECEIVE, ComIPduHandleId=123, ComIPduCallout=ComEx_ReceivePduCallout, ComIPduGroupRef=HUT_oB30_for_SC_CAN_V3_2_Rx_4400ad35, ComIPduSignalRef=PEPS4_0x302_oPEPS4_oB30_for_SC_CAN_V3_2_97914cf7_Rx, ComPduIdRef=PEPS4_oB30_for_SC_CAN_V3_2_5d25af87_Rx
        ABS1_oB30_for_SC_CAN_V3_2_3c057b3e_Rx: ComIPduDirection=RECEIVE, ComIPduHandleId=2, ComIPduCallout=ComEx_ReceivePduCallout, ComIPduGroupRef=HUT_oB30_for_SC_CAN_V3_2_Rx_4400ad35, ComIPduSignalRef=ABS1_0x231_oABS1_oB30_for_SC_CAN_V3_2_12e0e9e4_Rx, ComPduIdRef=ABS1_oB30_for_SC_CAN_V3_2_a04728c8_Rx
        EEM1_oB30_for_SC_CAN_V3_2_1aa1b1a2_Rx: ComIPduDirection=RECEIVE, ComIPduHandleId=72, ComIPduCallout=ComEx_ReceivePduCallout, ComIPduGroupRef=HUT_oB30_for_SC_CAN_V3_2_Rx_4400ad35, ComIPduSignalRef=EEM1_0x2A8_oEEM1_oB30_for_SC_CAN_V3_2_a343c1b7_Rx, ComPduIdRef=EEM1_oB30_for_SC_CAN_V3_2_788fa486_Rx
        RSDS_FD1_oB30_for_SC_CAN_V3_2_984f3330_Rx: ComIPduDirection=RECEIVE, ComIPduHandleId=126, ComIPduCallout=ComEx_ReceivePduCallout, ComIPduGroupRef=HUT_oB30_for_SC_CAN_V3_2_Rx_4400ad35, ComIPduSignalRef=RSDS_FD1_0x16F_oRSDS_FD1_oB30_for_SC_CAN_V3_2_0c3e88fc_Rx, ComPduIdRef=RSDS_FD1_oB30_for_SC_CAN_V3_2_b597372e_Rx
        HUT13_oB30_for_SC_CAN_V3_2_a69cbae5_Tx: ComIPduDirection=SEND, ComIPduHandleId=11, ComIPduCallout=ComEx_TransmitPduCallout, ComIPduGroupRef=HUT_oB30_for_SC_CAN_V3_2_Tx_125a0ab3, ComIPduSignalRef=HUT13_0x31C_oHUT13_oB30_for_SC_CAN_V3_2_86243622_Tx, ComPduIdRef=HUT13_oB30_for_SC_CAN_V3_2_d404bffe_Tx, ComIPduGroupRef=HUT_oB30_for_SC_CAN_V3_2_Tx_HEV
          ComTxIPdu: ComMinimumDelayTime=0, ComTxIPduUnusedAreasDefault=0
            ComTxModeTrue
              ComTxMode: ComTxModeMode=PERIODIC, ComTxModeTimePeriod=0.1, ComTxModeTimeOffset=0
            ComTxModeFalse
              ComTxMode: ComTxModeMode=PERIODIC, ComTxModeTimePeriod=0.1, ComTxModeTimeOffset=0
        ECM20_oB30_for_SC_CAN_V3_2_6e2e5e01_Rx: ComIPduDirection=RECEIVE, ComIPduHandleId=67, ComIPduCallout=ComEx_ReceivePduCallout, ComIPduGroupRef=HUT_oB30_for_SC_CAN_V3_2_Rx_4400ad35, ComIPduSignalRef=ECM20_0x3B7_oECM20_oB30_for_SC_CAN_V3_2_bb09ac86_Rx, ComPduIdRef=ECM20_oB30_for_SC_CAN_V3_2_2b350587_Rx
        PEPS2_oB30_for_SC_CAN_V3_2_9567d791_Rx: ComIPduDirection=RECEIVE, ComIPduHandleId=122, ComIPduCallout=ComEx_ReceivePduCallout, ComIPduGroupRef=HUT_oB30_for_SC_CAN_V3_2_Rx_4400ad35, ComIPduSignalRef=PEPS2_0x295_oPEPS2_oB30_for_SC_CAN_V3_2_d1207061_Rx, ComPduIdRef=PEPS2_oB30_for_SC_CAN_V3_2_8c308c2e_Rx
      HUT_oLIN00_Tx_718d6663 (ComIPduGroup): ComIPduGroupHandleId=7
      HUT_oB30_for_SC_CAN_V3_2_Tx_125a0ab3 (ComIPduGroup): ComIPduGroupHandleId=3
      27 x ComIPdu, all with ComIPduType=NORMAL, ComIPduSignalProcessing=DEFERRED, ComIPduCancellationSupport=false:
        HUT20_oB30_for_SC_CAN_V3_2_e9012e98_Tx: ComIPduDirection=SEND, ComIPduHandleId=16, ComIPduCallout=ComEx_TransmitPduCallout, ComIPduGroupRef=HUT_oB30_for_SC_CAN_V3_2_Tx_125a0ab3, ComIPduSignalRef=HUT20_0x2DE_oHUT20_oB30_for_SC_CAN_V3_2_fd1a0297_Tx, ComPduIdRef=HUT20_oB30_for_SC_CAN_V3_2_eb63a91d_Tx, ComIPduGroupRef=HUT_oB30_for_SC_CAN_V3_2_Tx_HEV
          ComTxIPdu: ComMinimumDelayTime=0.015, ComTxIPduUnusedAreasDefault=0
            ComTxModeTrue
              ComTxMode: ComTxModeMode=NONE, ComTxModeNumberOfRepetitions=0, ComTxModeRepetitionPeriod=0
            ComTxModeFalse
              ComTxMode: ComTxModeMode=NONE, ComTxModeNumberOfRepetitions=0, ComTxModeRepetitionPeriod=0
        CSA1_oB30_for_SC_CAN_V3_2_bec912dc_Rx: ComIPduDirection=RECEIVE, ComIPduHandleId=44, ComIPduCallout=ComEx_ReceivePduCallout, ComIPduGroupRef=HUT_oB30_for_SC_CAN_V3_2_Rx_4400ad35, ComIPduSignalRef=CSA1_0x165_oCSA1_oB30_for_SC_CAN_V3_2_432419b3_Rx, ComPduIdRef=CSA1_oB30_for_SC_CAN_V3_2_a478f17e_Rx
        HUT10_oB30_for_SC_CAN_V3_2_9fe417a5_Tx: ComIPduDirection=SEND, ComIPduHandleId=9, ComIPduCallout=ComEx_TransmitPduCallout, ComIPduGroupRef=HUT_oB30_for_SC_CAN_V3_2_Tx_125a0ab3, ComIPduSignalRef=HUT10_0x331_oHUT10_oB30_for_SC_CAN_V3_2_acd87eba_Tx, ComPduIdRef=HUT10_oB30_for_SC_CAN_V3_2_5136ad0a_Tx, ComIPduGroupRef=HUT_oB30_for_SC_CAN_V3_2_Tx_HEV
          ComTxIPdu: ComMinimumDelayTime=0.055, ComTxIPduUnusedAreasDefault=0
            ComTxModeTrue
              ComTxMode: ComTxModeMode=NONE, ComTxModeNumberOfRepetitions=0, ComTxModeRepetitionPeriod=0
            ComTxModeFalse
              ComTxMode: ComTxModeMode=NONE, ComTxModeNumberOfRepetitions=0, ComTxModeRepetitionPeriod=0
        HUT1_oB30_for_SC_CAN_V3_2_8d4fa863_Tx: ComIPduDirection=SEND, ComIPduHandleId=3, ComIPduCallout=ComEx_TransmitPduCallout, ComIPduGroupRef=HUT_oB30_for_SC_CAN_V3_2_Tx_125a0ab3, ComIPduSignalRef=HUT1_0x367_oHUT1_oB30_for_SC_CAN_V3_2_4cf1fae5_Tx, ComPduIdRef=HUT1_oB30_for_SC_CAN_V3_2_49ed343e_Tx, ComIPduGroupRef=HUT_oB30_for_SC_CAN_V3_2_Tx_HEV
          ComTxIPdu: ComMinimumDelayTime=0.055, ComTxIPduUnusedAreasDefault=0
            ComTxModeTrue
              ComTxMode: ComTxModeMode=NONE, ComTxModeNumberOfRepetitions=0, ComTxModeRepetitionPeriod=0
            ComTxModeFalse
              ComTxMode: ComTxModeMode=NONE, ComTxModeNumberOfRepetitions=0, ComTxModeRepetitionPeriod=0
        ECM1_oB30_for_SC_CAN_V3_2_aa9ce3f2_Rx: ComIPduDirection=RECEIVE, ComIPduHandleId=58, ComIPduCallout=ComEx_ReceivePduCallout, ComIPduGroupRef=HUT_oB30_for_SC_CAN_V3_2_Rx_4400ad35, ComIPduSignalRef=ECM1_0x111_oECM1_oB30_for_SC_CAN_V3_2_b49cfb6f_Rx, ComPduIdRef=ECM1_oB30_for_SC_CAN_V3_2_a52d0341_Rx
        AMP4_ANC1_oB30_for_SC_CAN_V3_2_0839201d_Rx: ComIPduDirection=RECEIVE, ComIPduHandleId=21, ComIPduCallout=ComEx_ReceivePduCallout, ComIPduGroupRef=HUT_oB30_for_SC_CAN_V3_2_Rx_4400ad35, ComIPduSignalRef=AMP4_ANC1_0x2D2_oAMP4_ANC1_oB30_for_SC_CAN_V3_2_2dfdb3ea_Rx, ComPduIdRef=AMP4_ANC1_oB30_for_SC_CAN_V3_2_e4b31b97_Rx
        ECM2_oB30_for_SC_CAN_V3_2_93e44eb2_Rx: ComIPduDirection=RECEIVE, ComIPduHandleId=59, ComIPduCallout=ComEx_ReceivePduCallout, ComIPduGroupRef=HUT_oB30_for_SC_CAN_V3_2_Rx_4400ad35, ComIPduSignalRef=ECM2_0x271_oECM2_oB30_for_SC_CAN_V3_2_35a250f4_Rx, ComPduIdRef=ECM2_oB30_for_SC_CAN_V3_2_201f11b5_Rx
        DDCM1_oB30_for_SC_CAN_V3_2_4226467c_Rx: ComIPduDirection=RECEIVE, ComIPduHandleId=50, ComIPduCallout=ComEx_ReceivePduCallout, ComIPduGroupRef=HUT_oB30_for_SC_CAN_V3_2_Rx_4400ad35, ComIPduSignalRef=DDCM1_0x2CA_oDDCM1_oB30_for_SC_CAN_V3_2_0a1045c1_Rx, ComPduIdRef=DDCM1_oB30_for_SC_CAN_V3_2_b3033028_Rx
        HUT22_oB30_for_SC_CAN_V3_2_c751e718_Tx: ComIPduDirection=SEND, ComIPduHandleId=18, ComIPduCallout=ComEx_TransmitPduCallout, ComIPduGroupRef=HUT_oB30_for_SC_CAN_V3_2_Tx_125a0ab3, ComIPduSignalRef=HUT22_0x2DA_oHUT22_oB30_for_SC_CAN_V3_2_c0698017_Tx, ComPduIdRef=HUT22_oB30_for_SC_CAN_V3_2_a46f487a_Tx, ComIPduGroupRef=HUT_oB30_for_SC_CAN_V3_2_Tx_HEV
          ComTxIPdu: ComMinimumDelayTime=0.015, ComTxIPduUnusedAreasDefault=0
            ComTxModeTrue
              ComTxMode: ComTxModeMode=NONE, ComTxModeNumberOfRepetitions=0, ComTxModeRepetitionPeriod=0
            ComTxModeFalse
              ComTxMode: ComTxModeMode=NONE, ComTxModeNumberOfRepetitions=0, ComTxModeRepetitionPeriod=0
        DCT3_oB30_for_SC_CAN_V3_2_bbff95c2_Rx: ComIPduDirection=RECEIVE, ComIPduHandleId=47, ComIPduCallout=ComEx_ReceivePduCallout, ComIPduGroupRef=HUT_oB30_for_SC_CAN_V3_2_Rx_4400ad35, ComIPduSignalRef=DCT3_0xA6_oDCT3_oB30_for_SC_CAN_V3_2_f1cd20ee_Rx, ComPduIdRef=DCT3_oB30_for_SC_CAN_V3_2_50b784e2_Rx
        HAP_FD2_oB30_for_SC_CAN_V3_2_4df0b94e_Rx: ComIPduDirection=RECEIVE, ComIPduHandleId=89, ComIPduCallout=ComEx_ReceivePduCallout, ComIPduGroupRef=HUT_oB30_for_SC_CAN_V3_2_Rx_4400ad35, ComIPduSignalRef=HAP_FD2_0x274_oHAP_FD2_oB30_for_SC_CAN_V3_2_5363b27c_Rx, ComPduIdRef=HAP_FD2_oB30_for_SC_CAN_V3_2_e5b1e853_Rx
        WPC1_oB30_for_SC_CAN_V3_2_a8eb0588_Rx: ComIPduDirection=RECEIVE, ComIPduHandleId=140, ComIPduCallout=ComEx_ReceivePduCallout, ComIPduGroupRef=HUT_oB30_for_SC_CAN_V3_2_Rx_4400ad35, ComIPduSignalRef=WPC1_0x2BA_oWPC1_oB30_for_SC_CAN_V3_2_0ada7fde_Rx, ComPduIdRef=WPC1_oB30_for_SC_CAN_V3_2_e844e41f_Rx
        ESP8_oB30_for_SC_CAN_V3_2_e1785022_Rx: ComIPduDirection=RECEIVE, ComIPduHandleId=77, ComIPduCallout=ComEx_ReceivePduCallout, ComIPduGroupRef=HUT_oB30_for_SC_CAN_V3_2_Rx_4400ad35, ComIPduSignalRef=ESP8_0x170_oESP8_oB30_for_SC_CAN_V3_2_97b77884_Rx, ComPduIdRef=ESP8_oB30_for_SC_CAN_V3_2_cf6f571c_Rx
        AMP1_oB30_for_SC_CAN_V3_2_a9f549ca_Rx: ComIPduDirection=RECEIVE, ComIPduHandleId=18, ComIPduCallout=ComEx_ReceivePduCallout, ComIPduGroupRef=HUT_oB30_for_SC_CAN_V3_2_Rx_4400ad35, ComIPduSignalRef=AMP1_0x3E1_oAMP1_oB30_for_SC_CAN_V3_2_ab4beb46_Rx, ComPduIdRef=AMP1_oB30_for_SC_CAN_V3_2_f94fb5d3_Rx
        ECM4_oB30_for_SC_CAN_V3_2_e1151432_Rx: ComIPduDirection=RECEIVE, ComIPduHandleId=61, ComIPduCallout=ComEx_ReceivePduCallout, ComIPduGroupRef=HUT_oB30_for_SC_CAN_V3_2_Rx_4400ad35, ComIPduSignalRef=ECM4_0x82_oECM4_oB30_for_SC_CAN_V3_2_ad48075d_Rx, ComPduIdRef=ECM4_oB30_for_SC_CAN_V3_2_f10a321c_Rx
        HAP_FD3_oB30_for_SC_CAN_V3_2_5ad8dd8e_Rx: ComIPduDirection=RECEIVE, ComIPduHandleId=90, ComIPduCallout=ComEx_ReceivePduCallout, ComIPduGroupRef=HUT_oB30_for_SC_CAN_V3_2_Rx_4400ad35, ComIPduSignalRef=HAP_FD3_0x298_oHAP_FD3_oB30_for_SC_CAN_V3_2_22400704_Rx, ComPduIdRef=HAP_FD3_oB30_for_SC_CAN_V3_2_2f8f1bc0_Rx
        AC1_oB30_for_SC_CAN_V3_2_b80b56cf_Rx: ComIPduDirection=RECEIVE, ComIPduHandleId=4, ComIPduCallout=ComEx_ReceivePduCallout, ComIPduGroupRef=HUT_oB30_for_SC_CAN_V3_2_Rx_4400ad35, ComIPduSignalRef=AC1_0x29D_oAC1_oB30_for_SC_CAN_V3_2_22980340_Rx, ComPduIdRef=AC1_oB30_for_SC_CAN_V3_2_3243b46e_Rx
        AEB_FD1_oB30_for_SC_CAN_V3_2_a6cb7aa9_Rx: ComIPduDirection=RECEIVE, ComIPduHandleId=15, ComIPduCallout=ComEx_ReceivePduCallout, ComIPduGroupRef=HUT_oB30_for_SC_CAN_V3_2_Rx_4400ad35, ComIPduSignalRef=AEB_FD1_0x18B_oAEB_FD1_oB30_for_SC_CAN_V3_2_88d04ffa_Rx, ComPduIdRef=AEB_FD1_oB30_for_SC_CAN_V3_2_c284a95c_Rx
        HCU_PT7_oB30_for_SC_CAN_V3_2_d8cce364_Rx: ComIPduDirection=RECEIVE, ComIPduHandleId=108, ComIPduCallout=ComEx_ReceivePduCallout, ComIPduGroupRef=HUT_oB30_for_SC_CAN_V3_2_Rx_4400ad35, ComIPduSignalRef=HCU_PT7_0x248_oHCU_PT7_oB30_for_SC_CAN_V3_2_30a9f673_Rx, ComPduIdRef=HCU_PT7_oB30_for_SC_CAN_V3_2_5726e4b6_Rx
        ECM9_oB30_for_SC_CAN_V3_2_13dfc5f2_Rx: ComIPduDirection=RECEIVE, ComIPduHandleId=63, ComIPduCallout=ComEx_ReceivePduCallout, ComIPduGroupRef=HUT_oB30_for_SC_CAN_V3_2_Rx_4400ad35, ComIPduSignalRef=ECM9_0x102_oECM9_oB30_for_SC_CAN_V3_2_93658c9d_Rx, ComPduIdRef=ECM9_oB30_for_SC_CAN_V3_2_426f809c_Rx
        HUT2_oB30_for_SC_CAN_V3_2_b4370523_Tx: ComIPduDirection=SEND, ComIPduHandleId=4, ComIPduCallout=ComEx_TransmitPduCallout, ComIPduGroupRef=HUT_oB30_for_SC_CAN_V3_2_Tx_125a0ab3, ComIPduSignalRef=HUT2_0x369_oHUT2_oB30_for_SC_CAN_V3_2_101c4259_Tx, ComPduIdRef=HUT2_oB30_for_SC_CAN_V3_2_ccdf26ca_Tx, ComIPduGroupRef=HUT_oB30_for_SC_CAN_V3_2_Tx_HEV
          ComTxIPdu: ComMinimumDelayTime=0.055, ComTxIPduUnusedAreasDefault=0
            ComTxModeTrue
              ComTxMode: ComTxModeMode=NONE, ComTxModeNumberOfRepetitions=0, ComTxModeRepetitionPeriod=0
            ComTxModeFalse
              ComTxMode: ComTxModeMode=NONE, ComTxModeNumberOfRepetitions=0, ComTxModeRepetitionPeriod=0
        BCM12_oB30_for_SC_CAN_V3_2_ee58d59a_Rx: ComIPduDirection=RECEIVE, ComIPduHandleId=27, ComIPduCallout=ComEx_ReceivePduCallout, ComIPduGroupRef=HUT_oB30_for_SC_CAN_V3_2_Rx_4400ad35, ComIPduSignalRef=BCM12_0x238_oBCM12_oB30_for_SC_CAN_V3_2_ced434a5_Rx, ComPduIdRef=BCM12_oB30_for_SC_CAN_V3_2_3066f987_Rx
        CSA2_oB30_for_SC_CAN_V3_2_87b1bf9c_Rx: ComIPduDirection=RECEIVE, ComIPduHandleId=45, ComIPduCallout=ComEx_ReceivePduCallout, ComIPduGroupRef=HUT_oB30_for_SC_CAN_V3_2_Rx_4400ad35, ComIPduSignalRef=CSA2_0xA1_oCSA2_oB30_for_SC_CAN_V3_2_7f0f027f_Rx, ComPduIdRef=CSA2_oB30_for_SC_CAN_V3_2_214ae38a_Rx
        ESP11_oB30_for_SC_CAN_V3_2_12b19c69_Rx: ComIPduDirection=RECEIVE, ComIPduHandleId=78, ComIPduCallout=ComEx_ReceivePduCallout, ComIPduGroupRef=HUT_oB30_for_SC_CAN_V3_2_Rx_4400ad35, ComIPduSignalRef=ESP11_0xC8_oESP11_oB30_for_SC_CAN_V3_2_b2794d17_Rx, ComPduIdRef=ESP11_oB30_for_SC_CAN_V3_2_dfa78df9_Rx
        HUT34_oB30_for_SC_CAN_V3_2_2ed3574c_Tx: ComIPduDirection=SEND, ComIPduHandleId=27, ComIPduCallout=ComEx_TransmitPduCallout, ComIPduGroupRef=HUT_oB30_for_SC_CAN_V3_2_Tx_125a0ab3, ComIPduSignalRef=HUT34_0x370_oHUT34_oB30_for_SC_CAN_V3_2_f661979e_Tx, ComPduIdRef=HUT34_oB30_for_SC_CAN_V3_2_1cb697de_Tx, ComIPduGroupRef=HUT_oB30_for_SC_CAN_V3_2_Tx_HEV
          ComTxIPdu: ComMinimumDelayTime=0, ComTxIPduUnusedAreasDefault=0
            ComTxModeTrue
              ComTxMode: ComTxModeMode=PERIODIC, ComTxModeTimePeriod=1, ComTxModeTimeOffset=0
            ComTxModeFalse
              ComTxMode: ComTxModeMode=PERIODIC, ComTxModeTimePeriod=1, ComTxModeTimeOffset=0
        GW_FD1_oB30_for_SC_CAN_V3_2_765a3f2a_Rx: ComIPduDirection=RECEIVE, ComIPduHandleId=85, ComIPduCallout=ComEx_ReceivePduCallout, ComIPduGroupRef=HUT_oB30_for_SC_CAN_V3_2_Rx_4400ad35, ComIPduSignalRef=GW_FD1_0x2BB_oGW_FD1_oB30_for_SC_CAN_V3_2_004ea45d_Rx, ComPduIdRef=GW_FD1_oB30_for_SC_CAN_V3_2_7270e594_Rx
        AMP3_oB30_for_SC_CAN_V3_2_87a5804a_Rx: ComIPduDirection=RECEIVE, ComIPduHandleId=20, ComIPduCallout=ComEx_ReceivePduCallout, ComIPduGroupRef=HUT_oB30_for_SC_CAN_V3_2_Rx_4400ad35, ComIPduSignalRef=AMP3_0x3E5_oAMP3_oB30_for_SC_CAN_V3_2_cac874de_Rx, ComPduIdRef=AMP3_oB30_for_SC_CAN_V3_2_b64354b4_Rx
      ComTimeBase: ComRxTimeBase=0.005, ComTxTimeBase=0.005, ComGwTimeBase=0.005
      BCM8_oB30_for_SC_CAN_V3_2_caa75d9a_Rx (ComIPdu):
        ComIPduDirection = RECEIVE
        ComIPduType = NORMAL
        ComIPduHandleId = 25
        ComIPduSignalProcessing = DEFERRED
        ComIPduCancellationSupport = false
        ComIPduCallout = ComEx_ReceivePduCallout
        ComIPduGroupRef = HUT_oB30_for_SC_CAN_V3_2_Rx_4400ad35
        ComIPduSignalRef = BCM8_0x29F_oBCM8_oB30_for_SC_CAN_V3_2_959fd4c6_Rx
        ComPduIdRef = BCM8_oB30_for_SC_CAN_V3_2_8c292f0d_Rx
      ComIPduGroup: ComIPduGroupHandleId=0
      ComIPdu_userData_tx (ComIPdu):
        ComIPduDirection = SEND
        ComIPduHandleId = 0
        ComIPduSignalProcessing = DEFERRED
        ComIPduType = NORMAL
        ComIPduCancellationSupport = false
        ComIPduCallout = 
        ComIPduTriggerTransmitCallout = ComIPdu_userData_Callback_tx
        ComPduIdRef = Pdu_Nm_userData_Tx
        ComIPduSignalRef = ComSignal_userData_byte2_tx
        ComIPduSignalRef = ComSignal_userdata_Byte3_tx
        ComTxIPdu: ComMinimumDelayTime=0, ComTxIPduUnusedAreasDefault=0
          ComTxModeFalse
            ComTxMode: ComTxModeMode=NONE
          ComTxModeTrue
            ComTxMode: ComTxModeMode=NONE
      45 x ComSignal:
        ComSignal_userdata_Byte3_tx: ComBitPosition=24, ComSignalEndianness=LITTLE_ENDIAN, ComSignalInitValue=0, ComSignalType=UINT8, ComSignalAccess=ACCESS_UNCLEAR, ComHandleId=6, ComBitSize=3, ComTransferProperty=PENDING
        ComSignal_userData_byte2_tx: ComBitPosition=16, ComSignalEndianness=LITTLE_ENDIAN, ComSignalInitValue=0, ComSignalType=UINT8, ComSignalAccess=ACCESS_UNCLEAR, ComHandleId=5, ComBitSize=1, ComTransferProperty=PENDING
        ECM1_0x111_oECM1_oB30_for_SC_CAN_V3_2_b49cfb6f_Rx: ComBitPosition=0, ComSignalEndianness=opaque, ComSignalInitValue=0 0 0 0 0 0 0 128, ComSignalLength=8, ComSignalType=UINT8_N, ComSignalAccess=ACCESS_NEEDED_BY_SWC_OR_COM, ComHandleId=58, ComNotification=Rte_COMCbk_ECM1_0x111_oECM1_oB30_for_SC_CAN_V3_2_b49cfb6f_Rx, ComTimeoutNotification=Rte_COMCbkRxTOut_ECM1_0x111_oECM1_oB30_for_SC_CAN_V3_2_b49cfb6f_Rx, ComTimeout=0.1, ComSystemTemplateSystemSignalRef=ECM1_0x111
        ECM3_0x371_oECM3_oB30_for_SC_CAN_V3_2_3a68860a_Rx: ComBitPosition=0, ComSignalEndianness=opaque, ComSignalInitValue=0 0 0 0 0 16 128 0, ComSignalLength=8, ComSignalType=UINT8_N, ComSignalAccess=ACCESS_NEEDED_BY_SWC_OR_COM, ComHandleId=60, ComNotification=Rte_COMCbk_ECM3_0x371_oECM3_oB30_for_SC_CAN_V3_2_3a68860a_Rx, ComTimeoutNotification=Rte_COMCbkRxTOut_ECM3_0x371_oECM3_oB30_for_SC_CAN_V3_2_3a68860a_Rx, ComTimeout=1, ComSystemTemplateSystemSignalRef=ECM3_0x371
        HUT2_0x369_oHUT2_oB30_for_SC_CAN_V3_2_101c4259_Tx: ComBitPosition=0, ComSignalEndianness=opaque, ComSignalInitValue=0 82 80 82 16 80 82 0, ComSignalLength=8, ComSignalType=UINT8_N, ComTransferProperty=TRIGGERED, ComSignalAccess=ACCESS_NEEDED_BY_SWC_OR_COM, ComHandleId=10, ComNotification=ComEx_TransmitPdu_HUT2_Confiratmion, ComSystemTemplateSystemSignalRef=HUT2_0x369
        HUT1_0x367_oHUT1_oB30_for_SC_CAN_V3_2_4cf1fae5_Tx: ComBitPosition=0, ComSignalEndianness=opaque, ComSignalInitValue=34 80 0 0 16 1 0 0, ComSignalLength=8, ComSignalType=UINT8_N, ComTransferProperty=TRIGGERED, ComSignalAccess=ACCESS_NEEDED_BY_SWC_OR_COM, ComHandleId=9, ComNotification=ComEx_TransmitPdu_HUT1_Confiratmion, ComSystemTemplateSystemSignalRef=HUT1_0x367
        HUT33_0x1ED_oHUT33_oB30_for_SC_CAN_V3_2_0dfdacd0_Tx: ComBitPosition=0, ComSignalEndianness=opaque, ComSignalInitValue=168 0 0 0 0 0 0 0, ComSignalLength=8, ComSignalType=UINT8_N, ComTransferProperty=TRIGGERED, ComSignalAccess=ACCESS_NEEDED_BY_SWC_OR_COM, ComHandleId=32, ComNotification=ComEx_TransmitPdu_HUT33_Confiratmion, ComSystemTemplateSystemSignalRef=HUT33_0x1ED
        HUT10_0x331_oHUT10_oB30_for_SC_CAN_V3_2_acd87eba_Tx: ComBitPosition=0, ComSignalEndianness=opaque, ComSignalInitValue=0 0 0 1 0 0 0 60, ComSignalLength=8, ComSignalType=UINT8_N, ComTransferProperty=TRIGGERED, ComSignalAccess=ACCESS_NEEDED_BY_SWC_OR_COM, ComHandleId=15, ComNotification=ComEx_TransmitPdu_HUT10_Confiratmion, ComSystemTemplateSystemSignalRef=HUT10_0x331
        HUT25_0x339_oHUT25_oB30_for_SC_CAN_V3_2_1c8c4a71_Tx: ComBitPosition=0, ComSignalEndianness=opaque, ComSignalInitValue=0 0 0 0 0 0 0 0, ComSignalLength=8, ComSignalType=UINT8_N, ComTransferProperty=TRIGGERED, ComSignalAccess=ACCESS_NEEDED_BY_SWC_OR_COM, ComHandleId=26, ComNotification=ComEx_TransmitPdu_HUT25_Confiratmion, ComSystemTemplateSystemSignalRef=HUT25_0x339
        HUT4_0x36D_oHUT4_oB30_for_SC_CAN_V3_2_f3b22adc_Tx: ComBitPosition=0, ComSignalEndianness=opaque, ComSignalInitValue=0 0 32 0 0 0 0 64, ComSignalLength=8, ComSignalType=UINT8_N, ComTransferProperty=TRIGGERED, ComSignalAccess=ACCESS_NEEDED_BY_SWC_OR_COM, ComHandleId=12, ComNotification=ComEx_TransmitPdu_HUT4_Confiratmion, ComSystemTemplateSystemSignalRef=HUT4_0x36D
        HUT17_0x33B_oHUT17_oB30_for_SC_CAN_V3_2_49d9e9b4_Tx: ComBitPosition=0, ComSignalEndianness=opaque, ComSignalInitValue=0 0 64 51 69 0 16 0, ComSignalLength=8, ComSignalType=UINT8_N, ComTransferProperty=TRIGGERED, ComSignalAccess=ACCESS_NEEDED_BY_SWC_OR_COM, ComHandleId=20, ComNotification=ComEx_TransmitPdu_HUT17_Confiratmion, ComSystemTemplateSystemSignalRef=HUT17_0x33B
        HUT32_0x26F_oHUT32_oB30_for_SC_CAN_V3_2_cd38c3b4_Tx: ComBitPosition=0, ComSignalEndianness=opaque, ComSignalInitValue=0 0 255 231 255 0 0 0, ComSignalLength=8, ComSignalType=UINT8_N, ComTransferProperty=PENDING, ComSignalAccess=ACCESS_NEEDED_BY_SWC_OR_COM, ComHandleId=31, ComNotification=ComEx_TransmitPdu_HUT32_Confiratmion, ComSystemTemplateSystemSignalRef=HUT32_0x26F
        ESP8_0x170_oESP8_oB30_for_SC_CAN_V3_2_97b77884_Rx: ComBitPosition=0, ComSignalEndianness=opaque, ComSignalInitValue=0 0 0 0 0 0 0 0, ComSignalLength=8, ComSignalType=UINT8_N, ComSignalAccess=ACCESS_NEEDED_BY_SWC_OR_COM, ComHandleId=77, ComNotification=Rte_COMCbk_ESP8_0x170_oESP8_oB30_for_SC_CAN_V3_2_97b77884_Rx, ComTimeoutNotification=Rte_COMCbkRxTOut_ESP8_0x170_oESP8_oB30_for_SC_CAN_V3_2_97b77884_Rx, ComTimeout=0.2, ComSystemTemplateSystemSignalRef=ESP8_0x170
        CSA1_0x165_oCSA1_oB30_for_SC_CAN_V3_2_432419b3_Rx: ComBitPosition=0, ComSignalEndianness=opaque, ComSignalInitValue=0 0 0 0 0 0 0 0, ComSignalLength=8, ComSignalType=UINT8_N, ComSignalAccess=ACCESS_NEEDED_BY_SWC_OR_COM, ComHandleId=44, ComNotification=Rte_COMCbk_CSA1_0x165_oCSA1_oB30_for_SC_CAN_V3_2_432419b3_Rx, ComTimeoutNotification=Rte_COMCbkRxTOut_CSA1_0x165_oCSA1_oB30_for_SC_CAN_V3_2_432419b3_Rx, ComTimeout=0.2, ComSystemTemplateSystemSignalRef=CSA1_0x165
        AC1_0x29D_oAC1_oB30_for_SC_CAN_V3_2_22980340_Rx: ComBitPosition=0, ComSignalEndianness=opaque, ComSignalInitValue=0 254 224 0 0 0 0 0, ComSignalLength=8, ComSignalType=UINT8_N, ComSignalAccess=ACCESS_NEEDED_BY_SWC_OR_COM, ComHandleId=4, ComNotification=Rte_COMCbk_AC1_0x29D_oAC1_oB30_for_SC_CAN_V3_2_22980340_Rx, ComTimeoutNotification=Rte_COMCbkRxTOut_AC1_0x29D_oAC1_oB30_for_SC_CAN_V3_2_22980340_Rx, ComTimeout=1, ComSystemTemplateSystemSignalRef=AC1_0x29D
        HUD1_0x325_oHUD1_oB30_for_SC_CAN_V3_2_567ca009_Rx: ComBitPosition=0, ComSignalEndianness=opaque, ComSignalInitValue=0 65 40 0 0 0 0 0, ComSignalLength=8, ComSignalType=UINT8_N, ComSignalAccess=ACCESS_NEEDED_BY_SWC_OR_COM, ComHandleId=109, ComNotification=Rte_COMCbk_HUD1_0x325_oHUD1_oB30_for_SC_CAN_V3_2_567ca009_Rx, ComTimeoutNotification=Rte_COMCbkRxTOut_HUD1_0x325_oHUD1_oB30_for_SC_CAN_V3_2_567ca009_Rx, ComTimeout=2, ComSystemTemplateSystemSignalRef=HUD1_0x325
        ECM2_0x271_oECM2_oB30_for_SC_CAN_V3_2_35a250f4_Rx: ComBitPosition=0, ComSignalEndianness=opaque, ComSignalInitValue=0 0 0 0 0 0 4 0, ComSignalLength=8, ComSignalType=UINT8_N, ComSignalAccess=ACCESS_NEEDED_BY_SWC_OR_COM, ComHandleId=59, ComNotification=Rte_COMCbk_ECM2_0x271_oECM2_oB30_for_SC_CAN_V3_2_35a250f4_Rx, ComTimeoutNotification=Rte_COMCbkRxTOut_ECM2_0x271_oECM2_oB30_for_SC_CAN_V3_2_35a250f4_Rx, ComTimeout=0.2, ComSystemTemplateSystemSignalRef=ECM2_0x271
        HCU_PT7_0x248_oHCU_PT7_oB30_for_SC_CAN_V3_2_30a9f673_Rx: ComBitPosition=0, ComSignalEndianness=opaque, ComSignalInitValue=0 0 0 0 0 0 0 0, ComSignalLength=8, ComSignalType=UINT8_N, ComSignalAccess=ACCESS_NEEDED_BY_SWC_OR_COM, ComHandleId=107, ComNotification=Rte_COMCbk_HCU_PT7_0x248_oHCU_PT7_oB30_for_SC_CAN_V3_2_30a9f673_Rx, ComTimeoutNotification=Rte_COMCbkRxTOut_HCU_PT7_0x248_oHCU_PT7_oB30_for_SC_CAN_V3_2_30a9f673_Rx, ComTimeout=0.5, ComSystemTemplateSystemSignalRef=HCU_PT7_0x248
        DDCM1_0x2CA_oDDCM1_oB30_for_SC_CAN_V3_2_0a1045c1_Rx: ComBitPosition=0, ComSignalEndianness=opaque, ComSignalInitValue=0 0 0 0 0 0 0 0, ComSignalLength=8, ComSignalType=UINT8_N, ComSignalAccess=ACCESS_NEEDED_BY_SWC_OR_COM, ComHandleId=50, ComNotification=Rte_COMCbk_DDCM1_0x2CA_oDDCM1_oB30_for_SC_CAN_V3_2_0a1045c1_Rx, ComTimeoutNotification=Rte_COMCbkRxTOut_DDCM1_0x2CA_oDDCM1_oB30_for_SC_CAN_V3_2_0a1045c1_Rx, ComTimeout=1, ComSystemTemplateSystemSignalRef=DDCM1_0x2CA
        HAP_FD3_0x298_oHAP_FD3_oB30_for_SC_CAN_V3_2_22400704_Rx: ComBitPosition=0, ComSignalEndianness=opaque, ComSignalInitValue=0 255 0 0 0 0 0 0 0 0 0 0 0 0 0 0 0 0 0 0 0 0 0 0 0 0 0 0 0 0 7 240 0 0 0 0 0 0 0 0 0 0 0 0 0 0 0 0 0 0 0 0 0 0 0 0 0 0 0 0 0 0 0 0, ComSignalLength=64, ComSignalType=UINT8_N, ComSignalAccess=ACCESS_NEEDED_BY_SWC_OR_COM, ComHandleId=89, ComNotification=Rte_COMCbk_HAP_FD3_0x298_oHAP_FD3_oB30_for_SC_CAN_V3_2_22400704_Rx, ComTimeoutNotification=Rte_COMCbkRxTOut_HAP_FD3_0x298_oHAP_FD3_oB30_for_SC_CAN_V3_2_22400704_Rx, ComTimeout=1, ComSystemTemplateSystemSignalRef=HAP_FD3_0x298
        RSDS_FD1_0x16F_oRSDS_FD1_oB30_for_SC_CAN_V3_2_0c3e88fc_Rx: ComBitPosition=0, ComSignalEndianness=opaque, ComSignalInitValue=0 0 0 0 0 0 0 0 0 0 0 0 0 0 0 0 0 0 0 0 0 0 0 0 0 0 0 0 0 0 0 0 0 0 0 0 0 0 0 0 0 0 0 0 0 0 0 0 0 0 0 0 0 0 0 0 0 0 0 0 0 0 0 0, ComSignalLength=64, ComSignalType=UINT8_N, ComSignalAccess=ACCESS_NEEDED_BY_SWC_OR_COM, ComHandleId=125, ComNotification=Rte_COMCbk_RSDS_FD1_0x16F_oRSDS_FD1_oB30_for_SC_CAN_V3_2_0c3e88fc_Rx, ComTimeoutNotification=Rte_COMCbkRxTOut_RSDS_FD1_0x16F_oRSDS_FD1_oB30_for_SC_CAN_V3_2_0c3e88fc_Rx, ComTimeout=0.2, ComSystemTemplateSystemSignalRef=RSDS_FD1_0x16F
        HCU_PT4_0x2FA_oHCU_PT4_oB30_for_SC_CAN_V3_2_a6c96633_Rx: ComBitPosition=0, ComSignalEndianness=opaque, ComSignalInitValue=0 0 0 0 0 0 4 0, ComSignalLength=8, ComSignalType=UINT8_N, ComSignalAccess=ACCESS_NEEDED_BY_SWC_OR_COM, ComHandleId=105, ComNotification=Rte_COMCbk_HCU_PT4_0x2FA_oHCU_PT4_oB30_for_SC_CAN_V3_2_a6c96633_Rx, ComTimeoutNotification=Rte_COMCbkRxTOut_HCU_PT4_0x2FA_oHCU_PT4_oB30_for_SC_CAN_V3_2_a6c96633_Rx, ComTimeout=1, ComSystemTemplateSystemSignalRef=HCU_PT4_0x2FA
        WPC1_0x2BA_oWPC1_oB30_for_SC_CAN_V3_2_0ada7fde_Rx: ComBitPosition=0, ComSignalEndianness=opaque, ComSignalInitValue=0 0 0 0 0 0 0 0, ComSignalLength=8, ComSignalType=UINT8_N, ComSignalAccess=ACCESS_NEEDED_BY_SWC_OR_COM, ComHandleId=139, ComNotification=Rte_COMCbk_WPC1_0x2BA_oWPC1_oB30_for_SC_CAN_V3_2_0ada7fde_Rx, ComTimeoutNotification=Rte_COMCbkRxTOut_WPC1_0x2BA_oWPC1_oB30_for_SC_CAN_V3_2_0ada7fde_Rx, ComTimeout=1, ComSystemTemplateSystemSignalRef=WPC1_0x2BA
        PEPS2_0x295_oPEPS2_oB30_for_SC_CAN_V3_2_d1207061_Rx: ComBitPosition=0, ComSignalEndianness=opaque, ComSignalInitValue=0 0 0 0 0 0 0 0, ComSignalLength=8, ComSignalType=UINT8_N, ComSignalAccess=ACCESS_NEEDED_BY_SWC_OR_COM, ComHandleId=121, ComNotification=Rte_COMCbk_PEPS2_0x295_oPEPS2_oB30_for_SC_CAN_V3_2_d1207061_Rx, ComTimeoutNotification=Rte_COMCbkRxTOut_PEPS2_0x295_oPEPS2_oB30_for_SC_CAN_V3_2_d1207061_Rx, ComTimeout=0.5, ComSystemTemplateSystemSignalRef=PEPS2_0x295
        HAP_FD1_0x15B_oHAP_FD1_oB30_for_SC_CAN_V3_2_93124709_Rx: ComBitPosition=0, ComSignalEndianness=opaque, ComSignalInitValue=0 0 0 0 0 0 0 0 0 0 0 0 0 254 0 0 0 0 0 0 0 0 0 0 0 0 0 0 0 0 0 0 0 0 0 0 0 0 0 0 0 0 0 0 0 0 0 0 0 0 0 0 0 0 0 0 0 0 0 0 0 0 0 0, ComSignalLength=64, ComSignalType=UINT8_N, ComSignalAccess=ACCESS_NEEDED_BY_SWC_OR_COM, ComHandleId=87, ComNotification=Rte_COMCbk_HAP_FD1_0x15B_oHAP_FD1_oB30_for_SC_CAN_V3_2_93124709_Rx, ComTimeoutNotification=Rte_COMCbkRxTOut_HAP_FD1_0x15B_oHAP_FD1_oB30_for_SC_CAN_V3_2_93124709_Rx, ComTimeout=0.2, ComSystemTemplateSystemSignalRef=HAP_FD1_0x15B
        CSA2_0xA1_oCSA2_oB30_for_SC_CAN_V3_2_7f0f027f_Rx: ComBitPosition=0, ComSignalEndianness=opaque, ComSignalInitValue=0 0 0 0 0 0 0 0, ComSignalLength=8, ComSignalType=UINT8_N, ComSignalAccess=ACCESS_NEEDED_BY_SWC_OR_COM, ComHandleId=45, ComNotification=Rte_COMCbk_CSA2_0xA1_oCSA2_oB30_for_SC_CAN_V3_2_7f0f027f_Rx, ComTimeoutNotification=Rte_COMCbkRxTOut_CSA2_0xA1_oCSA2_oB30_for_SC_CAN_V3_2_7f0f027f_Rx, ComTimeout=0.1, ComSystemTemplateSystemSignalRef=CSA2_0xA1
        DCT5_0x221_oDCT5_oB30_for_SC_CAN_V3_2_6e7f38ea_Rx: ComBitPosition=0, ComSignalEndianness=opaque, ComSignalInitValue=0 0 0 0 0 0 14 0, ComSignalLength=8, ComSignalType=UINT8_N, ComSignalAccess=ACCESS_NEEDED_BY_SWC_OR_COM, ComHandleId=48, ComNotification=Rte_COMCbk_DCT5_0x221_oDCT5_oB30_for_SC_CAN_V3_2_6e7f38ea_Rx, ComTimeoutNotification=Rte_COMCbkRxTOut_DCT5_0x221_oDCT5_oB30_for_SC_CAN_V3_2_6e7f38ea_Rx, ComTimeout=0.2, ComSystemTemplateSystemSignalRef=DCT5_0x221
        PDCM1_0x2CD_oPDCM1_oB30_for_SC_CAN_V3_2_6c5cb461_Rx: ComBitPosition=0, ComSignalEndianness=opaque, ComSignalInitValue=0 0 0 0 0 0 0 0, ComSignalLength=8, ComSignalType=UINT8_N, ComSignalAccess=ACCESS_NEEDED_BY_SWC_OR_COM, ComHandleId=120, ComNotification=Rte_COMCbk_PDCM1_0x2CD_oPDCM1_oB30_for_SC_CAN_V3_2_6c5cb461_Rx, ComTimeoutNotification=Rte_COMCbkRxTOut_PDCM1_0x2CD_oPDCM1_oB30_for_SC_CAN_V3_2_6c5cb461_Rx, ComTimeout=1, ComSystemTemplateSystemSignalRef=PDCM1_0x2CD
        PEPS4_0x302_oPEPS4_oB30_for_SC_CAN_V3_2_97914cf7_Rx: ComBitPosition=0, ComSignalEndianness=opaque, ComSignalInitValue=0 0 0 0 0 0 0 0, ComSignalLength=8, ComSignalType=UINT8_N, ComSignalAccess=ACCESS_NEEDED_BY_SWC_OR_COM, ComHandleId=122, ComNotification=Rte_COMCbk_PEPS4_0x302_oPEPS4_oB30_for_SC_CAN_V3_2_97914cf7_Rx, ComTimeoutNotification=Rte_COMCbkRxTOut_PEPS4_0x302_oPEPS4_oB30_for_SC_CAN_V3_2_97914cf7_Rx, ComTimeout=2, ComSystemTemplateSystemSignalRef=PEPS4_0x302
        BCM8_0x29F_oBCM8_oB30_for_SC_CAN_V3_2_959fd4c6_Rx: ComBitPosition=0, ComSignalEndianness=opaque, ComSignalInitValue=0 0 0 0 0 0 0 0, ComSignalLength=8, ComSignalType=UINT8_N, ComSignalAccess=ACCESS_NEEDED_BY_SWC_OR_COM, ComHandleId=25, ComNotification=Rte_COMCbk_BCM8_0x29F_oBCM8_oB30_for_SC_CAN_V3_2_959fd4c6_Rx, ComTimeoutNotification=Rte_COMCbkRxTOut_BCM8_0x29F_oBCM8_oB30_for_SC_CAN_V3_2_959fd4c6_Rx, ComTimeout=1, ComSystemTemplateSystemSignalRef=BCM8_0x29F
        HAP_FD2_0x274_oHAP_FD2_oB30_for_SC_CAN_V3_2_5363b27c_Rx: ComBitPosition=0, ComSignalEndianness=opaque, ComSignalInitValue=0 0 0 0 0 0 0 0 0 0 0 0 0 0 0 0 0 0 0 0 0 0 0 0 0 0 0 0 0 0 0 0 0 0 0 0 0 0 0 0 0 0 0 0 0 0 0 0 0 0 0 0 0 0 0 0 0 0 0 0 0 0 0 0, ComSignalLength=64, ComSignalType=UINT8_N, ComSignalAccess=ACCESS_NEEDED_BY_SWC_OR_COM, ComHandleId=88, ComNotification=Rte_COMCbk_HAP_FD2_0x274_oHAP_FD2_oB30_for_SC_CAN_V3_2_5363b27c_Rx, ComTimeoutNotification=Rte_COMCbkRxTOut_HAP_FD2_0x274_oHAP_FD2_oB30_for_SC_CAN_V3_2_5363b27c_Rx, ComTimeout=0.5, ComSystemTemplateSystemSignalRef=HAP_FD2_0x274
        IFC_FD3_0x2CF_oIFC_FD3_oB30_for_SC_CAN_V3_2_b81a4d55_Rx: ComBitPosition=0, ComSignalEndianness=opaque, ComSignalInitValue=0 0 0 0 0 0 0 0 0 32 0 0 15 0 0 0 0 0 0 0 0 0 0 0 0 0 0 0 0 0 0 0 0 0 0 0 0 0 0 0 0 0 0 0 0 0 0 0 0 0 0 0 0 0 0 0 0 0 0 0 0 0 0 0, ComSignalLength=64, ComSignalType=UINT8_N, ComSignalAccess=ACCESS_NEEDED_BY_SWC_OR_COM, ComHandleId=112, ComNotification=Rte_COMCbk_IFC_FD3_0x2CF_oIFC_FD3_oB30_for_SC_CAN_V3_2_b81a4d55_Rx, ComTimeoutNotification=Rte_COMCbkRxTOut_IFC_FD3_0x2CF_oIFC_FD3_oB30_for_SC_CAN_V3_2_b81a4d55_Rx, ComTimeout=1, ComSystemTemplateSystemSignalRef=IFC_FD3_0x2CF
        EPB1_0x16B_oEPB1_oB30_for_SC_CAN_V3_2_19631844_Rx: ComBitPosition=0, ComSignalEndianness=opaque, ComSignalInitValue=0 0 0 0 0 0 0 0, ComSignalLength=8, ComSignalType=UINT8_N, ComSignalAccess=ACCESS_NEEDED_BY_SWC_OR_COM, ComHandleId=74, ComNotification=Rte_COMCbk_EPB1_0x16B_oEPB1_oB30_for_SC_CAN_V3_2_19631844_Rx, ComTimeoutNotification=Rte_COMCbkRxTOut_EPB1_0x16B_oEPB1_oB30_for_SC_CAN_V3_2_19631844_Rx, ComTimeout=0.2, ComSystemTemplateSystemSignalRef=EPB1_0x16B
        BMS4_0xF1_oBMS4_oB30_for_SC_CAN_V3_2_ad291777_Rx: ComBitPosition=0, ComSignalEndianness=opaque, ComSignalInitValue=0 0 0 178 0 0 0 0, ComSignalLength=8, ComSignalType=UINT8_N, ComSignalAccess=ACCESS_NEEDED_BY_SWC_OR_COM, ComHandleId=33, ComNotification=Rte_COMCbk_BMS4_0xF1_oBMS4_oB30_for_SC_CAN_V3_2_ad291777_Rx, ComTimeoutNotification=Rte_COMCbkRxTOut_BMS4_0xF1_oBMS4_oB30_for_SC_CAN_V3_2_ad291777_Rx, ComTimeout=0.1, ComSystemTemplateSystemSignalRef=BMS4_0xF1
        HCU_HC7_0x3C2_oHCU_HC7_oB30_for_SC_CAN_V3_2_d59a401d_Rx: ComBitPosition=0, ComSignalEndianness=opaque, ComSignalInitValue=0 0 0 0 0 0 0 0, ComSignalLength=8, ComSignalType=UINT8_N, ComSignalAccess=ACCESS_NEEDED_BY_SWC_OR_COM, ComHandleId=99, ComNotification=Rte_COMCbk_HCU_HC7_0x3C2_oHCU_HC7_oB30_for_SC_CAN_V3_2_d59a401d_Rx, ComTimeoutNotification=Rte_COMCbkRxTOut_HCU_HC7_0x3C2_oHCU_HC7_oB30_for_SC_CAN_V3_2_d59a401d_Rx, ComTimeout=10, ComSystemTemplateSystemSignalRef=HCU_HC7_0x3C2
        ESP11_0xC8_oESP11_oB30_for_SC_CAN_V3_2_b2794d17_Rx: ComBitPosition=0, ComSignalEndianness=opaque, ComSignalInitValue=0 0 0 0 0 0 0 0, ComSignalLength=8, ComSignalType=UINT8_N, ComSignalAccess=ACCESS_NEEDED_BY_SWC_OR_COM, ComHandleId=78, ComNotification=Rte_COMCbk_ESP11_0xC8_oESP11_oB30_for_SC_CAN_V3_2_b2794d17_Rx, ComTimeoutNotification=Rte_COMCbkRxTOut_ESP11_0xC8_oESP11_oB30_for_SC_CAN_V3_2_b2794d17_Rx, ComTimeout=0.1, ComSystemTemplateSystemSignalRef=ESP11_0xC8
        AC2_0x385_oAC2_oB30_for_SC_CAN_V3_2_0cf77687_Rx: ComBitPosition=0, ComSignalEndianness=opaque, ComSignalInitValue=0 15 254 0 66 6 33 0, ComSignalLength=8, ComSignalType=UINT8_N, ComSignalAccess=ACCESS_NEEDED_BY_SWC_OR_COM, ComHandleId=5, ComNotification=Rte_COMCbk_AC2_0x385_oAC2_oB30_for_SC_CAN_V3_2_0cf77687_Rx, ComTimeoutNotification=Rte_COMCbkRxTOut_AC2_0x385_oAC2_oB30_for_SC_CAN_V3_2_0cf77687_Rx, ComTimeout=1, ComSystemTemplateSystemSignalRef=AC2_0x385
        CSA3_0x244_oCSA3_oB30_for_SC_CAN_V3_2_a76b1812_Rx: ComBitPosition=0, ComSignalEndianness=opaque, ComSignalInitValue=0 0 0 0 0 0 0 0, ComSignalLength=8, ComSignalType=UINT8_N, ComSignalAccess=ACCESS_NEEDED_BY_SWC_OR_COM, ComHandleId=46, ComNotification=Rte_COMCbk_CSA3_0x244_oCSA3_oB30_for_SC_CAN_V3_2_a76b1812_Rx, ComTimeoutNotification=Rte_COMCbkRxTOut_CSA3_0x244_oCSA3_oB30_for_SC_CAN_V3_2_a76b1812_Rx, ComTimeout=0.5, ComSystemTemplateSystemSignalRef=CSA3_0x244
        EEM1_0x2A8_oEEM1_oB30_for_SC_CAN_V3_2_a343c1b7_Rx: ComBitPosition=0, ComSignalEndianness=opaque, ComSignalInitValue=0 0 0 0 0 0 0 0, ComSignalLength=8, ComSignalType=UINT8_N, ComSignalAccess=ACCESS_NEEDED_BY_SWC_OR_COM, ComHandleId=72, ComNotification=Rte_COMCbk_EEM1_0x2A8_oEEM1_oB30_for_SC_CAN_V3_2_a343c1b7_Rx, ComTimeoutNotification=Rte_COMCbkRxTOut_EEM1_0x2A8_oEEM1_oB30_for_SC_CAN_V3_2_a343c1b7_Rx, ComTimeout=1, ComSystemTemplateSystemSignalRef=EEM1_0x2A8
        GW_FD1_0x2BB_oGW_FD1_oB30_for_SC_CAN_V3_2_004ea45d_Rx: ComBitPosition=0, ComSignalEndianness=opaque, ComSignalInitValue=0 0 0 0 0 0 0 0 255 255 255 255 0 0 0 0 255 255 0 0 0 0 240 0 0 0 0 0 0 0 0 0 0 0 0 0 0 0 0 0 0 0 0 0 0 0 0 0 0 0 0 0 0 0 0 0 0 0 0 0 0 0 0 0, ComSignalLength=64, ComSignalType=UINT8_N, ComSignalAccess=ACCESS_NEEDED_BY_SWC_OR_COM, ComHandleId=85, ComNotification=Rte_COMCbk_GW_FD1_0x2BB_oGW_FD1_oB30_for_SC_CAN_V3_2_004ea45d_Rx, ComTimeoutNotification=Rte_COMCbkRxTOut_GW_FD1_0x2BB_oGW_FD1_oB30_for_SC_CAN_V3_2_004ea45d_Rx, ComTimeout=1, ComSystemTemplateSystemSignalRef=GW_FD1_0x2BB
        HUT23_0x2D8_oHUT23_oB30_for_SC_CAN_V3_2_f39d4000_Tx: ComBitPosition=0, ComSignalEndianness=opaque, ComSignalInitValue=0 0 0 0 0 0 0 0, ComSignalLength=8, ComSignalType=UINT8_N, ComTransferProperty=TRIGGERED, ComSignalAccess=ACCESS_NEEDED_BY_SWC_OR_COM, ComHandleId=25, ComNotification=ComEx_TransmitPdu_HUT23_Confiratmion, ComSystemTemplateSystemSignalRef=HUT23_0x2D8
        CR_FD1_0x15E_oCR_FD1_oB30_for_SC_CAN_V3_2_779ff2cc_Rx: ComBitPosition=0, ComSignalEndianness=opaque, ComSignalInitValue=0 0 0 0 0 0 0 0 0 0 0 0 0 0 0 0 0 0 0 0 0 0 0 0 0 0 0 0 0 0 0 0 0 0 0 0 0 0 0 0 0 0 0 0 0 0 0 0 0 0 0 0 0 0 0 0 0 0 0 0 0 0 0 0, ComSignalLength=64, ComSignalType=UINT8_N, ComSignalAccess=ACCESS_NEEDED_BY_SWC_OR_COM, ComHandleId=43, ComSystemTemplateSystemSignalRef=CR_FD1_0x15E
        BCM12_0x238_oBCM12_oB30_for_SC_CAN_V3_2_ced434a5_Rx: ComBitPosition=0, ComSignalEndianness=opaque, ComSignalInitValue=0 0 0 0 0 127 127 0, ComSignalLength=8, ComSignalType=UINT8_N, ComSignalAccess=ACCESS_NEEDED_BY_SWC_OR_COM, ComHandleId=27, ComNotification=Rte_COMCbk_BCM12_0x238_oBCM12_oB30_for_SC_CAN_V3_2_ced434a5_Rx, ComTimeoutNotification=Rte_COMCbkRxTOut_BCM12_0x238_oBCM12_oB30_for_SC_CAN_V3_2_ced434a5_Rx, ComTimeout=0.5, ComSystemTemplateSystemSignalRef=BCM12_0x238
        AMP4_ANC1_0x2D2_oAMP4_ANC1_oB30_for_SC_CAN_V3_2_2dfdb3ea_Rx: ComBitPosition=0, ComSignalEndianness=opaque, ComSignalInitValue=0 0 0 0 0 0 0 4, ComSignalLength=8, ComSignalType=UINT8_N, ComSignalAccess=ACCESS_UNCLEAR, ComHandleId=21, ComSystemTemplateSystemSignalRef=AMP4_ANC1_0x2D2
        DSM1_0x2C1_oDSM1_oB30_for_SC_CAN_V3_2_abfa59d6_Rx: ComBitPosition=0, ComSignalEndianness=opaque, ComSignalInitValue=0 0 0 0 0 0 0 0, ComSignalLength=8, ComSignalType=UINT8_N, ComSignalAccess=ACCESS_NEEDED_BY_SWC_OR_COM, ComHandleId=55, ComNotification=Rte_COMCbk_DSM1_0x2C1_oDSM1_oB30_for_SC_CAN_V3_2_abfa59d6_Rx, ComTimeoutNotification=Rte_COMCbkRxTOut_DSM1_0x2C1_oDSM1_oB30_for_SC_CAN_V3_2_abfa59d6_Rx, ComTimeout=1, ComSystemTemplateSystemSignalRef=DSM1_0x2C1
      ACC_FD3_oB30_for_SC_CAN_V3_2_d3df4879_Rx (ComIPdu):
        ComIPduDirection = RECEIVE
        ComIPduType = NORMAL
        ComIPduHandleId = 13
        ComIPduSignalProcessing = DEFERRED
        ComIPduCancellationSupport = false
        ComIPduCallout = ComEx_ReceivePduCallout
        ComIPduGroupRef = HUT_oB30_for_SC_CAN_V3_2_Rx_4400ad35
        ComIPduSignalRef = ACC_FD3_0x2B4_oACC_FD3_oB30_for_SC_CAN_V3_2_adc7888c_Rx
        ComPduIdRef = ACC_FD3_oB30_for_SC_CAN_V3_2_d3df4879_Rx
      3 x ComSignal, all with ComBitPosition=0, ComSignalEndianness=opaque, ComSignalType=UINT8_N, ComSignalAccess=ACCESS_NEEDED_BY_SWC_OR_COM:
        HUT19_0x415_oHUT19_oB30_for_SC_CAN_V3_2_0070b441_Tx: ComSignalInitValue=0 0 0 0 128 0 0 0, ComSignalLength=8, ComTransferProperty=PENDING, ComHandleId=21, ComNotification=ComEx_TransmitPdu_HUT19_Confiratmion, ComSystemTemplateSystemSignalRef=HUT19_0x415
        ABS2_0x246_oABS2_oB30_for_SC_CAN_V3_2_b0714d10_Rx: ComSignalInitValue=0 0 0 0 0 0 0 0, ComSignalLength=8, ComHandleId=3, ComNotification=Rte_COMCbk_ABS2_0x246_oABS2_oB30_for_SC_CAN_V3_2_b0714d10_Rx, ComTimeoutNotification=Rte_COMCbkRxTOut_ABS2_0x246_oABS2_oB30_for_SC_CAN_V3_2_b0714d10_Rx, ComTimeout=0.2, ComSystemTemplateSystemSignalRef=ABS2_0x246
        IFC_FD5_0x19F_oIFC_FD5_oB30_for_SC_CAN_V3_2_ac61e9de_Rx: ComSignalInitValue=0 93 207 161 46 166 0 0 0 93 207 161 46 166 0 0 0 93 207 161 46 166 0 0 0 93 207 161 46 166 0 0 0 93 207 161 46 166 0 0 0 93 207 161 46 166 0 0 0 0 0 0 0 0 0 0 0 0 0 0 0 0 0 0, ComSignalLength=64, ComHandleId=113, ComSystemTemplateSystemSignalRef=IFC_FD5_0x19F
      RSDS_FD2_oB30_for_SC_CAN_V3_2_a1379e70_Rx (ComIPdu):
        ComIPduDirection = RECEIVE
        ComIPduType = NORMAL
        ComIPduHandleId = 127
        ComIPduSignalProcessing = DEFERRED
        ComIPduCancellationSupport = false
        ComIPduCallout = ComEx_ReceivePduCallout
        ComIPduGroupRef = HUT_oB30_for_SC_CAN_V3_2_Rx_4400ad35
        ComIPduSignalRef = RSDS_FD2_0x30A_oRSDS_FD2_oB30_for_SC_CAN_V3_2_3f10f708_Rx
        ComPduIdRef = RSDS_FD2_oB30_for_SC_CAN_V3_2_a1379e70_Rx
      6 x ComSignal, all with ComBitPosition=0, ComSignalEndianness=opaque, ComSignalType=UINT8_N:
        DVR_FD1_0x2EC_oDVR_FD1_oB30_for_SC_CAN_V3_2_5deb10a1_Tx: ComSignalInitValue=0 0 0 0 0 0 0 0 0 0 0 0 0 0 0 0 0 0 0 0 0 0 0 0 0 0 0 0 0 0 0 0 0 0 0 0 0 0 0 0 0 0 0 0 0 0 0 0 0 0 0 0 0 0 0 0 0 0 0 0 0 0 0 0, ComSignalLength=64, ComTransferProperty=PENDING, ComSignalAccess=ACCESS_UNCLEAR, ComHandleId=8, ComNotification=ComEx_TransmitPdu_DVR_FD1_Confiratmion, ComSystemTemplateSystemSignalRef=DVR_FD1_0x2EC
        ACC_FD4_0x2B8_oACC_FD4_oB30_for_SC_CAN_V3_2_b08c3adf_Rx: ComSignalInitValue=255 0 0 0 0 0 0 0 0 0 0 0 0 0 0 255 0 0 0 0 0 0 0 0 0 0 255 0 0 0 0 0 0 0 0 0 0 0 0 255 0 0 0 0 0 0 0 0 0 0 0 0 127 255 127 255 254 252 252 252 0 0 0 0, ComSignalLength=64, ComSignalAccess=ACCESS_NEEDED_BY_SWC_OR_COM, ComHandleId=14, ComSystemTemplateSystemSignalRef=ACC_FD4_0x2B8
        HUT20_0x2DE_oHUT20_oB30_for_SC_CAN_V3_2_fd1a0297_Tx: ComSignalInitValue=0 0 0 0 0 0 0 0, ComSignalLength=8, ComTransferProperty=TRIGGERED, ComSignalAccess=ACCESS_NEEDED_BY_SWC_OR_COM, ComHandleId=22, ComNotification=ComEx_TransmitPdu_HUT20_Confiratmion, ComSystemTemplateSystemSignalRef=HUT20_0x2DE
        IFC1_0x109_oIFC1_oB30_for_SC_CAN_V3_2_1195757e_Rx: ComSignalInitValue=0 112 4 0 127 224 0 0, ComSignalLength=8, ComSignalAccess=ACCESS_UNCLEAR, ComHandleId=110, ComSystemTemplateSystemSignalRef=IFC1_0x109
        RSDS_FD2_0x30A_oRSDS_FD2_oB30_for_SC_CAN_V3_2_3f10f708_Rx: ComSignalInitValue=0 0 0 0 0 0 0 0 0 0 0 0 0 0 0 0 0 0 0 0 0 0 0 0 0 0 0 0 0 0 0 0 0 0 0 0 0 0 0 0 0 0 0 0 0 0 0 0 0 0 0 0 0 0 0 0 0 0 0 0 0 0 0 0, ComSignalLength=64, ComSignalAccess=ACCESS_NEEDED_BY_SWC_OR_COM, ComHandleId=126, ComNotification=Rte_COMCbk_RSDS_FD2_0x30A_oRSDS_FD2_oB30_for_SC_CAN_V3_2_3f10f708_Rx, ComTimeoutNotification=Rte_COMCbkRxTOut_RSDS_FD2_0x30A_oRSDS_FD2_oB30_for_SC_CAN_V3_2_3f10f708_Rx, ComTimeout=2, ComSystemTemplateSystemSignalRef=RSDS_FD2_0x30A
        HUT39_0x1EB_oHUT39_oB30_for_SC_CAN_V3_2_85871b1d_Tx: ComSignalInitValue=0 0 0 0 0 0 0 0, ComSignalLength=8, ComTransferProperty=TRIGGERED, ComSignalAccess=ACCESS_NEEDED_BY_SWC_OR_COM, ComHandleId=38, ComNotification=ComEx_TransmitPdu_HUT39_Confiratmion, ComSystemTemplateSystemSignalRef=HUT39_0x1EB
      IFC1_oB30_for_SC_CAN_V3_2_787af09a_Rx (ComIPdu):
        ComIPduDirection = RECEIVE
        ComIPduType = NORMAL
        ComIPduHandleId = 111
        ComIPduSignalProcessing = DEFERRED
        ComIPduCancellationSupport = false
        ComIPduCallout = ComEx_ReceivePduCallout
        ComIPduGroupRef = HUT_oB30_for_SC_CAN_V3_2_Rx_4400ad35
        ComIPduSignalRef = IFC1_0x109_oIFC1_oB30_for_SC_CAN_V3_2_1195757e_Rx
        ComPduIdRef = IFC1_oB30_for_SC_CAN_V3_2_787af09a_Rx
      HUT21_0x2DD_oHUT21_oB30_for_SC_CAN_V3_2_46aba8bb_Tx (ComSignal):
        ComBitPosition = 0
        ComSignalEndianness = opaque
        ComSignalInitValue = 0 0 0 0 192 0 0 0
        ComSignalLength = 8
        ComSignalType = UINT8_N
        ComTransferProperty = TRIGGERED
        ComSignalAccess = ACCESS_NEEDED_BY_SWC_OR_COM
        ComHandleId = 23
        ComNotification = ComEx_TransmitPdu_HUT21_Confiratmion
        ComSystemTemplateSystemSignalRef = HUT21_0x2DD
      ECM7_0x84_oECM7_oB30_for_SC_CAN_V3_2_ca9b1546_Rx (ComSignal):
        ComBitPosition = 0
        ComSignalEndianness = opaque
        ComSignalInitValue = 0 0 0 127 255 0 0 64
        ComSignalLength = 8
        ComSignalType = UINT8_N
        ComSignalAccess = ACCESS_UNCLEAR
        ComHandleId = 62
        ComSystemTemplateSystemSignalRef = ECM7_0x84
      DVR_FD1_oB30_for_SC_CAN_V3_2_e61bae2e_Tx (ComIPdu):
        ComIPduDirection = SEND
        ComIPduType = NORMAL
        ComIPduHandleId = 2
        ComIPduSignalProcessing = DEFERRED
        ComIPduCancellationSupport = false
        ComIPduCallout = ComEx_TransmitPduCallout
        ComIPduGroupRef = HUT_oB30_for_SC_CAN_V3_2_Tx_125a0ab3
        ComIPduSignalRef = DVR_FD1_0x2EC_oDVR_FD1_oB30_for_SC_CAN_V3_2_5deb10a1_Tx
        ComPduIdRef = DVR_FD1_oB30_for_SC_CAN_V3_2_e61bae2e_Tx
        ComIPduGroupRef = HUT_oB30_for_SC_CAN_V3_2_Tx_HEV
        ComTxIPdu: ComMinimumDelayTime=0, ComTxIPduUnusedAreasDefault=0
          ComTxModeTrue
            ComTxMode: ComTxModeMode=PERIODIC, ComTxModeTimePeriod=0.1, ComTxModeTimeOffset=0
          ComTxModeFalse
            ComTxMode: ComTxModeMode=PERIODIC, ComTxModeTimePeriod=0.1, ComTxModeTimeOffset=0
      AMP3_0x3E5_oAMP3_oB30_for_SC_CAN_V3_2_cac874de_Rx (ComSignal):
        ComBitPosition = 0
        ComSignalEndianness = opaque
        ComSignalInitValue = 40 40 40 40 60 4 0 0
        ComSignalLength = 8
        ComSignalType = UINT8_N
        ComSignalAccess = ACCESS_NEEDED_BY_SWC_OR_COM
        ComHandleId = 20
        ComNotification = Rte_COMCbk_AMP3_0x3E5_oAMP3_oB30_for_SC_CAN_V3_2_cac874de_Rx
        ComSystemTemplateSystemSignalRef = AMP3_0x3E5
      HUT34_0x370_oHUT34_oB30_for_SC_CAN_V3_2_f661979e_Tx (ComSignal):
        ComBitPosition = 0
        ComSignalEndianness = opaque
        ComSignalInitValue = 0 248 252 252 255 0 0 0
        ComSignalLength = 8
        ComSignalType = UINT8_N
        ComTransferProperty = PENDING
        ComSignalAccess = ACCESS_NEEDED_BY_SWC_OR_COM
        ComHandleId = 33
        ComNotification = ComEx_TransmitPdu_HUT34_Confiratmion
        ComSystemTemplateSystemSignalRef = HUT34_0x370
      HUT39_oB30_for_SC_CAN_V3_2_dc19868c_Tx (ComIPdu):
        ComIPduDirection = SEND
        ComIPduType = NORMAL
        ComIPduHandleId = 32
        ComIPduSignalProcessing = DEFERRED
        ComIPduCancellationSupport = false
        ComIPduCallout = ComEx_TransmitPduCallout
        ComIPduGroupRef = HUT_oB30_for_SC_CAN_V3_2_Tx_125a0ab3
        ComIPduSignalRef = HUT39_0x1EB_oHUT39_oB30_for_SC_CAN_V3_2_85871b1d_Tx
        ComPduIdRef = HUT39_oB30_for_SC_CAN_V3_2_dc19868c_Tx
        ComIPduGroupRef = HUT_oB30_for_SC_CAN_V3_2_Tx_HEV
        ComTxIPdu: ComMinimumDelayTime=0.045, ComTxIPduUnusedAreasDefault=0
          ComTxModeTrue
            ComTxMode: ComTxModeMode=NONE, ComTxModeNumberOfRepetitions=0, ComTxModeRepetitionPeriod=0
          ComTxModeFalse
            ComTxMode: ComTxModeMode=NONE, ComTxModeNumberOfRepetitions=0, ComTxModeRepetitionPeriod=0
      ACC_FD4_oB30_for_SC_CAN_V3_2_b6067639_Rx (ComIPdu):
        ComIPduDirection = RECEIVE
        ComIPduType = NORMAL
        ComIPduHandleId = 14
        ComIPduSignalProcessing = DEFERRED
        ComIPduCancellationSupport = false
        ComIPduCallout = ComEx_ReceivePduCallout
        ComIPduGroupRef = HUT_oB30_for_SC_CAN_V3_2_Rx_4400ad35
        ComIPduSignalRef = ACC_FD4_0x2B8_oACC_FD4_oB30_for_SC_CAN_V3_2_b08c3adf_Rx
        ComPduIdRef = ACC_FD4_oB30_for_SC_CAN_V3_2_b6067639_Rx
      4 x ComSignal, all with ComBitPosition=0, ComSignalEndianness=opaque, ComSignalLength=8, ComSignalType=UINT8_N:
        ABS1_0x231_oABS1_oB30_for_SC_CAN_V3_2_12e0e9e4_Rx: ComSignalInitValue=0 0 0 0 0 0 0 0, ComSignalAccess=ACCESS_NEEDED_BY_SWC_OR_COM, ComHandleId=2, ComNotification=Rte_COMCbk_ABS1_0x231_oABS1_oB30_for_SC_CAN_V3_2_12e0e9e4_Rx, ComTimeoutNotification=Rte_COMCbkRxTOut_ABS1_0x231_oABS1_oB30_for_SC_CAN_V3_2_12e0e9e4_Rx, ComTimeout=0.2, ComSystemTemplateSystemSignalRef=ABS1_0x231
        ECM9_0x102_oECM9_oB30_for_SC_CAN_V3_2_93658c9d_Rx: ComSignalInitValue=0 0 0 0 0 0 0 0, ComSignalAccess=ACCESS_UNCLEAR, ComHandleId=63, ComSystemTemplateSystemSignalRef=ECM9_0x102
        HUT13_0x31C_oHUT13_oB30_for_SC_CAN_V3_2_86243622_Tx: ComSignalInitValue=0 1 0 0 0 0 0 0, ComTransferProperty=PENDING, ComSignalAccess=ACCESS_NEEDED_BY_SWC_OR_COM, ComHandleId=17, ComNotification=ComEx_TransmitPdu_HUT13_Confiratmion, ComSystemTemplateSystemSignalRef=HUT13_0x31C
        AMP1_0x3E1_oAMP1_oB30_for_SC_CAN_V3_2_ab4beb46_Rx: ComSignalInitValue=0 0 0 0 0 0 32 0, ComSignalAccess=ACCESS_UNCLEAR, ComHandleId=18, ComSystemTemplateSystemSignalRef=AMP1_0x3E1
      IFC_FD6_oB30_for_SC_CAN_V3_2_9a342755_Rx (ComIPdu):
        ComIPduDirection = RECEIVE
        ComIPduType = NORMAL
        ComIPduHandleId = 115
        ComIPduSignalProcessing = DEFERRED
        ComIPduCancellationSupport = false
        ComIPduCallout = ComEx_ReceivePduCallout
        ComIPduGroupRef = HUT_oB30_for_SC_CAN_V3_2_Rx_4400ad35
        ComIPduSignalRef = IFC_FD6_0x222_oIFC_FD6_oB30_for_SC_CAN_V3_2_6311fcf7_Rx
        ComPduIdRef = IFC_FD6_oB30_for_SC_CAN_V3_2_9a342755_Rx
      8 x ComSignal, all with ComBitPosition=0, ComSignalEndianness=opaque, ComSignalType=UINT8_N:
        HUT3_0x36B_oHUT3_oB30_for_SC_CAN_V3_2_6c58ad50_Tx: ComSignalInitValue=40 40 40 40 0 8 0 0, ComSignalLength=8, ComTransferProperty=TRIGGERED, ComSignalAccess=ACCESS_NEEDED_BY_SWC_OR_COM, ComHandleId=11, ComNotification=ComEx_TransmitPdu_HUT3_Confiratmion, ComSystemTemplateSystemSignalRef=HUT3_0x36B
        IFC_FD6_0x222_oIFC_FD6_oB30_for_SC_CAN_V3_2_6311fcf7_Rx: ComSignalInitValue=0 0 0 0 1 146 201 0 0 0 0 0 0 0 0 0 0 0 0 201 0 0 201 0 0 0 0 0 0 0 0 0 0 100 128 0 0 0 201 0 0 0 0 0 0 0 0 0 0 0 0 0 0 0 0 0 0 0 0 0 0 0 0 0, ComSignalLength=64, ComSignalAccess=ACCESS_NEEDED_BY_SWC_OR_COM, ComHandleId=114, ComSystemTemplateSystemSignalRef=IFC_FD6_0x222
        ECM4_0x82_oECM4_oB30_for_SC_CAN_V3_2_ad48075d_Rx: ComSignalInitValue=0 127 255 127 255 0 0 128, ComSignalLength=8, ComSignalAccess=ACCESS_UNCLEAR, ComHandleId=61, ComSystemTemplateSystemSignalRef=ECM4_0x82
        HUT16_0x348_oHUT16_oB30_for_SC_CAN_V3_2_6a07ebf7_Tx: ComSignalInitValue=0 0 0 0 128 0 0 0, ComSignalLength=8, ComTransferProperty=PENDING, ComSignalAccess=ACCESS_NEEDED_BY_SWC_OR_COM, ComHandleId=19, ComNotification=ComEx_TransmitPdu_HUT16_Confiratmion, ComSystemTemplateSystemSignalRef=HUT16_0x348
        HUT6_0x4A_oHUT6_oB30_for_SC_CAN_V3_2_d227f5be_Tx: ComSignalInitValue=0 0 0 0 0 0 0 0, ComSignalLength=8, ComTransferProperty=TRIGGERED, ComSignalAccess=ACCESS_NEEDED_BY_SWC_OR_COM, ComHandleId=13, ComNotification=ComEx_TransmitPdu_HUT6_Confiratmion, ComSystemTemplateSystemSignalRef=HUT6_0x4A
        ABM2_0x245_oABM2_oB30_for_SC_CAN_V3_2_17c6621a_Rx: ComSignalInitValue=0 86 17 86 17 34 17 0, ComSignalLength=8, ComSignalAccess=ACCESS_UNCLEAR, ComHandleId=1, ComSystemTemplateSystemSignalRef=ABM2_0x245
        HUT30_0x1E9_oHUT30_oB30_for_SC_CAN_V3_2_037aee47_Tx: ComSignalInitValue=0 0 0 0 21 85 111 255, ComSignalLength=8, ComTransferProperty=TRIGGERED, ComSignalAccess=ACCESS_NEEDED_BY_SWC_OR_COM, ComHandleId=29, ComNotification=ComEx_TransmitPdu_HUT30_Confiratmion, ComSystemTemplateSystemSignalRef=HUT30_0x1E9
        ECM11_0x2D3_oECM11_oB30_for_SC_CAN_V3_2_a1715d7d_Rx: ComSignalInitValue=0 0 0 0 0 0 0 0, ComSignalLength=8, ComSignalAccess=ACCESS_NEEDED_BY_SWC_OR_COM, ComHandleId=64, ComNotification=Rte_COMCbk_ECM11_0x2D3_oECM11_oB30_for_SC_CAN_V3_2_a1715d7d_Rx, ComTimeoutNotification=Rte_COMCbkRxTOut_ECM11_0x2D3_oECM11_oB30_for_SC_CAN_V3_2_a1715d7d_Rx, ComTimeout=1, ComSystemTemplateSystemSignalRef=ECM11_0x2D3
      IFC_FD5_oB30_for_SC_CAN_V3_2_a34c8a15_Rx (ComIPdu):
        ComIPduDirection = RECEIVE
        ComIPduType = NORMAL
        ComIPduHandleId = 114
        ComIPduSignalProcessing = DEFERRED
        ComIPduCancellationSupport = false
        ComIPduCallout = ComEx_ReceivePduCallout
        ComIPduGroupRef = HUT_oB30_for_SC_CAN_V3_2_Rx_4400ad35
        ComIPduSignalRef = IFC_FD5_0x19F_oIFC_FD5_oB30_for_SC_CAN_V3_2_ac61e9de_Rx
        ComPduIdRef = IFC_FD5_oB30_for_SC_CAN_V3_2_a34c8a15_Rx
      HUT22_0x2DA_oHUT22_oB30_for_SC_CAN_V3_2_c0698017_Tx (ComSignal):
        ComBitPosition = 0
        ComSignalEndianness = opaque
        ComSignalInitValue = 0 0 0 0 0 0 0 0
        ComSignalLength = 8
        ComSignalType = UINT8_N
        ComTransferProperty = TRIGGERED
        ComSignalAccess = ACCESS_NEEDED_BY_SWC_OR_COM
        ComHandleId = 24
        ComNotification = ComEx_TransmitPdu_HUT22_Confiratmion
        ComSystemTemplateSystemSignalRef = HUT22_0x2DA
      ECM20_0x3B7_oECM20_oB30_for_SC_CAN_V3_2_bb09ac86_Rx (ComSignal):
        ComBitPosition = 0
        ComSignalEndianness = opaque
        ComSignalInitValue = 0 0 0 0 0 0 0 0
        ComSignalLength = 8
        ComSignalType = UINT8_N
        ComSignalAccess = ACCESS_UNCLEAR
        ComHandleId = 67
        ComSystemTemplateSystemSignalRef = ECM20_0x3B7
      CR_FD1_oB30_for_SC_CAN_V3_2_da926426_Rx (ComIPdu):
        ComIPduDirection = RECEIVE
        ComIPduType = NORMAL
        ComIPduHandleId = 43
        ComIPduSignalProcessing = DEFERRED
        ComIPduCancellationSupport = false
        ComIPduCallout = ComEx_ReceivePduCallout
        ComIPduGroupRef = HUT_oB30_for_SC_CAN_V3_2_Rx_4400ad35
        ComIPduSignalRef = CR_FD1_0x15E_oCR_FD1_oB30_for_SC_CAN_V3_2_779ff2cc_Rx
        ComPduIdRef = CR_FD1_oB30_for_SC_CAN_V3_2_da926426_Rx
      3 x ComSignal, all with ComBitPosition=0, ComSignalEndianness=opaque, ComSignalType=UINT8_N:
        AEB_FD1_0x18B_oAEB_FD1_oB30_for_SC_CAN_V3_2_88d04ffa_Rx: ComSignalInitValue=0 0 0 0 0 0 0 0 0 0 0 0 0 0 0 0 0 0 0 0 0 0 0 0 0 0 0 0 0 0 0 0 0 0 0 0 0 0 0 0 0 0 0 0 0 0 0 0 0 0 0 0 0 0 0 0 0 0 0 0 0 0 0 0, ComSignalLength=64, ComSignalAccess=ACCESS_UNCLEAR, ComHandleId=15, ComSystemTemplateSystemSignalRef=AEB_FD1_0x18B
        ACC_FD3_0x2B4_oACC_FD3_oB30_for_SC_CAN_V3_2_adc7888c_Rx: ComSignalInitValue=0 0 0 0 0 0 0 0 0 255 0 0 0 0 255 0 0 0 0 0 0 0 0 0 0 0 0 0 0 0 0 0 0 0 0 0 0 0 0 0 0 0 0 0 0 0 0 0 0 0 0 0 0 0 0 0 0 0 0 0 0 0 0 0, ComSignalLength=64, ComSignalAccess=ACCESS_NEEDED_BY_SWC_OR_COM, ComHandleId=13, ComNotification=Rte_COMCbk_ACC_FD3_0x2B4_oACC_FD3_oB30_for_SC_CAN_V3_2_adc7888c_Rx, ComTimeoutNotification=Rte_COMCbkRxTOut_ACC_FD3_0x2B4_oACC_FD3_oB30_for_SC_CAN_V3_2_adc7888c_Rx, ComTimeout=1, ComSystemTemplateSystemSignalRef=ACC_FD3_0x2B4
        DCT3_0xA6_oDCT3_oB30_for_SC_CAN_V3_2_f1cd20ee_Rx: ComSignalInitValue=0 0 0 0 0 0 0 0, ComSignalLength=8, ComSignalAccess=ACCESS_NEEDED_BY_SWC_OR_COM, ComHandleId=47, ComNotification=Rte_COMCbk_DCT3_0xA6_oDCT3_oB30_for_SC_CAN_V3_2_f1cd20ee_Rx, ComTimeoutNotification=Rte_COMCbkRxTOut_DCT3_0xA6_oDCT3_oB30_for_SC_CAN_V3_2_f1cd20ee_Rx, ComTimeout=0.1, ComSystemTemplateSystemSignalRef=DCT3_0xA6
      3 x ComIPdu, all with ComIPduType=NORMAL, ComIPduSignalProcessing=DEFERRED, ComIPduCancellationSupport=false:
        HUT_FD2_oB30_for_SC_CAN_V3_2_5851ef80_Tx: ComIPduDirection=SEND, ComIPduHandleId=41, ComIPduCallout=ComEx_TransmitPduCallout, ComIPduGroupRef=HUT_oB30_for_SC_CAN_V3_2_Tx_125a0ab3, ComIPduSignalRef=HUT_FD2_0x203_oHUT_FD2_oB30_for_SC_CAN_V3_2_3a1f5203_Tx, ComPduIdRef=HUT_FD2_oB30_for_SC_CAN_V3_2_5851ef80_Tx, ComIPduGroupRef=HUT_oB30_for_SC_CAN_V3_2_Tx_HEV
          ComTxIPdu: ComMinimumDelayTime=0, ComTxIPduUnusedAreasDefault=0
            ComTxModeTrue
              ComTxMode: ComTxModeMode=PERIODIC, ComTxModeTimePeriod=0.05, ComTxModeTimeOffset=0
            ComTxModeFalse
              ComTxMode: ComTxModeMode=PERIODIC, ComTxModeTimePeriod=0.05, ComTxModeTimeOffset=0
        HAP_FD6_oB30_for_SC_CAN_V3_2_11512a4e_Rx: ComIPduDirection=RECEIVE, ComIPduHandleId=91, ComIPduCallout=ComEx_ReceivePduCallout, ComIPduGroupRef=HUT_oB30_for_SC_CAN_V3_2_Rx_4400ad35, ComIPduSignalRef=HAP_FD6_0x289_oHAP_FD6_oB30_for_SC_CAN_V3_2_78575c1f_Rx, ComPduIdRef=HAP_FD6_oB30_for_SC_CAN_V3_2_11512a4e_Rx
        HUT_FD3_oB30_for_SC_CAN_V3_2_4f798b40_Tx: ComIPduDirection=SEND, ComIPduHandleId=42, ComIPduCallout=ComEx_TransmitPduCallout, ComIPduGroupRef=HUT_oB30_for_SC_CAN_V3_2_Tx_125a0ab3, ComIPduSignalRef=HUT_FD3_0x243_oHUT_FD3_oB30_for_SC_CAN_V3_2_dc4d3bf6_Tx, ComPduIdRef=HUT_FD3_oB30_for_SC_CAN_V3_2_4f798b40_Tx, ComIPduGroupRef=HUT_oB30_for_SC_CAN_V3_2_Tx_HEV
          ComTxIPdu: ComMinimumDelayTime=0, ComTxIPduUnusedAreasDefault=0
            ComTxModeTrue
              ComTxMode: ComTxModeMode=PERIODIC, ComTxModeTimePeriod=0.05, ComTxModeTimeOffset=0
            ComTxModeFalse
              ComTxMode: ComTxModeMode=PERIODIC, ComTxModeTimePeriod=0.05, ComTxModeTimeOffset=0
      HAP_FD6_0x289_oHAP_FD6_oB30_for_SC_CAN_V3_2_78575c1f_Rx (ComSignal):
        ComBitPosition = 0
        ComSignalEndianness = opaque
        ComSignalInitValue = 0 0 0 0 0 0 0 0 0 0 0 0 0 0 0 0 0 0 0 0 0 0 0 0 0 0 0 0 0 0 0 0 0 0 0 0 0 0 0 0 0 0 0 0 0 0 0 0 0 0 0 0 0 0 0 0 0 0 0 0 0 0 0 0
        ComSignalLength = 64
        ComSignalType = UINT8_N
        ComSignalAccess = ACCESS_UNCLEAR
        ComHandleId = 90
        ComSystemTemplateSystemSignalRef = HAP_FD6_0x289
      BCM1_oB30_for_SC_CAN_V3_2_64cc1f5a_Rx (ComIPdu):
        ComIPduDirection = RECEIVE
        ComIPduType = NORMAL
        ComIPduHandleId = 22
        ComIPduSignalProcessing = DEFERRED
        ComIPduCancellationSupport = false
        ComIPduCallout = ComEx_ReceivePduCallout
        ComIPduGroupRef = HUT_oB30_for_SC_CAN_V3_2_Rx_4400ad35
        ComIPduSignalRef = BCM1_0x319_oBCM1_oB30_for_SC_CAN_V3_2_3b9040e0_Rx
        ComPduIdRef = BCM1_oB30_for_SC_CAN_V3_2_64cc1f5a_Rx
      AEB_FD2_0x227_oAEB_FD2_oB30_for_SC_CAN_V3_2_b89db7a8_Rx (ComSignal):
        ComBitPosition = 0
        ComSignalEndianness = opaque
        ComSignalInitValue = 0 0 0 0 0 0 0 0 0 0 0 0 0 0 0 0 0 0 0 0 0 0 0 0 0 0 0 0 0 0 0 0 0 0 0 0 0 0 0 0 0 0 0 0 0 0 0 0 0 0 0 0 0 0 0 0
        ComSignalLength = 56
        ComSignalType = UINT8_N
        ComSignalAccess = ACCESS_NEEDED_BY_SWC_OR_COM
        ComHandleId = 16
        ComNotification = Rte_COMCbk_AEB_FD2_0x227_oAEB_FD2_oB30_for_SC_CAN_V3_2_b89db7a8_Rx
        ComTimeoutNotification = Rte_COMCbkRxTOut_AEB_FD2_0x227_oAEB_FD2_oB30_for_SC_CAN_V3_2_b89db7a8_Rx
        ComTimeout = 0.5
        ComSystemTemplateSystemSignalRef = AEB_FD2_0x227
      AMP2_oB30_for_SC_CAN_V3_2_908de48a_Rx (ComIPdu):
        ComIPduDirection = RECEIVE
        ComIPduType = NORMAL
        ComIPduHandleId = 19
        ComIPduSignalProcessing = DEFERRED
        ComIPduCancellationSupport = false
        ComIPduCallout = ComEx_ReceivePduCallout
        ComIPduGroupRef = HUT_oB30_for_SC_CAN_V3_2_Rx_4400ad35
        ComIPduSignalRef = AMP2_0x3E3_oAMP2_oB30_for_SC_CAN_V3_2_fcde4f66_Rx
        ComPduIdRef = AMP2_oB30_for_SC_CAN_V3_2_908de48a_Rx
      IFC_FD2_0x23D_oIFC_FD2_oB30_for_SC_CAN_V3_2_6083e7b7_Rx (ComSignal):
        ComBitPosition = 0
        ComSignalEndianness = opaque
        ComSignalInitValue = 0 0 0 0 0 0 0 0 0 0 0 0 0 0 0 0 0 0 0 0 0 0 0 0 0 0 0 0 0 0 0 0 0 0 0 0 0 0 0 0 0 0 0 0 0 0 0 0 0 0 0 0 0 0 0 0
        ComSignalLength = 56
        ComSignalType = UINT8_N
        ComSignalAccess = ACCESS_NEEDED_BY_SWC_OR_COM
        ComHandleId = 111
        ComNotification = Rte_COMCbk_IFC_FD2_0x23D_oIFC_FD2_oB30_for_SC_CAN_V3_2_6083e7b7_Rx
        ComTimeoutNotification = Rte_COMCbkRxTOut_IFC_FD2_0x23D_oIFC_FD2_oB30_for_SC_CAN_V3_2_6083e7b7_Rx
        ComTimeout = 0.5
        ComSystemTemplateSystemSignalRef = IFC_FD2_0x23D
      TPMS1_oB30_for_SC_CAN_V3_2_c5efa96f_Rx (ComIPdu):
        ComIPduDirection = RECEIVE
        ComIPduType = NORMAL
        ComIPduHandleId = 131
        ComIPduSignalProcessing = DEFERRED
        ComIPduCancellationSupport = false
        ComIPduCallout = ComEx_ReceivePduCallout
        ComIPduGroupRef = HUT_oB30_for_SC_CAN_V3_2_Rx_4400ad35
        ComIPduSignalRef = TPMS1_0x341_oTPMS1_oB30_for_SC_CAN_V3_2_7481a0ed_Rx
        ComPduIdRef = TPMS1_oB30_for_SC_CAN_V3_2_c5efa96f_Rx
      ESP_FD2_0x137_oESP_FD2_oB30_for_SC_CAN_V3_2_bc62acd8_Rx (ComSignal):
        ComBitPosition = 0
        ComSignalEndianness = opaque
        ComSignalInitValue = 0 0 0 0 0 0 0 0 0 0 0 0 0 0 0 0 0 0 0 0 0 0 0 0 0 0 0 0 0 0 0 0 0 0 0 0 0 0 0 0 0 0 0 0 0 0 0 0 0 0 0 0 0 0 0 0
        ComSignalLength = 56
        ComSignalType = UINT8_N
        ComSignalAccess = ACCESS_NEEDED_BY_SWC_OR_COM
        ComHandleId = 79
        ComNotification = Rte_COMCbk_ESP_FD2_0x137_oESP_FD2_oB30_for_SC_CAN_V3_2_bc62acd8_Rx
        ComTimeoutNotification = Rte_COMCbkRxTOut_ESP_FD2_0x137_oESP_FD2_oB30_for_SC_CAN_V3_2_bc62acd8_Rx
        ComTimeout = 0.2
        ComSystemTemplateSystemSignalRef = ESP_FD2_0x137
      ESP_FD2_oB30_for_SC_CAN_V3_2_c451c518_Rx (ComIPdu):
        ComIPduDirection = RECEIVE
        ComIPduType = NORMAL
        ComIPduHandleId = 79
        ComIPduSignalProcessing = DEFERRED
        ComIPduCancellationSupport = false
        ComIPduCallout = ComEx_ReceivePduCallout
        ComIPduGroupRef = HUT_oB30_for_SC_CAN_V3_2_Rx_4400ad35
        ComIPduSignalRef = ESP_FD2_0x137_oESP_FD2_oB30_for_SC_CAN_V3_2_bc62acd8_Rx
        ComPduIdRef = ESP_FD2_oB30_for_SC_CAN_V3_2_c451c518_Rx
      HUT_FD1_oB30_for_SC_CAN_V3_2_612942c0_Tx (ComIPdu):
        ComIPduDirection = SEND
        ComIPduType = NORMAL
        ComIPduHandleId = 40
        ComIPduSignalProcessing = DEFERRED
        ComIPduCancellationSupport = false
        ComIPduCallout = ComEx_TransmitPduCallout
        ComIPduGroupRef = HUT_oB30_for_SC_CAN_V3_2_Tx_125a0ab3
        ComIPduSignalRef = HUT_FD1_0x2C3_oHUT_FD1_oB30_for_SC_CAN_V3_2_c297c003_Tx
        ComPduIdRef = HUT_FD1_oB30_for_SC_CAN_V3_2_612942c0_Tx
        ComIPduGroupRef = HUT_oB30_for_SC_CAN_V3_2_Tx_HEV
        ComTxIPdu: ComMinimumDelayTime=0, ComTxIPduUnusedAreasDefault=0
          ComTxModeTrue
            ComTxMode: ComTxModeMode=PERIODIC, ComTxModeTimePeriod=0.1, ComTxModeTimeOffset=0
          ComTxModeFalse
            ComTxMode: ComTxModeMode=PERIODIC, ComTxModeTimePeriod=0.1, ComTxModeTimeOffset=0
      HUT_FD1_0x2C3_oHUT_FD1_oB30_for_SC_CAN_V3_2_c297c003_Tx (ComSignal):
        ComBitPosition = 0
        ComSignalEndianness = opaque
        ComSignalInitValue = 0 0 0 0 0 0 0 0 0 0 0 0 0 0 0 0 0 0 0 0 0 0 0 0 0 0 0 0 0 0 0 0 0 0 0 0 0 0 0 0 0 0 0 0 0 0 0 0 0 0 0 0 0 0 0 0
        ComSignalLength = 56
        ComSignalType = UINT8_N
        ComTransferProperty = PENDING
        ComSignalAccess = ACCESS_NEEDED_BY_SWC_OR_COM
        ComHandleId = 46
        ComNotification = ComEx_TransmitPdu_HUT_FD1_Confiratmion
        ComSystemTemplateSystemSignalRef = HUT_FD1_0x2C3
      7 x ComIPdu, all with ComIPduType=NORMAL, ComIPduSignalProcessing=DEFERRED, ComIPduCancellationSupport=false:
        BCM3_oB30_for_SC_CAN_V3_2_4a9cd6da_Rx: ComIPduDirection=RECEIVE, ComIPduHandleId=23, ComIPduCallout=ComEx_ReceivePduCallout, ComIPduGroupRef=HUT_oB30_for_SC_CAN_V3_2_Rx_4400ad35, ComIPduSignalRef=BCM3_0x345_oBCM3_oB30_for_SC_CAN_V3_2_63d58c65_Rx, ComPduIdRef=BCM3_oB30_for_SC_CAN_V3_2_4a9cd6da_Rx
        TPMS2_oB30_for_SC_CAN_V3_2_fc97042f_Rx: ComIPduDirection=RECEIVE, ComIPduHandleId=132, ComIPduCallout=ComEx_ReceivePduCallout, ComIPduGroupRef=HUT_oB30_for_SC_CAN_V3_2_Rx_4400ad35, ComIPduSignalRef=TPMS2_0x395_oTPMS2_oB30_for_SC_CAN_V3_2_64d1204c_Rx, ComPduIdRef=TPMS2_oB30_for_SC_CAN_V3_2_fc97042f_Rx
        AEB_FD2_oB30_for_SC_CAN_V3_2_9fb3d7e9_Rx: ComIPduDirection=RECEIVE, ComIPduHandleId=16, ComIPduCallout=ComEx_ReceivePduCallout, ComIPduGroupRef=HUT_oB30_for_SC_CAN_V3_2_Rx_4400ad35, ComIPduSignalRef=AEB_FD2_0x227_oAEB_FD2_oB30_for_SC_CAN_V3_2_b89db7a8_Rx, ComPduIdRef=AEB_FD2_oB30_for_SC_CAN_V3_2_9fb3d7e9_Rx
        ACC_FD2_oB30_for_SC_CAN_V3_2_c4f72cb9_Rx: ComIPduDirection=RECEIVE, ComIPduHandleId=12, ComIPduCallout=ComEx_ReceivePduCallout, ComIPduGroupRef=HUT_oB30_for_SC_CAN_V3_2_Rx_4400ad35, ComIPduSignalRef=ACC_FD2_0x2AB_oACC_FD2_oB30_for_SC_CAN_V3_2_33ba28b9_Rx, ComPduIdRef=ACC_FD2_oB30_for_SC_CAN_V3_2_c4f72cb9_Rx
        ABM1_oB30_for_SC_CAN_V3_2_d004cc2e_Rx: ComIPduDirection=RECEIVE, ComIPduHandleId=0, ComIPduCallout=ComEx_ReceivePduCallout, ComIPduGroupRef=HUT_oB30_for_SC_CAN_V3_2_Rx_4400ad35, ComIPduSignalRef=ABM1_0x351_oABM1_oB30_for_SC_CAN_V3_2_1a88f258_Rx, ComPduIdRef=ABM1_oB30_for_SC_CAN_V3_2_d004cc2e_Rx
        HUT15_oB30_for_SC_CAN_V3_2_d46de065_Tx: ComIPduDirection=SEND, ComIPduHandleId=12, ComIPduCallout=ComEx_TransmitPduCallout, ComIPduGroupRef=HUT_oB30_for_SC_CAN_V3_2_Tx_125a0ab3, ComIPduSignalRef=HUT15_0x1EE_oHUT15_oB30_for_SC_CAN_V3_2_ccda2985_Tx, ComPduIdRef=HUT15_oB30_for_SC_CAN_V3_2_d46de065_Tx, ComIPduGroupRef=HUT_oB30_for_SC_CAN_V3_2_Tx_HEV
          ComTxIPdu: ComMinimumDelayTime=0.045, ComTxIPduUnusedAreasDefault=0
            ComTxModeTrue
              ComTxMode: ComTxModeMode=NONE, ComTxModeNumberOfRepetitions=0, ComTxModeRepetitionPeriod=0
            ComTxModeFalse
              ComTxMode: ComTxModeMode=NONE, ComTxModeNumberOfRepetitions=0, ComTxModeRepetitionPeriod=0
        IFC_FD2_oB30_for_SC_CAN_V3_2_c695b455_Rx: ComIPduDirection=RECEIVE, ComIPduHandleId=112, ComIPduCallout=ComEx_ReceivePduCallout, ComIPduGroupRef=HUT_oB30_for_SC_CAN_V3_2_Rx_4400ad35, ComIPduSignalRef=IFC_FD2_0x23D_oIFC_FD2_oB30_for_SC_CAN_V3_2_6083e7b7_Rx, ComPduIdRef=IFC_FD2_oB30_for_SC_CAN_V3_2_c695b455_Rx
      ACC_FD2_0x2AB_oACC_FD2_oB30_for_SC_CAN_V3_2_33ba28b9_Rx (ComSignal):
        ComBitPosition = 0
        ComSignalEndianness = opaque
        ComSignalInitValue = 0 0 0 0 0 0 0 0 0 0 0 0 0 0 0 0 0 0 0 0 0 0 0 0 0 0 0 0 0 0 0 0 0 0 0 0 0 0 0 0 0 0 0 0 0 0 0 0 0 0 0 0 0 0 0 0
        ComSignalLength = 56
        ComSignalType = UINT8_N
        ComSignalAccess = ACCESS_NEEDED_BY_SWC_OR_COM
        ComHandleId = 12
        ComNotification = Rte_COMCbk_ACC_FD2_0x2AB_oACC_FD2_oB30_for_SC_CAN_V3_2_33ba28b9_Rx
        ComTimeoutNotification = Rte_COMCbkRxTOut_ACC_FD2_0x2AB_oACC_FD2_oB30_for_SC_CAN_V3_2_33ba28b9_Rx
        ComTimeout = 1
        ComSystemTemplateSystemSignalRef = ACC_FD2_0x2AB
      HUT35_0x1E5_oHUT35_oB30_for_SC_CAN_V3_2_f645fa9e_Tx (ComSignal):
        ComBitPosition = 0
        ComSignalEndianness = opaque
        ComSignalInitValue = 0 0 0 0 0 0 0 0
        ComSignalLength = 8
        ComSignalType = UINT8_N
        ComTransferProperty = TRIGGERED
        ComSignalAccess = ACCESS_NEEDED_BY_SWC_OR_COM
        ComHandleId = 34
        ComNotification = ComEx_TransmitPdu_HUT35_Confiratmion
        ComSystemTemplateSystemSignalRef = HUT35_0x1E5
      3 x ComIPdu, all with ComIPduDirection=SEND, ComIPduType=NORMAL, ComIPduSignalProcessing=DEFERRED, ComIPduCancellationSupport=false, ComIPduCallout=ComEx_TransmitPduCallout, ComIPduGroupRef=HUT_oB30_for_SC_CAN_V3_2_Tx_125a0ab3, ComIPduGroupRef=HUT_oB30_for_SC_CAN_V3_2_Tx_HEV:
        HUT35_oB30_for_SC_CAN_V3_2_39fb338c_Tx: ComIPduHandleId=28, ComIPduSignalRef=HUT35_0x1E5_oHUT35_oB30_for_SC_CAN_V3_2_f645fa9e_Tx, ComPduIdRef=HUT35_oB30_for_SC_CAN_V3_2_39fb338c_Tx
          ComTxIPdu: ComMinimumDelayTime=0.045, ComTxIPduUnusedAreasDefault=0
            ComTxModeTrue
              ComTxMode: ComTxModeMode=NONE, ComTxModeNumberOfRepetitions=0, ComTxModeRepetitionPeriod=0
            ComTxModeFalse
              ComTxMode: ComTxModeMode=NONE, ComTxModeNumberOfRepetitions=0, ComTxModeRepetitionPeriod=0
        IP3_oB30_for_SC_CAN_V3_2_33c11c80_Tx: ComIPduHandleId=48, ComIPduSignalRef=IP3_0x34A_oIP3_oB30_for_SC_CAN_V3_2_20c56bb4_Tx, ComPduIdRef=IP3_oB30_for_SC_CAN_V3_2_33c11c80_Tx
          ComTxIPdu: ComMinimumDelayTime=0, ComTxIPduUnusedAreasDefault=0
            ComTxModeTrue
              ComTxMode: ComTxModeMode=PERIODIC, ComTxModeTimePeriod=0.5, ComTxModeTimeOffset=0
            ComTxModeFalse
              ComTxMode: ComTxModeMode=PERIODIC, ComTxModeTimePeriod=0.5, ComTxModeTimeOffset=0
        IP2_oB30_for_SC_CAN_V3_2_24e97840_Tx: ComIPduHandleId=47, ComIPduSignalRef=IP2_0x27F_oIP2_oB30_for_SC_CAN_V3_2_b2130702_Tx, ComPduIdRef=IP2_oB30_for_SC_CAN_V3_2_24e97840_Tx
          ComTxIPdu: ComMinimumDelayTime=0, ComTxIPduUnusedAreasDefault=0
            ComTxModeTrue
              ComTxMode: ComTxModeMode=PERIODIC, ComTxModeTimePeriod=0.05, ComTxModeTimeOffset=0
            ComTxModeFalse
              ComTxMode: ComTxModeMode=PERIODIC, ComTxModeTimePeriod=0.05, ComTxModeTimeOffset=0
      ECM19_0x3B5_oECM19_oB30_for_SC_CAN_V3_2_c4b3a800_Rx (ComSignal):
        ComBitPosition = 0
        ComSignalEndianness = opaque
        ComSignalInitValue = 0 0 0 0 0 0 0 0
        ComSignalLength = 8
        ComSignalType = UINT8_N
        ComSignalAccess = ACCESS_UNCLEAR
        ComHandleId = 66
        ComSystemTemplateSystemSignalRef = ECM19_0x3B5
      DDCM3_oB30_for_SC_CAN_V3_2_6c768ffc_Rx (ComIPdu):
        ComIPduDirection = RECEIVE
        ComIPduType = NORMAL
        ComIPduHandleId = 51
        ComIPduSignalProcessing = DEFERRED
        ComIPduCancellationSupport = false
        ComIPduCallout = ComEx_ReceivePduCallout
        ComIPduGroupRef = HUT_oB30_for_SC_CAN_V3_2_Rx_4400ad35
        ComIPduSignalRef = DDCM3_0x2F7_oDDCM3_oB30_for_SC_CAN_V3_2_1a16b5b8_Rx
        ComPduIdRef = DDCM3_oB30_for_SC_CAN_V3_2_6c768ffc_Rx
      DMS_FD1_0x24D_oDMS_FD1_oB30_for_SC_CAN_V3_2_d4f63723_Tx (ComSignal):
        ComBitPosition = 0
        ComSignalEndianness = opaque
        ComSignalInitValue = 0 0 0 0 0 0 0 0 0 0 0 0 0 0 0 0 0 0 0 0 0 0 0 0 0 0 0 0 0 0 0 0 0 0 0 0 0 0 0 0 0 0 0 0 0 0 0 0 0 0 0 0 0 0 0 0 0 0 0 0 0 0 0 0
        ComSignalLength = 64
        ComSignalType = UINT8_N
        ComTransferProperty = PENDING
        ComSignalAccess = ACCESS_NEEDED_BY_SWC_OR_COM
        ComHandleId = 7
        ComNotification = ComEx_TransmitPdu_DMS_FD1_Confiratmion
        ComSystemTemplateSystemSignalRef = DMS_FD1_0x24D
      DDCM3_0x2F7_oDDCM3_oB30_for_SC_CAN_V3_2_1a16b5b8_Rx (ComSignal):
        ComBitPosition = 0
        ComSignalEndianness = opaque
        ComSignalInitValue = 0 0 0 0 0 0 0 0
        ComSignalLength = 8
        ComSignalType = UINT8_N
        ComSignalAccess = ACCESS_UNCLEAR
        ComHandleId = 51
        ComSystemTemplateSystemSignalRef = DDCM3_0x2F7
      DMS_FD1_oB30_for_SC_CAN_V3_2_2e6458a5_Tx (ComIPdu):
        ComIPduDirection = SEND
        ComIPduType = NORMAL
        ComIPduHandleId = 1
        ComIPduSignalProcessing = DEFERRED
        ComIPduCancellationSupport = false
        ComIPduCallout = ComEx_TransmitPduCallout
        ComIPduGroupRef = HUT_oB30_for_SC_CAN_V3_2_Tx_125a0ab3
        ComIPduSignalRef = DMS_FD1_0x24D_oDMS_FD1_oB30_for_SC_CAN_V3_2_d4f63723_Tx
        ComPduIdRef = DMS_FD1_oB30_for_SC_CAN_V3_2_2e6458a5_Tx
        ComIPduGroupRef = HUT_oB30_for_SC_CAN_V3_2_Tx_HEV
        ComTxIPdu: ComMinimumDelayTime=0, ComTxIPduUnusedAreasDefault=0
          ComTxModeTrue
            ComTxMode: ComTxModeMode=PERIODIC, ComTxModeTimePeriod=0.05, ComTxModeTimeOffset=0
          ComTxModeFalse
            ComTxMode: ComTxModeMode=PERIODIC, ComTxModeTimePeriod=0.05, ComTxModeTimeOffset=0
      DCT_FD4_0x236_oDCT_FD4_oB30_for_SC_CAN_V3_2_186dc059_Rx (ComSignal):
        ComBitPosition = 0
        ComSignalEndianness = opaque
        ComSignalInitValue = 0 0 0 0 0 0 0 0 0 0 0 0 0 0 0 0 0 0 0 0 0 0 0 0 0 0 0 0 0 0 0 0 0 0 0 0 0 0 0 0 0 0 0 0 0 0 0 0 0 0 0 0 0 0 0 0 0 0 0 0 0 0 0 0
        ComSignalLength = 64
        ComSignalType = UINT8_N
        ComSignalAccess = ACCESS_UNCLEAR
        ComHandleId = 49
        ComSystemTemplateSystemSignalRef = DCT_FD4_0x236
      IP1_oB30_for_SC_CAN_V3_2_1d91d500_Tx (ComIPdu):
        ComIPduDirection = SEND
        ComIPduType = NORMAL
        ComIPduHandleId = 46
        ComIPduSignalProcessing = DEFERRED
        ComIPduCancellationSupport = false
        ComIPduCallout = ComEx_TransmitPduCallout
        ComIPduGroupRef = HUT_oB30_for_SC_CAN_V3_2_Tx_125a0ab3
        ComIPduSignalRef = IP1_0x293_oIP1_oB30_for_SC_CAN_V3_2_979cdb1f_Tx
        ComPduIdRef = IP1_oB30_for_SC_CAN_V3_2_1d91d500_Tx
        ComIPduGroupRef = HUT_oB30_for_SC_CAN_V3_2_Tx_HEV
        ComTxIPdu: ComMinimumDelayTime=0, ComTxIPduUnusedAreasDefault=0
          ComTxModeTrue
            ComTxMode: ComTxModeMode=PERIODIC, ComTxModeTimePeriod=0.1, ComTxModeTimeOffset=0
          ComTxModeFalse
            ComTxMode: ComTxModeMode=PERIODIC, ComTxModeTimePeriod=0.1, ComTxModeTimeOffset=0
      IP1_0x293_oIP1_oB30_for_SC_CAN_V3_2_979cdb1f_Tx (ComSignal):
        ComBitPosition = 0
        ComSignalEndianness = opaque
        ComSignalInitValue = 0 0 0 0 0 0 0 0
        ComSignalLength = 8
        ComSignalType = UINT8_N
        ComTransferProperty = PENDING
        ComSignalAccess = ACCESS_UNCLEAR
        ComHandleId = 51
        ComNotification = ComEx_TransmitPdu_IP1_Confiratmion
        ComSystemTemplateSystemSignalRef = IP1_0x293
      DCT_FD4_oB30_for_SC_CAN_V3_2_c3f55f0e_Rx (ComIPdu):
        ComIPduDirection = RECEIVE
        ComIPduType = NORMAL
        ComIPduHandleId = 49
        ComIPduSignalProcessing = DEFERRED
        ComIPduCancellationSupport = false
        ComIPduCallout = ComEx_ReceivePduCallout
        ComIPduGroupRef = HUT_oB30_for_SC_CAN_V3_2_Rx_4400ad35
        ComIPduSignalRef = DCT_FD4_0x236_oDCT_FD4_oB30_for_SC_CAN_V3_2_186dc059_Rx
        ComPduIdRef = DCT_FD4_oB30_for_SC_CAN_V3_2_c3f55f0e_Rx
      5 x ComSignal, all with ComBitPosition=0, ComSignalEndianness=opaque, ComSignalType=UINT8_N:
        IP3_0x34A_oIP3_oB30_for_SC_CAN_V3_2_20c56bb4_Tx: ComSignalInitValue=0 0 0 0 0 0 0 0 0 0 0 0 0 0 0 0, ComSignalLength=16, ComTransferProperty=PENDING, ComSignalAccess=ACCESS_UNCLEAR, ComHandleId=53, ComNotification=ComEx_TransmitPdu_IP3_Confiratmion, ComSystemTemplateSystemSignalRef=IP3_0x34A
        BCM3_0x345_oBCM3_oB30_for_SC_CAN_V3_2_63d58c65_Rx: ComSignalInitValue=0 0 0 0 0 0 0 0, ComSignalLength=8, ComSignalAccess=ACCESS_NEEDED_BY_SWC_OR_COM, ComHandleId=23, ComNotification=Rte_COMCbk_BCM3_0x345_oBCM3_oB30_for_SC_CAN_V3_2_63d58c65_Rx, ComTimeoutNotification=Rte_COMCbkRxTOut_BCM3_0x345_oBCM3_oB30_for_SC_CAN_V3_2_63d58c65_Rx, ComTimeout=0.5, ComSystemTemplateSystemSignalRef=BCM3_0x345
        HUT15_0x1EE_oHUT15_oB30_for_SC_CAN_V3_2_ccda2985_Tx: ComSignalInitValue=0 0 0 0 0 0 0 0, ComSignalLength=8, ComTransferProperty=TRIGGERED, ComSignalAccess=ACCESS_NEEDED_BY_SWC_OR_COM, ComHandleId=18, ComNotification=ComEx_TransmitPdu_HUT15_Confiratmion, ComSystemTemplateSystemSignalRef=HUT15_0x1EE
        TPMS1_0x341_oTPMS1_oB30_for_SC_CAN_V3_2_7481a0ed_Rx: ComSignalInitValue=0 0 0 0 0 0 0 0, ComSignalLength=8, ComSignalAccess=ACCESS_NEEDED_BY_SWC_OR_COM, ComHandleId=130, ComNotification=Rte_COMCbk_TPMS1_0x341_oTPMS1_oB30_for_SC_CAN_V3_2_7481a0ed_Rx, ComTimeoutNotification=Rte_COMCbkRxTOut_TPMS1_0x341_oTPMS1_oB30_for_SC_CAN_V3_2_7481a0ed_Rx, ComTimeout=5, ComSystemTemplateSystemSignalRef=TPMS1_0x341
        BCM1_0x319_oBCM1_oB30_for_SC_CAN_V3_2_3b9040e0_Rx: ComSignalInitValue=0 0 0 0 0 0 0 0, ComSignalLength=8, ComSignalAccess=ACCESS_NEEDED_BY_SWC_OR_COM, ComHandleId=22, ComNotification=Rte_COMCbk_BCM1_0x319_oBCM1_oB30_for_SC_CAN_V3_2_3b9040e0_Rx, ComTimeoutNotification=Rte_COMCbkRxTOut_BCM1_0x319_oBCM1_oB30_for_SC_CAN_V3_2_3b9040e0_Rx, ComTimeout=0.5, ComSystemTemplateSystemSignalRef=BCM1_0x319
      GW_Sync_Req_oB30_for_SC_CAN_V3_2_6800966b_Rx (ComIPdu):
        ComIPduDirection = RECEIVE
        ComIPduType = NORMAL
        ComIPduHandleId = 87
        ComIPduSignalProcessing = DEFERRED
        ComIPduCancellationSupport = false
        ComIPduCallout = ComEx_ReceivePduCallout
        ComIPduGroupRef = HUT_oB30_for_SC_CAN_V3_2_Rx_4400ad35
        ComIPduSignalRef = null_oGW_Sync_Req_oB30_for_SC_CAN_V3_2_dbe97aeb_Rx
        ComPduIdRef = GW_Sync_Req_oB30_for_SC_CAN_V3_2_6800966b_Rx
      5 x ComSignal, all with ComBitPosition=0, ComSignalEndianness=opaque:
        null_oGW_Sync_Req_oB30_for_SC_CAN_V3_2_dbe97aeb_Rx: ComBitSize=0, ComSignalType=UINT8, ComSignalInitValue=0, ComSignalAccess=ACCESS_UNCLEAR, ComHandleId=140, ComSystemTemplateSystemSignalRef=null
        IP2_0x27F_oIP2_oB30_for_SC_CAN_V3_2_b2130702_Tx: ComSignalInitValue=0 0 0 0 0 0 0 0, ComSignalLength=8, ComSignalType=UINT8_N, ComTransferProperty=PENDING, ComSignalAccess=ACCESS_UNCLEAR, ComHandleId=52, ComNotification=ComEx_TransmitPdu_IP2_Confiratmion, ComSystemTemplateSystemSignalRef=IP2_0x27F
        TPMS2_0x395_oTPMS2_oB30_for_SC_CAN_V3_2_64d1204c_Rx: ComSignalInitValue=0 0 0 0 0 0 0 0, ComSignalLength=8, ComSignalType=UINT8_N, ComSignalAccess=ACCESS_NEEDED_BY_SWC_OR_COM, ComHandleId=131, ComNotification=Rte_COMCbk_TPMS2_0x395_oTPMS2_oB30_for_SC_CAN_V3_2_64d1204c_Rx, ComTimeoutNotification=Rte_COMCbkRxTOut_TPMS2_0x395_oTPMS2_oB30_for_SC_CAN_V3_2_64d1204c_Rx, ComTimeout=5, ComSystemTemplateSystemSignalRef=TPMS2_0x395
        AMP2_0x3E3_oAMP2_oB30_for_SC_CAN_V3_2_fcde4f66_Rx: ComSignalInitValue=0 0 0 0 0 0 0 0, ComSignalLength=8, ComSignalType=UINT8_N, ComSignalAccess=ACCESS_NEEDED_BY_SWC_OR_COM, ComHandleId=19, ComNotification=Rte_COMCbk_AMP2_0x3E3_oAMP2_oB30_for_SC_CAN_V3_2_fcde4f66_Rx, ComSystemTemplateSystemSignalRef=AMP2_0x3E3
        ABM1_0x351_oABM1_oB30_for_SC_CAN_V3_2_1a88f258_Rx: ComSignalInitValue=0 0 0 0 0 0 0 0, ComSignalLength=8, ComSignalType=UINT8_N, ComSignalAccess=ACCESS_UNCLEAR, ComHandleId=0, ComSystemTemplateSystemSignalRef=ABM1_0x351
      HUT38_oB30_for_SC_CAN_V3_2_cb31e24c_Tx (ComIPdu):
        ComIPduDirection = SEND
        ComIPduType = NORMAL
        ComIPduHandleId = 31
        ComIPduSignalProcessing = DEFERRED
        ComIPduCancellationSupport = false
        ComIPduCallout = ComEx_TransmitPduCallout
        ComIPduGroupRef = HUT_oB30_for_SC_CAN_V3_2_Tx_125a0ab3
        ComIPduSignalRef = HUT38_0x1E7_oHUT38_oB30_for_SC_CAN_V3_2_4fc17c79_Tx
        ComPduIdRef = HUT38_oB30_for_SC_CAN_V3_2_cb31e24c_Tx
        ComIPduGroupRef = HUT_oB30_for_SC_CAN_V3_2_Tx_HEV
        ComTxIPdu: ComMinimumDelayTime=0.045, ComTxIPduUnusedAreasDefault=0
          ComTxModeTrue
            ComTxMode: ComTxModeMode=NONE, ComTxModeNumberOfRepetitions=0, ComTxModeRepetitionPeriod=0
          ComTxModeFalse
            ComTxMode: ComTxModeMode=NONE, ComTxModeNumberOfRepetitions=0, ComTxModeRepetitionPeriod=0
      4 x ComSignal, all with ComBitPosition=0, ComSignalEndianness=opaque, ComSignalType=UINT8_N, ComSignalAccess=ACCESS_UNCLEAR:
        BCM14_0x2A3_oBCM14_oB30_for_SC_CAN_V3_2_8a12cec7_Rx: ComSignalInitValue=0 0 0 0 0 0 0 0, ComSignalLength=8, ComHandleId=28, ComSystemTemplateSystemSignalRef=BCM14_0x2A3
        Ibooster_FD2_0x120_oIbooster_FD2_oB30_for_SC_CAN_V3_2_a4812faa_Rx: ComSignalInitValue=0 0 0 0 0 0 0 0 0 0 0 0 0 0 0 0 0 0 0 0 0 0 0 0 0 0 0 0 0 0 0 0 0 0 0 0 0 0 0 0 0 0 0 0 0 0 0 0 0 0 0 0 0 0 0 0 0 0 0 0 0 0 0 0, ComSignalLength=64, ComHandleId=115, ComSystemTemplateSystemSignalRef=Ibooster_FD2_0x120
        T_BOX_FD4_0x1E1_oT_BOX_FD4_oB30_for_SC_CAN_V3_2_30217c42_Rx: ComSignalInitValue=0 0 0 0 0 0 0 0 0 0 0 0 0 0 0 0, ComSignalLength=16, ComHandleId=134, ComSystemTemplateSystemSignalRef=T_BOX_FD4_0x1E1
        AC6_0x2F8_oAC6_oB30_for_SC_CAN_V3_2_6d580a77_Rx: ComSignalInitValue=0 0 0 0 0 0 0 0, ComSignalLength=8, ComHandleId=8, ComSystemTemplateSystemSignalRef=AC6_0x2F8
      AC7_oB30_for_SC_CAN_V3_2_cafa0c4f_Rx (ComIPdu):
        ComIPduDirection = RECEIVE
        ComIPduType = NORMAL
        ComIPduHandleId = 9
        ComIPduSignalProcessing = DEFERRED
        ComIPduCancellationSupport = false
        ComIPduCallout = ComEx_ReceivePduCallout
        ComIPduGroupRef = HUT_oB30_for_SC_CAN_V3_2_Rx_4400ad35
        ComIPduSignalRef = AC7_0x2D0_oAC7_oB30_for_SC_CAN_V3_2_8d6bd2f4_Rx
        ComPduIdRef = AC7_oB30_for_SC_CAN_V3_2_cafa0c4f_Rx
      HCU_HC16_oB30_for_SC_CAN_V3_2_a481d524_Rx (ComIPdu):
        ComIPduDirection = RECEIVE
        ComIPduType = NORMAL
        ComIPduHandleId = 102
        ComIPduSignalProcessing = DEFERRED
        ComIPduCancellationSupport = false
        ComIPduCallout = ComEx_ReceivePduCallout
        ComIPduGroupRef = HUT_oB30_for_SC_CAN_V3_2_Rx_4400ad35
        ComIPduSignalRef = HCU_HC16_0x9E_oHCU_HC16_oB30_for_SC_CAN_V3_2_40590207_Rx
        ComPduIdRef = HCU_HC16_oB30_for_SC_CAN_V3_2_a481d524_Rx
      HUT31_0x30C_oHUT31_oB30_for_SC_CAN_V3_2_cc5f49f9_Tx (ComSignal):
        ComBitPosition = 0
        ComSignalEndianness = opaque
        ComSignalInitValue = 0 0 0 0 0 0 0 0
        ComSignalLength = 8
        ComSignalType = UINT8_N
        ComTransferProperty = PENDING
        ComSignalAccess = ACCESS_UNCLEAR
        ComHandleId = 30
        ComNotification = ComEx_TransmitPdu_HUT31_Confiratmion
        ComSystemTemplateSystemSignalRef = HUT31_0x30C
      BMS65_oB30_for_SC_CAN_V3_2_a7b39db6_Rx (ComIPdu):
        ComIPduDirection = RECEIVE
        ComIPduType = NORMAL
        ComIPduHandleId = 39
        ComIPduSignalProcessing = DEFERRED
        ComIPduCancellationSupport = false
        ComIPduCallout = ComEx_ReceivePduCallout
        ComIPduGroupRef = HUT_oB30_for_SC_CAN_V3_2_Rx_4400ad35
        ComIPduSignalRef = BMS65_0x14F_oBMS65_oB30_for_SC_CAN_V3_2_41016de9_Rx
        ComPduIdRef = BMS65_oB30_for_SC_CAN_V3_2_a7b39db6_Rx
      BMS65_0x14F_oBMS65_oB30_for_SC_CAN_V3_2_41016de9_Rx (ComSignal):
        ComBitPosition = 0
        ComSignalEndianness = opaque
        ComSignalInitValue = 0 0 0 0 0 0 0 0
        ComSignalLength = 8
        ComSignalType = UINT8_N
        ComSignalAccess = ACCESS_UNCLEAR
        ComHandleId = 39
        ComSystemTemplateSystemSignalRef = BMS65_0x14F
      ESCL2_oB30_for_SC_CAN_V3_2_91777cb9_Rx (ComIPdu):
        ComIPduDirection = RECEIVE
        ComIPduType = NORMAL
        ComIPduHandleId = 76
        ComIPduSignalProcessing = DEFERRED
        ComIPduCancellationSupport = false
        ComIPduCallout = ComEx_ReceivePduCallout
        ComIPduGroupRef = HUT_oB30_for_SC_CAN_V3_2_Rx_4400ad35
        ComIPduSignalRef = ESCL2_0x303_oESCL2_oB30_for_SC_CAN_V3_2_09a4f237_Rx
        ComPduIdRef = ESCL2_oB30_for_SC_CAN_V3_2_91777cb9_Rx
      ECM16_0x2D4_oECM16_oB30_for_SC_CAN_V3_2_3587073b_Rx (ComSignal):
        ComBitPosition = 0
        ComSignalEndianness = opaque
        ComSignalInitValue = 0 0 0 0 0 0 0 0
        ComSignalLength = 8
        ComSignalType = UINT8_N
        ComSignalAccess = ACCESS_UNCLEAR
        ComHandleId = 65
        ComSystemTemplateSystemSignalRef = ECM16_0x2D4
      AC7_0x2D0_oAC7_oB30_for_SC_CAN_V3_2_8d6bd2f4_Rx (ComSignal):
        ComBitPosition = 0
        ComSignalEndianness = opaque
        ComSignalInitValue = 0 0 0 0 0 0 0 0
        ComSignalLength = 8
        ComSignalType = UINT8_N
        ComSignalAccess = ACCESS_UNCLEAR
        ComHandleId = 9
        ComSystemTemplateSystemSignalRef = AC7_0x2D0
      ECM16_oB30_for_SC_CAN_V3_2_6a3a3dbc_Rx (ComIPdu):
        ComIPduDirection = RECEIVE
        ComIPduType = NORMAL
        ComIPduHandleId = 65
        ComIPduSignalProcessing = DEFERRED
        ComIPduCancellationSupport = false
        ComIPduCallout = ComEx_ReceivePduCallout
        ComIPduGroupRef = HUT_oB30_for_SC_CAN_V3_2_Rx_4400ad35
        ComIPduSignalRef = ECM16_0x2D4_oECM16_oB30_for_SC_CAN_V3_2_3587073b_Rx
        ComPduIdRef = ECM16_oB30_for_SC_CAN_V3_2_6a3a3dbc_Rx
      3 x ComSignal, all with ComBitPosition=0, ComSignalEndianness=opaque, ComSignalInitValue=0 0 0 0 0 0 0 0, ComSignalLength=8, ComSignalType=UINT8_N, ComSignalAccess=ACCESS_UNCLEAR:
        HUT42_0x1F9_oHUT42_oB30_for_SC_CAN_V3_2_07cf90c9_Tx: ComTransferProperty=TRIGGERED, ComHandleId=41, ComNotification=ComEx_TransmitPdu_HUT42_Confiratmion, ComSystemTemplateSystemSignalRef=HUT42_0x1F9
        AC3_0x2FD_oAC3_oB30_for_SC_CAN_V3_2_2814c5ad_Rx: ComHandleId=6, ComSystemTemplateSystemSignalRef=AC3_0x2FD
        Trailer1_0x273_oTrailer1_oB30_for_SC_CAN_V3_2_e6f8aad9_Rx: ComHandleId=137, ComSystemTemplateSystemSignalRef=Trailer1_0x273
      4 x ComIPdu, all with ComIPduType=NORMAL, ComIPduSignalProcessing=DEFERRED, ComIPduCancellationSupport=false:
        HUT43_oB30_for_SC_CAN_V3_2_3db3f1a2_Tx: ComIPduDirection=SEND, ComIPduHandleId=36, ComIPduCallout=ComEx_TransmitPduCallout, ComIPduGroupRef=HUT_oB30_for_SC_CAN_V3_2_Tx_125a0ab3, ComIPduSignalRef=HUT43_0x1FD_oHUT43_oB30_for_SC_CAN_V3_2_6355320f_Tx, ComPduIdRef=HUT43_oB30_for_SC_CAN_V3_2_3db3f1a2_Tx, ComIPduGroupRef=HUT_oB30_for_SC_CAN_V3_2_Tx_HEV
          ComTxIPdu: ComMinimumDelayTime=0.045, ComTxIPduUnusedAreasDefault=0
            ComTxModeTrue
              ComTxMode: ComTxModeMode=NONE, ComTxModeNumberOfRepetitions=0, ComTxModeRepetitionPeriod=0
            ComTxModeFalse
              ComTxMode: ComTxModeMode=NONE, ComTxModeNumberOfRepetitions=0, ComTxModeRepetitionPeriod=0
        CP1_oB30_for_SC_CAN_V3_2_16a725b1_Rx: ComIPduDirection=RECEIVE, ComIPduHandleId=42, ComIPduCallout=ComEx_ReceivePduCallout, ComIPduGroupRef=HUT_oB30_for_SC_CAN_V3_2_Rx_4400ad35, ComIPduSignalRef=CP1_0x35E_oCP1_oB30_for_SC_CAN_V3_2_86ba6def_Rx, ComPduIdRef=CP1_oB30_for_SC_CAN_V3_2_16a725b1_Rx
        AC4_oB30_for_SC_CAN_V3_2_f382a10f_Rx: ComIPduDirection=RECEIVE, ComIPduHandleId=7, ComIPduCallout=ComEx_ReceivePduCallout, ComIPduGroupRef=HUT_oB30_for_SC_CAN_V3_2_Rx_4400ad35, ComIPduSignalRef=AC4_0x2CC_oAC4_oB30_for_SC_CAN_V3_2_18a746db_Rx, ComPduIdRef=AC4_oB30_for_SC_CAN_V3_2_f382a10f_Rx
        TOD1_oB30_for_SC_CAN_V3_2_77c15f81_Rx: ComIPduDirection=RECEIVE, ComIPduHandleId=130, ComIPduCallout=ComEx_ReceivePduCallout, ComIPduGroupRef=HUT_oB30_for_SC_CAN_V3_2_Rx_4400ad35, ComIPduSignalRef=TOD1_0x251_oTOD1_oB30_for_SC_CAN_V3_2_d5e91403_Rx, ComPduIdRef=TOD1_oB30_for_SC_CAN_V3_2_77c15f81_Rx
      BCM11_0x305_oBCM11_oB30_for_SC_CAN_V3_2_ac8c1462_Rx (ComSignal):
        ComBitPosition = 0
        ComSignalEndianness = opaque
        ComSignalInitValue = 0 0 0 0 0 0 0 0
        ComSignalLength = 8
        ComSignalType = UINT8_N
        ComSignalAccess = ACCESS_UNCLEAR
        ComHandleId = 26
        ComSystemTemplateSystemSignalRef = BCM11_0x305
      T_BOX_FD4_oB30_for_SC_CAN_V3_2_f4d43aba_Rx (ComIPdu):
        ComIPduDirection = RECEIVE
        ComIPduType = NORMAL
        ComIPduHandleId = 135
        ComIPduSignalProcessing = DEFERRED
        ComIPduCancellationSupport = false
        ComIPduCallout = ComEx_ReceivePduCallout
        ComIPduGroupRef = HUT_oB30_for_SC_CAN_V3_2_Rx_4400ad35
        ComIPduSignalRef = T_BOX_FD4_0x1E1_oT_BOX_FD4_oB30_for_SC_CAN_V3_2_30217c42_Rx
        ComPduIdRef = T_BOX_FD4_oB30_for_SC_CAN_V3_2_f4d43aba_Rx
      HUT31_oB30_for_SC_CAN_V3_2_655aa08c_Tx (ComIPdu):
        ComIPduDirection = SEND
        ComIPduType = NORMAL
        ComIPduHandleId = 24
        ComIPduSignalProcessing = DEFERRED
        ComIPduCancellationSupport = false
        ComIPduCallout = ComEx_TransmitPduCallout
        ComIPduGroupRef = HUT_oB30_for_SC_CAN_V3_2_Tx_125a0ab3
        ComIPduSignalRef = HUT31_0x30C_oHUT31_oB30_for_SC_CAN_V3_2_cc5f49f9_Tx
        ComPduIdRef = HUT31_oB30_for_SC_CAN_V3_2_655aa08c_Tx
        ComIPduGroupRef = HUT_oB30_for_SC_CAN_V3_2_Tx_HEV
        ComTxIPdu: ComMinimumDelayTime=0, ComTxIPduUnusedAreasDefault=0
          ComTxModeTrue
            ComTxMode: ComTxModeMode=PERIODIC, ComTxModeTimePeriod=0.2, ComTxModeTimeOffset=0
          ComTxModeFalse
            ComTxMode: ComTxModeMode=PERIODIC, ComTxModeTimePeriod=0.2, ComTxModeTimeOffset=0
      ELD1_0x152_oELD1_oB30_for_SC_CAN_V3_2_b0381828_Rx (ComSignal):
        ComBitPosition = 0
        ComSignalEndianness = opaque
        ComSignalInitValue = 0 0 0 0 0 0 0 0
        ComSignalLength = 8
        ComSignalType = UINT8_N
        ComSignalAccess = ACCESS_UNCLEAR
        ComHandleId = 73
        ComSystemTemplateSystemSignalRef = ELD1_0x152
      AC6_oB30_for_SC_CAN_V3_2_ddd2688f_Rx (ComIPdu):
        ComIPduDirection = RECEIVE
        ComIPduType = NORMAL
        ComIPduHandleId = 8
        ComIPduSignalProcessing = DEFERRED
        ComIPduCancellationSupport = false
        ComIPduCallout = ComEx_ReceivePduCallout
        ComIPduGroupRef = HUT_oB30_for_SC_CAN_V3_2_Rx_4400ad35
        ComIPduSignalRef = AC6_0x2F8_oAC6_oB30_for_SC_CAN_V3_2_6d580a77_Rx
        ComPduIdRef = AC6_oB30_for_SC_CAN_V3_2_ddd2688f_Rx
      CP1_0x35E_oCP1_oB30_for_SC_CAN_V3_2_86ba6def_Rx (ComSignal):
        ComBitPosition = 0
        ComSignalEndianness = opaque
        ComSignalInitValue = 0 0 0 0 0 0 0 0
        ComSignalLength = 8
        ComSignalType = UINT8_N
        ComSignalAccess = ACCESS_UNCLEAR
        ComHandleId = 42
        ComSystemTemplateSystemSignalRef = CP1_0x35E
      HUT45_oB30_for_SC_CAN_V3_2_4f42ab22_Tx (ComIPdu):
        ComIPduDirection = SEND
        ComIPduType = NORMAL
        ComIPduHandleId = 37
        ComIPduSignalProcessing = DEFERRED
        ComIPduCancellationSupport = false
        ComIPduCallout = ComEx_TransmitPduCallout
        ComIPduGroupRef = HUT_oB30_for_SC_CAN_V3_2_Tx_125a0ab3
        ComIPduSignalRef = HUT45_0x1DC_oHUT45_oB30_for_SC_CAN_V3_2_57d4dd51_Tx
        ComPduIdRef = HUT45_oB30_for_SC_CAN_V3_2_4f42ab22_Tx
        ComIPduGroupRef = HUT_oB30_for_SC_CAN_V3_2_Tx_HEV
        ComTxIPdu: ComMinimumDelayTime=0.045, ComTxIPduUnusedAreasDefault=0
          ComTxModeTrue
            ComTxMode: ComTxModeMode=NONE, ComTxModeNumberOfRepetitions=0, ComTxModeRepetitionPeriod=0
          ComTxModeFalse
            ComTxMode: ComTxModeMode=NONE, ComTxModeNumberOfRepetitions=0, ComTxModeRepetitionPeriod=0
      HUT38_0x1E7_oHUT38_oB30_for_SC_CAN_V3_2_4fc17c79_Tx (ComSignal):
        ComBitPosition = 0
        ComSignalEndianness = opaque
        ComSignalInitValue = 0 0 0 0 0 0 0 0
        ComSignalLength = 8
        ComSignalType = UINT8_N
        ComTransferProperty = TRIGGERED
        ComSignalAccess = ACCESS_UNCLEAR
        ComHandleId = 37
        ComNotification = ComEx_TransmitPdu_HUT38_Confiratmion
        ComSystemTemplateSystemSignalRef = HUT38_0x1E7
      BCM14_oB30_for_SC_CAN_V3_2_9ca98f1a_Rx (ComIPdu):
        ComIPduDirection = RECEIVE
        ComIPduType = NORMAL
        ComIPduHandleId = 28
        ComIPduSignalProcessing = DEFERRED
        ComIPduCancellationSupport = false
        ComIPduCallout = ComEx_ReceivePduCallout
        ComIPduGroupRef = HUT_oB30_for_SC_CAN_V3_2_Rx_4400ad35
        ComIPduSignalRef = BCM14_0x2A3_oBCM14_oB30_for_SC_CAN_V3_2_8a12cec7_Rx
        ComPduIdRef = BCM14_oB30_for_SC_CAN_V3_2_9ca98f1a_Rx
      HUT45_0x1DC_oHUT45_oB30_for_SC_CAN_V3_2_57d4dd51_Tx (ComSignal):
        ComBitPosition = 0
        ComSignalEndianness = opaque
        ComSignalInitValue = 0 0 0 0 0 0 0 0
        ComSignalLength = 8
        ComSignalType = UINT8_N
        ComTransferProperty = TRIGGERED
        ComSignalAccess = ACCESS_UNCLEAR
        ComHandleId = 43
        ComNotification = ComEx_TransmitPdu_HUT45_Confiratmion
        ComSystemTemplateSystemSignalRef = HUT45_0x1DC
      3 x ComIPdu, all with ComIPduType=NORMAL, ComIPduSignalProcessing=DEFERRED, ComIPduCancellationSupport=false:
        HUT26_oB30_for_SC_CAN_V3_2_9bf07418_Tx: ComIPduDirection=SEND, ComIPduHandleId=21, ComIPduCallout=ComEx_TransmitPduCallout, ComIPduGroupRef=HUT_oB30_for_SC_CAN_V3_2_Tx_125a0ab3, ComIPduSignalRef=HUT26_0x2B6_oHUT26_oB30_for_SC_CAN_V3_2_49efaca1_Tx, ComPduIdRef=HUT26_oB30_for_SC_CAN_V3_2_9bf07418_Tx, ComIPduGroupRef=HUT_oB30_for_SC_CAN_V3_2_Tx_HEV
          ComTxIPdu: ComMinimumDelayTime=0, ComTxIPduUnusedAreasDefault=0
            ComTxModeTrue
              ComTxMode: ComTxModeMode=PERIODIC, ComTxModeTimePeriod=0.1, ComTxModeTimeOffset=0
            ComTxModeFalse
              ComTxMode: ComTxModeMode=PERIODIC, ComTxModeTimePeriod=0.1, ComTxModeTimeOffset=0
        AC3_oB30_for_SC_CAN_V3_2_965b9f4f_Rx: ComIPduDirection=RECEIVE, ComIPduHandleId=6, ComIPduCallout=ComEx_ReceivePduCallout, ComIPduGroupRef=HUT_oB30_for_SC_CAN_V3_2_Rx_4400ad35, ComIPduSignalRef=AC3_0x2FD_oAC3_oB30_for_SC_CAN_V3_2_2814c5ad_Rx, ComPduIdRef=AC3_oB30_for_SC_CAN_V3_2_965b9f4f_Rx
        BCM11_oB30_for_SC_CAN_V3_2_d72078da_Rx: ComIPduDirection=RECEIVE, ComIPduHandleId=26, ComIPduCallout=ComEx_ReceivePduCallout, ComIPduGroupRef=HUT_oB30_for_SC_CAN_V3_2_Rx_4400ad35, ComIPduSignalRef=BCM11_0x305_oBCM11_oB30_for_SC_CAN_V3_2_ac8c1462_Rx, ComPduIdRef=BCM11_oB30_for_SC_CAN_V3_2_d72078da_Rx
      ESCL2_0x303_oESCL2_oB30_for_SC_CAN_V3_2_09a4f237_Rx (ComSignal):
        ComBitPosition = 0
        ComSignalEndianness = opaque
        ComSignalInitValue = 0 0 0 0 0 0 0 0
        ComSignalLength = 8
        ComSignalType = UINT8_N
        ComSignalAccess = ACCESS_UNCLEAR
        ComHandleId = 76
        ComSystemTemplateSystemSignalRef = ESCL2_0x303
      ELD1_oB30_for_SC_CAN_V3_2_d24341c9_Rx (ComIPdu):
        ComIPduDirection = RECEIVE
        ComIPduType = NORMAL
        ComIPduHandleId = 73
        ComIPduSignalProcessing = DEFERRED
        ComIPduCancellationSupport = false
        ComIPduCallout = ComEx_ReceivePduCallout
        ComIPduGroupRef = HUT_oB30_for_SC_CAN_V3_2_Rx_4400ad35
        ComIPduSignalRef = ELD1_0x152_oELD1_oB30_for_SC_CAN_V3_2_b0381828_Rx
        ComPduIdRef = ELD1_oB30_for_SC_CAN_V3_2_d24341c9_Rx
      TOD1_0x251_oTOD1_oB30_for_SC_CAN_V3_2_d5e91403_Rx (ComSignal):
        ComBitPosition = 0
        ComSignalEndianness = opaque
        ComSignalInitValue = 0 0 0 0 0 0 0 0
        ComSignalLength = 8
        ComSignalType = UINT8_N
        ComSignalAccess = ACCESS_UNCLEAR
        ComHandleId = 129
        ComSystemTemplateSystemSignalRef = TOD1_0x251
      HUT12_oB30_for_SC_CAN_V3_2_b1b4de25_Tx (ComIPdu):
        ComIPduDirection = SEND
        ComIPduType = NORMAL
        ComIPduHandleId = 10
        ComIPduSignalProcessing = DEFERRED
        ComIPduCancellationSupport = false
        ComIPduCallout = ComEx_TransmitPduCallout
        ComIPduGroupRef = HUT_oB30_for_SC_CAN_V3_2_Tx_125a0ab3
        ComIPduSignalRef = HUT12_0x3AF_oHUT12_oB30_for_SC_CAN_V3_2_e30e4c90_Tx
        ComPduIdRef = HUT12_oB30_for_SC_CAN_V3_2_b1b4de25_Tx
        ComIPduGroupRef = HUT_oB30_for_SC_CAN_V3_2_Tx_HEV
        ComTxIPdu: ComMinimumDelayTime=0, ComTxIPduUnusedAreasDefault=0
          ComTxModeTrue
            ComTxMode: ComTxModeMode=PERIODIC, ComTxModeTimePeriod=1, ComTxModeTimeOffset=0
          ComTxModeFalse
            ComTxMode: ComTxModeMode=PERIODIC, ComTxModeTimePeriod=1, ComTxModeTimeOffset=0
      HUT26_0x2B6_oHUT26_oB30_for_SC_CAN_V3_2_49efaca1_Tx (ComSignal):
        ComBitPosition = 0
        ComSignalEndianness = opaque
        ComSignalInitValue = 0 0 0 0 0 0 0 0
        ComSignalLength = 8
        ComSignalType = UINT8_N
        ComTransferProperty = PENDING
        ComSignalAccess = ACCESS_UNCLEAR
        ComHandleId = 27
        ComNotification = ComEx_TransmitPdu_HUT26_Confiratmion
        ComSystemTemplateSystemSignalRef = HUT26_0x2B6
      AC4_0x2CC_oAC4_oB30_for_SC_CAN_V3_2_18a746db_Rx (ComSignal):
        ComBitPosition = 0
        ComSignalEndianness = opaque
        ComSignalInitValue = 0 0 0 0 0 0 0 0
        ComSignalLength = 8
        ComSignalType = UINT8_N
        ComSignalAccess = ACCESS_UNCLEAR
        ComHandleId = 7
        ComSystemTemplateSystemSignalRef = AC4_0x2CC
      AC8_oB30_for_SC_CAN_V3_2_1660140f_Rx (ComIPdu):
        ComIPduDirection = RECEIVE
        ComIPduType = NORMAL
        ComIPduHandleId = 10
        ComIPduSignalProcessing = DEFERRED
        ComIPduCancellationSupport = false
        ComIPduCallout = ComEx_ReceivePduCallout
        ComIPduGroupRef = HUT_oB30_for_SC_CAN_V3_2_Rx_4400ad35
        ComIPduSignalRef = AC8_0x27C_oAC8_oB30_for_SC_CAN_V3_2_0c22f08a_Rx
        ComPduIdRef = AC8_oB30_for_SC_CAN_V3_2_1660140f_Rx
      3 x ComSignal, all with ComBitPosition=0, ComSignalEndianness=opaque, ComSignalInitValue=0 0 0 0 0 0 0 0, ComSignalLength=8, ComSignalType=UINT8_N, ComSignalAccess=ACCESS_UNCLEAR:
        AC8_0x27C_oAC8_oB30_for_SC_CAN_V3_2_0c22f08a_Rx: ComHandleId=10, ComSystemTemplateSystemSignalRef=AC8_0x27C
        HCU_HC16_0x9E_oHCU_HC16_oB30_for_SC_CAN_V3_2_40590207_Rx: ComHandleId=101, ComSystemTemplateSystemSignalRef=HCU_HC16_0x9E
        HUT12_0x3AF_oHUT12_oB30_for_SC_CAN_V3_2_e30e4c90_Tx: ComTransferProperty=PENDING, ComHandleId=16, ComNotification=ComEx_TransmitPdu_HUT12_Confiratmion, ComSystemTemplateSystemSignalRef=HUT12_0x3AF
      Ibooster_FD2_oB30_for_SC_CAN_V3_2_e9e18adf_Rx (ComIPdu):
        ComIPduDirection = RECEIVE
        ComIPduType = NORMAL
        ComIPduHandleId = 116
        ComIPduSignalProcessing = DEFERRED
        ComIPduCancellationSupport = false
        ComIPduCallout = ComEx_ReceivePduCallout
        ComIPduGroupRef = HUT_oB30_for_SC_CAN_V3_2_Rx_4400ad35
        ComIPduSignalRef = Ibooster_FD2_0x120_oIbooster_FD2_oB30_for_SC_CAN_V3_2_a4812faa_Rx
        ComPduIdRef = Ibooster_FD2_oB30_for_SC_CAN_V3_2_e9e18adf_Rx
      HUT42_oB30_for_SC_CAN_V3_2_2a9b9562_Tx (ComIPdu):
        ComIPduDirection = SEND
        ComIPduType = NORMAL
        ComIPduHandleId = 35
        ComIPduSignalProcessing = DEFERRED
        ComIPduCancellationSupport = false
        ComIPduCallout = ComEx_TransmitPduCallout
        ComIPduGroupRef = HUT_oB30_for_SC_CAN_V3_2_Tx_125a0ab3
        ComIPduSignalRef = HUT42_0x1F9_oHUT42_oB30_for_SC_CAN_V3_2_07cf90c9_Tx
        ComPduIdRef = HUT42_oB30_for_SC_CAN_V3_2_2a9b9562_Tx
        ComIPduGroupRef = HUT_oB30_for_SC_CAN_V3_2_Tx_HEV
        ComTxIPdu: ComMinimumDelayTime=0.045, ComTxIPduUnusedAreasDefault=0
          ComTxModeTrue
            ComTxMode: ComTxModeMode=NONE, ComTxModeNumberOfRepetitions=0, ComTxModeRepetitionPeriod=0
          ComTxModeFalse
            ComTxMode: ComTxModeMode=NONE, ComTxModeNumberOfRepetitions=0, ComTxModeRepetitionPeriod=0
      HUT43_0x1FD_oHUT43_oB30_for_SC_CAN_V3_2_6355320f_Tx (ComSignal):
        ComBitPosition = 0
        ComSignalEndianness = opaque
        ComSignalInitValue = 0 0 0 0 0 0 0 0
        ComSignalLength = 8
        ComSignalType = UINT8_N
        ComTransferProperty = TRIGGERED
        ComSignalAccess = ACCESS_UNCLEAR
        ComHandleId = 42
        ComNotification = ComEx_TransmitPdu_HUT43_Confiratmion
        ComSystemTemplateSystemSignalRef = HUT43_0x1FD
      Trailer1_oB30_for_SC_CAN_V3_2_7da566bd_Rx (ComIPdu):
        ComIPduDirection = RECEIVE
        ComIPduType = NORMAL
        ComIPduHandleId = 138
        ComIPduSignalProcessing = DEFERRED
        ComIPduCancellationSupport = false
        ComIPduCallout = ComEx_ReceivePduCallout
        ComIPduGroupRef = HUT_oB30_for_SC_CAN_V3_2_Rx_4400ad35
        ComIPduSignalRef = Trailer1_0x273_oTrailer1_oB30_for_SC_CAN_V3_2_e6f8aad9_Rx
        ComPduIdRef = Trailer1_oB30_for_SC_CAN_V3_2_7da566bd_Rx
      SyncRequstReseverData_oHUT_Sync_Req_oB30_for_SC_CAN_V3_2_92a62205_Tx (ComSignal):
        ComBitPosition = 8
        ComSignalEndianness = opaque
        ComSignalInitValue = 0 0 0 0 0 0 0
        ComSignalLength = 7
        ComSignalType = UINT8_N
        ComTransferProperty = TRIGGERED
        ComSignalAccess = ACCESS_UNCLEAR
        ComHandleId = 55
        ComSystemTemplateSystemSignalRef = SyncRequstReseverData
      T_BOX_FD1_oB30_for_SC_CAN_V3_2_bf5dcd7a_Rx (ComIPdu):
        ComIPduDirection = RECEIVE
        ComIPduType = NORMAL
        ComIPduHandleId = 133
        ComIPduSignalProcessing = DEFERRED
        ComIPduCancellationSupport = false
        ComIPduCallout = ComEx_ReceivePduCallout
        ComIPduGroupRef = HUT_oB30_for_SC_CAN_V3_2_Rx_4400ad35
        ComIPduSignalRef = T_BOX_FD1_0x33_oT_BOX_FD1_oB30_for_SC_CAN_V3_2_f218711f_Rx
        ComPduIdRef = T_BOX_FD1_oB30_for_SC_CAN_V3_2_bf5dcd7a_Rx
      T_BOX_FD3_oB30_for_SC_CAN_V3_2_910d04fa_Rx (ComIPdu):
        ComIPduDirection = RECEIVE
        ComIPduType = NORMAL
        ComIPduHandleId = 134
        ComIPduSignalProcessing = DEFERRED
        ComIPduCancellationSupport = false
        ComIPduCallout = ComEx_ReceivePduCallout
        ComIPduGroupRef = HUT_oB30_for_SC_CAN_V3_2_Rx_4400ad35
        ComIPduSignalRef = T_BOX_FD3_0x3E9_oT_BOX_FD3_oB30_for_SC_CAN_V3_2_4f9ede14_Rx
        ComPduIdRef = T_BOX_FD3_oB30_for_SC_CAN_V3_2_910d04fa_Rx
      3 x ComSignal:
        SyncRequestMessageId_oHUT_Sync_Req_oB30_for_SC_CAN_V3_2_d94984d1_Tx: ComBitPosition=7, ComBitSize=8, ComSignalEndianness=BIG_ENDIAN, ComSignalInitValue=0, ComSignalType=UINT8, ComTransferProperty=TRIGGERED, ComSignalAccess=ACCESS_UNCLEAR, ComHandleId=54, ComSystemTemplateSystemSignalRef=SyncRequestMessageId
        T_BOX_FD1_0x33_oT_BOX_FD1_oB30_for_SC_CAN_V3_2_f218711f_Rx: ComBitPosition=0, ComSignalEndianness=opaque, ComSignalInitValue=0 0 0 0 0 0 0 0, ComSignalLength=8, ComSignalType=UINT8_N, ComSignalAccess=ACCESS_UNCLEAR, ComHandleId=132, ComSystemTemplateSystemSignalRef=T_BOX_FD1_0x33
        EPS_FD1_0x147_oEPS_FD1_oB30_for_SC_CAN_V3_2_fd5fd087_Rx: ComBitPosition=0, ComSignalEndianness=opaque, ComSignalInitValue=0 0 0 0 0 0 0 0 0 0 0 0 0 0 0 0 0 0 0 0 0 0 0 0 0 0 0 0 0 0 0 0 0 0 0 0 0 0 0 0 0 0 0 0 0 0 0 0 0 0 0 0 0 0 0 0 0 0 0 0 0 0 0 0, ComSignalLength=64, ComSignalType=UINT8_N, ComSignalAccess=ACCESS_NEEDED_BY_SWC_OR_COM, ComHandleId=75, ComNotification=Rte_COMCbk_EPS_FD1_0x147_oEPS_FD1_oB30_for_SC_CAN_V3_2_fd5fd087_Rx, ComTimeoutNotification=Rte_COMCbkRxTOut_EPS_FD1_0x147_oEPS_FD1_oB30_for_SC_CAN_V3_2_fd5fd087_Rx, ComTimeout=0.2, ComSystemTemplateSystemSignalRef=EPS_FD1_0x147
      HUT_Sync_Req_oB30_for_SC_CAN_V3_2_c00563cb_Tx (ComIPdu):
        ComIPduDirection = SEND
        ComIPduType = NORMAL
        ComIPduHandleId = 45
        ComIPduSignalProcessing = DEFERRED
        ComIPduCancellationSupport = false
        ComIPduCallout = ComEx_TransmitPduCallout
        ComIPduGroupRef = HUT_oB30_for_SC_CAN_V3_2_Tx_125a0ab3
        ComIPduSignalRef = SyncRequestMessageId_oHUT_Sync_Req_oB30_for_SC_CAN_V3_2_d94984d1_Tx
        ComIPduSignalRef = SyncRequstReseverData_oHUT_Sync_Req_oB30_for_SC_CAN_V3_2_92a62205_Tx
        ComPduIdRef = HUT_Sync_Req_oB30_for_SC_CAN_V3_2_c00563cb_Tx
        ComIPduGroupRef = HUT_oB30_for_SC_CAN_V3_2_Tx_HEV
        ComTxIPdu: ComMinimumDelayTime=0, ComTxIPduUnusedAreasDefault=0
          ComTxModeTrue
            ComTxMode: ComTxModeMode=DIRECT, ComTxModeNumberOfRepetitions=0, ComTxModeRepetitionPeriod=0
          ComTxModeFalse
            ComTxMode: ComTxModeMode=DIRECT, ComTxModeNumberOfRepetitions=0, ComTxModeRepetitionPeriod=0
      T_BOX_FD3_0x3E9_oT_BOX_FD3_oB30_for_SC_CAN_V3_2_4f9ede14_Rx (ComSignal):
        ComBitPosition = 0
        ComSignalEndianness = opaque
        ComSignalInitValue = 0 0 0 0 0 0 0 0
        ComSignalLength = 8
        ComSignalType = UINT8_N
        ComSignalAccess = ACCESS_UNCLEAR
        ComHandleId = 133
        ComSystemTemplateSystemSignalRef = T_BOX_FD3_0x3E9
      EPS_FD1_oB30_for_SC_CAN_V3_2_bceaa863_Rx (ComIPdu):
        ComIPduDirection = RECEIVE
        ComIPduType = NORMAL
        ComIPduHandleId = 75
        ComIPduSignalProcessing = DEFERRED
        ComIPduCancellationSupport = false
        ComIPduCallout = ComEx_ReceivePduCallout
        ComIPduGroupRef = HUT_oB30_for_SC_CAN_V3_2_Rx_4400ad35
        ComIPduSignalRef = EPS_FD1_0x147_oEPS_FD1_oB30_for_SC_CAN_V3_2_fd5fd087_Rx
        ComPduIdRef = EPS_FD1_oB30_for_SC_CAN_V3_2_bceaa863_Rx
      DWD1_0x2B9_oDWD1_oB30_for_SC_CAN_V3_2_0a15b1ed_Rx (ComSignal):
        ComBitPosition = 0
        ComSignalEndianness = opaque
        ComSignalInitValue = 0 0 0 0 0 0 0 0
        ComSignalLength = 8
        ComSignalType = UINT8_N
        ComSignalAccess = ACCESS_UNCLEAR
        ComHandleId = 56
        ComSystemTemplateSystemSignalRef = DWD1_0x2B9
      HUT7_oB30_for_SC_CAN_V3_2_ffbef2e3_Tx (ComIPdu):
        ComIPduDirection = SEND
        ComIPduType = NORMAL
        ComIPduHandleId = 8
        ComIPduSignalProcessing = DEFERRED
        ComIPduCancellationSupport = false
        ComIPduCallout = ComEx_TransmitPduCallout
        ComIPduGroupRef = HUT_oB30_for_SC_CAN_V3_2_Tx_125a0ab3
        ComIPduSignalRef = HUT7_0x44_oHUT7_oB30_for_SC_CAN_V3_2_b4003dd4_Tx
        ComPduIdRef = HUT7_oB30_for_SC_CAN_V3_2_ffbef2e3_Tx
        ComIPduGroupRef = HUT_oB30_for_SC_CAN_V3_2_Tx_HEV
        ComTxIPdu: ComMinimumDelayTime=0.045, ComTxIPduUnusedAreasDefault=0
          ComTxModeTrue
            ComTxMode: ComTxModeMode=NONE, ComTxModeNumberOfRepetitions=0, ComTxModeRepetitionPeriod=0
          ComTxModeFalse
            ComTxMode: ComTxModeMode=NONE, ComTxModeNumberOfRepetitions=0, ComTxModeRepetitionPeriod=0
      HUT36_oB30_for_SC_CAN_V3_2_00839ecc_Tx (ComIPdu):
        ComIPduDirection = SEND
        ComIPduType = NORMAL
        ComIPduHandleId = 29
        ComIPduSignalProcessing = DEFERRED
        ComIPduCancellationSupport = false
        ComIPduCallout = ComEx_TransmitPduCallout
        ComIPduGroupRef = HUT_oB30_for_SC_CAN_V3_2_Tx_125a0ab3
        ComIPduSignalRef = HUT36_0x1E6_oHUT36_oB30_for_SC_CAN_V3_2_e1e602ab_Tx
        ComPduIdRef = HUT36_oB30_for_SC_CAN_V3_2_00839ecc_Tx
        ComTxIPdu: ComMinimumDelayTime=0.045, ComTxIPduUnusedAreasDefault=0
          ComTxModeTrue
            ComTxMode: ComTxModeMode=NONE, ComTxModeNumberOfRepetitions=0, ComTxModeRepetitionPeriod=0
          ComTxModeFalse
            ComTxMode: ComTxModeMode=NONE, ComTxModeNumberOfRepetitions=0, ComTxModeRepetitionPeriod=0
      5 x ComSignal, all with ComBitPosition=0, ComSignalEndianness=opaque, ComSignalType=UINT8_N, ComSignalAccess=ACCESS_UNCLEAR:
        HUT37_0x1EC_oHUT37_oB30_for_SC_CAN_V3_2_2ba065cf_Tx: ComSignalInitValue=0 0 0 0 0 0 0 0, ComSignalLength=8, ComTransferProperty=TRIGGERED, ComHandleId=36, ComNotification=ComEx_TransmitPdu_HUT37_Confiratmion, ComSystemTemplateSystemSignalRef=HUT37_0x1EC
        HUT_FD3_0x243_oHUT_FD3_oB30_for_SC_CAN_V3_2_dc4d3bf6_Tx: ComSignalInitValue=0 0 0 0 0 0 0 0 0 0 0 0 0 0 0 0 0 0 0 0 0 0 0 0 0 0 0 0 0 0 0 0 0 0 0 0 0 0 0 0 0 0 0 0 0 0 0 0 0 0 0 0 0 0 0 0 0 0 0 0 0 0 0 0, ComSignalLength=64, ComTransferProperty=PENDING, ComHandleId=48, ComNotification=ComEx_TransmitPdu_HUT_FD3_Confiratmion, ComSystemTemplateSystemSignalRef=HUT_FD3_0x243
        HUT41_0x1FB_oHUT41_oB30_for_SC_CAN_V3_2_982902c7_Tx: ComSignalInitValue=0 0 0 0 0 0 0 0, ComSignalLength=8, ComTransferProperty=TRIGGERED, ComHandleId=40, ComNotification=ComEx_TransmitPdu_HUT41_Confiratmion, ComSystemTemplateSystemSignalRef=HUT41_0x1FB
        DSC4_0x2CE_oDSC4_oB30_for_SC_CAN_V3_2_fb519096_Rx: ComSignalInitValue=0 0 0 0 0 0 0 0, ComSignalLength=8, ComHandleId=54, ComSystemTemplateSystemSignalRef=DSC4_0x2CE
        HUT46_0x1DD_oHUT46_oB30_for_SC_CAN_V3_2_171947b5_Tx: ComSignalInitValue=0 0 0 0 0 0 0 0, ComSignalLength=8, ComTransferProperty=TRIGGERED, ComHandleId=44, ComNotification=ComEx_TransmitPdu_HUT46_Confiratmion, ComSystemTemplateSystemSignalRef=HUT46_0x1DD
      3 x ComIPdu, all with ComIPduType=NORMAL, ComIPduSignalProcessing=DEFERRED, ComIPduCancellationSupport=false:
        HUT46_oB30_for_SC_CAN_V3_2_763a0662_Tx: ComIPduDirection=SEND, ComIPduHandleId=38, ComIPduCallout=ComEx_TransmitPduCallout, ComIPduGroupRef=HUT_oB30_for_SC_CAN_V3_2_Tx_125a0ab3, ComIPduSignalRef=HUT46_0x1DD_oHUT46_oB30_for_SC_CAN_V3_2_171947b5_Tx, ComPduIdRef=HUT46_oB30_for_SC_CAN_V3_2_763a0662_Tx, ComIPduGroupRef=HUT_oB30_for_SC_CAN_V3_2_Tx_HEV
          ComTxIPdu: ComMinimumDelayTime=0.045, ComTxIPduUnusedAreasDefault=0
            ComTxModeTrue
              ComTxMode: ComTxModeMode=NONE, ComTxModeNumberOfRepetitions=0, ComTxModeRepetitionPeriod=0
            ComTxModeFalse
              ComTxMode: ComTxModeMode=NONE, ComTxModeNumberOfRepetitions=0, ComTxModeRepetitionPeriod=0
        HUT41_oB30_for_SC_CAN_V3_2_13e33822_Tx: ComIPduDirection=SEND, ComIPduHandleId=34, ComIPduCallout=ComEx_TransmitPduCallout, ComIPduGroupRef=HUT_oB30_for_SC_CAN_V3_2_Tx_125a0ab3, ComIPduSignalRef=HUT41_0x1FB_oHUT41_oB30_for_SC_CAN_V3_2_982902c7_Tx, ComPduIdRef=HUT41_oB30_for_SC_CAN_V3_2_13e33822_Tx, ComIPduGroupRef=HUT_oB30_for_SC_CAN_V3_2_Tx_HEV
          ComTxIPdu: ComMinimumDelayTime=0.045, ComTxIPduUnusedAreasDefault=0
            ComTxModeTrue
              ComTxMode: ComTxModeMode=NONE, ComTxModeNumberOfRepetitions=0, ComTxModeRepetitionPeriod=0
            ComTxModeFalse
              ComTxMode: ComTxModeMode=NONE, ComTxModeNumberOfRepetitions=0, ComTxModeRepetitionPeriod=0
        DOCK2_oB30_for_SC_CAN_V3_2_8f72bca2_Rx: ComIPduDirection=RECEIVE, ComIPduHandleId=53, ComIPduCallout=ComEx_ReceivePduCallout, ComIPduGroupRef=HUT_oB30_for_SC_CAN_V3_2_Rx_4400ad35, ComIPduSignalRef=DOCK2_0x1DF_oDOCK2_oB30_for_SC_CAN_V3_2_2bb215fd_Rx, ComPduIdRef=DOCK2_oB30_for_SC_CAN_V3_2_8f72bca2_Rx
      HUT7_0x44_oHUT7_oB30_for_SC_CAN_V3_2_b4003dd4_Tx (ComSignal):
        ComBitPosition = 0
        ComSignalEndianness = opaque
        ComSignalInitValue = 0 0 0 0 0 0 0 0
        ComSignalLength = 8
        ComSignalType = UINT8_N
        ComTransferProperty = TRIGGERED
        ComSignalAccess = ACCESS_UNCLEAR
        ComHandleId = 14
        ComNotification = ComEx_TransmitPdu_HUT7_Confiratmion
        ComSystemTemplateSystemSignalRef = HUT7_0x44
      DSC4_oB30_for_SC_CAN_V3_2_d686ca5d_Rx (ComIPdu):
        ComIPduDirection = RECEIVE
        ComIPduType = NORMAL
        ComIPduHandleId = 54
        ComIPduSignalProcessing = DEFERRED
        ComIPduCancellationSupport = false
        ComIPduCallout = ComEx_ReceivePduCallout
        ComIPduGroupRef = HUT_oB30_for_SC_CAN_V3_2_Rx_4400ad35
        ComIPduSignalRef = DSC4_0x2CE_oDSC4_oB30_for_SC_CAN_V3_2_fb519096_Rx
        ComPduIdRef = DSC4_oB30_for_SC_CAN_V3_2_d686ca5d_Rx
      HUT_FD5_0x1DB_oHUT_FD5_oB30_for_SC_CAN_V3_2_fbeae75e_Tx (ComSignal):
        ComBitPosition = 0
        ComSignalEndianness = opaque
        ComSignalInitValue = 0 0 0 0 0 0 0 0 0 0 0 0 0 0 0 0 0 0 0 0 0 0 0 0 0 0 0 0 0 0 0 0 0 0 0 0 0 0 0 0 0 0 0 0 0 0 0 0 0 0 0 0 0 0 0 0 0 0 0 0 0 0 0 0
        ComSignalLength = 64
        ComSignalType = UINT8_N
        ComTransferProperty = TRIGGERED
        ComSignalAccess = ACCESS_UNCLEAR
        ComHandleId = 50
        ComNotification = ComEx_TransmitPdu_HUT_FD5_Confiratmion
        ComSystemTemplateSystemSignalRef = HUT_FD5_0x1DB
      DOCK2_0x1DF_oDOCK2_oB30_for_SC_CAN_V3_2_2bb215fd_Rx (ComSignal):
        ComBitPosition = 0
        ComSignalEndianness = opaque
        ComSignalInitValue = 0 0 0 0 0 0 0 0 0 0 0 0 0 0 0 0 0 0 0 0 0 0 0 0 0 0 0 0 0 0 0 0 0 0 0 0 0 0 0 0 0 0 0 0 0 0 0 0 0 0 0 0 0 0 0 0 0 0 0 0 0 0 0 0
        ComSignalLength = 64
        ComSignalType = UINT8_N
        ComSignalAccess = ACCESS_UNCLEAR
        ComHandleId = 53
        ComSystemTemplateSystemSignalRef = DOCK2_0x1DF
      HUT_FD5_oB30_for_SC_CAN_V3_2_3d88d1c0_Tx (ComIPdu):
        ComIPduDirection = SEND
        ComIPduType = NORMAL
        ComIPduHandleId = 44
        ComIPduSignalProcessing = DEFERRED
        ComIPduCancellationSupport = false
        ComIPduCallout = ComEx_TransmitPduCallout
        ComIPduGroupRef = HUT_oB30_for_SC_CAN_V3_2_Tx_125a0ab3
        ComIPduSignalRef = HUT_FD5_0x1DB_oHUT_FD5_oB30_for_SC_CAN_V3_2_fbeae75e_Tx
        ComPduIdRef = HUT_FD5_oB30_for_SC_CAN_V3_2_3d88d1c0_Tx
        ComIPduGroupRef = HUT_oB30_for_SC_CAN_V3_2_Tx_HEV
        ComTxIPdu: ComMinimumDelayTime=0.045, ComTxIPduUnusedAreasDefault=0
          ComTxModeTrue
            ComTxMode: ComTxModeMode=NONE, ComTxModeNumberOfRepetitions=0, ComTxModeRepetitionPeriod=0
          ComTxModeFalse
            ComTxMode: ComTxModeMode=NONE, ComTxModeNumberOfRepetitions=0, ComTxModeRepetitionPeriod=0
      HUT40_0x224_oHUT40_oB30_for_SC_CAN_V3_2_9c3909d3_Tx (ComSignal):
        ComBitPosition = 0
        ComSignalEndianness = opaque
        ComSignalInitValue = 0 0 0 0 0 0 0 0
        ComSignalLength = 8
        ComSignalType = UINT8_N
        ComTransferProperty = PENDING
        ComSignalAccess = ACCESS_UNCLEAR
        ComHandleId = 39
        ComNotification = ComEx_TransmitPdu_HUT40_Confiratmion
        ComSystemTemplateSystemSignalRef = HUT40_0x224
      DOCK1_oB30_for_SC_CAN_V3_2_b60a11e2_Rx (ComIPdu):
        ComIPduDirection = RECEIVE
        ComIPduType = NORMAL
        ComIPduHandleId = 52
        ComIPduSignalProcessing = DEFERRED
        ComIPduCancellationSupport = false
        ComIPduCallout = ComEx_ReceivePduCallout
        ComIPduGroupRef = HUT_oB30_for_SC_CAN_V3_2_Rx_4400ad35
        ComIPduSignalRef = DOCK1_0x311_oDOCK1_oB30_for_SC_CAN_V3_2_143f2c45_Rx
        ComPduIdRef = DOCK1_oB30_for_SC_CAN_V3_2_b60a11e2_Rx
      DWD1_oB30_for_SC_CAN_V3_2_82b03b6c_Rx (ComIPdu):
        ComIPduDirection = RECEIVE
        ComIPduType = NORMAL
        ComIPduHandleId = 56
        ComIPduSignalProcessing = DEFERRED
        ComIPduCancellationSupport = false
        ComIPduCallout = ComEx_ReceivePduCallout
        ComIPduGroupRef = HUT_oB30_for_SC_CAN_V3_2_Rx_4400ad35
        ComIPduSignalRef = DWD1_0x2B9_oDWD1_oB30_for_SC_CAN_V3_2_0a15b1ed_Rx
        ComPduIdRef = DWD1_oB30_for_SC_CAN_V3_2_82b03b6c_Rx
      HUT36_0x1E6_oHUT36_oB30_for_SC_CAN_V3_2_e1e602ab_Tx (ComSignal):
        ComBitPosition = 0
        ComSignalEndianness = opaque
        ComSignalInitValue = 0 0 0 0 0 0 0 0
        ComSignalLength = 8
        ComSignalType = UINT8_N
        ComTransferProperty = TRIGGERED
        ComSignalAccess = ACCESS_UNCLEAR
        ComHandleId = 35
        ComNotification = ComEx_TransmitPdu_HUT36_Confiratmion
        ComSystemTemplateSystemSignalRef = HUT36_0x1E6
      HUT37_oB30_for_SC_CAN_V3_2_17abfa0c_Tx (ComIPdu):
        ComIPduDirection = SEND
        ComIPduType = NORMAL
        ComIPduHandleId = 30
        ComIPduSignalProcessing = DEFERRED
        ComIPduCancellationSupport = false
        ComIPduCallout = ComEx_TransmitPduCallout
        ComIPduGroupRef = HUT_oB30_for_SC_CAN_V3_2_Tx_125a0ab3
        ComIPduSignalRef = HUT37_0x1EC_oHUT37_oB30_for_SC_CAN_V3_2_2ba065cf_Tx
        ComPduIdRef = HUT37_oB30_for_SC_CAN_V3_2_17abfa0c_Tx
        ComTxIPdu: ComMinimumDelayTime=0.045, ComTxIPduUnusedAreasDefault=0
          ComTxModeTrue
            ComTxMode: ComTxModeMode=NONE, ComTxModeNumberOfRepetitions=0, ComTxModeRepetitionPeriod=0
          ComTxModeFalse
            ComTxMode: ComTxModeMode=NONE, ComTxModeNumberOfRepetitions=0, ComTxModeRepetitionPeriod=0
      HUT_FD2_0x203_oHUT_FD2_oB30_for_SC_CAN_V3_2_3a1f5203_Tx (ComSignal):
        ComBitPosition = 0
        ComSignalEndianness = opaque
        ComSignalInitValue = 0 0 0 0 0 0 0 0 0 0 0 0 0 0 0 0 0 0 0 0 0 0 0 0 0 0 0 0 0 0 0 0 0 0 0 0 0 0 0 0 0 0 0 0 0 0 0 0 0 0 0 0 0 0 0 0 0 0 0 0 0 0 0 0
        ComSignalLength = 64
        ComSignalType = UINT8_N
        ComTransferProperty = PENDING
        ComSignalAccess = ACCESS_UNCLEAR
        ComHandleId = 47
        ComNotification = ComEx_TransmitPdu_HUT_FD2_Confiratmion
        ComSystemTemplateSystemSignalRef = HUT_FD2_0x203
      DOCK1_0x311_oDOCK1_oB30_for_SC_CAN_V3_2_143f2c45_Rx (ComSignal):
        ComBitPosition = 0
        ComSignalEndianness = opaque
        ComSignalInitValue = 0 0 0 0 0 0 0 0 0 0 0 0 0 0 0 0 0 0 0 0 0 0 0 0 0 0 0 0 0 0 0 0 0 0 0 0 0 0 0 0 0 0 0 0 0 0 0 0 0 0 0 0 0 0 0 0 0 0 0 0 0 0 0 0
        ComSignalLength = 64
        ComSignalType = UINT8_N
        ComSignalAccess = ACCESS_UNCLEAR
        ComHandleId = 52
        ComSystemTemplateSystemSignalRef = DOCK1_0x311
      HUT40_oB30_for_SC_CAN_V3_2_04cb5ce2_Tx (ComIPdu):
        ComIPduDirection = SEND
        ComIPduType = NORMAL
        ComIPduHandleId = 33
        ComIPduSignalProcessing = DEFERRED
        ComIPduCancellationSupport = false
        ComIPduCallout = ComEx_TransmitPduCallout
        ComIPduGroupRef = HUT_oB30_for_SC_CAN_V3_2_Tx_125a0ab3
        ComIPduSignalRef = HUT40_0x224_oHUT40_oB30_for_SC_CAN_V3_2_9c3909d3_Tx
        ComPduIdRef = HUT40_oB30_for_SC_CAN_V3_2_04cb5ce2_Tx
        ComIPduGroupRef = HUT_oB30_for_SC_CAN_V3_2_Tx_HEV
        ComTxIPdu: ComMinimumDelayTime=0, ComTxIPduUnusedAreasDefault=0
          ComTxModeTrue
            ComTxMode: ComTxModeMode=PERIODIC, ComTxModeTimePeriod=0.05, ComTxModeTimeOffset=0
          ComTxModeFalse
            ComTxMode: ComTxModeMode=PERIODIC, ComTxModeTimePeriod=0.05, ComTxModeTimeOffset=0
      ECM_PT7_0x117_oECM_PT7_oB30_for_SC_CAN_V3_2_e3782145_Rx (ComSignal):
        ComBitPosition = 0
        ComSignalEndianness = opaque
        ComSignalInitValue = 0 0 0 0 0 0 0 0
        ComSignalLength = 8
        ComSignalType = UINT8_N
        ComSignalAccess = ACCESS_UNCLEAR
        ComHandleId = 71
        ComSystemTemplateSystemSignalRef = ECM_PT7_0x117
      P2M1_oB30_for_SC_CAN_V3_2_8af900bc_Rx (ComIPdu):
        ComIPduDirection = RECEIVE
        ComIPduType = NORMAL
        ComIPduHandleId = 119
        ComIPduSignalProcessing = DEFERRED
        ComIPduCancellationSupport = false
        ComIPduCallout = ComEx_ReceivePduCallout
        ComIPduGroupRef = HUT_oB30_for_SC_CAN_V3_2_Rx_4400ad35
        ComIPduSignalRef = P2M1_0xAC_oP2M1_oB30_for_SC_CAN_V3_2_369d99f8_Rx
        ComPduIdRef = P2M1_oB30_for_SC_CAN_V3_2_8af900bc_Rx
      HCU_HC3_oB30_for_SC_CAN_V3_2_5ec02d05_Rx (ComIPdu):
        ComIPduDirection = RECEIVE
        ComIPduType = NORMAL
        ComIPduHandleId = 98
        ComIPduSignalProcessing = DEFERRED
        ComIPduCancellationSupport = false
        ComIPduCallout = ComEx_ReceivePduCallout
        ComIPduGroupRef = HUT_oB30_for_SC_CAN_V3_2_Rx_4400ad35
        ComIPduSignalRef = HCU_HC3_0x268_oHCU_HC3_oB30_for_SC_CAN_V3_2_69b49564_Rx
        ComPduIdRef = HCU_HC3_oB30_for_SC_CAN_V3_2_5ec02d05_Rx
      BMS8_0x285_oBMS8_oB30_for_SC_CAN_V3_2_cae03fe4_Rx (ComSignal):
        ComBitPosition = 0
        ComSignalEndianness = opaque
        ComSignalInitValue = 0 0 0 0 0 0 0 0
        ComSignalLength = 8
        ComSignalType = UINT8_N
        ComSignalAccess = ACCESS_UNCLEAR
        ComHandleId = 34
        ComSystemTemplateSystemSignalRef = BMS8_0x285
      BMS66_0x3AE_oBMS66_oB30_for_SC_CAN_V3_2_0f7b9919_Rx (ComSignal):
        ComBitPosition = 0
        ComSignalEndianness = opaque
        ComSignalInitValue = 0 0 0 0 0 0 0 0
        ComSignalLength = 8
        ComSignalType = UINT8_N
        ComSignalAccess = ACCESS_UNCLEAR
        ComHandleId = 40
        ComSystemTemplateSystemSignalRef = BMS66_0x3AE
      4 x ComIPdu, all with ComIPduDirection=RECEIVE, ComIPduType=NORMAL, ComIPduSignalProcessing=DEFERRED, ComIPduCancellationSupport=false, ComIPduCallout=ComEx_ReceivePduCallout, ComIPduGroupRef=HUT_oB30_for_SC_CAN_V3_2_Rx_4400ad35:
        HCU_PT8_oB30_for_SC_CAN_V3_2_0456fb24_Rx: ComIPduHandleId=109, ComIPduSignalRef=HCU_PT8_0x1C0_oHCU_PT8_oB30_for_SC_CAN_V3_2_c294c705_Rx, ComPduIdRef=HCU_PT8_oB30_for_SC_CAN_V3_2_0456fb24_Rx
        HCU_FD1_oB30_for_SC_CAN_V3_2_641912c5_Rx: ComIPduHandleId=97, ComIPduSignalRef=HCU_FD1_0x60_oHCU_FD1_oB30_for_SC_CAN_V3_2_3ebe3c03_Rx, ComPduIdRef=HCU_FD1_oB30_for_SC_CAN_V3_2_641912c5_Rx
        BMS66_oB30_for_SC_CAN_V3_2_9ecb30f6_Rx: ComIPduHandleId=40, ComIPduSignalRef=BMS66_0x3AE_oBMS66_oB30_for_SC_CAN_V3_2_0f7b9919_Rx, ComPduIdRef=BMS66_oB30_for_SC_CAN_V3_2_9ecb30f6_Rx
        ECM_PT7_oB30_for_SC_CAN_V3_2_2d7a7421_Rx: ComIPduHandleId=71, ComIPduSignalRef=ECM_PT7_0x117_oECM_PT7_oB30_for_SC_CAN_V3_2_e3782145_Rx, ComPduIdRef=ECM_PT7_oB30_for_SC_CAN_V3_2_2d7a7421_Rx
      7 x ComSignal, all with ComBitPosition=0, ComSignalEndianness=opaque, ComSignalType=UINT8_N, ComSignalAccess=ACCESS_UNCLEAR:
        ECM_PT6_0x290_oECM_PT6_oB30_for_SC_CAN_V3_2_e4144dec_Rx: ComSignalInitValue=0 0 0 0 0 0 0 0, ComSignalLength=8, ComHandleId=70, ComSystemTemplateSystemSignalRef=ECM_PT6_0x290
        HCU_FD1_0x60_oHCU_FD1_oB30_for_SC_CAN_V3_2_3ebe3c03_Rx: ComSignalInitValue=0 0 0 0 0 0 0 0 0 0 0 0 0 0 0 0 0 0 0 0 0 0 0 0 0 0 0 0 0 0 0 0 0 0 0 0 0 0 0 0 0 0 0 0 0 0 0 0 0 0 0 0 0 0 0 0 0 0 0 0 0 0 0 0, ComSignalLength=64, ComHandleId=96, ComSystemTemplateSystemSignalRef=HCU_FD1_0x60
        P2M3_0xBE_oP2M3_oB30_for_SC_CAN_V3_2_d59c14bc_Rx: ComSignalInitValue=0 0 0 0 0 0 0 0, ComSignalLength=8, ComHandleId=119, ComSystemTemplateSystemSignalRef=P2M3_0xBE
        HCU_HC3_0x268_oHCU_HC3_oB30_for_SC_CAN_V3_2_69b49564_Rx: ComSignalInitValue=0 0 0 0 0 0 0 0, ComSignalLength=8, ComHandleId=97, ComSystemTemplateSystemSignalRef=HCU_HC3_0x268
        HCU_HC6_0x314_oHCU_HC6_oB30_for_SC_CAN_V3_2_0e5944ae_Rx: ComSignalInitValue=0 0 0 0 0 0 0 0, ComSignalLength=8, ComHandleId=98, ComSystemTemplateSystemSignalRef=HCU_HC6_0x314
        EBOOSTER_FD1_0x12D_oEBOOSTER_FD1_oB30_for_SC_CAN_V3_2_276bef9e_Rx: ComSignalInitValue=0 0 0 0 0 0 0 0 0 0 0 0 0 0 0 0 0 0 0 0 0 0 0 0 0 0 0 0 0 0 0 0 0 0 0 0 0 0 0 0 0 0 0 0 0 0 0 0 0 0 0 0 0 0 0 0 0 0 0 0 0 0 0 0, ComSignalLength=64, ComHandleId=57, ComSystemTemplateSystemSignalRef=EBOOSTER_FD1_0x12D
        BMS19_0x352_oBMS19_oB30_for_SC_CAN_V3_2_9c6d6e6b_Rx: ComSignalInitValue=0 0 0 0 0 0 0 0, ComSignalLength=8, ComHandleId=35, ComSystemTemplateSystemSignalRef=BMS19_0x352
      HCU_PT5_oB30_for_SC_CAN_V3_2_f69c2ae4_Rx (ComIPdu):
        ComIPduDirection = RECEIVE
        ComIPduType = NORMAL
        ComIPduHandleId = 107
        ComIPduSignalProcessing = DEFERRED
        ComIPduCancellationSupport = false
        ComIPduCallout = ComEx_ReceivePduCallout
        ComIPduGroupRef = HUT_oB30_for_SC_CAN_V3_2_Rx_4400ad35
        ComIPduSignalRef = HCU_PT5_0x14A_oHCU_PT5_oB30_for_SC_CAN_V3_2_004da173_Rx
        ComPduIdRef = HCU_PT5_oB30_for_SC_CAN_V3_2_f69c2ae4_Rx
      3 x ComSignal, all with ComBitPosition=0, ComSignalEndianness=opaque, ComSignalInitValue=0 0 0 0 0 0 0 0, ComSignalLength=8, ComSignalType=UINT8_N, ComSignalAccess=ACCESS_UNCLEAR:
        HCU_HP8_0xF9_oHCU_HP8_oB30_for_SC_CAN_V3_2_1d9304d5_Rx: ComHandleId=104, ComSystemTemplateSystemSignalRef=HCU_HP8_0xF9
        ECM_PT5_0x8E_oECM_PT5_oB30_for_SC_CAN_V3_2_9b098e80_Rx: ComHandleId=69, ComSystemTemplateSystemSignalRef=ECM_PT5_0x8E
        HCU_HC8_0x1E2_oHCU_HC8_oB30_for_SC_CAN_V3_2_c53eaa25_Rx: ComHandleId=100, ComSystemTemplateSystemSignalRef=HCU_HC8_0x1E2
      ECM_PT6_oB30_for_SC_CAN_V3_2_3a5210e1_Rx (ComIPdu):
        ComIPduDirection = RECEIVE
        ComIPduType = NORMAL
        ComIPduHandleId = 70
        ComIPduSignalProcessing = DEFERRED
        ComIPduCancellationSupport = false
        ComIPduCallout = ComEx_ReceivePduCallout
        ComIPduGroupRef = HUT_oB30_for_SC_CAN_V3_2_Rx_4400ad35
        ComIPduSignalRef = ECM_PT6_0x290_oECM_PT6_oB30_for_SC_CAN_V3_2_e4144dec_Rx
        ComPduIdRef = ECM_PT6_oB30_for_SC_CAN_V3_2_3a5210e1_Rx
      BMS8_oB30_for_SC_CAN_V3_2_44968464_Rx (ComIPdu):
        ComIPduDirection = RECEIVE
        ComIPduType = NORMAL
        ComIPduHandleId = 34
        ComIPduSignalProcessing = DEFERRED
        ComIPduCancellationSupport = false
        ComIPduCallout = ComEx_ReceivePduCallout
        ComIPduGroupRef = HUT_oB30_for_SC_CAN_V3_2_Rx_4400ad35
        ComIPduSignalRef = BMS8_0x285_oBMS8_oB30_for_SC_CAN_V3_2_cae03fe4_Rx
        ComPduIdRef = BMS8_oB30_for_SC_CAN_V3_2_44968464_Rx
      BMS_FD14_0x1E3_oBMS_FD14_oB30_for_SC_CAN_V3_2_60b89745_Rx (ComSignal):
        ComBitPosition = 0
        ComSignalEndianness = opaque
        ComSignalInitValue = 0 0 0 0 0 0 0 0
        ComSignalLength = 8
        ComSignalType = UINT8_N
        ComSignalAccess = ACCESS_UNCLEAR
        ComHandleId = 41
        ComSystemTemplateSystemSignalRef = BMS_FD14_0x1E3
      BMS22_0x3BF_oBMS22_oB30_for_SC_CAN_V3_2_02e5eecb_Rx (ComSignal):
        ComBitPosition = 0
        ComSignalEndianness = opaque
        ComSignalInitValue = 0 0 0 0 0 0 0 0
        ComSignalLength = 8
        ComSignalType = UINT8_N
        ComSignalAccess = ACCESS_UNCLEAR
        ComHandleId = 36
        ComSystemTemplateSystemSignalRef = BMS22_0x3BF
      BMS22_oB30_for_SC_CAN_V3_2_c2360265_Rx (ComIPdu):
        ComIPduDirection = RECEIVE
        ComIPduType = NORMAL
        ComIPduHandleId = 36
        ComIPduSignalProcessing = DEFERRED
        ComIPduCancellationSupport = false
        ComIPduCallout = ComEx_ReceivePduCallout
        ComIPduGroupRef = HUT_oB30_for_SC_CAN_V3_2_Rx_4400ad35
        ComIPduSignalRef = BMS22_0x3BF_oBMS22_oB30_for_SC_CAN_V3_2_02e5eecb_Rx
        ComPduIdRef = BMS22_oB30_for_SC_CAN_V3_2_c2360265_Rx
      T_BOX_FD9_0x1FE_oT_BOX_FD9_oB30_for_SC_CAN_V3_2_a242690e_Rx (ComSignal):
        ComBitPosition = 0
        ComSignalEndianness = opaque
        ComSignalInitValue = 0 0 0 0 0 0 0 0
        ComSignalLength = 8
        ComSignalType = UINT8_N
        ComSignalAccess = ACCESS_UNCLEAR
        ComHandleId = 135
        ComSystemTemplateSystemSignalRef = T_BOX_FD9_0x1FE
      P2M1_0xAC_oP2M1_oB30_for_SC_CAN_V3_2_369d99f8_Rx (ComSignal):
        ComBitPosition = 0
        ComSignalEndianness = opaque
        ComSignalInitValue = 0 0 0 0 0 0 0 0
        ComSignalLength = 8
        ComSignalType = UINT8_N
        ComSignalAccess = ACCESS_UNCLEAR
        ComHandleId = 118
        ComSystemTemplateSystemSignalRef = P2M1_0xAC
      HCU_HC8_oB30_for_SC_CAN_V3_2_defba645_Rx (ComIPdu):
        ComIPduDirection = RECEIVE
        ComIPduType = NORMAL
        ComIPduHandleId = 101
        ComIPduSignalProcessing = DEFERRED
        ComIPduCancellationSupport = false
        ComIPduCallout = ComEx_ReceivePduCallout
        ComIPduGroupRef = HUT_oB30_for_SC_CAN_V3_2_Rx_4400ad35
        ComIPduSignalRef = HCU_HC8_0x1E2_oHCU_HC8_oB30_for_SC_CAN_V3_2_c53eaa25_Rx
        ComPduIdRef = HCU_HC8_oB30_for_SC_CAN_V3_2_defba645_Rx
      BMS30_0x3F1_oBMS30_oB30_for_SC_CAN_V3_2_43871adf_Rx (ComSignal):
        ComBitPosition = 0
        ComSignalEndianness = opaque
        ComSignalInitValue = 0 0 0 0 0 0 0 0
        ComSignalLength = 8
        ComSignalType = UINT8_N
        ComSignalAccess = ACCESS_UNCLEAR
        ComHandleId = 37
        ComSystemTemplateSystemSignalRef = BMS30_0x3F1
      6 x ComIPdu, all with ComIPduDirection=RECEIVE, ComIPduType=NORMAL, ComIPduSignalProcessing=DEFERRED, ComIPduCancellationSupport=false, ComIPduCallout=ComEx_ReceivePduCallout, ComIPduGroupRef=HUT_oB30_for_SC_CAN_V3_2_Rx_4400ad35:
        BMS19_oB30_for_SC_CAN_V3_2_34e8b018_Rx: ComIPduHandleId=35, ComIPduSignalRef=BMS19_0x352_oBMS19_oB30_for_SC_CAN_V3_2_9c6d6e6b_Rx, ComPduIdRef=BMS19_oB30_for_SC_CAN_V3_2_34e8b018_Rx
        BMS_FD14_oB30_for_SC_CAN_V3_2_20801849_Rx: ComIPduHandleId=41, ComIPduSignalRef=BMS_FD14_0x1E3_oBMS_FD14_oB30_for_SC_CAN_V3_2_60b89745_Rx, ComPduIdRef=BMS_FD14_oB30_for_SC_CAN_V3_2_20801849_Rx
        EBOOSTER_FD1_oB30_for_SC_CAN_V3_2_683305cd_Rx: ComIPduHandleId=57, ComIPduSignalRef=EBOOSTER_FD1_0x12D_oEBOOSTER_FD1_oB30_for_SC_CAN_V3_2_276bef9e_Rx, ComPduIdRef=EBOOSTER_FD1_oB30_for_SC_CAN_V3_2_683305cd_Rx
        HCU_HP8_oB30_for_SC_CAN_V3_2_a96c1934_Rx: ComIPduHandleId=105, ComIPduSignalRef=HCU_HP8_0xF9_oHCU_HP8_oB30_for_SC_CAN_V3_2_1d9304d5_Rx, ComPduIdRef=HCU_HP8_oB30_for_SC_CAN_V3_2_a96c1934_Rx
        BMS30_oB30_for_SC_CAN_V3_2_77152131_Rx: ComIPduHandleId=37, ComIPduSignalRef=BMS30_0x3F1_oBMS30_oB30_for_SC_CAN_V3_2_43871adf_Rx, ComPduIdRef=BMS30_oB30_for_SC_CAN_V3_2_77152131_Rx
        ECM_PT5_oB30_for_SC_CAN_V3_2_032abda1_Rx: ComIPduHandleId=69, ComIPduSignalRef=ECM_PT5_0x8E_oECM_PT5_oB30_for_SC_CAN_V3_2_9b098e80_Rx, ComPduIdRef=ECM_PT5_oB30_for_SC_CAN_V3_2_032abda1_Rx
      HCU_PT5_0x14A_oHCU_PT5_oB30_for_SC_CAN_V3_2_004da173_Rx (ComSignal):
        ComBitPosition = 0
        ComSignalEndianness = opaque
        ComSignalInitValue = 0 0 0 0 0 0 0 0
        ComSignalLength = 8
        ComSignalType = UINT8_N
        ComSignalAccess = ACCESS_UNCLEAR
        ComHandleId = 106
        ComSystemTemplateSystemSignalRef = HCU_PT5_0x14A
      T_BOX_FD9_oB30_for_SC_CAN_V3_2_061eeb7a_Rx (ComIPdu):
        ComIPduDirection = RECEIVE
        ComIPduType = NORMAL
        ComIPduHandleId = 136
        ComIPduSignalProcessing = DEFERRED
        ComIPduCancellationSupport = false
        ComIPduCallout = ComEx_ReceivePduCallout
        ComIPduGroupRef = HUT_oB30_for_SC_CAN_V3_2_Rx_4400ad35
        ComIPduSignalRef = T_BOX_FD9_0x1FE_oT_BOX_FD9_oB30_for_SC_CAN_V3_2_a242690e_Rx
        ComPduIdRef = T_BOX_FD9_oB30_for_SC_CAN_V3_2_061eeb7a_Rx
      P2M3_oB30_for_SC_CAN_V3_2_a4a9c93c_Rx (ComIPdu):
        ComIPduDirection = RECEIVE
        ComIPduType = NORMAL
        ComIPduHandleId = 120
        ComIPduSignalProcessing = DEFERRED
        ComIPduCancellationSupport = false
        ComIPduCallout = ComEx_ReceivePduCallout
        ComIPduGroupRef = HUT_oB30_for_SC_CAN_V3_2_Rx_4400ad35
        ComIPduSignalRef = P2M3_0xBE_oP2M3_oB30_for_SC_CAN_V3_2_d59c14bc_Rx
        ComPduIdRef = P2M3_oB30_for_SC_CAN_V3_2_a4a9c93c_Rx
      HCU_PT8_0x1C0_oHCU_PT8_oB30_for_SC_CAN_V3_2_c294c705_Rx (ComSignal):
        ComBitPosition = 0
        ComSignalEndianness = opaque
        ComSignalInitValue = 0 0 0 0 0 0 0 0
        ComSignalLength = 8
        ComSignalType = UINT8_N
        ComSignalAccess = ACCESS_UNCLEAR
        ComHandleId = 108
        ComSystemTemplateSystemSignalRef = HCU_PT8_0x1C0
      HCU_HC6_oB30_for_SC_CAN_V3_2_1549dac5_Rx (ComIPdu):
        ComIPduDirection = RECEIVE
        ComIPduType = NORMAL
        ComIPduHandleId = 99
        ComIPduSignalProcessing = DEFERRED
        ComIPduCancellationSupport = false
        ComIPduCallout = ComEx_ReceivePduCallout
        ComIPduGroupRef = HUT_oB30_for_SC_CAN_V3_2_Rx_4400ad35
        ComIPduSignalRef = HCU_HC6_0x314_oHCU_HC6_oB30_for_SC_CAN_V3_2_0e5944ae_Rx
        ComPduIdRef = HCU_HC6_oB30_for_SC_CAN_V3_2_1549dac5_Rx
      HUT_oB30_for_SC_CAN_V3_2_Tx_HEV (ComIPduGroup): ComIPduGroupHandleId=1
      BCM18_0x34D_oBCM18_oB30_for_SC_CAN_V3_2_b3211af2_Rx (ComSignal):
        ComBitPosition = 0
        ComSignalEndianness = opaque
        ComSignalInitValue = 0 0 0 0 0 0 0 0
        ComSignalLength = 8
        ComSignalType = UINT8_N
        ComSignalAccess = ACCESS_UNCLEAR
        ComHandleId = 29
        ComSystemTemplateSystemSignalRef = BCM18_0x34D
      BCM18_oB30_for_SC_CAN_V3_2_794b3a1a_Rx (ComIPdu):
        ComIPduDirection = RECEIVE
        ComIPduType = NORMAL
        ComIPduHandleId = 29
        ComIPduSignalProcessing = DEFERRED
        ComIPduCancellationSupport = false
        ComIPduCallout = ComEx_ReceivePduCallout
        ComIPduGroupRef = HUT_oB30_for_SC_CAN_V3_2_Rx_4400ad35
        ComIPduSignalRef = BCM18_0x34D_oBCM18_oB30_for_SC_CAN_V3_2_b3211af2_Rx
        ComPduIdRef = BCM18_oB30_for_SC_CAN_V3_2_794b3a1a_Rx
      ECM24_0x350_oECM24_oB30_for_SC_CAN_V3_2_a1837eee_Rx (ComSignal):
        ComBitPosition = 0
        ComSignalEndianness = opaque
        ComSignalInitValue = 0 0 0 0 0 0 0 0
        ComSignalLength = 8
        ComSignalType = UINT8_N
        ComSignalAccess = ACCESS_UNCLEAR
        ComHandleId = 68
        ComSystemTemplateSystemSignalRef = ECM24_0x350
      ECM24_oB30_for_SC_CAN_V3_2_328fcd01_Rx (ComIPdu):
        ComIPduDirection = RECEIVE
        ComIPduType = NORMAL
        ComIPduHandleId = 68
        ComIPduSignalProcessing = DEFERRED
        ComIPduCancellationSupport = false
        ComIPduCallout = ComEx_ReceivePduCallout
        ComIPduGroupRef = HUT_oB30_for_SC_CAN_V3_2_Rx_4400ad35
        ComIPduSignalRef = ECM24_0x350_oECM24_oB30_for_SC_CAN_V3_2_a1837eee_Rx
        ComPduIdRef = ECM24_oB30_for_SC_CAN_V3_2_328fcd01_Rx
      HCU_HP6_0x11A_oHCU_HP6_oB30_for_SC_CAN_V3_2_3fe3cb15_Rx (ComSignal):
        ComBitPosition = 0
        ComSignalEndianness = opaque
        ComSignalInitValue = 0 0 0 0 0 0 0 0
        ComSignalLength = 8
        ComSignalType = UINT8_N
        ComSignalAccess = ACCESS_UNCLEAR
        ComHandleId = 103
        ComSystemTemplateSystemSignalRef = HCU_HP6_0x11A
      HCU_HP6_oB30_for_SC_CAN_V3_2_62de65b4_Rx (ComIPdu):
        ComIPduDirection = RECEIVE
        ComIPduType = NORMAL
        ComIPduHandleId = 104
        ComIPduSignalProcessing = DEFERRED
        ComIPduCancellationSupport = false
        ComIPduCallout = ComEx_ReceivePduCallout
        ComIPduGroupRef = HUT_oB30_for_SC_CAN_V3_2_Rx_4400ad35
        ComIPduSignalRef = HCU_HP6_0x11A_oHCU_HP6_oB30_for_SC_CAN_V3_2_3fe3cb15_Rx
        ComPduIdRef = HCU_HP6_oB30_for_SC_CAN_V3_2_62de65b4_Rx
      3 x ComSignal, all with ComBitPosition=0, ComSignalEndianness=opaque, ComSignalType=UINT8_N, ComSignalAccess=ACCESS_UNCLEAR:
        BLE5_0x1FA_oBLE5_oB30_for_SC_CAN_V3_2_11cf5179_Rx: ComSignalInitValue=0 0 0 0 0 0 0 0, ComSignalLength=8, ComHandleId=32, ComSystemTemplateSystemSignalRef=BLE5_0x1FA
        BLE1_0x25C_oBLE1_oB30_for_SC_CAN_V3_2_1b3c9d76_Rx: ComSignalInitValue=0 0 0 0 0 0 0 0, ComSignalLength=8, ComHandleId=31, ComSystemTemplateSystemSignalRef=BLE1_0x25C
        HUT_FD4_0x1DA_oHUT_FD4_oB30_for_SC_CAN_V3_2_7f1aadf2_Tx: ComSignalInitValue=0 0 0 0 0 0 0 0 0 0 0 0 0 0 0 0 0 0 0 0 0 0 0 0 0 0 0 0 0 0 0 0 0 0 0 0 0 0 0 0 0 0 0 0 0 0 0 0 0 0 0 0 0 0 0 0 0 0 0 0 0 0 0 0, ComSignalLength=64, ComTransferProperty=TRIGGERED, ComHandleId=49, ComNotification=ComEx_TransmitPdu_HUT_FD4_Confiratmion, ComSystemTemplateSystemSignalRef=HUT_FD4_0x1DA
      HAP_FD7_oB30_for_SC_CAN_V3_2_06794e8e_Rx (ComIPdu):
        ComIPduDirection = RECEIVE
        ComIPduType = NORMAL
        ComIPduHandleId = 92
        ComIPduSignalProcessing = DEFERRED
        ComIPduCancellationSupport = false
        ComIPduCallout = ComEx_ReceivePduCallout
        ComIPduGroupRef = HUT_oB30_for_SC_CAN_V3_2_Rx_4400ad35
        ComIPduSignalRef = HAP_FD7_0x29B_oHAP_FD7_oB30_for_SC_CAN_V3_2_9ca8fc22_Rx
        ComPduIdRef = HAP_FD7_oB30_for_SC_CAN_V3_2_06794e8e_Rx
      BCM7_0x28D_oBCM7_oB30_for_SC_CAN_V3_2_2985d7eb_Rx (ComSignal):
        ComBitPosition = 0
        ComSignalEndianness = opaque
        ComSignalInitValue = 0 0 0 0 0 0 0 0
        ComSignalLength = 8
        ComSignalType = UINT8_N
        ComSignalAccess = ACCESS_UNCLEAR
        ComHandleId = 24
        ComSystemTemplateSystemSignalRef = BCM7_0x28D
      5 x ComIPdu, all with ComIPduType=NORMAL, ComIPduSignalProcessing=DEFERRED, ComIPduCancellationSupport=false:
        BCM7_oB30_for_SC_CAN_V3_2_163d45da_Rx: ComIPduDirection=RECEIVE, ComIPduHandleId=24, ComIPduCallout=ComEx_ReceivePduCallout, ComIPduGroupRef=HUT_oB30_for_SC_CAN_V3_2_Rx_4400ad35, ComIPduSignalRef=BCM7_0x28D_oBCM7_oB30_for_SC_CAN_V3_2_2985d7eb_Rx, ComPduIdRef=BCM7_oB30_for_SC_CAN_V3_2_163d45da_Rx
        AC14_oB30_for_SC_CAN_V3_2_1c102f98_Rx: ComIPduDirection=RECEIVE, ComIPduHandleId=11, ComIPduCallout=ComEx_ReceivePduCallout, ComIPduGroupRef=HUT_oB30_for_SC_CAN_V3_2_Rx_4400ad35, ComIPduSignalRef=AC14_0x299_oAC14_oB30_for_SC_CAN_V3_2_4b535511_Rx, ComPduIdRef=AC14_oB30_for_SC_CAN_V3_2_1c102f98_Rx
        HCU_HP5_oB30_for_SC_CAN_V3_2_5ba6c8f4_Rx: ComIPduDirection=RECEIVE, ComIPduHandleId=103, ComIPduCallout=ComEx_ReceivePduCallout, ComIPduGroupRef=HUT_oB30_for_SC_CAN_V3_2_Rx_4400ad35, ComIPduSignalRef=HCU_HP5_0x201_oHCU_HP5_oB30_for_SC_CAN_V3_2_10dd4439_Rx, ComPduIdRef=HCU_HP5_oB30_for_SC_CAN_V3_2_5ba6c8f4_Rx
        HUT_FD4_oB30_for_SC_CAN_V3_2_2aa0b500_Tx: ComIPduDirection=SEND, ComIPduHandleId=43, ComIPduCallout=ComEx_TransmitPduCallout, ComIPduGroupRef=HUT_oB30_for_SC_CAN_V3_2_Tx_125a0ab3, ComIPduSignalRef=HUT_FD4_0x1DA_oHUT_FD4_oB30_for_SC_CAN_V3_2_7f1aadf2_Tx, ComPduIdRef=HUT_FD4_oB30_for_SC_CAN_V3_2_2aa0b500_Tx, ComIPduGroupRef=HUT_oB30_for_SC_CAN_V3_2_Tx_HEV
          ComTxIPdu: ComMinimumDelayTime=0.045, ComTxIPduUnusedAreasDefault=0
            ComTxModeTrue
              ComTxMode: ComTxModeMode=NONE, ComTxModeNumberOfRepetitions=0, ComTxModeRepetitionPeriod=0
            ComTxModeFalse
              ComTxMode: ComTxModeMode=NONE, ComTxModeNumberOfRepetitions=0, ComTxModeRepetitionPeriod=0
        GW_OTA_oB30_for_SC_CAN_V3_2_cf261bba_Rx: ComIPduDirection=RECEIVE, ComIPduHandleId=86, ComIPduCallout=ComEx_ReceivePduCallout, ComIPduGroupRef=HUT_oB30_for_SC_CAN_V3_2_Rx_4400ad35, ComIPduSignalRef=GW_OTA_0x1D9_oGW_OTA_oB30_for_SC_CAN_V3_2_30df0d5c_Rx, ComPduIdRef=GW_OTA_oB30_for_SC_CAN_V3_2_cf261bba_Rx
      3 x ComSignal, all with ComBitPosition=0, ComSignalEndianness=opaque, ComSignalType=UINT8_N, ComSignalAccess=ACCESS_UNCLEAR:
        HCU_HP5_0x201_oHCU_HP5_oB30_for_SC_CAN_V3_2_10dd4439_Rx: ComSignalInitValue=0 0 0 0 0 0 0 0, ComSignalLength=8, ComHandleId=102, ComSystemTemplateSystemSignalRef=HCU_HP5_0x201
        AC14_0x299_oAC14_oB30_for_SC_CAN_V3_2_4b535511_Rx: ComSignalInitValue=0 0 0 0 0 0 0 0, ComSignalLength=8, ComHandleId=11, ComSystemTemplateSystemSignalRef=AC14_0x299
        HAP_FD7_0x29B_oHAP_FD7_oB30_for_SC_CAN_V3_2_9ca8fc22_Rx: ComSignalInitValue=0 0 0 0 0 0 0 0 0 0 0 0 0 0 0 0 0 0 0 0 0 0 0 0 0 0 0 0 0 0 0 0 0 0 0 0 0 0 0 0 0 0 0 0 0 0 0 0 0 0 0 0 0 0 0 0 0 0 0 0 0 0 0 0, ComSignalLength=64, ComHandleId=91, ComSystemTemplateSystemSignalRef=HAP_FD7_0x29B
      T_BOX_FD10_oB30_for_SC_CAN_V3_2_fbbdad00_Rx (ComIPdu):
        ComIPduDirection = RECEIVE
        ComIPduType = NORMAL
        ComIPduHandleId = 137
        ComIPduSignalProcessing = DEFERRED
        ComIPduCancellationSupport = false
        ComIPduCallout = ComEx_ReceivePduCallout
        ComIPduGroupRef = HUT_oB30_for_SC_CAN_V3_2_Rx_4400ad35
        ComIPduSignalRef = T_BOX_FD10_0x2F0_oT_BOX_FD10_oB30_for_SC_CAN_V3_2_8b5da6a2_Rx
        ComPduIdRef = T_BOX_FD10_oB30_for_SC_CAN_V3_2_fbbdad00_Rx
      BLE1_oB30_for_SC_CAN_V3_2_876057b5_Rx (ComIPdu):
        ComIPduDirection = RECEIVE
        ComIPduType = NORMAL
        ComIPduHandleId = 31
        ComIPduSignalProcessing = DEFERRED
        ComIPduCancellationSupport = false
        ComIPduCallout = ComEx_ReceivePduCallout
        ComIPduGroupRef = HUT_oB30_for_SC_CAN_V3_2_Rx_4400ad35
        ComIPduSignalRef = BLE1_0x25C_oBLE1_oB30_for_SC_CAN_V3_2_1b3c9d76_Rx
        ComPduIdRef = BLE1_oB30_for_SC_CAN_V3_2_876057b5_Rx
      SCM1_0x2D1_oSCM1_oB30_for_SC_CAN_V3_2_07ffa3ae_Rx (ComSignal):
        ComBitPosition = 0
        ComSignalEndianness = opaque
        ComSignalInitValue = 0 0 0 0 0 0 0 0
        ComSignalLength = 8
        ComSignalType = UINT8_N
        ComSignalAccess = ACCESS_UNCLEAR
        ComHandleId = 128
        ComSystemTemplateSystemSignalRef = SCM1_0x2D1
      SCM1_oB30_for_SC_CAN_V3_2_9950a83a_Rx (ComIPdu):
        ComIPduDirection = RECEIVE
        ComIPduType = NORMAL
        ComIPduHandleId = 129
        ComIPduSignalProcessing = DEFERRED
        ComIPduCancellationSupport = false
        ComIPduCallout = ComEx_ReceivePduCallout
        ComIPduGroupRef = HUT_oB30_for_SC_CAN_V3_2_Rx_4400ad35
        ComIPduSignalRef = SCM1_0x2D1_oSCM1_oB30_for_SC_CAN_V3_2_07ffa3ae_Rx
        ComPduIdRef = SCM1_oB30_for_SC_CAN_V3_2_9950a83a_Rx
      BLE5_oB30_for_SC_CAN_V3_2_dbc1c4b5_Rx (ComIPdu):
        ComIPduDirection = RECEIVE
        ComIPduType = NORMAL
        ComIPduHandleId = 32
        ComIPduSignalProcessing = DEFERRED
        ComIPduCancellationSupport = false
        ComIPduCallout = ComEx_ReceivePduCallout
        ComIPduGroupRef = HUT_oB30_for_SC_CAN_V3_2_Rx_4400ad35
        ComIPduSignalRef = BLE5_0x1FA_oBLE5_oB30_for_SC_CAN_V3_2_11cf5179_Rx
        ComPduIdRef = BLE5_oB30_for_SC_CAN_V3_2_dbc1c4b5_Rx
      GW_OTA_0x1D9_oGW_OTA_oB30_for_SC_CAN_V3_2_30df0d5c_Rx (ComSignal):
        ComBitPosition = 0
        ComSignalEndianness = opaque
        ComSignalInitValue = 0 0 0 0 0 0 0 0
        ComSignalLength = 8
        ComSignalType = UINT8_N
        ComSignalAccess = ACCESS_UNCLEAR
        ComHandleId = 86
        ComSystemTemplateSystemSignalRef = GW_OTA_0x1D9
      T_BOX_FD10_0x2F0_oT_BOX_FD10_oB30_for_SC_CAN_V3_2_8b5da6a2_Rx (ComSignal):
        ComBitPosition = 0
        ComSignalEndianness = opaque
        ComSignalInitValue = 0 0 0 0 0 0 0 0 0 0 0 0 0 0 0 0 0 0 0 0 0 0 0 0 0 0 0 0 0 0 0 0 0 0 0 0 0 0 0 0 0 0 0 0 0 0 0 0 0 0 0 0 0 0 0 0 0 0 0 0 0 0 0 0
        ComSignalLength = 64
        ComSignalType = UINT8_N
        ComSignalAccess = ACCESS_UNCLEAR
        ComHandleId = 136
        ComSystemTemplateSystemSignalRef = T_BOX_FD10_0x2F0
      OBC1_oB30_for_SC_CAN_V3_2_7aa70263_Rx (ComIPdu):
        ComIPduDirection = RECEIVE
        ComIPduType = NORMAL
        ComIPduHandleId = 117
        ComIPduSignalProcessing = DEFERRED
        ComIPduCancellationSupport = false
        ComIPduCallout = ComEx_ReceivePduCallout
        ComIPduGroupRef = HUT_oB30_for_SC_CAN_V3_2_Rx_4400ad35
        ComIPduSignalRef = OBC1_0x316_oOBC1_oB30_for_SC_CAN_V3_2_8dbaa55f_Rx
        ComPduIdRef = OBC1_oB30_for_SC_CAN_V3_2_7aa70263_Rx
      HUT27_0x2B2_oHUT27_oB30_for_SC_CAN_V3_2_c637bd78_Tx (ComSignal):
        ComBitPosition = 0
        ComSignalEndianness = opaque
        ComSignalInitValue = 0 0 0 0 0 0 0 0
        ComSignalLength = 8
        ComSignalType = UINT8_N
        ComTransferProperty = PENDING
        ComSignalAccess = ACCESS_UNCLEAR
        ComHandleId = 28
        ComNotification = ComEx_TransmitPdu_HUT27_Confiratmion
        ComSystemTemplateSystemSignalRef = HUT27_0x2B2
      3 x ComIPdu, all with ComIPduDirection=RECEIVE, ComIPduType=NORMAL, ComIPduSignalProcessing=DEFERRED, ComIPduCancellationSupport=false, ComIPduCallout=ComEx_ReceivePduCallout, ComIPduGroupRef=HUT_oB30_for_SC_CAN_V3_2_Rx_4400ad35:
        ETC2_oB30_for_SC_CAN_V3_2_30e437a4_Rx: ComIPduHandleId=80, ComIPduSignalRef=ETC2_0x1F1_oETC2_oB30_for_SC_CAN_V3_2_2cfee004_Rx, ComPduIdRef=ETC2_oB30_for_SC_CAN_V3_2_30e437a4_Rx
        HCM_L2_oB30_for_SC_CAN_V3_2_3b38ab71_Rx: ComIPduHandleId=94, ComIPduSignalRef=HCM_L2_0x304_oHCM_L2_oB30_for_SC_CAN_V3_2_22360a96_Rx, ComPduIdRef=HCM_L2_oB30_for_SC_CAN_V3_2_3b38ab71_Rx
        HCM_R1_oB30_for_SC_CAN_V3_2_ee41b121_Rx: ComIPduHandleId=95, ComIPduSignalRef=HCM_R1_0x30D_oHCM_R1_oB30_for_SC_CAN_V3_2_10025674_Rx, ComPduIdRef=HCM_R1_oB30_for_SC_CAN_V3_2_ee41b121_Rx
      3 x ComSignal, all with ComBitPosition=0, ComSignalEndianness=opaque, ComSignalInitValue=0 0 0 0 0 0 0 0, ComSignalLength=8, ComSignalType=UINT8_N, ComSignalAccess=ACCESS_UNCLEAR:
        RFCM_L1_0x332_oRFCM_L1_oB30_for_SC_CAN_V3_2_91cc902c_Rx: ComHandleId=123, ComSystemTemplateSystemSignalRef=RFCM_L1_0x332
        BMS35_0x2C4_oBMS35_oB30_for_SC_CAN_V3_2_b8679579_Rx: ComHandleId=38, ComSystemTemplateSystemSignalRef=BMS35_0x2C4
        ETC4_0x1F2_oETC4_oB30_for_SC_CAN_V3_2_87dc5b17_Rx: ComHandleId=82, ComSystemTemplateSystemSignalRef=ETC4_0x1F2
      ETC4_oB30_for_SC_CAN_V3_2_42156d24_Rx (ComIPdu):
        ComIPduDirection = RECEIVE
        ComIPduType = NORMAL
        ComIPduHandleId = 82
        ComIPduSignalProcessing = DEFERRED
        ComIPduCancellationSupport = false
        ComIPduCallout = ComEx_ReceivePduCallout
        ComIPduGroupRef = HUT_oB30_for_SC_CAN_V3_2_Rx_4400ad35
        ComIPduSignalRef = ETC4_0x1F2_oETC4_oB30_for_SC_CAN_V3_2_87dc5b17_Rx
        ComPduIdRef = ETC4_oB30_for_SC_CAN_V3_2_42156d24_Rx
      OBC2_0x317_oOBC2_oB30_for_SC_CAN_V3_2_d8f10658_Rx (ComSignal):
        ComBitPosition = 0
        ComSignalEndianness = opaque
        ComSignalInitValue = 0 0 0 0 0 0 0 0
        ComSignalLength = 8
        ComSignalType = UINT8_N
        ComSignalAccess = ACCESS_UNCLEAR
        ComHandleId = 117
        ComSystemTemplateSystemSignalRef = OBC2_0x317
      HCM_L1_oB30_for_SC_CAN_V3_2_02400631_Rx (ComIPdu):
        ComIPduDirection = RECEIVE
        ComIPduType = NORMAL
        ComIPduHandleId = 93
        ComIPduSignalProcessing = DEFERRED
        ComIPduCancellationSupport = false
        ComIPduCallout = ComEx_ReceivePduCallout
        ComIPduGroupRef = HUT_oB30_for_SC_CAN_V3_2_Rx_4400ad35
        ComIPduSignalRef = HCM_L1_0x308_oHCM_L1_oB30_for_SC_CAN_V3_2_b65b4e09_Rx
        ComPduIdRef = HCM_L1_oB30_for_SC_CAN_V3_2_02400631_Rx
      HUT27_oB30_for_SC_CAN_V3_2_8cd810d8_Tx (ComIPdu):
        ComIPduDirection = SEND
        ComIPduType = NORMAL
        ComIPduHandleId = 22
        ComIPduSignalProcessing = DEFERRED
        ComIPduCancellationSupport = false
        ComIPduCallout = ComEx_TransmitPduCallout
        ComIPduGroupRef = HUT_oB30_for_SC_CAN_V3_2_Tx_HEV
        ComIPduSignalRef = HUT27_0x2B2_oHUT27_oB30_for_SC_CAN_V3_2_c637bd78_Tx
        ComPduIdRef = HUT27_oB30_for_SC_CAN_V3_2_8cd810d8_Tx
        ComTxIPdu: ComMinimumDelayTime=0, ComTxIPduUnusedAreasDefault=0
          ComTxModeTrue
            ComTxMode: ComTxModeMode=PERIODIC, ComTxModeTimePeriod=0.1, ComTxModeTimeOffset=0
          ComTxModeFalse
            ComTxMode: ComTxModeMode=PERIODIC, ComTxModeTimePeriod=0.1, ComTxModeTimeOffset=0
      ALS1_0x287_oALS1_oB30_for_SC_CAN_V3_2_c7d86158_Rx (ComSignal):
        ComBitPosition = 0
        ComSignalEndianness = opaque
        ComSignalInitValue = 0 0 0 0 0 0 0 0 0 0 0 0 0 0 0 0
        ComSignalLength = 16
        ComSignalType = UINT8_N
        ComSignalAccess = ACCESS_UNCLEAR
        ComHandleId = 17
        ComSystemTemplateSystemSignalRef = ALS1_0x287
      ALS1_oB30_for_SC_CAN_V3_2_5e3515d0_Rx (ComIPdu):
        ComIPduDirection = RECEIVE
        ComIPduType = NORMAL
        ComIPduHandleId = 17
        ComIPduSignalProcessing = DEFERRED
        ComIPduCancellationSupport = false
        ComIPduCallout = ComEx_ReceivePduCallout
        ComIPduGroupRef = HUT_oB30_for_SC_CAN_V3_2_Rx_4400ad35
        ComIPduSignalRef = ALS1_0x287_oALS1_oB30_for_SC_CAN_V3_2_c7d86158_Rx
        ComPduIdRef = ALS1_oB30_for_SC_CAN_V3_2_5e3515d0_Rx
      4 x ComSignal, all with ComBitPosition=0, ComSignalEndianness=opaque, ComSignalInitValue=0 0 0 0 0 0 0 0, ComSignalLength=8, ComSignalType=UINT8_N, ComSignalAccess=ACCESS_UNCLEAR:
        ETC2_0x1F1_oETC2_oB30_for_SC_CAN_V3_2_2cfee004_Rx: ComHandleId=80, ComSystemTemplateSystemSignalRef=ETC2_0x1F1
        HUT49_0x1D1_oHUT49_oB30_for_SC_CAN_V3_2_107f8727_Tx: ComTransferProperty=TRIGGERED, ComHandleId=45, ComNotification=ComEx_TransmitPdu_HUT49_Confiratmion, ComSystemTemplateSystemSignalRef=HUT49_0x1D1
        HCM_L2_0x304_oHCM_L2_oB30_for_SC_CAN_V3_2_22360a96_Rx: ComHandleId=93, ComSystemTemplateSystemSignalRef=HCM_L2_0x304
        HCM_L1_0x308_oHCM_L1_oB30_for_SC_CAN_V3_2_b65b4e09_Rx: ComHandleId=92, ComSystemTemplateSystemSignalRef=HCM_L1_0x308
      R_PBOX1_oB30_for_SC_CAN_V3_2_3929a458_Rx (ComIPdu):
        ComIPduDirection = RECEIVE
        ComIPduType = NORMAL
        ComIPduHandleId = 128
        ComIPduSignalProcessing = DEFERRED
        ComIPduCancellationSupport = false
        ComIPduCallout = ComEx_ReceivePduCallout
        ComIPduGroupRef = HUT_oB30_for_SC_CAN_V3_2_Rx_4400ad35
        ComIPduSignalRef = R_PBOX1_0x19C_oR_PBOX1_oB30_for_SC_CAN_V3_2_a642ab1f_Rx
        ComPduIdRef = R_PBOX1_oB30_for_SC_CAN_V3_2_3929a458_Rx
      OBC1_0x316_oOBC1_oB30_for_SC_CAN_V3_2_8dbaa55f_Rx (ComSignal):
        ComBitPosition = 0
        ComSignalEndianness = opaque
        ComSignalInitValue = 0 0 0 0 0 0 0 0
        ComSignalLength = 8
        ComSignalType = UINT8_N
        ComSignalAccess = ACCESS_UNCLEAR
        ComHandleId = 116
        ComSystemTemplateSystemSignalRef = OBC1_0x316
      OBC2_oB30_for_SC_CAN_V3_2_43dfaf23_Rx (ComIPdu):
        ComIPduDirection = RECEIVE
        ComIPduType = NORMAL
        ComIPduHandleId = 118
        ComIPduSignalProcessing = DEFERRED
        ComIPduCancellationSupport = false
        ComIPduCallout = ComEx_ReceivePduCallout
        ComIPduGroupRef = HUT_oB30_for_SC_CAN_V3_2_Rx_4400ad35
        ComIPduSignalRef = OBC2_0x317_oOBC2_oB30_for_SC_CAN_V3_2_d8f10658_Rx
        ComPduIdRef = OBC2_oB30_for_SC_CAN_V3_2_43dfaf23_Rx
      HCM_R2_0x330_oHCM_R2_oB30_for_SC_CAN_V3_2_26c487d6_Rx (ComSignal):
        ComBitPosition = 0
        ComSignalEndianness = opaque
        ComSignalInitValue = 0 0 0 0 0 0 0 0
        ComSignalLength = 8
        ComSignalType = UINT8_N
        ComSignalAccess = ACCESS_UNCLEAR
        ComHandleId = 95
        ComSystemTemplateSystemSignalRef = HCM_R2_0x330
      HCM_R2_oB30_for_SC_CAN_V3_2_d7391c61_Rx (ComIPdu):
        ComIPduDirection = RECEIVE
        ComIPduType = NORMAL
        ComIPduHandleId = 96
        ComIPduSignalProcessing = DEFERRED
        ComIPduCancellationSupport = false
        ComIPduCallout = ComEx_ReceivePduCallout
        ComIPduGroupRef = HUT_oB30_for_SC_CAN_V3_2_Rx_4400ad35
        ComIPduSignalRef = HCM_R2_0x330_oHCM_R2_oB30_for_SC_CAN_V3_2_26c487d6_Rx
        ComPduIdRef = HCM_R2_oB30_for_SC_CAN_V3_2_d7391c61_Rx
      R_PBOX1_0x19C_oR_PBOX1_oB30_for_SC_CAN_V3_2_a642ab1f_Rx (ComSignal):
        ComBitPosition = 0
        ComSignalEndianness = opaque
        ComSignalInitValue = 0 0 0 0 0 0 0 0
        ComSignalLength = 8
        ComSignalType = UINT8_N
        ComSignalAccess = ACCESS_UNCLEAR
        ComHandleId = 127
        ComSystemTemplateSystemSignalRef = R_PBOX1_0x19C
      ETC3_oB30_for_SC_CAN_V3_2_27cc5364_Rx (ComIPdu):
        ComIPduDirection = RECEIVE
        ComIPduType = NORMAL
        ComIPduHandleId = 81
        ComIPduSignalProcessing = DEFERRED
        ComIPduCancellationSupport = false
        ComIPduCallout = ComEx_ReceivePduCallout
        ComIPduGroupRef = HUT_oB30_for_SC_CAN_V3_2_Rx_4400ad35
        ComIPduSignalRef = ETC3_0x344_oETC3_oB30_for_SC_CAN_V3_2_8061075a_Rx
        ComPduIdRef = ETC3_oB30_for_SC_CAN_V3_2_27cc5364_Rx
      HCM_R1_0x30D_oHCM_R1_oB30_for_SC_CAN_V3_2_10025674_Rx (ComSignal):
        ComBitPosition = 0
        ComSignalEndianness = opaque
        ComSignalInitValue = 0 0 0 0 0 0 0 0
        ComSignalLength = 8
        ComSignalType = UINT8_N
        ComSignalAccess = ACCESS_UNCLEAR
        ComHandleId = 94
        ComSystemTemplateSystemSignalRef = HCM_R1_0x30D
      F_PBOX1_oB30_for_SC_CAN_V3_2_24a181fc_Rx (ComIPdu):
        ComIPduDirection = RECEIVE
        ComIPduType = NORMAL
        ComIPduHandleId = 83
        ComIPduSignalProcessing = DEFERRED
        ComIPduCancellationSupport = false
        ComIPduCallout = ComEx_ReceivePduCallout
        ComIPduGroupRef = HUT_oB30_for_SC_CAN_V3_2_Rx_4400ad35
        ComIPduSignalRef = F_PBOX1_0x19B_oF_PBOX1_oB30_for_SC_CAN_V3_2_d80ac1f1_Rx
        ComPduIdRef = F_PBOX1_oB30_for_SC_CAN_V3_2_24a181fc_Rx
      F_PBOX1_0x19B_oF_PBOX1_oB30_for_SC_CAN_V3_2_d80ac1f1_Rx (ComSignal):
        ComBitPosition = 0
        ComSignalEndianness = opaque
        ComSignalInitValue = 0 0 0 0 0 0 0 0
        ComSignalLength = 8
        ComSignalType = UINT8_N
        ComSignalAccess = ACCESS_UNCLEAR
        ComHandleId = 83
        ComSystemTemplateSystemSignalRef = F_PBOX1_0x19B
      3 x ComIPdu, all with ComIPduType=NORMAL, ComIPduSignalProcessing=DEFERRED, ComIPduCancellationSupport=false:
        RFCM_L1_oB30_for_SC_CAN_V3_2_0f4843bb_Rx: ComIPduDirection=RECEIVE, ComIPduHandleId=124, ComIPduCallout=ComEx_ReceivePduCallout, ComIPduGroupRef=HUT_oB30_for_SC_CAN_V3_2_Rx_4400ad35, ComIPduSignalRef=RFCM_L1_0x332_oRFCM_L1_oB30_for_SC_CAN_V3_2_91cc902c_Rx, ComPduIdRef=RFCM_L1_oB30_for_SC_CAN_V3_2_0f4843bb_Rx
        HUT49_oB30_for_SC_CAN_V3_2_aaa01e22_Tx: ComIPduDirection=SEND, ComIPduHandleId=39, ComIPduCallout=ComEx_TransmitPduCallout, ComIPduGroupRef=HUT_oB30_for_SC_CAN_V3_2_Tx_125a0ab3, ComIPduSignalRef=HUT49_0x1D1_oHUT49_oB30_for_SC_CAN_V3_2_107f8727_Tx, ComPduIdRef=HUT49_oB30_for_SC_CAN_V3_2_aaa01e22_Tx, ComIPduGroupRef=HUT_oB30_for_SC_CAN_V3_2_Tx_HEV
          ComTxIPdu: ComMinimumDelayTime=0.045, ComTxIPduUnusedAreasDefault=0
            ComTxModeTrue
              ComTxMode: ComTxModeMode=NONE, ComTxModeNumberOfRepetitions=0, ComTxModeRepetitionPeriod=0
            ComTxModeFalse
              ComTxMode: ComTxModeMode=NONE, ComTxModeNumberOfRepetitions=0, ComTxModeRepetitionPeriod=0
        BMS35_oB30_for_SC_CAN_V3_2_3c9cd6f1_Rx: ComIPduDirection=RECEIVE, ComIPduHandleId=38, ComIPduCallout=ComEx_ReceivePduCallout, ComIPduGroupRef=HUT_oB30_for_SC_CAN_V3_2_Rx_4400ad35, ComIPduSignalRef=BMS35_0x2C4_oBMS35_oB30_for_SC_CAN_V3_2_b8679579_Rx, ComPduIdRef=BMS35_oB30_for_SC_CAN_V3_2_3c9cd6f1_Rx
      ETC3_0x344_oETC3_oB30_for_SC_CAN_V3_2_8061075a_Rx (ComSignal):
        ComBitPosition = 0
        ComSignalEndianness = opaque
        ComSignalInitValue = 0 0 0 0 0 0 0 0
        ComSignalLength = 8
        ComSignalType = UINT8_N
        ComSignalAccess = ACCESS_UNCLEAR
        ComHandleId = 81
        ComSystemTemplateSystemSignalRef = ETC3_0x344
      RFCM_R1_0x333_oRFCM_R1_oB30_for_SC_CAN_V3_2_ea29c6d8_Rx (ComSignal):
        ComBitPosition = 0
        ComSignalEndianness = opaque
        ComSignalInitValue = 0 0 0 0 0 0 0 0
        ComSignalLength = 8
        ComSignalType = UINT8_N
        ComSignalAccess = ACCESS_UNCLEAR
        ComHandleId = 124
        ComSystemTemplateSystemSignalRef = RFCM_R1_0x333
      RFCM_R1_oB30_for_SC_CAN_V3_2_e349f4ab_Rx (ComIPdu):
        ComIPduDirection = RECEIVE
        ComIPduType = NORMAL
        ComIPduHandleId = 125
        ComIPduSignalProcessing = DEFERRED
        ComIPduCancellationSupport = false
        ComIPduCallout = ComEx_ReceivePduCallout
        ComIPduGroupRef = HUT_oB30_for_SC_CAN_V3_2_Rx_4400ad35
        ComIPduSignalRef = RFCM_R1_0x333_oRFCM_R1_oB30_for_SC_CAN_V3_2_ea29c6d8_Rx
        ComPduIdRef = RFCM_R1_oB30_for_SC_CAN_V3_2_e349f4ab_Rx
      5 x ComSignal, all with ComBitPosition=0, ComSignalEndianness=opaque, ComSignalInitValue=0 0 0 0 0 0 0 0 0 0 0 0 0 0 0 0 0 0 0 0 0 0 0 0 0 0 0 0 0 0 0 0 0 0 0 0 0 0 0 0 0 0 0 0 0 0 0 0 0 0 0 0 0 0 0 0 0 0 0 0 0 0 0 0, ComSignalType=UINT8_N, ComSignalAccess=ACCESS_UNCLEAR, ComSignalLength=64, ComTransferProperty=PENDING:
        ComSignal_Cluster_Debug_Msg_0x7AB_Tx: ComHandleId=0
        ComSignal_Cluster_Debug_Msg_0x7AC_Tx: ComHandleId=1
        ComSignal_Cluster_Debug_Msg_0x7AD_Tx: ComHandleId=2
        ComSignal_Cluster_Debug_Msg_0x7AE_Tx: ComHandleId=3
        ComSignal_Cluster_Debug_Msg_0x7AF_Tx: ComHandleId=4
      7 x ComIPdu, all with ComIPduSignalProcessing=DEFERRED, ComIPduType=NORMAL, ComIPduCancellationSupport=false:
        ZCluster_Debug_Msg_0x7AB_Tx: ComIPduDirection=SEND, ComIPduHandleId=49, ComPduIdRef=ZCluster_Debug_Msg_0x7AB_Tx, ComIPduGroupRef=HUT_oB30_for_SC_CAN_V3_2_Tx_125a0ab3, ComIPduGroupRef=HUT_oB30_for_SC_CAN_V3_2_Tx_HEV, ComIPduSignalRef=ComSignal_Cluster_Debug_Msg_0x7AB_Tx
          ComTxIPdu: ComMinimumDelayTime=0, ComTxIPduUnusedAreasDefault=0
            ComTxModeFalse
              ComTxMode: ComTxModeMode=DIRECT, ComTxModeNumberOfRepetitions=0
            ComTxModeTrue
              ComTxMode: ComTxModeMode=DIRECT, ComTxModeNumberOfRepetitions=0
        ZCluster_Debug_Msg_0x7AC_Tx: ComIPduDirection=SEND, ComIPduHandleId=50, ComPduIdRef=ZCluster_Debug_Msg_0x7AC_Tx, ComIPduGroupRef=HUT_oB30_for_SC_CAN_V3_2_Tx_125a0ab3, ComIPduGroupRef=HUT_oB30_for_SC_CAN_V3_2_Tx_HEV, ComIPduSignalRef=ComSignal_Cluster_Debug_Msg_0x7AC_Tx
          ComTxIPdu: ComMinimumDelayTime=0, ComTxIPduUnusedAreasDefault=0
            ComTxModeFalse
              ComTxMode: ComTxModeMode=DIRECT, ComTxModeNumberOfRepetitions=0
            ComTxModeTrue
              ComTxMode: ComTxModeMode=DIRECT, ComTxModeNumberOfRepetitions=0
        ZCluster_Debug_Msg_0x7AD_Tx: ComIPduDirection=SEND, ComIPduHandleId=51, ComPduIdRef=ZCluster_Debug_Msg_0x7AD_Tx, ComIPduGroupRef=HUT_oB30_for_SC_CAN_V3_2_Tx_125a0ab3, ComIPduGroupRef=HUT_oB30_for_SC_CAN_V3_2_Tx_HEV, ComIPduSignalRef=ComSignal_Cluster_Debug_Msg_0x7AD_Tx
          ComTxIPdu: ComMinimumDelayTime=0, ComTxIPduUnusedAreasDefault=0
            ComTxModeFalse
              ComTxMode: ComTxModeMode=DIRECT, ComTxModeNumberOfRepetitions=0
            ComTxModeTrue
              ComTxMode: ComTxModeMode=DIRECT, ComTxModeNumberOfRepetitions=0
        ZCluster_Debug_Msg_0x7AE_Tx: ComIPduDirection=SEND, ComIPduHandleId=52, ComPduIdRef=ZCluster_Debug_Msg_0x7AE_Tx, ComIPduGroupRef=HUT_oB30_for_SC_CAN_V3_2_Tx_125a0ab3, ComIPduGroupRef=HUT_oB30_for_SC_CAN_V3_2_Tx_HEV, ComIPduSignalRef=ComSignal_Cluster_Debug_Msg_0x7AE_Tx
          ComTxIPdu: ComMinimumDelayTime=0, ComTxIPduUnusedAreasDefault=0
            ComTxModeFalse
              ComTxMode: ComTxModeMode=DIRECT, ComTxModeNumberOfRepetitions=0
            ComTxModeTrue
              ComTxMode: ComTxModeMode=DIRECT, ComTxModeNumberOfRepetitions=0
        ZCluster_Debug_Msg_0x7AF_Tx: ComIPduDirection=SEND, ComIPduHandleId=53, ComPduIdRef=ZCluster_Debug_Msg_0x7AF_Tx, ComIPduGroupRef=HUT_oB30_for_SC_CAN_V3_2_Tx_125a0ab3, ComIPduGroupRef=HUT_oB30_for_SC_CAN_V3_2_Tx_HEV, ComIPduSignalRef=ComSignal_Cluster_Debug_Msg_0x7AF_Tx
          ComTxIPdu: ComMinimumDelayTime=0, ComTxIPduUnusedAreasDefault=0
            ComTxModeFalse
              ComTxMode: ComTxModeMode=DIRECT, ComTxModeNumberOfRepetitions=0
            ComTxModeTrue
              ComTxMode: ComTxModeMode=DIRECT, ComTxModeNumberOfRepetitions=0
        GLO_NASS1_oB30_for_SC_CAN_V3_2_96a1bccc_Rx: ComIPduDirection=RECEIVE, ComIPduHandleId=84, ComIPduCallout=ComEx_ReceivePduCallout, ComIPduGroupRef=HUT_oB30_for_SC_CAN_V3_2_Rx_4400ad35, ComIPduSignalRef=GLO_NASS1_0x56_oGLO_NASS1_oB30_for_SC_CAN_V3_2_db007902_Rx, ComPduIdRef=GLO_NASS1_oB30_for_SC_CAN_V3_2_96a1bccc_Rx
        VMDR1_oB30_for_SC_CAN_V3_2_32d43f61_Rx: ComIPduDirection=RECEIVE, ComIPduHandleId=139, ComIPduCallout=ComEx_ReceivePduCallout, ComIPduGroupRef=HUT_oB30_for_SC_CAN_V3_2_Rx_4400ad35, ComIPduSignalRef=VMDR1_0x2FB_oVMDR1_oB30_for_SC_CAN_V3_2_7f271e6c_Rx, ComPduIdRef=VMDR1_oB30_for_SC_CAN_V3_2_32d43f61_Rx
      3 x ComSignal, all with ComBitPosition=0, ComSignalEndianness=opaque, ComSignalInitValue=0 0 0 0 0 0 0 0, ComSignalLength=8, ComSignalType=UINT8_N, ComSignalAccess=ACCESS_UNCLEAR:
        BCM19_0x30F_oBCM19_oB30_for_SC_CAN_V3_2_5c1b5792_Rx: ComHandleId=30, ComSystemTemplateSystemSignalRef=BCM19_0x30F
        VMDR1_0x2FB_oVMDR1_oB30_for_SC_CAN_V3_2_7f271e6c_Rx: ComHandleId=138, ComSystemTemplateSystemSignalRef=VMDR1_0x2FB
        GLO_NASS1_0x56_oGLO_NASS1_oB30_for_SC_CAN_V3_2_db007902_Rx: ComHandleId=84, ComSystemTemplateSystemSignalRef=GLO_NASS1_0x56
      BCM19_oB30_for_SC_CAN_V3_2_6e635eda_Rx (ComIPdu):
        ComIPduDirection = RECEIVE
        ComIPduType = NORMAL
        ComIPduHandleId = 30
        ComIPduSignalProcessing = DEFERRED
        ComIPduCancellationSupport = false
        ComIPduCallout = ComEx_ReceivePduCallout
        ComIPduGroupRef = HUT_oB30_for_SC_CAN_V3_2_Rx_4400ad35
        ComIPduSignalRef = BCM19_0x30F_oBCM19_oB30_for_SC_CAN_V3_2_5c1b5792_Rx
        ComPduIdRef = BCM19_oB30_for_SC_CAN_V3_2_6e635eda_Rx
    ComGeneral:
      ComConfigurationUseDet = true
      ComSafeBswChecks = false
      ComEnableSignalGroupArrayApi = false
      ComRetryFailedTransmitRequests = true
      ComSupportedIPduGroups = 8
      ComVersionInfoApi = false
      ComAdvancedIPduCallouts = true
      ComOptimizedIPduGroupHandling = true
      ComMetaDataSupport = false
      ComReceiveSignalMacroAPI = false
      ComDeferredEventCacheSupport = false
      ComMainfunctionTimingDomainSupport = false
      ComSignalGateway = false
      ComDescriptionGateway = false
      ComDescriptionRoutingCodeGeneration = false
      ComUserCbkHeaderFile = Rte_Cbk.h
      ComEnableMDTForCyclicTransmission = true
      ComUserCbkHeaderFile = ComEx_Cbk.h
      ComUserCbkHeaderFile = Appl_Cbk.h
