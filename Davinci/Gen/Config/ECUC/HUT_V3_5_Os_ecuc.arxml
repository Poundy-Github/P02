AUTOSAR XML (schema 00046)
package /ActiveEcuC
  module config Os: implementation-config-variant=VARIANT-PRE-COMPILE, module-description=Os_Impl
    vHsmResponseIsr (OsIsr):
      OsIsrCategory = CATEGORY_2
      OsIsrInterruptType = EXTERNAL
      OsIsrInterruptSource = 7
      OsIsrInterruptPriority = 8
      OsIsrStackSize = 1024
      OsIsrEnableNesting = false
      OsIsrUsesFpu = false
      OsIsrInitialEnableInterruptSource = true
      OsIsrSpecialFunctionName = vHsmResponseIsr
    SWC_LOW (OsTask):
      OsTaskActivation = 1
      OsTaskPriority = 3
      OsTaskSchedule = FULL
      OsTaskStackSharing = false
      OsTaskStackSize = 1024
      OsTaskType = EXTENDED
      OsTaskUsesFpu = false
      OsTaskAccessingApplication = SystemApplication_OsCore0
      OsTaskEventRef = Rte_Ev_Run_EOL_EOL_MainFunction
      OsTaskEventRef = Rte_Ev_Cyclic_SWC_LOW_0_10ms
      OsTaskAccessingApplication = OsApplication_NonTrust_OsCore0
      OsTaskEventRef = Rte_Ev_Run_DidDataProcess_E2ESwitchStatusRead
      OsTaskEventRef = Rte_Ev_Run_DidDataProcess_E2ESwitchStatusWrite
      OsTaskEventRef = Rte_Ev_Run_DidDataProcess_SecOcSwitchStatusRead
      OsTaskEventRef = Rte_Ev_Run_DidDataProcess_SecOcSwitchStatusWrite
      OsTaskEventRef = Rte_Ev_Run_SocDtcProcess_PpCS_AppClearDTCInfo_AppClearDTCInfo
      OsTaskEventRef = Rte_Ev_WP_SWC_LOW
    INTFICUIF0DFRQPE (OsIsr):
      OsIsrCategory = CATEGORY_2
      OsIsrInterruptType = EXTERNAL
      OsIsrInterruptSource = 359
      OsIsrInterruptPriority = 15
      OsIsrStackSize = 1024
      OsIsrEnableNesting = false
      OsIsrUsesFpu = false
      OsIsrInitialEnableInterruptSource = true
      OsIsrSpecialFunctionName = INTFICUIF0DFRQPE
    OsPublishedInformation: OsKernelVersion=7, OsPlatformName=Rh850
      RH850F1KM (OsDerivativeInformation):
        OsMpuAlignment = 4
        OsMpuEndAddressAccessible = true
        OsStackAlignment = 4
        OsExceptionVectorTableAlignment = 512
        OsInterruptVectorTableAlignment = 512
        OsHardwareManuals = RH850/F1KM Group Users Manual: Hardware Rev.0.50 Jan 2017 RH850G3KH Users Manual: Software Rev.1.10 Jul 2016
        3 x OsHardwareTimer, all with OsHardwareTimerUnit=PIT, OsHardwareTimerSize=32, OsHardwareTimerType=TAUJ:
          TAUJ0: OsHardwareTimerBaseAddress=4293197824, OsHardwareTimerId=0
            4 x OsHardwareTimerChannel:
              TAUJ0_CH3: OsHardwareTimerChannelIntSource=83, OsHardwareTimerChannelOffset=3, OsHardwareTimerChannelId=3
              TAUJ0_CH2: OsHardwareTimerChannelIntSource=82, OsHardwareTimerChannelOffset=2, OsHardwareTimerChannelId=2
              TAUJ0_CH1: OsHardwareTimerChannelIntSource=81, OsHardwareTimerChannelOffset=1, OsHardwareTimerChannelId=1
              TAUJ0_CH0: OsHardwareTimerChannelIntSource=80, OsHardwareTimerChannelOffset=0, OsHardwareTimerChannelId=0
          TAUJ1: OsHardwareTimerBaseAddress=4293201920, OsHardwareTimerId=1
            4 x OsHardwareTimerChannel:
              TAUJ1_CH3: OsHardwareTimerChannelIntSource=171, OsHardwareTimerChannelOffset=3, OsHardwareTimerChannelId=3
              TAUJ1_CH0: OsHardwareTimerChannelIntSource=168, OsHardwareTimerChannelOffset=0, OsHardwareTimerChannelId=0
              TAUJ1_CH2: OsHardwareTimerChannelIntSource=170, OsHardwareTimerChannelOffset=2, OsHardwareTimerChannelId=2
              TAUJ1_CH1: OsHardwareTimerChannelIntSource=169, OsHardwareTimerChannelOffset=1, OsHardwareTimerChannelId=1
          TAUJ2: OsHardwareTimerBaseAddress=4293198080, OsHardwareTimerId=2
            4 x OsHardwareTimerChannel:
              TAUJ2_CH1: OsHardwareTimerChannelIntSource=278, OsHardwareTimerChannelOffset=1, OsHardwareTimerChannelId=1
              TAUJ2_CH0: OsHardwareTimerChannelIntSource=277, OsHardwareTimerChannelOffset=0, OsHardwareTimerChannelId=0
              TAUJ2_CH3: OsHardwareTimerChannelIntSource=280, OsHardwareTimerChannelOffset=3, OsHardwareTimerChannelId=3
              TAUJ2_CH2: OsHardwareTimerChannelIntSource=279, OsHardwareTimerChannelOffset=2, OsHardwareTimerChannelId=2
        OsInterruptRouting: OsSELBINTC1BaseAddress=4290777088
          13 x OsInterruptRoutingSource, all with OsInterruptRoutingRegister=SELB_INTC1:
            OsSELBINTC112: OsInterruptRoutingBit=12, OsInterruptSourceAlternative=32, OsInterruptSourceDefault=20
            OsSELBINTC110: OsInterruptRoutingBit=10, OsInterruptSourceAlternative=160, OsInterruptSourceDefault=14
            OsSELBINTC19: OsInterruptRoutingBit=9, OsInterruptSourceAlternative=159, OsInterruptSourceDefault=13
            OsSELBINTC111: OsInterruptRoutingBit=11, OsInterruptSourceAlternative=161, OsInterruptSourceDefault=15
            OsSELBINTC18: OsInterruptRoutingBit=8, OsInterruptSourceAlternative=158, OsInterruptSourceDefault=9
            OsSELBINTC17: OsInterruptRoutingBit=7, OsInterruptSourceAlternative=135, OsInterruptSourceDefault=12
            OsSELBINTC16: OsInterruptRoutingBit=6, OsInterruptSourceAlternative=134, OsInterruptSourceDefault=11
            OsSELBINTC15: OsInterruptRoutingBit=5, OsInterruptSourceAlternative=133, OsInterruptSourceDefault=10
            OsSELBINTC14: OsInterruptRoutingBit=4, OsInterruptSourceAlternative=132, OsInterruptSourceDefault=8
            OsSELBINTC13: OsInterruptRoutingBit=3, OsInterruptSourceAlternative=119, OsInterruptSourceDefault=28
            OsSELBINTC12: OsInterruptRoutingBit=2, OsInterruptSourceAlternative=118, OsInterruptSourceDefault=27
            OsSELBINTC11: OsInterruptRoutingBit=1, OsInterruptSourceAlternative=117, OsInterruptSourceDefault=17
            OsSELBINTC10: OsInterruptRoutingBit=0, OsInterruptSourceAlternative=116, OsInterruptSourceDefault=16
        CORE0 (OsPhysicalCore):
          OsPhysicalCoreId = 0
          OsPhysicalCoreDefaultEntrySymbol = RESET_CORE0
          OsPhysicalCoreType = G3KH
          OsPhysicalCoreExceptionSources = 16
          OsPhysicalCoreIsAutostart = true
          OsPhysicalCoreMasterStartAllowed = false
          OsPhysicalCorePrivelegedHwAccess = true
          OsPhysicalCoreStackProtectionUnit = MPU_CORE0
          MPU_CORE0 (OsPhysicalCoreMpu): OsPhysicalCoreMpuId=0, OsPhysicalCoreMpuMaxRegions=16, OsPhysicalCoreMpuType=CORE_MPU_G3X
        INTC (OsSystemIntCtrl): OsSystemIntCtrlBaseAddress=4294896128, OsSystemIntCtrlMaxPrios=16, OsSystemIntCtrlMaxSources=376, OsSystemIntCtrlPrioOrder=DESC
          5 x OsSystemIntCtrlAddress:
            IPIR: OsSystemIntCtrlAddressValue=0
            INTC2: OsSystemIntCtrlAddressValue=4294946816
            EIBD1: OsSystemIntCtrlAddressValue=0
            INTC1: OsSystemIntCtrlAddressValue=4294896128
            EIBD2: OsSystemIntCtrlAddressValue=0
        TAUJ3 (OsHardwareTimer): OsHardwareTimerBaseAddress=4293202176, OsHardwareTimerUnit=PIT, OsHardwareTimerSize=32, OsHardwareTimerId=3, OsHardwareTimerType=TAUJ
          4 x OsHardwareTimerChannel:
            TAUJ3_CH0: OsHardwareTimerChannelIntSource=281, OsHardwareTimerChannelOffset=0, OsHardwareTimerChannelId=0
            TAUJ3_CH2: OsHardwareTimerChannelIntSource=283, OsHardwareTimerChannelOffset=2, OsHardwareTimerChannelId=2
            TAUJ3_CH1: OsHardwareTimerChannelIntSource=282, OsHardwareTimerChannelOffset=1, OsHardwareTimerChannelId=1
            TAUJ3_CH3: OsHardwareTimerChannelIntSource=284, OsHardwareTimerChannelOffset=3, OsHardwareTimerChannelId=3
        OSTM0 (OsHardwareTimer): OsHardwareTimerBaseAddress=4292280320, OsHardwareTimerUnit=FRTPIT, OsHardwareTimerSize=32, OsHardwareTimerId=0, OsHardwareTimerType=OSTM
          OSTM0 (OsHardwareTimerChannel): OsHardwareTimerChannelIntSource=84, OsHardwareTimerChannelOffset=0, OsHardwareTimerChannelId=0
        ROUTED (OsInterruptSupportedType): OsInterruptSupportedTypeSeparateSources=false, OsInterruptSupportedTypeSeparatePriority=false
        MPAT (OsMemoryRegionSpecifics)
          6 x OsMemoryRegionAccess:
            SW: OsMemoryRegionAccessRights=W, OsMemoryRegionAccessType=SUPERVISOR
            SX: OsMemoryRegionAccessRights=X, OsMemoryRegionAccessType=SUPERVISOR
            UW: OsMemoryRegionAccessRights=W, OsMemoryRegionAccessType=USER
            UX: OsMemoryRegionAccessRights=X, OsMemoryRegionAccessType=USER
            UR: OsMemoryRegionAccessRights=R, OsMemoryRegionAccessType=USER
            SR: OsMemoryRegionAccessRights=R, OsMemoryRegionAccessType=SUPERVISOR
    OS_APPMODE_ANY (OsAppMode)
    OSDEFAULTAPPMODE (OsAppMode)
    OsOS:
      OsStackMonitoring = true
      OsStatus = EXTENDED
      OsUseGetServiceId = false
      OsUseParameterAccess = false
      OsUseResScheduler = false
      OsForcibleTermination = true
      OsGenerateCalloutStubs = true
      OsGenerateMemMap = COMPLETE
      OsGenerateMemMapForNearAddressing = true
      OsGenerateMemMapForThreads = false
      OsServiceProtection = true
      OsStackUsageMeasurement = true
      OsUseXSignalAsyncApiCalls = false
      OsFpuUsage = NONE
      OsScalabilityClass = SC3
      OsNumberOfCores = 1
      OsMasterCore = OsCore0
      OsSystemTimer = SystemTimer
      OsStackSummary
        19 x OsStack, all with OsStackCore=OsCore0:
          OsCore0_Error: OsStackSize=1024, OsStackType=CORE_ERROR_STACK, OsStackUser=OsCore0
          OsCore0_Init: OsStackSize=1024, OsStackType=CORE_INIT_STACK, OsStackUser=OsCore0
          OsCore0_Kernel: OsStackSize=1024, OsStackType=CORE_KERNEL_STACK, OsStackUser=OsCore0
          OsCore0_Task_Prio4294967295: OsStackSize=1024, OsStackType=TASK_SHARED_PRIORITY_STACK, OsStackUser=IdleTask_OsCore0
          OsCore0_Isr_Core: OsStackSize=1024, OsStackType=ISR_SHARED_CORE_STACK, OsStackUser=CounterIsr_SystemTimer, OsStackUser=Lin_RLIN_31_INTRLIN31, OsStackUser=CanIsrGlobalStatus, OsStackUser=EXT_INTP_CH21_CAT2_ISR, OsStackUser=CanIsrStatus_3, OsStackUser=ADC0_SG1_CAT2_ISR, OsStackUser=ADC1_SG1_CAT2_ISR, OsStackUser=EXT_INTP_CH00_CAT2_ISR, OsStackUser=EXT_INTP_CH01_CAT2_ISR, OsStackUser=EXT_INTP_CH03_CAT2_ISR, OsStackUser=EXT_INTP_CH04_CAT2_ISR, OsStackUser=EXT_INTP_CH05_CAT2_ISR, OsStackUser=EXT_INTP_CH11_CAT2_ISR, OsStackUser=EXT_INTP_CH12_CAT2_ISR, OsStackUser=EXT_INTP_CH13_CAT2_ISR, OsStackUser=EXT_INTP_CH18_CAT2_ISR, OsStackUser=EXT_INTP_CH19_CAT2_ISR, OsStackUser=TAUD0_CH13_CAT2_ISR, OsStackUser=TAUD0_CH15_CAT2_ISR, OsStackUser=INTRIIC0TI_interrupt, OsStackUser=INTRIIC0EE_interrupt, OsStackUser=INTRIIC0RI_interrupt, OsStackUser=INTRIIC0TEI_interrupt, OsStackUser=Uart_IntTx4, OsStackUser=Uart_IntRx4, OsStackUser=Uart_IntErr4, OsStackUser=Uart_IntTx5, OsStackUser=Uart_IntRx5, OsStackUser=Uart_IntErr5, OsStackUser=INTRIIC1TI_interrupt, OsStackUser=INTRIIC1EE_interrupt, OsStackUser=INTRIIC1RI_interrupt, OsStackUser=INTRIIC1TEI_interrupt, OsStackUser=CanIsrWakeup_3, OsStackUser=CanIsrStatus_0, OsStackUser=CanIsrStatus_1, OsStackUser=CanIsrWakeup_0, OsStackUser=CanIsrWakeup_1, OsStackUser=Lin_RLIN_32_INTRLIN32, OsStackUser=INTFICUIF0DFRQPE, OsStackUser=EXT_INTP_CH09_CAT2_ISR, OsStackUser=EXT_INTP_CH20_CAT2_ISR, OsStackUser=vHsmResponseIsr, OsStackUser=SPI_CSIH3_TIR_CAT2_ISR
          BSW_COMM: OsStackSize=2048, OsStackType=TASK_EXTENDED_STACK, OsStackUser=Os/BSW_COMM
          OsCore0_Task_Prio50: OsStackSize=1024, OsStackType=TASK_SHARED_PRIORITY_STACK, OsStackUser=Default_Init_Task
          OsCore0_Task_Prio49: OsStackSize=1024, OsStackType=TASK_SHARED_PRIORITY_STACK, OsStackUser=Default_Init_Task_Trusted
          FUEL_TC_ODO: OsStackSize=2048, OsStackType=TASK_EXTENDED_STACK, OsStackUser=Os/FUEL_TC_ODO
          OsCore0_Protection: OsStackSize=1024, OsStackType=CORE_PROTECTION_STACK, OsStackUser=OsCore0
          OsCore0_Shutdown: OsStackSize=1024, OsStackType=CORE_SHUTDOWN_STACK, OsStackUser=OsCore0
          Default_BSW: OsStackSize=2048, OsStackType=TASK_EXTENDED_STACK, OsStackUser=Os/Default_BSW
          IPC: OsStackSize=1536, OsStackType=TASK_EXTENDED_STACK, OsStackUser=Os/IPC
          TT_GEAR: OsStackSize=1536, OsStackType=TASK_EXTENDED_STACK, OsStackUser=Os/TT_GEAR
          SYS: OsStackSize=2048, OsStackType=TASK_EXTENDED_STACK, OsStackUser=Os/SYS
          BSW_DIAGNOSE: OsStackSize=2048, OsStackType=TASK_EXTENDED_STACK, OsStackUser=Os/BSW_DIAGNOSE
          DRIVERS_SAFE: OsStackSize=1536, OsStackType=TASK_EXTENDED_STACK, OsStackUser=Os/DRIVERS_SAFE
          GateWay: OsStackSize=2048, OsStackType=TASK_EXTENDED_STACK, OsStackUser=Os/GateWay
          SWC_LOW: OsStackSize=1024, OsStackType=TASK_EXTENDED_STACK, OsStackUser=Os/SWC_LOW
      OsHooks: OsErrorHook=true, OsPostTaskHook=true, OsPreTaskHook=true, OsShutdownHook=true, OsStartupHook=false, OsProtectionHook=true, OsPanicHook=true
    OsCore0 (OsCore):
      OsCoreIsAutostart = true
      OsCoreIsAutosar = true
      OsCoreEntrySymbol = RESET_CORE0
      OsCorePhysicalCoreRef = CORE0
      OsCoreEcucCoreRef = EcucCoreDefinition
      OsCoreIdleTask = IdleTask_OsCore0
      OsCoreSystemApplication = SystemApplication_OsCore0
      OsCoreStacks:
        OsCoreKernelStackSize = 1024
        OsCoreStartupStackSize = 1024
        OsCoreShutdownStackSize = 1024
        OsCoreErrorStackSize = 1024
        OsCoreProtectionStackSize = 1024
        OsCoreInitStackSize = 1024
    IdleTask_OsCore0 (OsTask):
      OsTaskActivation = 1
      OsTaskPriority = 4294967295
      OsTaskSchedule = FULL
      OsTaskStackSharing = false
      OsTaskStackSize = 1024
      OsTaskType = AUTO
      OsTaskUsesFpu = false
      OsTaskAccessingApplication = SystemApplication_OsCore0
      OsTaskAutostart: OsTaskAppModeRef=OS_APPMODE_ANY
    SystemApplication_OsCore0 (OsApplication):
      OsTrusted = true
      OsTrustedApplicationDelayTimingViolationCall = false
      OsTrustedApplicationWithProtection = false
      OsApplicationIsPrivileged = true
      OsAppUseTrustedFunctionStubs = false
      OsApplicationCoreRef = EcucCoreDefinition
      OsAppTaskRef = IdleTask_OsCore0
      OsAppIsrRef = CounterIsr_SystemTimer
      OsAppCounterRef = SystemTimer
      OsAppIsrRef = System1msTick
      OsAppIsrRef = ECCTST_G3KH_FEINT_CAT1_ISR
      OsAppIsrRef = ECCTST_G3KH_SYSERR_CAT1_ISR
      OsApplicationHooks: OsAppErrorHook=false, OsAppShutdownHook=false, OsAppStartupHook=false
    SystemTimer (OsCounter):
      OsCounterMaxAllowedValue = 1073741823
      OsCounterMinCycle = 1
      OsCounterTicksPerBase = 40000
      OsCounterType = HARDWARE
      OsSecondsPerTick = 0.001
      OsCounterAccessingApplication = SystemApplication_OsCore0
      OsCounterAccessingApplication = OsApplication_NonTrust_OsCore0
      OsCounterAccessingApplication = OsApplication_Trust_OsCore0
      OsDriver: OsDriverHighResolution=false, OsDriverHardwareTimerChannelRef=TAUJ2_CH0, OsDriverIsrRef=CounterIsr_SystemTimer
    OsApplication_NonTrust_OsCore0 (OsApplication):
      OsTrusted = false
      OsTrustedApplicationDelayTimingViolationCall = false
      OsTrustedApplicationWithProtection = false
      OsApplicationIsPrivileged = false
      OsAppUseTrustedFunctionStubs = false
      OsApplicationCoreRef = EcucCoreDefinition
      OsAppTaskRef = Os/FUEL_TC_ODO
      OsAppEcucPartitionRef = EcucPartition_NonTrust
      OsAppAlarmRef = Rte_Al_TE_Common_Normal_Common_Normal_100msMainFunction
      OsAppAlarmRef = Rte_Al_TE_Common_Normal_Common_Normal_10msMainFunction
      OsAppAlarmRef = Rte_Al_TE_Common_Normal_Common_Normal_20msMainFunction
      OsAppAlarmRef = Rte_Al_TE_Common_Normal_Common_Normal_5msMainFunction
      OsAppAlarmRef = Rte_Al_TE_Common_Normal_Common_Normal_100msMainFunction_
      OsAppAlarmRef = Rte_Al_TE_Common_Normal_Common_Normal_10msMainFunction_
      OsAppAlarmRef = Rte_Al_TE_Common_Normal_Common_Normal_20msMainFunction_
      OsAppTaskRef = Os/GateWay
      OsAppAlarmRef = Rte_Al_TE_Common_GateWay_Common_GateWay_5msMainFunction
      OsAppAlarmRef = Rte_Al_TE_Common_Normal_Common_Normal_20msMainFunction_A
      OsAppAlarmRef = Rte_Al_TE_Common_Normal_Common_Normal_20msMainFunction_B
      OsAppAlarmRef = Rte_Al_TE_Common_GateWay_Common_GateWay_10msMainFunction
      OsApplicationHooks: OsAppErrorHook=false, OsAppShutdownHook=false, OsAppStartupHook=false
    BSW_COMM (OsTask):
      OsTaskActivation = 1
      OsTaskPriority = 8
      OsTaskSchedule = FULL
      OsTaskStackSharing = false
      OsTaskStackSize = 2048
      OsTaskType = EXTENDED
      OsTaskUsesFpu = false
      OsTaskAccessingApplication = SystemApplication_OsCore0
      OsTaskResourceRef = OsResource
      OsTaskEventRef = Rte_Ev_Cyclic2_BSW_COMM_0_10ms
      OsTaskEventRef = Rte_Ev_Cyclic2_BSW_COMM_0_5ms
      OsTaskAccessingApplication = OsApplication_NonTrust_OsCore0
      OsTaskEventRef = Rte_Ev_Run_CConfig_CConfig_MainFunction
      OsTaskEventRef = Rte_Ev_Run_FvM_FvM_MainFunction
      OsTaskEventRef = Rte_Ev_Run_SecOc_Server_SecOc_Server_MainFunction
      OsTaskEventRef = Rte_Ev_WP_BSW_COMM
      OsTaskEventRef = Rte_Ev_Cyclic2_BSW_COMM_0_2ms
      OsTaskEventRef = Rte_Ev_Run_Can_Server_CNA_SignalGroupSet
      OsTaskEventRef = Rte_Ev_Run_Can_Server_CNA_SignalSet
      OsTaskEventRef = Rte_Ev_Run_Can_Server_CNA_SignalSetNoTrigger
      OsTaskEventRef = Rte_Ev_Run_Can_Server_CNA_SignalSet_U8N
    CounterIsr_SystemTimer (OsIsr):
      OsIsrCategory = CATEGORY_2
      OsIsrInterruptType = EXTERNAL
      OsIsrInterruptSource = 277
      OsIsrInterruptPriority = 12
      OsIsrStackSize = 1024
      OsIsrEnableNesting = false
      OsIsrUsesFpu = false
      OsIsrInitialEnableInterruptSource = false
      OsIsrSpecialFunctionName = Os_TimerPitIsr
    OsResource:
      OsResourceProperty = STANDARD
      OsResourceAccessingApplication = SystemApplication_OsCore0
      OsResourceAccessingApplication = OsApplication_NonTrust_OsCore0
      OsResourceAccessingApplication = OsApplication_Trust_OsCore0
    Lin_RLIN_31_INTRLIN31 (OsIsr):  # /ActiveEcuC/Lin PLAIN_TEXT LIN interrupt INTRLIN31 for RLIN 31. This OsInterrupt container has been created automatically based on the driver configuration.
      OsIsrCategory = CATEGORY_2
      OsIsrInterruptType = EXTERNAL
      OsIsrInterruptSource = 120
      OsIsrInterruptPriority = 10
      OsIsrStackSize = 1024
      OsIsrEnableNesting = false
      OsIsrUsesFpu = false
      OsIsrInitialEnableInterruptSource = true
      OsIsrSpecialFunctionName = LinIsr_30_Rh850Rlin_31_0
    CanIsrGlobalStatus (OsIsr):  # /ActiveEcuC/Can PLAIN_TEXT Global Can RX BasicCAN overrun event. This OsIsr container has been created automatically based on the Can driver configuration.
      OsIsrCategory = CATEGORY_2
      OsIsrInterruptType = EXTERNAL
      OsIsrInterruptSource = 22
      OsIsrInterruptPriority = 7
      OsIsrStackSize = 1024
      OsIsrEnableNesting = false
      OsIsrUsesFpu = false
      OsIsrInitialEnableInterruptSource = true
    6 x OsTask, all with OsTaskActivation=1, OsTaskSchedule=FULL, OsTaskStackSharing=false, OsTaskUsesFpu=false, OsTaskAccessingApplication=SystemApplication_OsCore0:
      BSW_DIAGNOSE: OsTaskPriority=4, OsTaskStackSize=2048, OsTaskType=EXTENDED, OsTaskEventRef=Rte_Ev_Cyclic2_BSW_DIAGNOSE_0_10ms, OsTaskAccessingApplication=OsApplication_NonTrust_OsCore0, OsTaskEventRef=Rte_Ev_Run_DemSatellite_0_SetEventStatus, OsTaskEventRef=Rte_Ev_WP_BSW_DIAGNOSE
      DRIVERS_SAFE: OsTaskPriority=6, OsTaskStackSize=1536, OsTaskType=EXTENDED, OsTaskEventRef=Rte_Ev_Cyclic_DRIVERS_SAFE_0_5ms, OsTaskEventRef=Rte_Ev_Run_RTC_RTC_MainFunction, OsTaskEventRef=Rte_Ev_Run_IIC_IIC0_MainFunction, OsTaskEventRef=Rte_Ev_Run_IIC_IIC1_MainFunction, OsTaskEventRef=Rte_Ev_Cyclic_DRIVERS_SAFE_0_100ms, OsTaskEventRef=Rte_Ev_Run_AMP_AMP_Event_MainFunction, OsTaskEventRef=Rte_Ev_Run_Gyro_Gyro_MainFunction, OsTaskAccessingApplication=OsApplication_NonTrust_OsCore0, OsTaskEventRef=Rte_Ev_Cyclic_DRIVERS_SAFE_0_50ms, OsTaskEventRef=Rte_Ev_Run_RTC_UTC2PerpetualCalendar, OsTaskEventRef=Rte_Ev_Run_ComEx_ComEx_GetRxE2EStatus, OsTaskEventRef=Rte_Ev_Run_ComEx_ComEx_SendSignal, OsTaskEventRef=Rte_Ev_WP_DRIVERS_SAFE, OsTaskEventRef=Rte_Ev_Run_RTC_GetUTCTimeInMillis
      SYS: OsTaskPriority=7, OsTaskStackSize=2048, OsTaskType=EXTENDED, OsTaskEventRef=Rte_Ev_Cyclic_SYS_0_5ms, OsTaskEventRef=Rte_Ev_WP_SYS, OsTaskAccessingApplication=OsApplication_NonTrust_OsCore0, OsTaskEventRef=Rte_Ev_Run_IoHwAb_IoHwAb_GetPin, OsTaskEventRef=Rte_Ev_Run_IoHwAb_IoHwAb_GetVoltage, OsTaskEventRef=Rte_Ev_Cyclic_SYS_0_10ms, OsTaskEventRef=Rte_Ev_Run_Vconfig_VConfig_GetKindConfig_Operation_VConfig_GetKindConfig, OsTaskEventRef=Rte_Ev_Run_Vconfig_VConfig_GetUpdateTick_OperationVConfig_GetUpdateTick, OsTaskEventRef=Rte_Ev_Cyclic_SYS_0_100ms, OsTaskEventRef=Rte_Ev_Cyclic_SYS_0_50ms, OsTaskEventRef=Rte_Ev_Run_Misc_Misc_MainFunction_500ms, OsTaskEventRef=Rte_Ev_Run_Can_Server_CanFrameCounter_Can_ABS3_Counter, OsTaskEventRef=Rte_Ev_Run_Can_Server_CanFrameCounter_Can_ECM2_Counter, OsTaskEventRef=Rte_Ev_Run_Can_Server_CanFrameCounter_Can_ESP_FD2_Counter
      IPC: OsTaskPriority=6, OsTaskStackSize=1536, OsTaskType=EXTENDED, OsTaskEventRef=Rte_Ev_Run_IPC_IPC_MainFunction, OsTaskAccessingApplication=OsApplication_NonTrust_OsCore0, OsTaskEventRef=Rte_Ev_Run_IPC_IPC_DataSend_If_Operation, OsTaskEventRef=Rte_Ev_Run_IPC_IPC_STB_MainFunction
      TT_GEAR: OsTaskPriority=6, OsTaskStackSize=1536, OsTaskType=EXTENDED, OsTaskEventRef=Rte_Ev_Run_Common_Safety_Common_Safety_10msMainFunction, OsTaskEventRef=Rte_Ev_Run_Common_Safety_Common_Safety_50msMainFunction, OsTaskEventRef=Rte_Ev_WP_TT_GEAR, OsTaskAccessingApplication=OsApplication_NonTrust_OsCore0
      Default_Init_Task: OsTaskPriority=50, OsTaskStackSize=1024, OsTaskType=BASIC
        OsTaskAutostart: OsTaskAppModeRef=OS_APPMODE_ANY
    Rte_Al_TE2_BSW_COMM_0_10ms (OsAlarm): OsAlarmCounterRef=SystemTimer, OsAlarmAccessingApplication=SystemApplication_OsCore0
      OsAlarmAction
        OsAlarmSetEvent: OsAlarmSetEventRef=Rte_Ev_Cyclic2_BSW_COMM_0_10ms, OsAlarmSetEventTaskRef=Os/BSW_COMM
    Rte_Al_TE2_BSW_COMM_0_5ms (OsAlarm): OsAlarmCounterRef=SystemTimer, OsAlarmAccessingApplication=SystemApplication_OsCore0
      OsAlarmAction
        OsAlarmSetEvent: OsAlarmSetEventRef=Rte_Ev_Cyclic2_BSW_COMM_0_5ms, OsAlarmSetEventTaskRef=Os/BSW_COMM
    Rte_Ev_Cyclic2_BSW_COMM_0_10ms (OsEvent)
    Rte_Ev_Cyclic2_BSW_COMM_0_5ms (OsEvent)
    OsMemoryProtection
      15 x OsMemoryRegion, all with OsMemoryRegionProtectionUnit=MPU_CORE0:
        MemoryRegion_trust_all: OsMemoryRegionStartAddress=0, OsMemoryRegionEndAddress=0xfebbffff, OsMemoryRegionAccessRights=SR, OsMemoryRegionAccessRights=SW, OsMemoryRegionAccessRights=SX, OsMemoryRegionAccessRights=UR, OsMemoryRegionAccessRights=UW, OsMemoryRegionAccessRights=UX
        MemoryRegion_gloabalA_RAM: OsMemoryRegionStartAddress=0xfeee80f0, OsMemoryRegionEndAddress=0xfeefffff, OsMemoryRegionAccessRights=SR, OsMemoryRegionAccessRights=SW, OsMemoryRegionAccessRights=SX
        MemoryRegion_registers: OsMemoryRegionStartAddress=0xff000000, OsMemoryRegionEndAddress=0xffffffff, OsMemoryRegionAccessRights=SR, OsMemoryRegionAccessRights=SW, OsMemoryRegionAccessRights=SX
        MemoryRegion_Dflash: OsMemoryRegionStartAddress=0xff200000, OsMemoryRegionEndAddress=0xff21ffff, OsMemoryRegionAccessRights=SR, OsMemoryRegionAccessRights=SW, OsMemoryRegionAccessRights=SX, OsMemoryRegionAccessRights=UR, OsMemoryRegionAccessRights=UW, OsMemoryRegionAccessRights=UX
        MemoryRegion_Nontrust_RAM: OsMemoryRegionStartAddress=NONTRUST_VAR_START, OsMemoryRegionEndAddress=NONTRUST_VAR_END, OsMemoryRegionOwner=OsApplication_NonTrust_OsCore0, OsMemoryRegionAccessRights=UR, OsMemoryRegionAccessRights=UW
        MemoryRegion_RRAM: OsMemoryRegionStartAddress=__ghs_rramstart, OsMemoryRegionEndAddress=__ghs_rramend, OsMemoryRegionAccessRights=SR, OsMemoryRegionAccessRights=SW, OsMemoryRegionAccessRights=UR, OsMemoryRegionAccessRights=UW
        MemoryRegion_Core0_RAM_2: OsMemoryRegionStartAddress=STACK_END, OsMemoryRegionEndAddress=__ghs_ramend, OsMemoryRegionAccessRights=SR, OsMemoryRegionAccessRights=SW, OsMemoryRegionAccessRights=SX
        MemoryRegion_RAM_RTE_SHARED: OsMemoryRegionStartAddress=RTE_SHARE_VAR_START, OsMemoryRegionEndAddress=RTE_SHARE_VAR_END, OsMemoryRegionAccessRights=SR, OsMemoryRegionAccessRights=SW, OsMemoryRegionAccessRights=UR, OsMemoryRegionAccessRights=UW
        MemoryRegion_Core0_RAM_1: OsMemoryRegionStartAddress=TRUST_VAR_START, OsMemoryRegionEndAddress=STACK_START, OsMemoryRegionAccessRights=SR, OsMemoryRegionAccessRights=SW, OsMemoryRegionAccessRights=SX, OsMemoryRegionAccessRights=UR
        MemoryRegion_IPC: OsMemoryRegionStartAddress=0, OsMemoryRegionEndAddress=0x0000ffff, OsMemoryRegionAccessRights=SR, OsMemoryRegionAccessRights=SW, OsMemoryRegionAccessRights=UR, OsMemoryRegionAccessRights=UW
        MemoryRegion_gloabalB_RAM: OsMemoryRegionStartAddress=__ghs_grambstart, OsMemoryRegionEndAddress=__ghs_grambend, OsMemoryRegionAccessRights=SR, OsMemoryRegionAccessRights=SW, OsMemoryRegionAccessRights=SX
        MemoryRegion_RAM_IPC_SHARED: OsMemoryRegionStartAddress=IPC_SHARE_VAR_START, OsMemoryRegionEndAddress=IPC_SHARE_VAR_END, OsMemoryRegionAccessRights=SR, OsMemoryRegionAccessRights=SW, OsMemoryRegionAccessRights=UR, OsMemoryRegionAccessRights=UW
        MemoryRegion_stack_deviation: OsMemoryRegionStartAddress=STACK_START, OsMemoryRegionEndAddress=STACK_END, OsMemoryRegionAccessRights=SR, OsMemoryRegionOwner=vHsmResponseIsr, OsMemoryRegionAccessRights=SW
        MemoryRegion_stack_read_deviation: OsMemoryRegionStartAddress=STACK_START, OsMemoryRegionEndAddress=STACK_END, OsMemoryRegionAccessRights=SR, OsMemoryRegionAccessRights=UR
        MemoryRegion_gloabalB_Nontrust_RAM: OsMemoryRegionStartAddress=GLOBAL_RAMB_NONTRUST_VAR_START, OsMemoryRegionEndAddress=GLOBAL_RAMB_NONTRUST_VAR_END, OsMemoryRegionAccessRights=UR, OsMemoryRegionAccessRights=UW
    3 x OsTask, all with OsTaskActivation=1, OsTaskSchedule=FULL, OsTaskStackSharing=false, OsTaskUsesFpu=false, OsTaskAccessingApplication=SystemApplication_OsCore0:
      Default_Init_Task_Trusted: OsTaskPriority=49, OsTaskStackSize=1024, OsTaskType=BASIC
      FUEL_TC_ODO: OsTaskPriority=5, OsTaskStackSize=2048, OsTaskType=EXTENDED, OsTaskEventRef=Rte_Ev_WP_FUEL_TC_ODO, OsTaskEventRef=Rte_Ev_Run_Common_Normal_Common_Normal_100msMainFunction, OsTaskEventRef=Rte_Ev_Run_Common_Normal_Common_Normal_10msMainFunction, OsTaskEventRef=Rte_Ev_Run_Common_Normal_Common_Normal_20msMainFunction, OsTaskEventRef=Rte_Ev_Run_Common_Normal_Common_Normal_5msMainFunction, OsTaskEventRef=Rte_Ev_Run_Common_Normal_Common_Normal_100msMainFunction_, OsTaskEventRef=Rte_Ev_Run_Common_Normal_Common_Normal_10msMainFunction_, OsTaskEventRef=Rte_Ev_Run_Common_Normal_Common_Normal_20msMainFunction_, OsTaskEventRef=Rte_Ev_Run_Common_Normal_Common_Normal_20msMainFunction_A, OsTaskEventRef=Rte_Ev_Run_Common_Normal_Common_Normal_20msMainFunction_B, OsTaskAccessingApplication=OsApplication_Trust_OsCore0, OsTaskEventRef=Rte_Ev_Run_Common_Normal_EOL_ReadDID0xFDD8_EOL_GetReadHardInputForCluster, OsTaskEventRef=Rte_Ev_Run_Common_Normal_Fuel_Api_ParamentGetCsPort_Operation
      Default_BSW: OsTaskPriority=7, OsTaskStackSize=2048, OsTaskType=EXTENDED, OsTaskEventRef=Rte_Ev_Run_Os_OsCore0_swc_GetCounterValue, OsTaskEventRef=Rte_Ev_Run_Os_OsCore0_swc_GetElapsedValue, OsTaskAccessingApplication=OsApplication_NonTrust_OsCore0, OsTaskEventRef=Rte_Ev_Cyclic2_Default_BSW_0_10ms, OsTaskEventRef=Rte_Ev_Run_BswM_BswM_Read_PowerModeShutdownReq, OsTaskEventRef=Rte_Ev_Run_BswM_BswM_Read_PowerModeShutdownReq_EmergencySleep, OsTaskEventRef=Rte_Ev_Run_DCM_Server_DCM_Server_MainFunction, OsTaskEventRef=Rte_Ev_Cyclic2_Default_BSW_1_5ms, OsTaskEventRef=Rte_Ev_Run_Misc_NVM_Read_Speedup_Runnable, OsTaskEventRef=Rte_Ev_Cyclic2_Default_BSW_0_5ms, OsTaskEventRef=Rte_Ev_Run_HSM_Hsm_MainFunction, OsTaskEventRef=Rte_Ev_Run_HSM_HsmGetAes128Key, OsTaskEventRef=Rte_Ev_Run_HSM_HsmSetAes128Key, OsTaskEventRef=Rte_Ev_Run_HSM_HsmTrngGenerate, OsTaskEventRef=Rte_Ev_Run_NvM_WriteBlock, OsTaskEventRef=Rte_Ev_WP_Default_BSW
    3 x OsEvent:
      Rte_Ev_Run_Os_OsCore0_swc_GetCounterValue
      Rte_Ev_Run_Os_OsCore0_swc_GetElapsedValue
      Rte_Ev_WP_FUEL_TC_ODO: OsEventMask=2
    Rte_Al_TE2_BSW_DIAGNOSE_0_10ms (OsAlarm): OsAlarmCounterRef=SystemTimer, OsAlarmAccessingApplication=SystemApplication_OsCore0
      OsAlarmAction
        OsAlarmSetEvent: OsAlarmSetEventRef=Rte_Ev_Cyclic2_BSW_DIAGNOSE_0_10ms, OsAlarmSetEventTaskRef=Os/BSW_DIAGNOSE
    Rte_Al_TE_EOL_EOL_MainFunction (OsAlarm): OsAlarmCounterRef=SystemTimer, OsAlarmAccessingApplication=SystemApplication_OsCore0
      OsAlarmAction
        OsAlarmSetEvent: OsAlarmSetEventRef=Rte_Ev_Run_EOL_EOL_MainFunction, OsAlarmSetEventTaskRef=Os/SWC_LOW
    Rte_Ev_Run_EOL_EOL_MainFunction (OsEvent)
    Rte_Al_TE2_Default_BSW_0_10ms (OsAlarm): OsAlarmCounterRef=SystemTimer, OsAlarmAccessingApplication=SystemApplication_OsCore0
      OsAlarmAction
        OsAlarmSetEvent: OsAlarmSetEventRef=Rte_Ev_Cyclic2_Default_BSW_0_10ms, OsAlarmSetEventTaskRef=Os/Default_BSW
    3 x OsEvent:
      Rte_Ev_Cyclic2_Default_BSW_0_10ms
      Rte_Ev_Run_BswM_BswM_Read_PowerModeShutdownReq
      Rte_Ev_Cyclic2_BSW_DIAGNOSE_0_10ms
    EXT_INTP_CH21_CAT2_ISR (OsIsr):
      OsIsrCategory = CATEGORY_2
      OsIsrInterruptType = EXTERNAL
      OsIsrInterruptSource = 373
      OsIsrInterruptPriority = 6
      OsIsrStackSize = 512
      OsIsrEnableNesting = false
      OsIsrUsesFpu = false
      OsIsrInitialEnableInterruptSource = true
    CanIsrStatus_3 (OsIsr):  # /ActiveEcuC/Can PLAIN_TEXT Can busoff event of controller CT_B30_for_SC_CAN_V3_2_4a04dc9c. This OsIsr container has been created automatically based on the Can driver configuration.
      OsIsrCategory = CATEGORY_2
      OsIsrInterruptType = EXTERNAL
      OsIsrInterruptSource = 220
      OsIsrInterruptPriority = 1
      OsIsrStackSize = 512
      OsIsrEnableNesting = false
      OsIsrUsesFpu = false
      OsIsrInitialEnableInterruptSource = true
    Rte_Al_TE_DRIVERS_SAFE_0_5ms (OsAlarm): OsAlarmCounterRef=SystemTimer, OsAlarmAccessingApplication=SystemApplication_OsCore0
      OsAlarmAction
        OsAlarmSetEvent: OsAlarmSetEventRef=Rte_Ev_Cyclic_DRIVERS_SAFE_0_5ms, OsAlarmSetEventTaskRef=Os/DRIVERS_SAFE
    4 x OsEvent:
      Rte_Ev_Cyclic_DRIVERS_SAFE_0_5ms
      Rte_Ev_Run_RTC_RTC_MainFunction
      Rte_Ev_Run_IIC_IIC0_MainFunction
      Rte_Ev_Run_IIC_IIC1_MainFunction
    29 x OsIsr, all with OsIsrCategory=CATEGORY_2, OsIsrInterruptType=EXTERNAL, OsIsrInterruptPriority=6, OsIsrStackSize=512, OsIsrEnableNesting=false, OsIsrUsesFpu=false:
      ADC0_SG1_CAT2_ISR: OsIsrInterruptSource=18, OsIsrInitialEnableInterruptSource=true
      ADC1_SG1_CAT2_ISR: OsIsrInterruptSource=213, OsIsrInitialEnableInterruptSource=true
      EXT_INTP_CH00_CAT2_ISR: OsIsrInterruptSource=37, OsIsrInitialEnableInterruptSource=false
      EXT_INTP_CH01_CAT2_ISR: OsIsrInterruptSource=38, OsIsrInitialEnableInterruptSource=false
      EXT_INTP_CH03_CAT2_ISR: OsIsrInterruptSource=43, OsIsrInitialEnableInterruptSource=false
      EXT_INTP_CH04_CAT2_ISR: OsIsrInterruptSource=44, OsIsrInitialEnableInterruptSource=true
      EXT_INTP_CH05_CAT2_ISR: OsIsrInterruptSource=45, OsIsrInitialEnableInterruptSource=true
      EXT_INTP_CH11_CAT2_ISR: OsIsrInterruptSource=47, OsIsrInitialEnableInterruptSource=false
      EXT_INTP_CH12_CAT2_ISR: OsIsrInterruptSource=131, OsIsrInitialEnableInterruptSource=false
      EXT_INTP_CH13_CAT2_ISR: OsIsrInterruptSource=206, OsIsrInitialEnableInterruptSource=false
      EXT_INTP_CH18_CAT2_ISR: OsIsrInterruptSource=370, OsIsrInitialEnableInterruptSource=false
      EXT_INTP_CH19_CAT2_ISR: OsIsrInterruptSource=371, OsIsrInitialEnableInterruptSource=false
      TAUD0_CH13_CAT2_ISR: OsIsrInterruptSource=54, OsIsrInitialEnableInterruptSource=true
      TAUD0_CH15_CAT2_ISR: OsIsrInterruptSource=55, OsIsrInitialEnableInterruptSource=true
      SPI_CSIH3_TIR_CAT2_ISR: OsIsrInterruptSource=159, OsIsrInitialEnableInterruptSource=false
      INTRIIC0TI_interrupt: OsIsrInterruptSource=76, OsIsrInitialEnableInterruptSource=true
      INTRIIC0EE_interrupt: OsIsrInterruptSource=77, OsIsrInitialEnableInterruptSource=true
      INTRIIC0RI_interrupt: OsIsrInterruptSource=78, OsIsrInitialEnableInterruptSource=true
      INTRIIC0TEI_interrupt: OsIsrInterruptSource=79, OsIsrInitialEnableInterruptSource=true
      Uart_IntTx4: OsIsrInterruptSource=233, OsIsrInitialEnableInterruptSource=true
      Uart_IntRx4: OsIsrInterruptSource=234, OsIsrInitialEnableInterruptSource=true
      Uart_IntErr4: OsIsrInterruptSource=235, OsIsrInitialEnableInterruptSource=true
      Uart_IntTx5: OsIsrInterruptSource=237, OsIsrInitialEnableInterruptSource=true
      Uart_IntRx5: OsIsrInterruptSource=238, OsIsrInitialEnableInterruptSource=true
      Uart_IntErr5: OsIsrInterruptSource=239, OsIsrInitialEnableInterruptSource=true
      INTRIIC1TI_interrupt: OsIsrInterruptSource=240, OsIsrInitialEnableInterruptSource=true
      INTRIIC1EE_interrupt: OsIsrInterruptSource=241, OsIsrInitialEnableInterruptSource=true
      INTRIIC1RI_interrupt: OsIsrInterruptSource=242, OsIsrInitialEnableInterruptSource=true
      INTRIIC1TEI_interrupt: OsIsrInterruptSource=243, OsIsrInitialEnableInterruptSource=true
    Rte_Al_TE_DRIVERS_SAFE_0_100ms (OsAlarm): OsAlarmCounterRef=SystemTimer, OsAlarmAccessingApplication=SystemApplication_OsCore0
      OsAlarmAction
        OsAlarmSetEvent: OsAlarmSetEventRef=Rte_Ev_Cyclic_DRIVERS_SAFE_0_100ms, OsAlarmSetEventTaskRef=Os/DRIVERS_SAFE
    Rte_Ev_Cyclic_DRIVERS_SAFE_0_100ms (OsEvent)
    CanIsrWakeup_3 (OsIsr):  # /ActiveEcuC/Can PLAIN_TEXT Can wakeup event of controller CT_B30_for_SC_CAN_V3_2_4a04dc9c. This OsIsr container has been created automatically based on the Can driver configuration.
      OsIsrCategory = CATEGORY_2
      OsIsrInterruptType = EXTERNAL
      OsIsrInterruptSource = 221
      OsIsrInterruptPriority = 1
      OsIsrStackSize = 512
      OsIsrEnableNesting = false
      OsIsrUsesFpu = false
      OsIsrInitialEnableInterruptSource = true
    Rte_Al_TE_SYS_0_5ms (OsAlarm): OsAlarmCounterRef=SystemTimer, OsAlarmAccessingApplication=SystemApplication_OsCore0
      OsAlarmAction
        OsAlarmSetEvent: OsAlarmSetEventRef=Rte_Ev_Cyclic_SYS_0_5ms, OsAlarmSetEventTaskRef=Os/SYS
    4 x OsEvent:
      Rte_Ev_Cyclic_SYS_0_5ms
      Rte_Ev_Run_AMP_AMP_Event_MainFunction
      Rte_Ev_WP_SYS: OsEventMask=2
      Rte_Ev_Run_BswM_BswM_Read_PowerModeShutdownReq_EmergencySleep
    Rte_Al_TE_IPC_IPC_MainFunction (OsAlarm):
      OsAlarmCounterRef = SystemTimer
      OsAlarmAccessingApplication = SystemApplication_OsCore0
      OsAlarmAccessingApplication = OsApplication_NonTrust_OsCore0
      OsAlarmAccessingApplication = OsApplication_Trust_OsCore0
      OsAlarmAction
        OsAlarmSetEvent: OsAlarmSetEventRef=Rte_Ev_Run_IPC_IPC_MainFunction, OsAlarmSetEventTaskRef=Os/IPC
    3 x OsEvent:
      Rte_Ev_Run_IPC_IPC_MainFunction
      Rte_Ev_Run_IoHwAb_IoHwAb_GetPin
      Rte_Ev_Run_IoHwAb_IoHwAb_GetVoltage
    Rte_Al_TE_SYS_0_10ms (OsAlarm): OsAlarmCounterRef=SystemTimer, OsAlarmAccessingApplication=SystemApplication_OsCore0
      OsAlarmAction
        OsAlarmSetEvent: OsAlarmSetEventRef=Rte_Ev_Cyclic_SYS_0_10ms, OsAlarmSetEventTaskRef=Os/SYS
    Rte_Ev_Cyclic_SYS_0_10ms (OsEvent)
    Rte_Al_TE_DCM_Server_DCM_Server_MainFunction (OsAlarm): OsAlarmCounterRef=SystemTimer, OsAlarmAccessingApplication=SystemApplication_OsCore0
      OsAlarmAction
        OsAlarmSetEvent: OsAlarmSetEventRef=Rte_Ev_Run_DCM_Server_DCM_Server_MainFunction, OsAlarmSetEventTaskRef=Os/Default_BSW
    Rte_Ev_Run_DCM_Server_DCM_Server_MainFunction (OsEvent)
    Rte_Al_TE_Gyro_Gyro_MainFunction (OsAlarm): OsAlarmCounterRef=SystemTimer, OsAlarmAccessingApplication=SystemApplication_OsCore0
      OsAlarmAction
        OsAlarmSetEvent: OsAlarmSetEventRef=Rte_Ev_Run_Gyro_Gyro_MainFunction, OsAlarmSetEventTaskRef=Os/DRIVERS_SAFE
    Rte_Ev_Run_Gyro_Gyro_MainFunction (OsEvent)
    7 x OsAlarm, all with OsAlarmCounterRef=SystemTimer, OsAlarmAccessingApplication=SystemApplication_OsCore0:
      Rte_Al_TE_Common_Normal_Common_Normal_100msMainFunction: OsAlarmAccessingApplication=OsApplication_Trust_OsCore0
        OsAlarmAction
          OsAlarmSetEvent: OsAlarmSetEventRef=Rte_Ev_Run_Common_Normal_Common_Normal_100msMainFunction, OsAlarmSetEventTaskRef=Os/FUEL_TC_ODO
      Rte_Al_TE_Common_Normal_Common_Normal_10msMainFunction: OsAlarmAccessingApplication=OsApplication_Trust_OsCore0
        OsAlarmAction
          OsAlarmSetEvent: OsAlarmSetEventRef=Rte_Ev_Run_Common_Normal_Common_Normal_10msMainFunction, OsAlarmSetEventTaskRef=Os/FUEL_TC_ODO
      Rte_Al_TE_Common_Normal_Common_Normal_20msMainFunction: OsAlarmAccessingApplication=OsApplication_Trust_OsCore0
        OsAlarmAction
          OsAlarmSetEvent: OsAlarmSetEventRef=Rte_Ev_Run_Common_Normal_Common_Normal_20msMainFunction, OsAlarmSetEventTaskRef=Os/FUEL_TC_ODO
      Rte_Al_TE_Common_Normal_Common_Normal_5msMainFunction: OsAlarmAccessingApplication=OsApplication_Trust_OsCore0
        OsAlarmAction
          OsAlarmSetEvent: OsAlarmSetEventRef=Rte_Ev_Run_Common_Normal_Common_Normal_5msMainFunction, OsAlarmSetEventTaskRef=Os/FUEL_TC_ODO
      Rte_Al_TE_Common_GateWay_Common_GateWay_5msMainFunction: OsAlarmAccessingApplication=OsApplication_Trust_OsCore0
        OsAlarmAction
          OsAlarmSetEvent: OsAlarmSetEventRef=Rte_Ev_Run_Common_GateWay_Common_GateWay_5msMainFunction, OsAlarmSetEventTaskRef=Os/GateWay
      Rte_Al_TE_Common_Safety_Common_Safety_10msMainFunction
        OsAlarmAction
          OsAlarmSetEvent: OsAlarmSetEventRef=Rte_Ev_Run_Common_Safety_Common_Safety_10msMainFunction, OsAlarmSetEventTaskRef=Os/TT_GEAR
      Rte_Al_TE_Common_Safety_Common_Safety_50msMainFunction
        OsAlarmAction
          OsAlarmSetEvent: OsAlarmSetEventRef=Rte_Ev_Run_Common_Safety_Common_Safety_50msMainFunction, OsAlarmSetEventTaskRef=Os/TT_GEAR
    10 x OsEvent:
      Rte_Ev_Run_Common_GateWay_Common_GateWay_5msMainFunction
      Rte_Ev_Run_Common_Normal_Common_Normal_100msMainFunction
      Rte_Ev_Run_Common_Normal_Common_Normal_10msMainFunction
      Rte_Ev_Run_Common_Normal_Common_Normal_20msMainFunction
      Rte_Ev_Run_Common_Normal_Common_Normal_5msMainFunction
      Rte_Ev_Run_Common_Safety_Common_Safety_10msMainFunction
      Rte_Ev_Run_Common_Safety_Common_Safety_50msMainFunction
      Rte_Ev_WP_TT_GEAR: OsEventMask=2
      Rte_Ev_Run_Vconfig_VConfig_GetKindConfig_Operation_VConfig_GetKindConfig
      Rte_Ev_Run_Vconfig_VConfig_GetUpdateTick_OperationVConfig_GetUpdateTick
    3 x OsAlarm, all with OsAlarmCounterRef=SystemTimer, OsAlarmAccessingApplication=OsApplication_Trust_OsCore0, OsAlarmAccessingApplication=SystemApplication_OsCore0:
      Rte_Al_TE_Common_Normal_Common_Normal_100msMainFunction_
        OsAlarmAction
          OsAlarmSetEvent: OsAlarmSetEventRef=Rte_Ev_Run_Common_Normal_Common_Normal_100msMainFunction_, OsAlarmSetEventTaskRef=Os/FUEL_TC_ODO
      Rte_Al_TE_Common_Normal_Common_Normal_10msMainFunction_
        OsAlarmAction
          OsAlarmSetEvent: OsAlarmSetEventRef=Rte_Ev_Run_Common_Normal_Common_Normal_10msMainFunction_, OsAlarmSetEventTaskRef=Os/FUEL_TC_ODO
      Rte_Al_TE_Common_Normal_Common_Normal_20msMainFunction_
        OsAlarmAction
          OsAlarmSetEvent: OsAlarmSetEventRef=Rte_Ev_Run_Common_Normal_Common_Normal_20msMainFunction_, OsAlarmSetEventTaskRef=Os/FUEL_TC_ODO
    3 x OsEvent:
      Rte_Ev_Run_Common_Normal_Common_Normal_100msMainFunction_
      Rte_Ev_Run_Common_Normal_Common_Normal_10msMainFunction_
      Rte_Ev_Run_Common_Normal_Common_Normal_20msMainFunction_
    GateWay (OsTask):
      OsTaskActivation = 1
      OsTaskPriority = 5
      OsTaskSchedule = FULL
      OsTaskStackSharing = false
      OsTaskStackSize = 2048
      OsTaskType = AUTO
      OsTaskUsesFpu = false
      OsTaskAccessingApplication = SystemApplication_OsCore0
      OsTaskEventRef = Rte_Ev_Run_Common_GateWay_Common_GateWay_5msMainFunction
      OsTaskAccessingApplication = OsApplication_Trust_OsCore0
      OsTaskEventRef = Rte_Ev_WP_GateWay
      OsTaskEventRef = Rte_Ev_Run_Common_GateWay_Common_GateWay_10msMainFunction
    Rte_Al_TE_SYS_0_100ms (OsAlarm): OsAlarmCounterRef=SystemTimer, OsAlarmAccessingApplication=SystemApplication_OsCore0
      OsAlarmAction
        OsAlarmSetEvent: OsAlarmSetEventRef=Rte_Ev_Cyclic_SYS_0_100ms, OsAlarmSetEventTaskRef=Os/SYS
    Rte_Ev_Cyclic_SYS_0_100ms (OsEvent)
    5 x OsIsr, all with OsIsrCategory=CATEGORY_2, OsIsrInterruptType=EXTERNAL, OsIsrEnableNesting=false, OsIsrUsesFpu=false, OsIsrInitialEnableInterruptSource=true:
      CanIsrWakeup_0: OsIsrInterruptSource=25, OsIsrInterruptPriority=1, OsIsrStackSize=512  # /ActiveEcuC/Can PLAIN_TEXT Can wakeup event of controller CT_B30_for_SC_CAN_V3_2_4a04dc9c_001. This OsIsr container has been created automatically based on the Can driver configuration.
      CanIsrStatus_0: OsIsrInterruptSource=24, OsIsrInterruptPriority=1, OsIsrStackSize=512  # /ActiveEcuC/Can PLAIN_TEXT Can busoff event of controller CT_B30_for_SC_CAN_V3_2_4a04dc9c_001. This OsIsr container has been created automatically based on the Can driver configuration.
      CanIsrStatus_1: OsIsrInterruptSource=113, OsIsrInterruptPriority=1, OsIsrStackSize=512  # /ActiveEcuC/Can PLAIN_TEXT Can busoff event of controller CT_B30_for_SC_CAN_V3_2_4a04dc9c_002. This OsIsr container has been created automatically based on the Can driver configuration.
      CanIsrWakeup_1: OsIsrInterruptSource=114, OsIsrInterruptPriority=1, OsIsrStackSize=512  # /ActiveEcuC/Can PLAIN_TEXT Can wakeup event of controller CT_B30_for_SC_CAN_V3_2_4a04dc9c_002. This OsIsr container has been created automatically based on the Can driver configuration.
      Lin_RLIN_32_INTRLIN32: OsIsrInterruptSource=164, OsIsrInterruptPriority=10, OsIsrStackSize=1024, OsIsrSpecialFunctionName=LinIsr_30_Rh850Rlin_32_0  # /ActiveEcuC/Lin PLAIN_TEXT LIN interrupt INTRLIN32 for RLIN 32. This OsInterrupt container has been created automatically based on the driver configuration.
    Rte_Al_TE_SYS_0_50ms (OsAlarm): OsAlarmCounterRef=SystemTimer, OsAlarmAccessingApplication=SystemApplication_OsCore0
      OsAlarmAction
        OsAlarmSetEvent: OsAlarmSetEventRef=Rte_Ev_Cyclic_SYS_0_50ms, OsAlarmSetEventTaskRef=Os/SYS
    Rte_Ev_Cyclic_SYS_0_50ms (OsEvent)
    Rte_Al_TE_SWC_LOW_0_10ms (OsAlarm): OsAlarmCounterRef=SystemTimer, OsAlarmAccessingApplication=SystemApplication_OsCore0
      OsAlarmAction
        OsAlarmSetEvent: OsAlarmSetEventRef=Rte_Ev_Cyclic_SWC_LOW_0_10ms, OsAlarmSetEventTaskRef=Os/SWC_LOW
    Rte_Ev_Cyclic_SWC_LOW_0_10ms (OsEvent)
    Rte_Al_TE_Misc_Misc_MainFunction_500ms (OsAlarm): OsAlarmCounterRef=SystemTimer, OsAlarmAccessingApplication=SystemApplication_OsCore0
      OsAlarmAction
        OsAlarmSetEvent: OsAlarmSetEventRef=Rte_Ev_Run_Misc_Misc_MainFunction_500ms, OsAlarmSetEventTaskRef=Os/SYS
    Rte_Ev_Run_Misc_Misc_MainFunction_500ms (OsEvent)
    Rte_Al_TE2_Default_BSW_1_5ms (OsAlarm): OsAlarmCounterRef=SystemTimer, OsAlarmAccessingApplication=SystemApplication_OsCore0, OsAlarmAccessingApplication=OsApplication_NonTrust_OsCore0
      OsAlarmAction
        OsAlarmSetEvent: OsAlarmSetEventRef=Rte_Ev_Cyclic2_Default_BSW_1_5ms, OsAlarmSetEventTaskRef=Os/Default_BSW
    Rte_Ev_Cyclic2_Default_BSW_1_5ms (OsEvent)
    Rte_Al_TE_CConfig_CConfig_MainFunction (OsAlarm): OsAlarmCounterRef=SystemTimer, OsAlarmAccessingApplication=SystemApplication_OsCore0
      OsAlarmAction
        OsAlarmSetEvent: OsAlarmSetEventRef=Rte_Ev_Run_CConfig_CConfig_MainFunction, OsAlarmSetEventTaskRef=Os/BSW_COMM
    Rte_Ev_Run_CConfig_CConfig_MainFunction (OsEvent)
    Rte_Al_TE_Common_Normal_Common_Normal_20msMainFunction_A (OsAlarm): OsAlarmCounterRef=SystemTimer, OsAlarmAccessingApplication=OsApplication_Trust_OsCore0, OsAlarmAccessingApplication=SystemApplication_OsCore0
      OsAlarmAction
        OsAlarmSetEvent: OsAlarmSetEventRef=Rte_Ev_Run_Common_Normal_Common_Normal_20msMainFunction_A, OsAlarmSetEventTaskRef=Os/FUEL_TC_ODO
    Rte_Ev_Run_Common_Normal_Common_Normal_20msMainFunction_A (OsEvent)
    Rte_Al_TE_Common_Normal_Common_Normal_20msMainFunction_B (OsAlarm): OsAlarmCounterRef=SystemTimer, OsAlarmAccessingApplication=OsApplication_Trust_OsCore0, OsAlarmAccessingApplication=SystemApplication_OsCore0
      OsAlarmAction
        OsAlarmSetEvent: OsAlarmSetEventRef=Rte_Ev_Run_Common_Normal_Common_Normal_20msMainFunction_B, OsAlarmSetEventTaskRef=Os/FUEL_TC_ODO
    Rte_Ev_Run_Common_Normal_Common_Normal_20msMainFunction_B (OsEvent)
    Rte_Al_TE_Misc_NVM_Read_Speedup_Runnable (OsAlarm): OsAlarmCounterRef=SystemTimer, OsAlarmAccessingApplication=SystemApplication_OsCore0
      OsAlarmAction
        OsAlarmSetEvent: OsAlarmSetEventRef=Rte_Ev_Run_Misc_NVM_Read_Speedup_Runnable, OsAlarmSetEventTaskRef=Os/Default_BSW
    Rte_Ev_Run_Misc_NVM_Read_Speedup_Runnable (OsEvent)
    Rte_Al_TE_FvM_FvM_MainFunction (OsAlarm): OsAlarmCounterRef=SystemTimer, OsAlarmAccessingApplication=SystemApplication_OsCore0
      OsAlarmAction
        OsAlarmSetEvent: OsAlarmSetEventRef=Rte_Ev_Run_FvM_FvM_MainFunction, OsAlarmSetEventTaskRef=Os/BSW_COMM
    Rte_Ev_Run_FvM_FvM_MainFunction (OsEvent)
    Rte_Al_TE_DRIVERS_SAFE_0_50ms (OsAlarm): OsAlarmCounterRef=SystemTimer, OsAlarmAccessingApplication=SystemApplication_OsCore0
      OsAlarmAction
        OsAlarmSetEvent: OsAlarmSetEventRef=Rte_Ev_Cyclic_DRIVERS_SAFE_0_50ms, OsAlarmSetEventTaskRef=Os/DRIVERS_SAFE
    Rte_Ev_Cyclic_DRIVERS_SAFE_0_50ms (OsEvent)
    3 x OsIsr, all with OsIsrCategory=CATEGORY_1, OsIsrInterruptType=EXCEPTION, OsIsrInterruptPriority=0, OsIsrStackSize=1024, OsIsrEnableNesting=false, OsIsrUsesFpu=false, OsIsrInitialEnableInterruptSource=false:
      CORTST_G3KH_FETRAP_CAT1_ISR: OsIsrInterruptSource=3, OsIsrSpecialFunctionName=CORTST_G3KH_FETRAP_ISR
      CORTST_G3KH_EITRAP1_CAT1_ISR: OsIsrInterruptSource=5, OsIsrSpecialFunctionName=CORTST_G3KH_EITRAP1_ISR
      CORTST_G3KH_MAE_CAT1_ISR: OsIsrInterruptSource=12, OsIsrSpecialFunctionName=CORTST_G3KH_MAE_ISR
    Rte_Al_TE2_Default_BSW_0_5ms (OsAlarm): OsAlarmCounterRef=SystemTimer, OsAlarmAccessingApplication=SystemApplication_OsCore0
      OsAlarmAction
        OsAlarmSetEvent: OsAlarmSetEventRef=Rte_Ev_Cyclic2_Default_BSW_0_5ms, OsAlarmSetEventTaskRef=Os/Default_BSW
    Rte_Ev_Cyclic2_Default_BSW_0_5ms (OsEvent)
    OsIoc: OsIocIncludeHeader=usrostyp.h, OsIocIncludeHeader=Rte.h
      Rte_Common_Normal_Rc_Cluster_Shutdown_Status_Element (OsIocCommunication)
        OsIocReceiverProperties: OsIocReceivingOsApplicationRef=OsApplication_NonTrust_OsCore0
        OsIocDataProperties0 (OsIocDataProperties):
          OsIocDataType = uint8
          OsIocDataTypeIsAtomic = true
          OsIocInitValue = Rte_IocInitValue_Common_Normal_Rc_Cluster_Shutdown_Status_Element
          OsIocDataPropertyIndex = 0
        OsIocSenderProperties0 (OsIocSenderProperties): OsIocSenderId=0, OsIocSendingOsApplicationRef=OsApplication_NonTrust_OsCore0
        OsIocSenderProperties1 (OsIocSenderProperties): OsIocSenderId=1, OsIocSendingOsApplicationRef=OsApplication_Trust_OsCore0
      Rte_Power_Rc_Cluster_Shutdown_Status_Element (OsIocCommunication)
        OsIocReceiverProperties: OsIocReceivingOsApplicationRef=OsApplication_Trust_OsCore0
        OsIocDataProperties0 (OsIocDataProperties):
          OsIocDataType = uint8
          OsIocDataTypeIsAtomic = true
          OsIocInitValue = Rte_IocInitValue_Power_Rc_Cluster_Shutdown_Status_Element
          OsIocDataPropertyIndex = 0
        OsIocSenderProperties0 (OsIocSenderProperties): OsIocSenderId=0, OsIocSendingOsApplicationRef=OsApplication_NonTrust_OsCore0
        OsIocSenderProperties1 (OsIocSenderProperties): OsIocSenderId=1, OsIocSendingOsApplicationRef=OsApplication_Trust_OsCore0
    Rte_Al_TE_SecOc_Server_SecOc_Server_MainFunction (OsAlarm): OsAlarmCounterRef=SystemTimer, OsAlarmAccessingApplication=SystemApplication_OsCore0
      OsAlarmAction
        OsAlarmSetEvent: OsAlarmSetEventRef=Rte_Ev_Run_SecOc_Server_SecOc_Server_MainFunction, OsAlarmSetEventTaskRef=Os/BSW_COMM
    Rte_Al_TE_HSM_Hsm_MainFunction (OsAlarm): OsAlarmCounterRef=SystemTimer, OsAlarmAccessingApplication=SystemApplication_OsCore0
      OsAlarmAction
        OsAlarmSetEvent: OsAlarmSetEventRef=Rte_Ev_Run_HSM_Hsm_MainFunction, OsAlarmSetEventTaskRef=Os/Default_BSW
    8 x OsEvent:
      Rte_Ev_Run_HSM_Hsm_MainFunction
      Rte_Ev_Run_SecOc_Server_SecOc_Server_MainFunction
      Rte_Ev_Run_DemSatellite_0_SetEventStatus
      Rte_Ev_Run_HSM_HsmGetAes128Key
      Rte_Ev_Run_HSM_HsmSetAes128Key
      Rte_Ev_Run_HSM_HsmTrngGenerate
      Rte_Ev_Run_NvM_WriteBlock
      Rte_Ev_Run_IPC_IPC_DataSend_If_Operation
    OsApplication_Trust_OsCore0 (OsApplication):
      OsTrusted = true
      OsTrustedApplicationDelayTimingViolationCall = false
      OsTrustedApplicationWithProtection = false
      OsApplicationIsPrivileged = true
      OsAppUseTrustedFunctionStubs = true
      OsAppCalloutStubsIncludeHeader = usrostyp.h
      OsApplicationCoreRef = EcucCoreDefinition
      OsAppIsrRef = ADC0_SG1_CAT2_ISR
      OsAppIsrRef = ADC1_SG1_CAT2_ISR
      OsAppIsrRef = CanIsrGlobalStatus
      OsAppIsrRef = CanIsrStatus_0
      OsAppIsrRef = CanIsrStatus_1
      OsAppIsrRef = CanIsrStatus_3
      OsAppIsrRef = CanIsrWakeup_0
      OsAppIsrRef = CanIsrWakeup_1
      OsAppIsrRef = CanIsrWakeup_3
      OsAppIsrRef = CORTST_G3KH_EITRAP1_CAT1_ISR
      OsAppIsrRef = CORTST_G3KH_FETRAP_CAT1_ISR
      OsAppIsrRef = CORTST_G3KH_MAE_CAT1_ISR
      OsAppIsrRef = EXT_INTP_CH00_CAT2_ISR
      OsAppIsrRef = EXT_INTP_CH01_CAT2_ISR
      OsAppIsrRef = EXT_INTP_CH{03..05}_CAT2_ISR
      OsAppIsrRef = EXT_INTP_CH{11..13}_CAT2_ISR
      OsAppIsrRef = EXT_INTP_CH18_CAT2_ISR
      OsAppIsrRef = EXT_INTP_CH19_CAT2_ISR
      OsAppIsrRef = EXT_INTP_CH21_CAT2_ISR
      OsAppIsrRef = INTFICUIF0DFRQPE
      OsAppIsrRef = INTRIIC0EE_interrupt
      OsAppIsrRef = INTRIIC0RI_interrupt
      OsAppIsrRef = INTRIIC0TEI_interrupt
      OsAppIsrRef = INTRIIC0TI_interrupt
      OsAppIsrRef = INTRIIC1EE_interrupt
      OsAppIsrRef = INTRIIC1RI_interrupt
      OsAppIsrRef = INTRIIC1TEI_interrupt
      OsAppIsrRef = INTRIIC1TI_interrupt
      OsAppIsrRef = Lin_RLIN_31_INTRLIN31
      OsAppIsrRef = Lin_RLIN_32_INTRLIN32
      OsAppIsrRef = SPI_CSIH3_TIR_CAT2_ISR
      OsAppIsrRef = TAUD0_CH13_CAT2_ISR
      OsAppIsrRef = TAUD0_CH15_CAT2_ISR
      OsAppIsrRef = Uart_IntErr4
      OsAppIsrRef = Uart_IntErr5
      OsAppIsrRef = Uart_IntRx4
      OsAppIsrRef = Uart_IntRx5
      OsAppIsrRef = Uart_IntTx4
      OsAppIsrRef = Uart_IntTx5
      OsAppTaskRef = Os/BSW_COMM
      OsAppTaskRef = Os/BSW_DIAGNOSE
      OsAppTaskRef = Os/Default_BSW
      OsAppTaskRef = Default_Init_Task
      OsAppTaskRef = Default_Init_Task_Trusted
      OsAppTaskRef = Os/DRIVERS_SAFE
      OsAppTaskRef = Os/IPC
      OsAppTaskRef = Os/SWC_LOW
      OsAppTaskRef = Os/SYS
      OsAppTaskRef = Os/TT_GEAR
      OsAppEcucPartitionRef = EcucPartition_Trust
      OsAppAlarmRef = Rte_Al_TE2_BSW_COMM_0_10ms
      OsAppAlarmRef = Rte_Al_TE2_BSW_COMM_0_5ms
      OsAppAlarmRef = Rte_Al_TE_CConfig_CConfig_MainFunction
      OsAppAlarmRef = Rte_Al_TE_FvM_FvM_MainFunction
      OsAppAlarmRef = Rte_Al_TE_SecOc_Server_SecOc_Server_MainFunction
      OsAppAlarmRef = Rte_Al_TE2_BSW_DIAGNOSE_0_10ms
      OsAppAlarmRef = Rte_Al_TE_DRIVERS_SAFE_0_100ms
      OsAppAlarmRef = Rte_Al_TE_DRIVERS_SAFE_0_50ms
      OsAppAlarmRef = Rte_Al_TE_DRIVERS_SAFE_0_5ms
      OsAppAlarmRef = Rte_Al_TE_Gyro_Gyro_MainFunction
      OsAppAlarmRef = Rte_Al_TE2_Default_BSW_0_10ms
      OsAppAlarmRef = Rte_Al_TE2_Default_BSW_0_5ms
      OsAppAlarmRef = Rte_Al_TE2_Default_BSW_1_5ms
      OsAppAlarmRef = Rte_Al_TE_DCM_Server_DCM_Server_MainFunction
      OsAppAlarmRef = Rte_Al_TE_HSM_Hsm_MainFunction
      OsAppAlarmRef = Rte_Al_TE_Misc_NVM_Read_Speedup_Runnable
      OsAppAlarmRef = Rte_Al_TE_IPC_IPC_MainFunction
      OsAppAlarmRef = Rte_Al_TE_EOL_EOL_MainFunction
      OsAppAlarmRef = Rte_Al_TE_SWC_LOW_0_10ms
      OsAppAlarmRef = Rte_Al_TE_Misc_Misc_MainFunction_500ms
      OsAppAlarmRef = Rte_Al_TE_SYS_0_100ms
      OsAppAlarmRef = Rte_Al_TE_SYS_0_10ms
      OsAppAlarmRef = Rte_Al_TE_SYS_0_50ms
      OsAppAlarmRef = Rte_Al_TE_SYS_0_5ms
      OsAppAlarmRef = Rte_Al_TE_Common_Safety_Common_Safety_10msMainFunction
      OsAppAlarmRef = Rte_Al_TE_Common_Safety_Common_Safety_50msMainFunction
      OsAppIsrRef = EXT_INTP_CH09_CAT2_ISR
      OsAppIsrRef = EXT_INTP_CH20_CAT2_ISR
      OsAppIsrRef = vHsmResponseIsr
      OsAppAlarmRef = Rte_Al_TE_IPC_IPC_STB_MainFunction
      OsAppAlarmRef = Rte_Al_TE2_BSW_COMM_0_2ms
      Csm_Decrypt (OsApplicationTrustedFunction): OsTrustedFunctionName=Csm_Decrypt, OsTrustedFunctionReturnType=Std_ReturnType
        6 x OsTrustedFunctionParam:
          jobId: OsTrustedFunctionParamId=1, OsTrustedFunctionParamDataType=uint32, OsTrustedFunctionParamDirection=IN
          mode: OsTrustedFunctionParamId=2, OsTrustedFunctionParamDataType=Crypto_OperationModeType, OsTrustedFunctionParamDirection=IN
          dataPtr: OsTrustedFunctionParamId=3, OsTrustedFunctionParamDataType=uint8*, OsTrustedFunctionParamDirection=IN
          datalength: OsTrustedFunctionParamId=4, OsTrustedFunctionParamDataType=uint32, OsTrustedFunctionParamDirection=IN
          resultPtr: OsTrustedFunctionParamId=5, OsTrustedFunctionParamDataType=uint8, OsTrustedFunctionParamDirection=OUT
          resultLengthPtr: OsTrustedFunctionParamId=6, OsTrustedFunctionParamDataType=uint32, OsTrustedFunctionParamDirection=IN_OUT
      Csm_Encrypt (OsApplicationTrustedFunction): OsTrustedFunctionName=Csm_Encrypt, OsTrustedFunctionReturnType=Std_ReturnType
        6 x OsTrustedFunctionParam:
          jobId: OsTrustedFunctionParamId=1, OsTrustedFunctionParamDataType=uint32, OsTrustedFunctionParamDirection=IN
          mode: OsTrustedFunctionParamId=2, OsTrustedFunctionParamDataType=Crypto_OperationModeType, OsTrustedFunctionParamDirection=IN
          dataPtr: OsTrustedFunctionParamId=3, OsTrustedFunctionParamDataType=uint8*, OsTrustedFunctionParamDirection=IN
          datalength: OsTrustedFunctionParamId=4, OsTrustedFunctionParamDataType=uint32, OsTrustedFunctionParamDirection=IN
          resultPtr: OsTrustedFunctionParamId=5, OsTrustedFunctionParamDataType=uint8, OsTrustedFunctionParamDirection=OUT
          resultLengthPtr: OsTrustedFunctionParamId=6, OsTrustedFunctionParamDataType=uint32, OsTrustedFunctionParamDirection=IN_OUT
      OsApplicationHooks: OsAppErrorHook=false, OsAppShutdownHook=false, OsAppStartupHook=false
      45 x OsApplicationTrustedFunction:
        Rte_TrustedCall_Common_GateWay_IPC_DataSend_If_Operation: OsTrustedFunctionName=Rte_TrustedCall_Common_GateWay_IPC_DataSend_If_Operation, OsTrustedFunctionReturnType=Std_ReturnType
          3 x OsTrustedFunctionParam:
            len: OsTrustedFunctionParamId=2, OsTrustedFunctionParamDataType=uint16, OsTrustedFunctionParamDirection=IN
            p_msg: OsTrustedFunctionParamId=1, OsTrustedFunctionParamDataType=uint8, OsTrustedFunctionParamDirection=IN_OUT
            priority: OsTrustedFunctionParamId=3, OsTrustedFunctionParamDataType=uint8, OsTrustedFunctionParamDirection=IN
        Rte_TrustedCall_Common_GateWay_NvMService_AC3_Defs_NvBlockNeed_Block_IPC_CAN_Data_WriteBlock: OsTrustedFunctionName=Rte_TrustedCall_Common_GateWay_NvMService_AC3_Defs_NvBlockNeed_Block_IPC_CAN_Data_WriteBlock, OsTrustedFunctionReturnType=Std_ReturnType
          SrcPtr (OsTrustedFunctionParam): OsTrustedFunctionParamId=1, OsTrustedFunctionParamDataType=dtRef_const_VOID, OsTrustedFunctionParamDirection=IN
        Rte_TrustedCall_Common_GateWay_NvMService_AC3_Defs_NvBlockNeed_Block_IPC_Config_Data_WriteBlock: OsTrustedFunctionName=Rte_TrustedCall_Common_GateWay_NvMService_AC3_Defs_NvBlockNeed_Block_IPC_Config_Data_WriteBlock, OsTrustedFunctionReturnType=Std_ReturnType
          SrcPtr (OsTrustedFunctionParam): OsTrustedFunctionParamId=1, OsTrustedFunctionParamDataType=dtRef_const_VOID, OsTrustedFunctionParamDirection=IN
        Rte_TrustedCall_Common_Normal_DiagnosticMonitor_Fuel_Sensor1_ShortToBAT_SetEventStatus: OsTrustedFunctionName=Rte_TrustedCall_Common_Normal_DiagnosticMonitor_Fuel_Sensor1_ShortToBAT_SetEventStatus, OsTrustedFunctionReturnType=Std_ReturnType
          EventStatus (OsTrustedFunctionParam): OsTrustedFunctionParamId=1, OsTrustedFunctionParamDataType=Dem_EventStatusType, OsTrustedFunctionParamDirection=IN
        Rte_TrustedCall_Common_Normal_DiagnosticMonitor_Fuel_Sensor1_ShortToGND_SetEventStatus: OsTrustedFunctionName=Rte_TrustedCall_Common_Normal_DiagnosticMonitor_Fuel_Sensor1_ShortToGND_SetEventStatus, OsTrustedFunctionReturnType=Std_ReturnType
          EventStatus (OsTrustedFunctionParam): OsTrustedFunctionParamId=1, OsTrustedFunctionParamDataType=Dem_EventStatusType, OsTrustedFunctionParamDirection=IN
        Rte_TrustedCall_Common_Normal_DiagnosticMonitor_Fuel_Sensor2_ShortToBAT_SetEventStatus: OsTrustedFunctionName=Rte_TrustedCall_Common_Normal_DiagnosticMonitor_Fuel_Sensor2_ShortToBAT_SetEventStatus, OsTrustedFunctionReturnType=Std_ReturnType
          EventStatus (OsTrustedFunctionParam): OsTrustedFunctionParamId=1, OsTrustedFunctionParamDataType=Dem_EventStatusType, OsTrustedFunctionParamDirection=IN
        Rte_TrustedCall_Common_Normal_DiagnosticMonitor_Fuel_Sensor2_ShortToGND_SetEventStatus: OsTrustedFunctionName=Rte_TrustedCall_Common_Normal_DiagnosticMonitor_Fuel_Sensor2_ShortToGND_SetEventStatus, OsTrustedFunctionReturnType=Std_ReturnType
          EventStatus (OsTrustedFunctionParam): OsTrustedFunctionParamId=1, OsTrustedFunctionParamDataType=Dem_EventStatusType, OsTrustedFunctionParamDirection=IN
        Rte_TrustedCall_Common_Normal_HsmKeyM_GetAes128Key: OsTrustedFunctionName=Rte_TrustedCall_Common_Normal_HsmKeyM_GetAes128Key, OsTrustedFunctionReturnType=Std_ReturnType
          3 x OsTrustedFunctionParam:
            IV: OsTrustedFunctionParamId=1, OsTrustedFunctionParamDataType=A_17Bytes, OsTrustedFunctionParamDirection=OUT
            KEY: OsTrustedFunctionParamId=2, OsTrustedFunctionParamDataType=A_16Bytes, OsTrustedFunctionParamDirection=OUT
            key_len: OsTrustedFunctionParamId=3, OsTrustedFunctionParamDataType=uint32, OsTrustedFunctionParamDirection=IN_OUT
        Rte_TrustedCall_Common_Normal_HsmKeyM_SetAes128Key: OsTrustedFunctionName=Rte_TrustedCall_Common_Normal_HsmKeyM_SetAes128Key, OsTrustedFunctionReturnType=Std_ReturnType
          3 x OsTrustedFunctionParam, all with OsTrustedFunctionParamDirection=IN:
            IV: OsTrustedFunctionParamId=1, OsTrustedFunctionParamDataType=const A_16Bytes*
            KEY: OsTrustedFunctionParamId=2, OsTrustedFunctionParamDataType=const A_16Bytes*
            key_len: OsTrustedFunctionParamId=3, OsTrustedFunctionParamDataType=uint32
        Rte_TrustedCall_Common_Normal_Hsm_Port_TrngGenerate: OsTrustedFunctionName=Rte_TrustedCall_Common_Normal_Hsm_Port_TrngGenerate, OsTrustedFunctionReturnType=Std_ReturnType
          Trng (OsTrustedFunctionParam): OsTrustedFunctionParamId=1, OsTrustedFunctionParamDataType=A_16Bytes, OsTrustedFunctionParamDirection=OUT
          len (OsTrustedFunctionParam): OsTrustedFunctionParamId=2, OsTrustedFunctionParamDataType=uint32, OsTrustedFunctionParamDirection=IN_OUT
        Rte_TrustedCall_Common_Normal_IoHwAb_Interface_GetPin: OsTrustedFunctionName=Rte_TrustedCall_Common_Normal_IoHwAb_Interface_GetPin, OsTrustedFunctionReturnType=Std_ReturnType
          Id (OsTrustedFunctionParam): OsTrustedFunctionParamId=1, OsTrustedFunctionParamDataType=uint8, OsTrustedFunctionParamDirection=IN
          Pin (OsTrustedFunctionParam): OsTrustedFunctionParamId=2, OsTrustedFunctionParamDataType=boolean, OsTrustedFunctionParamDirection=OUT
        Rte_TrustedCall_Common_Normal_IoHwAb_Interface_GetVoltage: OsTrustedFunctionName=Rte_TrustedCall_Common_Normal_IoHwAb_Interface_GetVoltage, OsTrustedFunctionReturnType=Std_ReturnType
          Id (OsTrustedFunctionParam): OsTrustedFunctionParamId=1, OsTrustedFunctionParamDataType=uint8, OsTrustedFunctionParamDirection=IN
          Voltage (OsTrustedFunctionParam): OsTrustedFunctionParamId=2, OsTrustedFunctionParamDataType=uint32, OsTrustedFunctionParamDirection=OUT
        Rte_TrustedCall_Common_Normal_NvMService_AC3_SRBS_Defs_NvBlockNeed_Block_MaintainOdo_WriteBlock: OsTrustedFunctionName=Rte_TrustedCall_Common_Normal_NvMService_AC3_SRBS_Defs_NvBlockNeed_Block_MaintainOdo_WriteBlock, OsTrustedFunctionReturnType=Std_ReturnType
          SrcPtr (OsTrustedFunctionParam): OsTrustedFunctionParamId=1, OsTrustedFunctionParamDataType=dtRef_const_VOID, OsTrustedFunctionParamDirection=IN
        Rte_TrustedCall_Common_Normal_NvMService_AC3_SRBS_Defs_NvBlockNeed_Block_ODO_1_WriteBlock: OsTrustedFunctionName=Rte_TrustedCall_Common_Normal_NvMService_AC3_SRBS_Defs_NvBlockNeed_Block_ODO_1_WriteBlock, OsTrustedFunctionReturnType=Std_ReturnType
          SrcPtr (OsTrustedFunctionParam): OsTrustedFunctionParamId=1, OsTrustedFunctionParamDataType=dtRef_const_VOID, OsTrustedFunctionParamDirection=IN
        Rte_TrustedCall_Common_Normal_NvMService_AC3_SRBS_Defs_NvBlockNeed_Block_ODO_2_WriteBlock: OsTrustedFunctionName=Rte_TrustedCall_Common_Normal_NvMService_AC3_SRBS_Defs_NvBlockNeed_Block_ODO_2_WriteBlock, OsTrustedFunctionReturnType=Std_ReturnType
          SrcPtr (OsTrustedFunctionParam): OsTrustedFunctionParamId=1, OsTrustedFunctionParamDataType=dtRef_const_VOID, OsTrustedFunctionParamDirection=IN
        Rte_TrustedCall_Common_Normal_NvMService_AC3_SRBS_Defs_NvBlockNeed_Block_ODO_3_WriteBlock: OsTrustedFunctionName=Rte_TrustedCall_Common_Normal_NvMService_AC3_SRBS_Defs_NvBlockNeed_Block_ODO_3_WriteBlock, OsTrustedFunctionReturnType=Std_ReturnType
          SrcPtr (OsTrustedFunctionParam): OsTrustedFunctionParamId=1, OsTrustedFunctionParamDataType=dtRef_const_VOID, OsTrustedFunctionParamDirection=IN
        Rte_TrustedCall_Common_Normal_NvMService_AC3_SRBS_Defs_NvBlockNeed_Block_ODO_4_WriteBlock: OsTrustedFunctionName=Rte_TrustedCall_Common_Normal_NvMService_AC3_SRBS_Defs_NvBlockNeed_Block_ODO_4_WriteBlock, OsTrustedFunctionReturnType=Std_ReturnType
          SrcPtr (OsTrustedFunctionParam): OsTrustedFunctionParamId=1, OsTrustedFunctionParamDataType=dtRef_const_VOID, OsTrustedFunctionParamDirection=IN
        Rte_TrustedCall_Common_Normal_NvMService_AC3_SRBS_Defs_NvBlockNeed_Block_ODO_5_WriteBlock: OsTrustedFunctionName=Rte_TrustedCall_Common_Normal_NvMService_AC3_SRBS_Defs_NvBlockNeed_Block_ODO_5_WriteBlock, OsTrustedFunctionReturnType=Std_ReturnType
          SrcPtr (OsTrustedFunctionParam): OsTrustedFunctionParamId=1, OsTrustedFunctionParamDataType=dtRef_const_VOID, OsTrustedFunctionParamDirection=IN
        Rte_TrustedCall_Common_Normal_NvMService_AC3_SRBS_Defs_NvBlockNeed_Block_Trip_WriteBlock: OsTrustedFunctionName=Rte_TrustedCall_Common_Normal_NvMService_AC3_SRBS_Defs_NvBlockNeed_Block_Trip_WriteBlock, OsTrustedFunctionReturnType=Std_ReturnType
          SrcPtr (OsTrustedFunctionParam): OsTrustedFunctionParamId=1, OsTrustedFunctionParamDataType=dtRef_const_VOID, OsTrustedFunctionParamDirection=IN
        Rte_TrustedCall_Common_Normal_NvMService_AC3_SRBS_NvBlockNeed_Menu_WriteBlock: OsTrustedFunctionName=Rte_TrustedCall_Common_Normal_NvMService_AC3_SRBS_NvBlockNeed_Menu_WriteBlock, OsTrustedFunctionReturnType=Std_ReturnType
          SrcPtr (OsTrustedFunctionParam): OsTrustedFunctionParamId=1, OsTrustedFunctionParamDataType=dtRef_const_VOID, OsTrustedFunctionParamDirection=IN
        Rte_TrustedCall_Common_Normal_Os_Service_GetCounterValue: OsTrustedFunctionName=Rte_TrustedCall_Common_Normal_Os_Service_GetCounterValue, OsTrustedFunctionReturnType=Std_ReturnType
          Value (OsTrustedFunctionParam): OsTrustedFunctionParamId=1, OsTrustedFunctionParamDataType=TimeInMicrosecondsType, OsTrustedFunctionParamDirection=OUT
        Rte_TrustedCall_Common_Normal_Os_Service_GetElapsedValue: OsTrustedFunctionName=Rte_TrustedCall_Common_Normal_Os_Service_GetElapsedValue, OsTrustedFunctionReturnType=Std_ReturnType
          ElapsedValue (OsTrustedFunctionParam): OsTrustedFunctionParamId=2, OsTrustedFunctionParamDataType=TimeInMicrosecondsType, OsTrustedFunctionParamDirection=OUT
          Value (OsTrustedFunctionParam): OsTrustedFunctionParamId=1, OsTrustedFunctionParamDataType=TimeInMicrosecondsType, OsTrustedFunctionParamDirection=IN_OUT
        Rte_TrustedCall_Common_Normal_VConfig_GetKindConfig_Operation_VConfig_GetKindConfig: OsTrustedFunctionName=Rte_TrustedCall_Common_Normal_VConfig_GetKindConfig_Operation_VConfig_GetKindConfig, OsTrustedFunctionReturnType=Std_ReturnType
          kindConfig (OsTrustedFunctionParam): OsTrustedFunctionParamId=2, OsTrustedFunctionParamDataType=uint8, OsTrustedFunctionParamDirection=OUT
          kindId (OsTrustedFunctionParam): OsTrustedFunctionParamId=1, OsTrustedFunctionParamDataType=uint16, OsTrustedFunctionParamDirection=IN
        Rte_TrustedCall_Common_Normal_VConfig_GetUpdateTick_OperationVConfig_GetUpdateTick: OsTrustedFunctionName=Rte_TrustedCall_Common_Normal_VConfig_GetUpdateTick_OperationVConfig_GetUpdateTick, OsTrustedFunctionReturnType=Std_ReturnType
          updateTick (OsTrustedFunctionParam): OsTrustedFunctionParamId=1, OsTrustedFunctionParamDataType=TimeInMicrosecondsType, OsTrustedFunctionParamDirection=OUT
        Rte_TrustedCom_SendSignal: OsTrustedFunctionName=Rte_TrustedCom_SendSignal, OsTrustedFunctionReturnType=uint8
          SignalDataPtr (OsTrustedFunctionParam): OsTrustedFunctionParamId=2, OsTrustedFunctionParamDataType=const void*, OsTrustedFunctionParamDirection=IN
          SignalId (OsTrustedFunctionParam): OsTrustedFunctionParamId=1, OsTrustedFunctionParamDataType=Com_SignalIdType, OsTrustedFunctionParamDirection=IN
        Rte_TrustedCall_Common_GateWay_CNA_SignalSet_Operation: OsTrustedFunctionName=Rte_TrustedCall_Common_GateWay_CNA_SignalSet_Operation, OsTrustedFunctionReturnType=Std_ReturnType
          signalId (OsTrustedFunctionParam): OsTrustedFunctionParamId=1, OsTrustedFunctionParamDataType=uint16, OsTrustedFunctionParamDirection=IN
          value (OsTrustedFunctionParam): OsTrustedFunctionParamId=2, OsTrustedFunctionParamDataType=uint32, OsTrustedFunctionParamDirection=IN_OUT
        Rte_TrustedCall_Common_Normal_CanFrameCounter_Can_ABS3_Counter: OsTrustedFunctionName=Rte_TrustedCall_Common_Normal_CanFrameCounter_Can_ABS3_Counter, OsTrustedFunctionReturnType=Std_ReturnType
          counter (OsTrustedFunctionParam): OsTrustedFunctionParamId=1, OsTrustedFunctionParamDataType=CanFrameCounterType, OsTrustedFunctionParamDirection=OUT
        Rte_TrustedCall_Common_Normal_CanFrameCounter_Can_ECM2_Counter: OsTrustedFunctionName=Rte_TrustedCall_Common_Normal_CanFrameCounter_Can_ECM2_Counter, OsTrustedFunctionReturnType=Std_ReturnType
          counter (OsTrustedFunctionParam): OsTrustedFunctionParamId=1, OsTrustedFunctionParamDataType=CanFrameCounterType, OsTrustedFunctionParamDirection=OUT
        Rte_TrustedCall_Common_Normal_CanFrameCounter_Can_ESP_FD2_Counter: OsTrustedFunctionName=Rte_TrustedCall_Common_Normal_CanFrameCounter_Can_ESP_FD2_Counter, OsTrustedFunctionReturnType=Std_ReturnType
          counter (OsTrustedFunctionParam): OsTrustedFunctionParamId=1, OsTrustedFunctionParamDataType=CanFrameCounterType, OsTrustedFunctionParamDirection=OUT
        Rte_TrustedCall_Common_GateWay_rpCS_SWCGateWay_E2ESwitchStatusRead_Operation: OsTrustedFunctionName=Rte_TrustedCall_Common_GateWay_rpCS_SWCGateWay_E2ESwitchStatusRead_Operation, OsTrustedFunctionReturnType=Std_ReturnType
          3 x OsTrustedFunctionParam, all with OsTrustedFunctionParamDataType=uint8:
            Data: OsTrustedFunctionParamId=2, OsTrustedFunctionParamDirection=IN_OUT
            Length: OsTrustedFunctionParamId=1, OsTrustedFunctionParamDirection=IN
            Status: OsTrustedFunctionParamId=3, OsTrustedFunctionParamDirection=OUT
        Rte_TrustedCall_Common_GateWay_rpCS_SWCGateWay_E2ESwitchStatusWrite_Operation: OsTrustedFunctionName=Rte_TrustedCall_Common_GateWay_rpCS_SWCGateWay_E2ESwitchStatusWrite_Operation, OsTrustedFunctionReturnType=Std_ReturnType
          3 x OsTrustedFunctionParam, all with OsTrustedFunctionParamDataType=uint8:
            Data: OsTrustedFunctionParamId=2, OsTrustedFunctionParamDirection=IN_OUT
            Length: OsTrustedFunctionParamId=1, OsTrustedFunctionParamDirection=IN
            Status: OsTrustedFunctionParamId=3, OsTrustedFunctionParamDirection=OUT
        Rte_TrustedCall_Common_GateWay_rpCS_SWCGateWay_SecOcSwitchStatusRead_Operation: OsTrustedFunctionName=Rte_TrustedCall_Common_GateWay_rpCS_SWCGateWay_SecOcSwitchStatusRead_Operation, OsTrustedFunctionReturnType=Std_ReturnType
          3 x OsTrustedFunctionParam, all with OsTrustedFunctionParamDataType=uint8:
            Data: OsTrustedFunctionParamId=2, OsTrustedFunctionParamDirection=IN_OUT
            Length: OsTrustedFunctionParamId=1, OsTrustedFunctionParamDirection=IN
            Status: OsTrustedFunctionParamId=3, OsTrustedFunctionParamDirection=OUT
        Rte_TrustedCall_Common_GateWay_rpCS_SWCGateWay_SecOcSwitchStatusWrite_Operation: OsTrustedFunctionName=Rte_TrustedCall_Common_GateWay_rpCS_SWCGateWay_SecOcSwitchStatusWrite_Operation, OsTrustedFunctionReturnType=Std_ReturnType
          3 x OsTrustedFunctionParam, all with OsTrustedFunctionParamDataType=uint8:
            Data: OsTrustedFunctionParamId=2, OsTrustedFunctionParamDirection=IN_OUT
            Length: OsTrustedFunctionParamId=1, OsTrustedFunctionParamDirection=IN
            Status: OsTrustedFunctionParamId=3, OsTrustedFunctionParamDirection=OUT
        Rte_TrustedCall_Common_GateWay_rpCS_AppClearDTCInfo_AppClearDTCInfo: OsTrustedFunctionName=Rte_TrustedCall_Common_GateWay_rpCS_AppClearDTCInfo_AppClearDTCInfo, OsTrustedFunctionReturnType=Std_ReturnType
          OpStatus (OsTrustedFunctionParam): OsTrustedFunctionParamId=1, OsTrustedFunctionParamDataType=uint8, OsTrustedFunctionParamDirection=IN
          Result (OsTrustedFunctionParam): OsTrustedFunctionParamId=2, OsTrustedFunctionParamDataType=uint8, OsTrustedFunctionParamDirection=OUT
        Rte_TrustedCall_Common_Normal_IRTC_Service_UTC2PerpetualCalendar: OsTrustedFunctionName=Rte_TrustedCall_Common_Normal_IRTC_Service_UTC2PerpetualCalendar, OsTrustedFunctionReturnType=Std_ReturnType
          date (OsTrustedFunctionParam): OsTrustedFunctionParamId=2, OsTrustedFunctionParamDataType=DateTimeType_t, OsTrustedFunctionParamDirection=OUT
          utc (OsTrustedFunctionParam): OsTrustedFunctionParamId=1, OsTrustedFunctionParamDataType=sint64, OsTrustedFunctionParamDirection=IN
        Rte_TrustedCall_Common_GateWay_rpCS_SWCGateWay_ComEx_GetRxE2EStatus: OsTrustedFunctionName=Rte_TrustedCall_Common_GateWay_rpCS_SWCGateWay_ComEx_GetRxE2EStatus, OsTrustedFunctionReturnType=Std_ReturnType
          E2eStatus (OsTrustedFunctionParam): OsTrustedFunctionParamId=2, OsTrustedFunctionParamDataType=uint32, OsTrustedFunctionParamDirection=OUT
          GroupId (OsTrustedFunctionParam): OsTrustedFunctionParamId=1, OsTrustedFunctionParamDataType=ComEx_SignalGroupIdType, OsTrustedFunctionParamDirection=IN
        Rte_TrustedCall_Common_GateWay_rpCS_SWCGateWay_ComEx_SendSignal: OsTrustedFunctionName=Rte_TrustedCall_Common_GateWay_rpCS_SWCGateWay_ComEx_SendSignal, OsTrustedFunctionReturnType=Std_ReturnType
          3 x OsTrustedFunctionParam, all with OsTrustedFunctionParamDirection=IN:
            Length: OsTrustedFunctionParamId=3, OsTrustedFunctionParamDataType=uint8
            SignalDataPtr: OsTrustedFunctionParamId=2, OsTrustedFunctionParamDataType=ComEx_ConstSignalDataType
            SignalId: OsTrustedFunctionParamId=1, OsTrustedFunctionParamDataType=ComEx_SignalIdType
        Rte_TrustedCall_Common_Normal_rpCS_SWCNormal_ComEx_GetRxE2EStatus: OsTrustedFunctionName=Rte_TrustedCall_Common_Normal_rpCS_SWCNormal_ComEx_GetRxE2EStatus, OsTrustedFunctionReturnType=Std_ReturnType
          E2eStatus (OsTrustedFunctionParam): OsTrustedFunctionParamId=2, OsTrustedFunctionParamDataType=uint32, OsTrustedFunctionParamDirection=OUT
          GroupId (OsTrustedFunctionParam): OsTrustedFunctionParamId=1, OsTrustedFunctionParamDataType=ComEx_SignalGroupIdType, OsTrustedFunctionParamDirection=IN
        Rte_TrustedCall_Common_Normal_rpCS_SWCNormal_ComEx_SendSignal: OsTrustedFunctionName=Rte_TrustedCall_Common_Normal_rpCS_SWCNormal_ComEx_SendSignal, OsTrustedFunctionReturnType=Std_ReturnType
          3 x OsTrustedFunctionParam, all with OsTrustedFunctionParamDirection=IN:
            Length: OsTrustedFunctionParamId=3, OsTrustedFunctionParamDataType=uint8
            SignalDataPtr: OsTrustedFunctionParamId=2, OsTrustedFunctionParamDataType=ComEx_ConstSignalDataType
            SignalId: OsTrustedFunctionParamId=1, OsTrustedFunctionParamDataType=ComEx_SignalIdType
        Rte_TrustedCall_Common_GateWay_rpCS_SWCGateway_UTCTime_UTC2PerpetualCalendar: OsTrustedFunctionName=Rte_TrustedCall_Common_GateWay_rpCS_SWCGateway_UTCTime_UTC2PerpetualCalendar, OsTrustedFunctionReturnType=Std_ReturnType
          date (OsTrustedFunctionParam): OsTrustedFunctionParamId=2, OsTrustedFunctionParamDataType=DateTimeType_t, OsTrustedFunctionParamDirection=OUT
          utc (OsTrustedFunctionParam): OsTrustedFunctionParamId=1, OsTrustedFunctionParamDataType=sint64, OsTrustedFunctionParamDirection=IN
        Rte_TrustedCall_Common_Normal_IRTC_Service_GetUTCTimeInMillis: OsTrustedFunctionName=Rte_TrustedCall_Common_Normal_IRTC_Service_GetUTCTimeInMillis, OsTrustedFunctionReturnType=Std_ReturnType
          arg (OsTrustedFunctionParam): OsTrustedFunctionParamId=1, OsTrustedFunctionParamDataType=uint64, OsTrustedFunctionParamDirection=OUT
        Rte_TrustedCall_Common_GateWay_rpCS_SWCGateWay_CNA_SignalSetNoTrigger_Operation: OsTrustedFunctionName=Rte_TrustedCall_Common_GateWay_rpCS_SWCGateWay_CNA_SignalSetNoTrigger_Operation, OsTrustedFunctionReturnType=Std_ReturnType
          signalId (OsTrustedFunctionParam): OsTrustedFunctionParamId=1, OsTrustedFunctionParamDataType=uint16, OsTrustedFunctionParamDirection=IN
          value (OsTrustedFunctionParam): OsTrustedFunctionParamId=2, OsTrustedFunctionParamDataType=uint8, OsTrustedFunctionParamDirection=IN_OUT
        Rte_TrustedCall_Common_GateWay_rpCS_SWCGateWay_CNA_SignalSet_U8N_Operation: OsTrustedFunctionName=Rte_TrustedCall_Common_GateWay_rpCS_SWCGateWay_CNA_SignalSet_U8N_Operation, OsTrustedFunctionReturnType=Std_ReturnType
          signalId (OsTrustedFunctionParam): OsTrustedFunctionParamId=1, OsTrustedFunctionParamDataType=uint16, OsTrustedFunctionParamDirection=IN
          value (OsTrustedFunctionParam): OsTrustedFunctionParamId=2, OsTrustedFunctionParamDataType=EventSignalType, OsTrustedFunctionParamDirection=IN_OUT
        Rte_TrustedCall_Common_GateWay_CNA_SignalGroupSet_Operation: OsTrustedFunctionName=Rte_TrustedCall_Common_GateWay_CNA_SignalGroupSet_Operation, OsTrustedFunctionReturnType=Std_ReturnType
          event_signal_info (OsTrustedFunctionParam): OsTrustedFunctionParamId=1, OsTrustedFunctionParamDataType=const EventSignalInfo_Type*, OsTrustedFunctionParamDirection=IN
        Rte_TrustedCall_Common_GateWay_VConfig_GetKindConfig_Operation_VConfig_GetKindConfig: OsTrustedFunctionName=Rte_TrustedCall_Common_GateWay_VConfig_GetKindConfig_Operation_VConfig_GetKindConfig, OsTrustedFunctionReturnType=Std_ReturnType
          kindConfig (OsTrustedFunctionParam): OsTrustedFunctionParamId=2, OsTrustedFunctionParamDataType=uint8, OsTrustedFunctionParamDirection=OUT
          kindId (OsTrustedFunctionParam): OsTrustedFunctionParamId=1, OsTrustedFunctionParamDataType=uint16, OsTrustedFunctionParamDirection=IN
    5 x OsEvent:
      Rte_Ev_Run_Can_Server_CNA_SignalSet
      Rte_Ev_WP_GateWay: OsEventMask=2
      Rte_Ev_Run_Can_Server_CanFrameCounter_Can_ABS3_Counter
      Rte_Ev_Run_Can_Server_CanFrameCounter_Can_ECM2_Counter
      Rte_Ev_Run_Can_Server_CanFrameCounter_Can_ESP_FD2_Counter
    EXT_INTP_CH09_CAT2_ISR (OsIsr):
      OsIsrCategory = CATEGORY_2
      OsIsrInterruptType = EXTERNAL
      OsIsrInterruptSource = 205
      OsIsrInterruptPriority = 6
      OsIsrStackSize = 512
      OsIsrEnableNesting = false
      OsIsrUsesFpu = false
      OsIsrInitialEnableInterruptSource = false
    EXT_INTP_CH20_CAT2_ISR (OsIsr):
      OsIsrCategory = CATEGORY_2
      OsIsrInterruptType = EXTERNAL
      OsIsrInterruptSource = 372
      OsIsrInterruptPriority = 6
      OsIsrStackSize = 512
      OsIsrEnableNesting = false
      OsIsrUsesFpu = false
      OsIsrInitialEnableInterruptSource = false
    7 x OsEvent:
      Rte_Ev_Run_DidDataProcess_E2ESwitchStatusRead
      Rte_Ev_Run_DidDataProcess_E2ESwitchStatusWrite
      Rte_Ev_Run_DidDataProcess_SecOcSwitchStatusRead
      Rte_Ev_Run_DidDataProcess_SecOcSwitchStatusWrite
      Rte_Ev_WP_BSW_COMM: OsEventMask=2
      Rte_Ev_Run_SocDtcProcess_PpCS_AppClearDTCInfo_AppClearDTCInfo
      Rte_Ev_Run_RTC_UTC2PerpetualCalendar
    3 x OsIsr, all with OsIsrCategory=CATEGORY_1, OsIsrInterruptPriority=0, OsIsrEnableNesting=false, OsIsrUsesFpu=false, OsIsrInitialEnableInterruptSource=false:
      System1msTick: OsIsrInterruptType=EXTERNAL, OsIsrInterruptSource=81, OsIsrStackSize=512, OsIsrSpecialFunctionName=GptIsr_1ms_tick
      ECCTST_G3KH_FEINT_CAT1_ISR: OsIsrInterruptType=EXCEPTION, OsIsrInterruptSource=15, OsIsrStackSize=1024, OsIsrSpecialFunctionName=ECCTST_G3KH_FEINT_ISR
      ECCTST_G3KH_SYSERR_CAT1_ISR: OsIsrInterruptType=EXCEPTION, OsIsrInterruptSource=1, OsIsrStackSize=1024, OsIsrSpecialFunctionName=ECCTST_G3KH_SYSERR_ISR
    7 x OsEvent:
      Rte_Ev_Run_ComEx_ComEx_GetRxE2EStatus
      Rte_Ev_Run_ComEx_ComEx_SendSignal
      Rte_Ev_WP_DRIVERS_SAFE: OsEventMask=2
      Rte_Ev_WP_Default_BSW: OsEventMask=2
      Rte_Ev_WP_SWC_LOW: OsEventMask=2
      Rte_Ev_WP_BSW_DIAGNOSE: OsEventMask=2
      Rte_Ev_Run_RTC_GetUTCTimeInMillis
    Rte_Al_TE_IPC_IPC_STB_MainFunction (OsAlarm): OsAlarmCounterRef=SystemTimer, OsAlarmAccessingApplication=SystemApplication_OsCore0
      OsAlarmAction
        OsAlarmSetEvent: OsAlarmSetEventRef=Rte_Ev_Run_IPC_IPC_STB_MainFunction, OsAlarmSetEventTaskRef=Os/IPC
    4 x OsEvent:
      Rte_Ev_Run_IPC_IPC_STB_MainFunction
      Rte_Ev_Run_Can_Server_CNA_SignalSetNoTrigger
      Rte_Ev_Run_Common_Normal_EOL_ReadDID0xFDD8_EOL_GetReadHardInputForCluster
      Rte_Ev_Run_Common_Normal_Fuel_Api_ParamentGetCsPort_Operation
    Rte_Al_TE_Common_GateWay_Common_GateWay_10msMainFunction (OsAlarm): OsAlarmCounterRef=SystemTimer, OsAlarmAccessingApplication=OsApplication_Trust_OsCore0, OsAlarmAccessingApplication=SystemApplication_OsCore0
      OsAlarmAction
        OsAlarmSetEvent: OsAlarmSetEventRef=Rte_Ev_Run_Common_GateWay_Common_GateWay_10msMainFunction, OsAlarmSetEventTaskRef=Os/GateWay
    Rte_Ev_Run_Common_GateWay_Common_GateWay_10msMainFunction (OsEvent)
    Rte_Ev_Run_Can_Server_CNA_SignalSet_U8N (OsEvent)
    Rte_Al_TE2_BSW_COMM_0_2ms (OsAlarm): OsAlarmCounterRef=SystemTimer, OsAlarmAccessingApplication=SystemApplication_OsCore0
      OsAlarmAction
        OsAlarmSetEvent: OsAlarmSetEventRef=Rte_Ev_Cyclic2_BSW_COMM_0_2ms, OsAlarmSetEventTaskRef=Os/BSW_COMM
    Rte_Ev_Cyclic2_BSW_COMM_0_2ms (OsEvent)
    Rte_Ev_Run_Can_Server_CNA_SignalGroupSet (OsEvent)
