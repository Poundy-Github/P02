AUTOSAR XML (schema 00046)
package /ActiveEcuC
  module config Can: implementation-config-variant=VARIANT-PRE-COMPILE, module-description=Can_Impl
    CanConfigSet
      CN_B30_for_SC_CAN_V3_2_c0d6c67b_Tx (CanHardwareObject):
        CanHandleType = BASIC
        CanIdValue = 0
        CanObjectType = TRANSMIT
        CanIdType = STANDARD
        CanObjectId = 18
        CanHwProcessing = true
        CanObjectHwSize = 3
        CanObjectHwHandle = 0
        CanMaxDataLen = 64
        CanFdPaddingValue = 0
        CanObjectMultiplexedTransmission = true
        CanObjectHwFifo = false
        CanControllerRef = CT_B30_for_SC_CAN_V3_2_4a04dc9c
        CanMainFunctionRWPeriodRef = CanMainFunctionRWPeriods
      CN_B30_for_SC_CAN_V3_2_efc035d8_Rx (CanHardwareObject):
        CanHandleType = BASIC
        CanIdType = STANDARD
        CanIdValue = 0
        CanObjectType = RECEIVE
        CanObjectId = 19
        CanHwProcessing = true
        CanObjectHwSize = 128
        CanObjectHwHandle = 2
        CanMaxDataLen = 64
        CanFdPaddingValue = 0
        CanObjectMultiplexedTransmission = false
        CanObjectHwFifo = false
        CanControllerRef = CT_B30_for_SC_CAN_V3_2_4a04dc9c
        CanMainFunctionRWPeriodRef = CanMainFunctionRWPeriods
        CanFilterMaskRef = CanFilterMaskRx_0x1c0
        CanFilterMaskRef = CanFilterMaskRx_0x1D9
        CanFilterMaskRef = CanFilterMaskRx_0x1df
        CanFilterMaskRef = CanFilterMaskRx_0x1e{1..3}
        CanFilterMaskRef = CanFilterMaskRx_0x1F1
        CanFilterMaskRef = CanFilterMaskRx_0x1F2
        CanFilterMaskRef = CanFilterMaskRx_0x1FA
        CanFilterMaskRef = CanFilterMaskRx_0x1fe
        CanFilterMaskRef = CanFilterMaskRx_0x2A3
        CanFilterMaskRef = CanFilterMaskRx_0x2a8
        CanFilterMaskRef = CanFilterMaskRx_0x2ab
        CanFilterMaskRef = CanFilterMaskRx_0x2b4
        CanFilterMaskRef = CanFilterMaskRx_0x2b8
        CanFilterMaskRef = CanFilterMaskRx_0x2b9
        CanFilterMaskRef = CanFilterMaskRx_0x2ba
        CanFilterMaskRef = CanFilterMaskRx_0x2bb
        CanFilterMaskRef = CanFilterMaskRx_0x2c1
        CanFilterMaskRef = CanFilterMaskRx_0x2c4
        CanFilterMaskRef = CanFilterMaskRx_0x2ca
        CanFilterMaskRef = CanFilterMaskRx_0x2cc
        CanFilterMaskRef = CanFilterMaskRx_0x2cd
        CanFilterMaskRef = CanFilterMaskRx_0x2ce
        CanFilterMaskRef = CanFilterMaskRx_0x2cf
        CanFilterMaskRef = CanFilterMaskRx_0x2d0
        CanFilterMaskRef = CanFilterMaskRx_0x2D1
        CanFilterMaskRef = CanFilterMaskRx_0x2d{2..4}
        CanFilterMaskRef = CanFilterMaskRx_0x2f0
        CanFilterMaskRef = CanFilterMaskRx_0x2f7
        CanFilterMaskRef = CanFilterMaskRx_0x2f8
        CanFilterMaskRef = CanFilterMaskRx_0x2fa
        CanFilterMaskRef = CanFilterMaskRx_0x2fd
        CanFilterMaskRef = CanFilterMaskRx_0x3ae
        CanFilterMaskRef = CanFilterMaskRx_0x3b5
        CanFilterMaskRef = CanFilterMaskRx_0x3b7
        CanFilterMaskRef = CanFilterMaskRx_0x3bf
        CanFilterMaskRef = CanFilterMaskRx_0x3c2
        CanFilterMaskRef = CanFilterMaskRx_0x3e1
        CanFilterMaskRef = CanFilterMaskRx_0x3e3
        CanFilterMaskRef = CanFilterMaskRx_0x3e5
        CanFilterMaskRef = CanFilterMaskRx_0x3e9
        CanFilterMaskRef = CanFilterMaskRx_0x3f1
        CanFilterMaskRef = CanFilterMaskRx_0x8e
        CanFilterMaskRef = CanFilterMaskRx_0x9E
        CanFilterMaskRef = CanFilterMaskRx_0x11a
        CanFilterMaskRef = CanFilterMaskRx_0x12d
        CanFilterMaskRef = CanFilterMaskRx_0x14a
        CanFilterMaskRef = CanFilterMaskRx_0x14f
        CanFilterMaskRef = CanFilterMaskRx_0x15b
        CanFilterMaskRef = CanFilterMaskRx_0x15e
        CanFilterMaskRef = CanFilterMaskRx_0x16B
        CanFilterMaskRef = CanFilterMaskRx_0x16f
        CanFilterMaskRef = CanFilterMaskRx_0x18b
        CanFilterMaskRef = CanFilterMaskRx_0x19b
        CanFilterMaskRef = CanFilterMaskRx_0x19c
        CanFilterMaskRef = CanFilterMaskRx_0x19f
        CanFilterMaskRef = CanFilterMaskRx_0x23d
        CanFilterMaskRef = CanFilterMaskRx_0x25C
        CanFilterMaskRef = CanFilterMaskRx_0x27c
        CanFilterMaskRef = CanFilterMaskRx_0x28D
        CanFilterMaskRef = CanFilterMaskRx_0x29B
        CanFilterMaskRef = CanFilterMaskRx_0x29d
        CanFilterMaskRef = CanFilterMaskRx_0x29f
        CanFilterMaskRef = CanFilterMaskRx_0x30a
        CanFilterMaskRef = CanFilterMaskRx_0x30d
        CanFilterMaskRef = CanFilterMaskRx_0x33
        CanFilterMaskRef = CanFilterMaskRx_0x34d
        CanFilterMaskRef = CanFilterMaskRx_0x35e
        CanFilterMaskRef = CanFilterMaskRx_0x50a
        CanFilterMaskRef = CanFilterMaskRx_0x60
        CanFilterMaskRef = CanFilterMaskRx_0x82
        CanFilterMaskRef = CanFilterMaskRx_0x84
        CanFilterMaskRef = CanFilterMaskRx_0x102
        CanFilterMaskRef = CanFilterMaskRx_0x109
        CanFilterMaskRef = CanFilterMaskRx_0x111
        CanFilterMaskRef = CanFilterMaskRx_0x117
        CanFilterMaskRef = CanFilterMaskRx_0x120
        CanFilterMaskRef = CanFilterMaskRx_0x137
        CanFilterMaskRef = CanFilterMaskRx_0x147
        CanFilterMaskRef = CanFilterMaskRx_0x152
        CanFilterMaskRef = CanFilterMaskRx_0x165
        CanFilterMaskRef = CanFilterMaskRx_0x170
        CanFilterMaskRef = CanFilterMaskRx_0x201
        CanFilterMaskRef = CanFilterMaskRx_0x221
        CanFilterMaskRef = CanFilterMaskRx_0x222
        CanFilterMaskRef = CanFilterMaskRx_0x227
        CanFilterMaskRef = CanFilterMaskRx_0x231
        CanFilterMaskRef = CanFilterMaskRx_0x236
        CanFilterMaskRef = CanFilterMaskRx_0x238
        CanFilterMaskRef = CanFilterMaskRx_0x{244..246}
        CanFilterMaskRef = CanFilterMaskRx_0x248
        CanFilterMaskRef = CanFilterMaskRx_0x251
        CanFilterMaskRef = CanFilterMaskRx_0x268
        CanFilterMaskRef = CanFilterMaskRx_0x271
        CanFilterMaskRef = CanFilterMaskRx_0x273
        CanFilterMaskRef = CanFilterMaskRx_0x274
        CanFilterMaskRef = CanFilterMaskRx_0x285
        CanFilterMaskRef = CanFilterMaskRx_0x287
        CanFilterMaskRef = CanFilterMaskRx_0x289
        CanFilterMaskRef = CanFilterMaskRx_0x290
        CanFilterMaskRef = CanFilterMaskRx_0x295
        CanFilterMaskRef = CanFilterMaskRx_0x298
        CanFilterMaskRef = CanFilterMaskRx_0x299
        CanFilterMaskRef = CanFilterMaskRx_0x{302..305}
        CanFilterMaskRef = CanFilterMaskRx_0x308
        CanFilterMaskRef = CanFilterMaskRx_0x311
        CanFilterMaskRef = CanFilterMaskRx_0x314
        CanFilterMaskRef = CanFilterMaskRx_0x316
        CanFilterMaskRef = CanFilterMaskRx_0x317
        CanFilterMaskRef = CanFilterMaskRx_0x319
        CanFilterMaskRef = CanFilterMaskRx_0x325
        CanFilterMaskRef = CanFilterMaskRx_0x330
        CanFilterMaskRef = CanFilterMaskRx_0x332
        CanFilterMaskRef = CanFilterMaskRx_0x333
        CanFilterMaskRef = CanFilterMaskRx_0x341
        CanFilterMaskRef = CanFilterMaskRx_0x344
        CanFilterMaskRef = CanFilterMaskRx_0x345
        CanFilterMaskRef = CanFilterMaskRx_0x{350..352}
        CanFilterMaskRef = CanFilterMaskRx_0x371
        CanFilterMaskRef = CanFilterMaskRx_0x385
        CanFilterMaskRef = CanFilterMaskRx_0x395
        CanFilterMaskRef = CanFilterMaskRx_0x461
        CanFilterMaskRef = CanFilterMaskRx_0x501
        CanFilterMaskRef = CanFilterMaskRx_0x536
        CanFilterMaskRef = CanFilterMaskRx_0x760
        CanFilterMaskRef = CanFilterMaskRx_0x773
        CanFilterMaskRef = CanFilterMaskRx_0xa1
        CanFilterMaskRef = CanFilterMaskRx_0xa6
        CanFilterMaskRef = CanFilterMaskRx_0xac
        CanFilterMaskRef = CanFilterMaskRx_0xbe
        CanFilterMaskRef = CanFilterMaskRx_0xc8
        CanFilterMaskRef = CanFilterMaskRx_0xf1
        CanFilterMaskRef = CanFilterMaskRx_0xf9
        CanFilterMaskRef = CanFilterMaskRx_0x056
        CanFilterMaskRef = CanFilterMaskRx_0x30F
        CanFilterMaskRef = CanFilterMaskRx_0x2FB
        CanFilterMaskRef = CanFilterMaskRx_0x517
      3 x CanController, all with CanControllerActivation=true, CanBusoffProcessing=INTERRUPT, CanRxProcessing=POLLING, CanTxProcessing=POLLING, CanWakeupProcessing=INTERRUPT, CanRxFullCanAllocation=16, CanRxBasicCanAllocation=1, CanRxFifoProcessCount=255, CanControllerDefaultBaudrate=CT_B30_for_SC_CAN_V3_2_4a04dc9c/CanControllerBaudrateConfig, CanControllerSystemRef=CT_B30_for_SC_CAN_V3_2, CanCpuClockRef=McuClockReferencePoint_CAN:
        CT_B30_for_SC_CAN_V3_2_4a04dc9c: CanControllerBaseAddress=4291821616, CanControllerId=0, CanWakeupSupport=true, CanWakeupSourceId=32, CanPhysController=CAN3, CanWakeupSourceRef=CN_B30_for_SC_CAN_V3_2_c0d6c67b
          CanFilterMaskRx_0x305 (CanFilterMask): CanFilterMaskValue=2047, CanFilterCodeValue=773, IsLocked=false
          CanControllerBaudrateConfig:
            CanControllerBaudRate = 500
            CanControllerBaudRateConfigID = 0
            CanControllerPropSeg = 15
            CanControllerSeg1 = 48
            CanControllerSeg2 = 16
            CanControllerSyncJumpWidth = 5
            CanBaudrateClock = 40000
            CanBaudratePrescaler = 1
            CanControllerFdBaudrateConfig:
              CanControllerFdBaudRate = 2000
              CanControllerPropSeg = 4
              CanControllerSeg1 = 10
              CanControllerSeg2 = 5
              CanControllerSyncJumpWidth = 5
              CanControllerTxBitRateSwitch = true
              CanBaudratePrescaler = 1
              CanControllerSspOffset = 15
          146 x CanFilterMask, all with IsLocked=false:
            CanFilterMaskRx_0x14f: CanFilterMaskValue=2047, CanFilterCodeValue=335
            CanFilterMaskRx_0x33: CanFilterMaskValue=2047, CanFilterCodeValue=51
            CanFilterMaskRx_0x82: CanFilterMaskValue=2047, CanFilterCodeValue=130
            CanFilterMaskRx_0x84: CanFilterMaskValue=2047, CanFilterCodeValue=132
            CanFilterMaskRx_0x9E: CanFilterMaskValue=2047, CanFilterCodeValue=158
            CanFilterMaskRx_0xa1: CanFilterMaskValue=2047, CanFilterCodeValue=161
            CanFilterMaskRx_0xa6: CanFilterMaskValue=2047, CanFilterCodeValue=166
            CanFilterMaskRx_0xc8: CanFilterMaskValue=2047, CanFilterCodeValue=200
            CanFilterMaskRx_0xf1: CanFilterMaskValue=2047, CanFilterCodeValue=241
            CanFilterMaskRx_0x102: CanFilterMaskValue=2047, CanFilterCodeValue=258
            CanFilterMaskRx_0x111: CanFilterMaskValue=2047, CanFilterCodeValue=273
            CanFilterMaskRx_0x120: CanFilterMaskValue=2047, CanFilterCodeValue=288
            CanFilterMaskRx_0x137: CanFilterMaskValue=2047, CanFilterCodeValue=311
            CanFilterMaskRx_0x147: CanFilterMaskValue=2047, CanFilterCodeValue=327
            CanFilterMaskRx_0x15b: CanFilterMaskValue=2047, CanFilterCodeValue=347
            CanFilterMaskRx_0x165: CanFilterMaskValue=2047, CanFilterCodeValue=357
            CanFilterMaskRx_0x16B: CanFilterMaskValue=2047, CanFilterCodeValue=363
            CanFilterMaskRx_0x16f: CanFilterMaskValue=2047, CanFilterCodeValue=367
            CanFilterMaskRx_0x170: CanFilterMaskValue=2047, CanFilterCodeValue=368
            CanFilterMaskRx_0x18b: CanFilterMaskValue=2047, CanFilterCodeValue=395
            CanFilterMaskRx_0x19b: CanFilterMaskValue=2047, CanFilterCodeValue=411
            CanFilterMaskRx_0x19c: CanFilterMaskValue=2047, CanFilterCodeValue=412
            CanFilterMaskRx_0x1e1: CanFilterMaskValue=2047, CanFilterCodeValue=481
            CanFilterMaskRx_0x221: CanFilterMaskValue=2047, CanFilterCodeValue=545
            CanFilterMaskRx_0x227: CanFilterMaskValue=2047, CanFilterCodeValue=551
            CanFilterMaskRx_0x231: CanFilterMaskValue=2047, CanFilterCodeValue=561
            CanFilterMaskRx_0x236: CanFilterMaskValue=2047, CanFilterCodeValue=566
            CanFilterMaskRx_0x238: CanFilterMaskValue=2047, CanFilterCodeValue=568
            CanFilterMaskRx_0x23d: CanFilterMaskValue=2047, CanFilterCodeValue=573
            CanFilterMaskRx_0x244: CanFilterMaskValue=2047, CanFilterCodeValue=580
            CanFilterMaskRx_0x245: CanFilterMaskValue=2047, CanFilterCodeValue=581
            CanFilterMaskRx_0x246: CanFilterMaskValue=2047, CanFilterCodeValue=582
            CanFilterMaskRx_0x248: CanFilterMaskValue=2047, CanFilterCodeValue=584
            CanFilterMaskRx_0x251: CanFilterMaskValue=2047, CanFilterCodeValue=593
            CanFilterMaskRx_0x271: CanFilterMaskValue=2047, CanFilterCodeValue=625
            CanFilterMaskRx_0x274: CanFilterMaskValue=2047, CanFilterCodeValue=628
            CanFilterMaskRx_0x295: CanFilterMaskValue=2047, CanFilterCodeValue=661
            CanFilterMaskRx_0x298: CanFilterMaskValue=2047, CanFilterCodeValue=664
            CanFilterMaskRx_0x29d: CanFilterMaskValue=2047, CanFilterCodeValue=669
            CanFilterMaskRx_0x29f: CanFilterMaskValue=2047, CanFilterCodeValue=671
            CanFilterMaskRx_0x2a8: CanFilterMaskValue=2047, CanFilterCodeValue=680
            CanFilterMaskRx_0x2ab: CanFilterMaskValue=2047, CanFilterCodeValue=683
            CanFilterMaskRx_0x2b8: CanFilterMaskValue=2047, CanFilterCodeValue=696
            CanFilterMaskRx_0x2ba: CanFilterMaskValue=2047, CanFilterCodeValue=698
            CanFilterMaskRx_0x2bb: CanFilterMaskValue=2047, CanFilterCodeValue=699
            CanFilterMaskRx_0x2c1: CanFilterMaskValue=2047, CanFilterCodeValue=705
            CanFilterMaskRx_0x2cc: CanFilterMaskValue=2047, CanFilterCodeValue=716
            CanFilterMaskRx_0x2ca: CanFilterMaskValue=2047, CanFilterCodeValue=714
            CanFilterMaskRx_0x2cd: CanFilterMaskValue=2047, CanFilterCodeValue=717
            CanFilterMaskRx_0x2cf: CanFilterMaskValue=2047, CanFilterCodeValue=719
            CanFilterMaskRx_0x2d2: CanFilterMaskValue=2047, CanFilterCodeValue=722
            CanFilterMaskRx_0x2d3: CanFilterMaskValue=2047, CanFilterCodeValue=723
            CanFilterMaskRx_0x2f7: CanFilterMaskValue=2047, CanFilterCodeValue=759
            CanFilterMaskRx_0x2fa: CanFilterMaskValue=2047, CanFilterCodeValue=762
            CanFilterMaskRx_0x303: CanFilterMaskValue=2047, CanFilterCodeValue=771
            CanFilterMaskRx_0x302: CanFilterMaskValue=2047, CanFilterCodeValue=770
            CanFilterMaskRx_0x319: CanFilterMaskValue=2047, CanFilterCodeValue=793
            CanFilterMaskRx_0x325: CanFilterMaskValue=2047, CanFilterCodeValue=805
            CanFilterMaskRx_0x341: CanFilterMaskValue=2047, CanFilterCodeValue=833
            CanFilterMaskRx_0x345: CanFilterMaskValue=2047, CanFilterCodeValue=837
            CanFilterMaskRx_0x351: CanFilterMaskValue=2047, CanFilterCodeValue=849
            CanFilterMaskRx_0x371: CanFilterMaskValue=2047, CanFilterCodeValue=881
            CanFilterMaskRx_0x385: CanFilterMaskValue=2047, CanFilterCodeValue=901
            CanFilterMaskRx_0x395: CanFilterMaskValue=2047, CanFilterCodeValue=917
            CanFilterMaskRx_0x3b5: CanFilterMaskValue=2047, CanFilterCodeValue=949
            CanFilterMaskRx_0x3b7: CanFilterMaskValue=2047, CanFilterCodeValue=951
            CanFilterMaskRx_0x3c2: CanFilterMaskValue=2047, CanFilterCodeValue=962
            CanFilterMaskRx_0x3e1: CanFilterMaskValue=2047, CanFilterCodeValue=993
            CanFilterMaskRx_0x3e3: CanFilterMaskValue=2047, CanFilterCodeValue=995
            CanFilterMaskRx_0x3e5: CanFilterMaskValue=2047, CanFilterCodeValue=997
            CanFilterMaskRx_0x3e9: CanFilterMaskValue=2047, CanFilterCodeValue=1001
            CanFilterMaskRx_0x50a: CanFilterMaskValue=2047, CanFilterCodeValue=1290
            CanFilterMaskRx_0x501: CanFilterMaskValue=1920, CanFilterCodeValue=1281
            CanFilterMaskRx_0x760: CanFilterMaskValue=2047, CanFilterCodeValue=1888
            CanFilterMaskRx_0x773: CanFilterMaskValue=2047, CanFilterCodeValue=1907
            CanFilterMaskRx_0x109: CanFilterMaskValue=2047, CanFilterCodeValue=265
            CanFilterMaskRx_0x15e: CanFilterMaskValue=2047, CanFilterCodeValue=350
            CanFilterMaskRx_0x19f: CanFilterMaskValue=2047, CanFilterCodeValue=415
            CanFilterMaskRx_0x222: CanFilterMaskValue=2047, CanFilterCodeValue=546
            CanFilterMaskRx_0x2b4: CanFilterMaskValue=2047, CanFilterCodeValue=692
            CanFilterMaskRx_0x30a: CanFilterMaskValue=2047, CanFilterCodeValue=778
            CanFilterMaskRx_0x289: CanFilterMaskValue=2047, CanFilterCodeValue=649
            CanFilterMaskRx_0x461: CanFilterMaskValue=2047, CanFilterCodeValue=1121
            CanFilterMaskRx_0x152: CanFilterMaskValue=2047, CanFilterCodeValue=338
            CanFilterMaskRx_0x273: CanFilterMaskValue=2047, CanFilterCodeValue=627
            CanFilterMaskRx_0x27c: CanFilterMaskValue=2047, CanFilterCodeValue=636
            CanFilterMaskRx_0x2A3: CanFilterMaskValue=2047, CanFilterCodeValue=675
            CanFilterMaskRx_0x2d0: CanFilterMaskValue=2047, CanFilterCodeValue=720
            CanFilterMaskRx_0x2d4: CanFilterMaskValue=2047, CanFilterCodeValue=724
            CanFilterMaskRx_0x2f8: CanFilterMaskValue=2047, CanFilterCodeValue=760
            CanFilterMaskRx_0x2fd: CanFilterMaskValue=2047, CanFilterCodeValue=765
            CanFilterMaskRx_0x35e: CanFilterMaskValue=2047, CanFilterCodeValue=862
            CanFilterMaskRx_0x1df: CanFilterMaskValue=2047, CanFilterCodeValue=479
            CanFilterMaskRx_0x2b9: CanFilterMaskValue=2047, CanFilterCodeValue=697
            CanFilterMaskRx_0x536: CanFilterMaskValue=2047, CanFilterCodeValue=1334
            CanFilterMaskRx_0x2f0: CanFilterMaskValue=2047, CanFilterCodeValue=752
            CanFilterMaskRx_0x2ce: CanFilterMaskValue=2047, CanFilterCodeValue=718
            CanFilterMaskRx_0x311: CanFilterMaskValue=2047, CanFilterCodeValue=785
            CanFilterMaskRx_0x60: CanFilterMaskValue=2047, CanFilterCodeValue=96
            CanFilterMaskRx_0x8e: CanFilterMaskValue=2047, CanFilterCodeValue=142
            CanFilterMaskRx_0xac: CanFilterMaskValue=2047, CanFilterCodeValue=172
            CanFilterMaskRx_0xbe: CanFilterMaskValue=2047, CanFilterCodeValue=190
            CanFilterMaskRx_0xf9: CanFilterMaskValue=2047, CanFilterCodeValue=249
            CanFilterMaskRx_0x117: CanFilterMaskValue=2047, CanFilterCodeValue=279
            CanFilterMaskRx_0x12d: CanFilterMaskValue=2047, CanFilterCodeValue=301
            CanFilterMaskRx_0x14a: CanFilterMaskValue=2047, CanFilterCodeValue=330
            CanFilterMaskRx_0x1c0: CanFilterMaskValue=2047, CanFilterCodeValue=448
            CanFilterMaskRx_0x1e2: CanFilterMaskValue=2047, CanFilterCodeValue=482
            CanFilterMaskRx_0x1e3: CanFilterMaskValue=2047, CanFilterCodeValue=483
            CanFilterMaskRx_0x1fe: CanFilterMaskValue=2047, CanFilterCodeValue=510
            CanFilterMaskRx_0x268: CanFilterMaskValue=2047, CanFilterCodeValue=616
            CanFilterMaskRx_0x285: CanFilterMaskValue=2047, CanFilterCodeValue=645
            CanFilterMaskRx_0x290: CanFilterMaskValue=2047, CanFilterCodeValue=656
            CanFilterMaskRx_0x314: CanFilterMaskValue=2047, CanFilterCodeValue=788
            CanFilterMaskRx_0x352: CanFilterMaskValue=2047, CanFilterCodeValue=850
            CanFilterMaskRx_0x3ae: CanFilterMaskValue=2047, CanFilterCodeValue=942
            CanFilterMaskRx_0x3bf: CanFilterMaskValue=2047, CanFilterCodeValue=959
            CanFilterMaskRx_0x3f1: CanFilterMaskValue=2047, CanFilterCodeValue=1009
            CanFilterMaskRx_0x11a: CanFilterMaskValue=2047, CanFilterCodeValue=282
            CanFilterMaskRx_0x34d: CanFilterMaskValue=2047, CanFilterCodeValue=845
            CanFilterMaskRx_0x350: CanFilterMaskValue=2047, CanFilterCodeValue=848
            CanFilterMaskRx_0x1D9: CanFilterMaskValue=2047, CanFilterCodeValue=473
            CanFilterMaskRx_0x1FA: CanFilterMaskValue=2047, CanFilterCodeValue=506
            CanFilterMaskRx_0x25C: CanFilterMaskValue=2047, CanFilterCodeValue=604
            CanFilterMaskRx_0x28D: CanFilterMaskValue=2047, CanFilterCodeValue=653
            CanFilterMaskRx_0x299: CanFilterMaskValue=2047, CanFilterCodeValue=665
            CanFilterMaskRx_0x29B: CanFilterMaskValue=2047, CanFilterCodeValue=667
            CanFilterMaskRx_0x2D1: CanFilterMaskValue=2047, CanFilterCodeValue=721
            CanFilterMaskRx_0x201: CanFilterMaskValue=2047, CanFilterCodeValue=513
            CanFilterMaskRx_0x30d: CanFilterMaskValue=2047, CanFilterCodeValue=781
            CanFilterMaskRx_0x1F1: CanFilterMaskValue=2047, CanFilterCodeValue=497
            CanFilterMaskRx_0x1F2: CanFilterMaskValue=2047, CanFilterCodeValue=498
            CanFilterMaskRx_0x287: CanFilterMaskValue=2047, CanFilterCodeValue=647
            CanFilterMaskRx_0x2c4: CanFilterMaskValue=2047, CanFilterCodeValue=708
            CanFilterMaskRx_0x304: CanFilterMaskValue=2047, CanFilterCodeValue=772
            CanFilterMaskRx_0x308: CanFilterMaskValue=2047, CanFilterCodeValue=776
            CanFilterMaskRx_0x316: CanFilterMaskValue=2047, CanFilterCodeValue=790
            CanFilterMaskRx_0x317: CanFilterMaskValue=2047, CanFilterCodeValue=791
            CanFilterMaskRx_0x330: CanFilterMaskValue=2047, CanFilterCodeValue=816
            CanFilterMaskRx_0x332: CanFilterMaskValue=2047, CanFilterCodeValue=818
            CanFilterMaskRx_0x333: CanFilterMaskValue=2047, CanFilterCodeValue=819
            CanFilterMaskRx_0x344: CanFilterMaskValue=2047, CanFilterCodeValue=836
            CanFilterMaskRx_0x056: CanFilterMaskValue=2047, CanFilterCodeValue=86
            CanFilterMaskRx_0x30F: CanFilterMaskValue=2047, CanFilterCodeValue=783
            CanFilterMaskRx_0x2FB: CanFilterMaskValue=2047, CanFilterCodeValue=763
            CanFilterMaskRx_0x517: CanFilterMaskValue=2047, CanFilterCodeValue=1303
        CT_B30_for_SC_CAN_V3_2_4a04dc9c_001: CanControllerBaseAddress=4291821568, CanControllerId=1, CanWakeupSourceId=0, CanPhysController=CAN0, CanWakeupSupport=false
          CanControllerBaudrateConfig:
            CanControllerBaudRate = 500
            CanControllerBaudRateConfigID = 0
            CanControllerPropSeg = 62
            CanControllerSeg1 = 1
            CanControllerSeg2 = 16
            CanControllerSyncJumpWidth = 1
            CanBaudrateClock = 40000
            CanBaudratePrescaler = 1
            CanControllerFdBaudrateConfig:
              CanControllerFdBaudRate = 2000
              CanControllerPropSeg = 13
              CanControllerSeg1 = 1
              CanControllerSeg2 = 5
              CanControllerSyncJumpWidth = 1
              CanControllerTxBitRateSwitch = true
              CanBaudratePrescaler = 1
              CanControllerSspOffset = 1
          CanFilterMask: CanFilterMaskValue=0, CanFilterCodeValue=0, IsLocked=false
        CT_B30_for_SC_CAN_V3_2_4a04dc9c_002: CanControllerBaseAddress=4291821584, CanControllerId=2, CanWakeupSupport=false, CanWakeupSourceId=0, CanPhysController=CAN1
          CanControllerBaudrateConfig:
            CanControllerBaudRate = 500
            CanControllerBaudRateConfigID = 0
            CanControllerPropSeg = 62
            CanControllerSeg1 = 1
            CanControllerSeg2 = 16
            CanControllerSyncJumpWidth = 1
            CanBaudrateClock = 40000
            CanBaudratePrescaler = 1
            CanControllerFdBaudrateConfig:
              CanControllerFdBaudRate = 2000
              CanControllerPropSeg = 13
              CanControllerSeg1 = 1
              CanControllerSeg2 = 5
              CanControllerSyncJumpWidth = 1
              CanControllerTxBitRateSwitch = true
              CanBaudratePrescaler = 1
              CanControllerSspOffset = 1
          CanFilterMask: CanFilterMaskValue=0, CanFilterCodeValue=0, IsLocked=false
      22 x CanHardwareObject, all with CanIdType=STANDARD, CanHwProcessing=true, CanFdPaddingValue=0, CanObjectMultiplexedTransmission=false, CanObjectHwFifo=false:
        CN_B30_for_SC_CAN_V3_2_c0d6c67b_Tx_001: CanHandleType=BASIC, CanIdValue=0, CanObjectType=TRANSMIT, CanObjectId=20, CanObjectHwSize=1, CanObjectHwHandle=0, CanMaxDataLen=64, CanControllerRef=CT_B30_for_SC_CAN_V3_2_4a04dc9c_001, CanMainFunctionRWPeriodRef=CanMainFunctionRWPeriods
        CN_B30_for_SC_CAN_V3_2_c0d6c67b_Tx_002: CanHandleType=BASIC, CanIdValue=0, CanObjectType=TRANSMIT, CanObjectId=22, CanObjectHwSize=1, CanObjectHwHandle=0, CanMaxDataLen=64, CanControllerRef=CT_B30_for_SC_CAN_V3_2_4a04dc9c_002, CanMainFunctionRWPeriodRef=CanMainFunctionRWPeriods
        CN_B30_for_SC_CAN_V3_2_efc035d8_Rx_001: CanHandleType=BASIC, CanIdValue=0, CanObjectType=RECEIVE, CanObjectId=21, CanObjectHwSize=128, CanObjectHwHandle=0, CanMaxDataLen=8, CanControllerRef=CT_B30_for_SC_CAN_V3_2_4a04dc9c_001, CanMainFunctionRWPeriodRef=CanMainFunctionRWPeriods, CanFilterMaskRef=CT_B30_for_SC_CAN_V3_2_4a04dc9c_001/CanFilterMask
        CN_B30_for_SC_CAN_V3_2_efc035d8_Rx_002: CanHandleType=BASIC, CanIdValue=0, CanObjectType=RECEIVE, CanObjectId=23, CanObjectHwSize=128, CanObjectHwHandle=1, CanMaxDataLen=8, CanControllerRef=CT_B30_for_SC_CAN_V3_2_4a04dc9c_002, CanMainFunctionRWPeriodRef=CanMainFunctionRWPeriods, CanFilterMaskRef=CT_B30_for_SC_CAN_V3_2_4a04dc9c_002/CanFilterMask
        CanHardwareObject_IP3_oB30_for_SC_CAN_V3_2_8dd4dc90_Tx: CanHandleType=FULL, CanIdValue=842, CanObjectId=14, CanObjectType=TRANSMIT, CanObjectHwSize=1, CanObjectHwHandle=17, CanMaxDataLen=64, CanCommonCANNode=A, CanControllerRef=CT_B30_for_SC_CAN_V3_2_4a04dc9c
        CanHardwareObject_IP2_Sc_oB30_for_SC_CAN_V3_2_fb13b195_Tx: CanHandleType=FULL, CanIdValue=639, CanObjectId=5, CanObjectType=TRANSMIT, CanObjectHwSize=1, CanObjectHwHandle=8, CanMaxDataLen=64, CanCommonCANNode=A, CanControllerRef=CT_B30_for_SC_CAN_V3_2_4a04dc9c
        CanHardwareObject_IP1_oB30_for_SC_CAN_V3_2_c2bc6804_Tx: CanHandleType=FULL, CanIdValue=659, CanObjectId=6, CanObjectType=TRANSMIT, CanObjectHwSize=1, CanObjectHwHandle=9, CanMaxDataLen=64, CanCommonCANNode=A, CanControllerRef=CT_B30_for_SC_CAN_V3_2_4a04dc9c
        CanHardwareObject_HUT_FD1_Sc_oB30_for_SC_CAN_V3_2_ad4f6083_Tx: CanHandleType=FULL, CanIdValue=707, CanObjectId=9, CanObjectType=TRANSMIT, CanObjectHwSize=1, CanObjectHwHandle=12, CanMaxDataLen=64, CanCommonCANNode=A, CanControllerRef=CT_B30_for_SC_CAN_V3_2_4a04dc9c
        CanHardwareObject_HUT_FD2_oB30_for_SC_CAN_V3_2_19e0e547_Tx: CanHandleType=FULL, CanIdValue=515, CanObjectId=0, CanObjectType=TRANSMIT, CanObjectHwSize=1, CanObjectHwHandle=3, CanMaxDataLen=64, CanCommonCANNode=A, CanControllerRef=CT_B30_for_SC_CAN_V3_2_4a04dc9c
        CanHardwareObject_HUT_FD3_oB30_for_SC_CAN_V3_2_e3a63189_Tx: CanHandleType=FULL, CanIdValue=579, CanObjectId=2, CanObjectType=TRANSMIT, CanObjectHwSize=1, CanObjectHwHandle=5, CanMaxDataLen=64, CanCommonCANNode=A, CanControllerRef=CT_B30_for_SC_CAN_V3_2_4a04dc9c
        CanHardwareObject_HUT40_oB30_for_SC_CAN_V3_2_f7205ed1_Tx: CanHandleType=FULL, CanIdValue=548, CanObjectId=1, CanObjectType=TRANSMIT, CanObjectHwSize=1, CanObjectHwHandle=4, CanMaxDataLen=64, CanCommonCANNode=A, CanControllerRef=CT_B30_for_SC_CAN_V3_2_4a04dc9c
        CanHardwareObject_HUT34_oB30_for_SC_CAN_V3_2_f7db0848_Tx: CanHandleType=FULL, CanIdValue=880, CanObjectId=15, CanObjectType=TRANSMIT, CanObjectHwSize=1, CanObjectHwHandle=18, CanMaxDataLen=64, CanCommonCANNode=A, CanControllerRef=CT_B30_for_SC_CAN_V3_2_4a04dc9c
        CanHardwareObject_HUT32_oB30_for_SC_CAN_V3_2_aa274fab_Tx: CanHandleType=FULL, CanIdValue=623, CanObjectId=4, CanObjectType=TRANSMIT, CanObjectHwSize=1, CanObjectHwHandle=7, CanMaxDataLen=64, CanCommonCANNode=A, CanControllerRef=CT_B30_for_SC_CAN_V3_2_4a04dc9c
        CanHardwareObject_HUT31_oB30_for_SC_CAN_V3_2_6961ef7a_Tx: CanHandleType=FULL, CanIdValue=780, CanObjectId=11, CanObjectType=TRANSMIT, CanObjectHwSize=1, CanObjectHwHandle=14, CanMaxDataLen=64, CanCommonCANNode=A, CanControllerRef=CT_B30_for_SC_CAN_V3_2_4a04dc9c
        CanHardwareObject_HUT26_oB30_for_SC_CAN_V3_2_938256b7_Tx: CanHandleType=FULL, CanIdValue=694, CanObjectId=8, CanObjectType=TRANSMIT, CanObjectHwSize=1, CanObjectHwHandle=11, CanMaxDataLen=64, CanCommonCANNode=A, CanControllerRef=CT_B30_for_SC_CAN_V3_2_4a04dc9c
        CanHardwareObject_HUT19_oB30_for_SC_CAN_V3_2_1a2bdd42_Tx: CanHandleType=FULL, CanIdValue=1045, CanObjectId=17, CanObjectType=TRANSMIT, CanObjectHwSize=1, CanObjectHwHandle=20, CanMaxDataLen=64, CanCommonCANNode=A, CanControllerRef=CT_B30_for_SC_CAN_V3_2_4a04dc9c
        CanHardwareObject_HUT16_oB30_for_SC_CAN_V3_2_6295f255_Tx: CanHandleType=FULL, CanIdValue=840, CanObjectId=13, CanObjectType=TRANSMIT, CanObjectHwSize=1, CanObjectHwHandle=16, CanMaxDataLen=64, CanCommonCANNode=A, CanControllerRef=CT_B30_for_SC_CAN_V3_2_4a04dc9c
        CanHardwareObject_HUT13_oB30_for_SC_CAN_V3_2_fc2f1567_Tx: CanHandleType=FULL, CanIdValue=796, CanObjectId=12, CanObjectType=TRANSMIT, CanObjectHwSize=1, CanObjectHwHandle=15, CanMaxDataLen=64, CanCommonCANNode=A, CanControllerRef=CT_B30_for_SC_CAN_V3_2_4a04dc9c
        CanHardwareObject_HUT12_oB30_for_SC_CAN_V3_2_0bc27717_Tx: CanHandleType=FULL, CanIdValue=943, CanObjectId=16, CanObjectType=TRANSMIT, CanObjectHwSize=1, CanObjectHwHandle=19, CanMaxDataLen=64, CanCommonCANNode=A, CanControllerRef=CT_B30_for_SC_CAN_V3_2_4a04dc9c
        CanHardwareObject_DMS_FD1_oB30_for_SC_CAN_V3_2_1702aefa_Tx: CanHandleType=FULL, CanIdValue=589, CanObjectId=3, CanObjectType=TRANSMIT, CanObjectHwSize=1, CanObjectHwHandle=6, CanMaxDataLen=64, CanCommonCANNode=A, CanControllerRef=CT_B30_for_SC_CAN_V3_2_4a04dc9c
        CanHardwareObject_DVR_FD1_oB30_for_SC_CAN_V3_2_2030c8ae_Tx: CanHandleType=FULL, CanIdValue=748, CanObjectId=10, CanObjectType=TRANSMIT, CanObjectHwSize=1, CanObjectHwHandle=13, CanMaxDataLen=64, CanCommonCANNode=A, CanControllerRef=CT_B30_for_SC_CAN_V3_2_4a04dc9c
        CanHardwareObject_HUT27_oB30_for_SC_CAN_V3_2_646f34c7_Tx: CanHandleType=FULL, CanIdValue=690, CanObjectId=7, CanObjectType=TRANSMIT, CanObjectHwSize=1, CanObjectHwHandle=10, CanMaxDataLen=64, CanCommonCANNode=A, CanControllerRef=CT_B30_for_SC_CAN_V3_2_4a04dc9c
    CanGeneral:
      CanIndex = 0
      CanChangeBaudrateApi = false
      CanDevErrorDetection = true
      CanHardwareCancellation = true
      CanIdenticalIdCancellation = false
      CanMainFunctionBusoffPeriod = 0.005
      CanMainFunctionModePeriod = 0.005
      CanMainFunctionWakeupPeriod = 0.005
      CanMultiplexedTransmission = true
      CanSetBaudrateApi = false
      CanTimeoutDuration = 0.01
      CanVersionInfoApi = false
      CanGenericPrecopy = false
      CanHardwareLoopCheck = true
      CanRxFullCANSupport = false
      CanTxFullCANSupport = true
      CanRxBasicCANSupport = true
      CanUseNestedCANInterrupts = false
      CanHardwareCancelByAppl = false
      CanIndividualProcessing = false
      CanGenericConfirmation = false
      CanGenericConfirmationAPI2 = false
      CanRxQueue = false
      CanSupportMixedID = false
      CanRxQueueSize = 10
      CanMultipleBasicCANObjects = false
      CanMultipleBasicCANTxObjects = false
      CanHardwareHandleType = UINT8
      CanOptimizeOneController = false
      CanInterruptCategory = CATEGORY2
      CanGetStatus = false
      CanInterruptLock = DRIVER
      CanWakeupSupport = true
      CanRamCheck = None
      CanOverrunNotification = DET
      CanReinitStart = false
      CanGenericPreTransmit = false
      CanFdSupport = FULL
      CanRuntimeMeasurementSupport = false
      CanMaxRxDataLen = 64
      CanMaxTxDataLen = 64
      CanUsePeripheralAccessApi = false
      CanMirrorModeSupport = false
      CanUseOsInterruptControl = true
      CanSafeBswChecks = false
      CanSilentModeSupport = false
      CanHwTxFifoSupport = false
      CanCheckWakeupCanRetType = false
      CanFdHardwareBufferOptimization = true
      CanNumberOfChannels = 8
      CanNumberOfRules = 1024
      CanRamSize = 28672
      CanNumberOfRxBuffers = 128
      CanNumberOfRxFifos = 8
      CanNumberOfTxFifos = 3
      CanNumberOfTxBuffers = 32
      CanBaseAddress = 4291821568
      CanExternalClockSource = false
      CanCanInterface = RSCAN_FD_V3
      CanCounterRef = SystemTimer
      CanMainFunctionRWPeriods: CanMainFunctionReadPeriod=0.005, CanMainFunctionWritePeriod=0.005
