AUTOSAR XML (schema 00046)
package /ActiveEcuC
  module config Spi: implementation-config-variant=VARIANT-POST-BUILD, module-description=Spi_Impl
    SpiDemEventParameterRefs0 (SpiDemEventParameterRefs)
    SpiDriver0 (SpiDriver): SpiMaxChannel=1, SpiMaxJob=1, SpiMaxSequence=1, SpiClockFrequencyRef=McuIsoCsi
      CSIH3 (SpiChannel): SpiChannelId=0, SpiChannelType=EB, SpiDataWidth=8, SpiEbMaxLength=256, SpiIbNBuffers=256, SpiTransferStart=MSB, SpiDefaultData=0
      SpiExternalDevice:
        SpiBaudrate = 5000000
        SpiCsIdentifier = NULL
        SpiCsPolarity = LOW
        SpiDataShiftEdge = LEADING
        SpiEnableCs = true
        SpiHwUnit = CSIH3
        SpiShiftClockIdleLevel = HIGH
        SpiTimeClk2Cs = 0
        SpiParitySelection = NO_PARITY
        SpiCsHoldTiming = HOLD_TIME_0_POINT_5
        SpiCsIdleEnforcement = false
        SpiCsIdleTiming = IDLE_TIME_1_POINT_5
        SpiCsInactiveAfterLastData = true
        SpiCsInterDataDelay = INTER_DATA_TIME_0_POINT_5
        SpiCsSelection = CS_VIA_PERIPHERAL_ENGINE
        SpiCsSetupTime = SETUP_TIME_0_POINT_5
        SpiBaudrateConfiguration = 1
        SpiEnableHandshake = false
        SpiInputClockSelect = PCLK_DIVBY_4
        SpiMasterMode = true
        SpiBaudrateConfigurationLowPower = 1
        SpiBaudrateRegisterSelect = CSIH_BAUDRATE_REGISTER_0
      SpiJob1 (SpiJob):
        SpiJobEndNotification = SpiJob0Notification
        SpiJobId = 0
        SpiJobPriority = 3
        SpiHwUnitSynchronous = ASYNCHRONOUS
        SpiPortPinSelect = CSS0
        SpiDeviceAssignment = SpiExternalDevice
        SpiChannelList: SpiChannelIndex=0, SpiChannelAssignment=CSIH3
      SpiSequence:
        SpiInterruptibleSequence = true
        SpiSeqEndNotification = SpiSequenceEndNotification
        SpiSequenceId = 0
        SpiSeqStartNotification = SpiWVErrorNotificationFunc
        SpiJobAssignment = SpiJob1
      SpiDma: SpiDmaHwUnit=CSIH3_TXID_41_RXID_42, SpiRxDmaChannel=DMA3, SpiTxDmaChannel=DMA4
      SpiMemoryMode: SpiHwUnitSelection=CSIH3, SpiMemoryModeSelection=FIFO_MODE
    SpiGeneral0 (SpiGeneral):
      SpiCancelApi = false
      SpiChannelBuffersAllowed = 2
      SpiDevErrorDetect = false
      SpiHwStatusApi = false
      SpiInterruptibleSeqAllowed = true
      SpiLevelDelivered = 2
      SpiMainFunctionPeriod = 0.01
      SpiSupportConcurrentSyncTransmit = false
      SpiVersionInfoApi = false
      SpiAlreadyInitDetCheck = false
      SpiCriticalSectionProtection = true
      SpiDeviceName = R7F701651
      SpiDmaMode = false
      SpiDMARamMirror = DISABLE
      SpiDMAWriteVerify = WV_DISABLE
      SpiECCSelfTest = ECC_NONE
      SpiUseWriteVerifyErrorInterface = false
      SpiVersionCheckExternalModules = false
      SpiWriteVerifyErrorInterface = NULL
      SpiEnableClkImmediateValue = false
      SpiTimeOutWaitingTime = 10
      SpiLoopBackSelfTest = LOOPBACK_NONE
      SpiAutosarVersion = R4_2_2
      SpiCSIXRamMirror = DISABLE
      SpiCSIXWriteVerify = WV_DISABLE
      SpiEnableClockMode = false
      SpiEnableDataConsistencyCheck = false
      SpiEnableExtendedDataLength = false
      SpiEnablePersistentHwConfiguration = false
      SpiEnableSeqStartNotification = false
      SpiEnableSyncSeqEndNotification = false
      SpiForceCancelApi = false
      SpiErrorBufferSize = 0
      SpiInterruptConsistencyCheck = false
      SpiIsrCategory = CAT2
      SpiSupportConcurrentAsyncTransmit = false
      SpiUserCallbackHeaderFile = Spi_Test.h
    SpiPublishedInformation: SpiMaxHwUnit=8
