AUTOSAR XML (schema 00046)
package /ActiveEcuC
  module config EcuC: implementation-config-variant=VARIANT-PRE-COMPILE, module-description=EcuC_Impl
    EcucPduCollection: PduIdTypeEnum=UINT16, PduLengthTypeEnum=UINT32
      372 x Pdu, all with J1939Requestable=false:
        MasterReq_Tp_oLIN00_7147b638_Tx: DynamicLength=false, PduLength=8, SysTPduToFrameMappingRef=MasterReq_Tp
        BMS4_oB30_for_SC_CAN_V3_2_15d37a43_Rx: DynamicLength=false, PduLength=8, SysTPduToFrameMappingRef=BMS4
        Frame_LinTr_HUT2_oLIN00_aac66511_Tx: DynamicLength=false, PduLength=3, SysTPduToFrameMappingRef=Frame_LinTr_HUT2
        SlaveResp_Tp_oLIN00_3328eb0b_Rx: DynamicLength=false, PduLength=8, SysTPduToFrameMappingRef=SlaveResp_Tp
        MasterReq_Slave3_oLIN00_a4cffd2e_Tx: DynamicLength=true, PduLength=8
        ECM9_oB30_for_SC_CAN_V3_2_426f809c_Rx: DynamicLength=false, PduLength=8, SysTPduToFrameMappingRef=ECM9
        Frame_LinTr_RearECU_oLIN00_22758e6f_Rx: DynamicLength=false, PduLength=1
        HUT30_oB30_for_SC_CAN_V3_2_82af5510_Tx: DynamicLength=false, PduLength=8, SysTPduToFrameMappingRef=HUT30
        Frame_LinTr_HUT_oLIN00_a123072b_Tx: DynamicLength=false, PduLength=1, SysTPduToFrameMappingRef=Frame_LinTr_HUT
        WPC1_oB30_for_SC_CAN_V3_2_e844e41f_Rx: DynamicLength=false, PduLength=8, SysTPduToFrameMappingRef=WPC1
        ECM3_oB30_for_SC_CAN_V3_2_ea21e226_Rx: DynamicLength=false, PduLength=8, SysTPduToFrameMappingRef=ECM3
        ESP11_oB30_for_SC_CAN_V3_2_dfa78df9_Rx: DynamicLength=false, PduLength=8, SysTPduToFrameMappingRef=ESP11
        AMP3_oB30_for_SC_CAN_V3_2_b64354b4_Rx: DynamicLength=false, PduLength=8, SysTPduToFrameMappingRef=AMP3
        HUT17_oB30_for_SC_CAN_V3_2_4a1d7d30_Tx: DynamicLength=false, PduLength=8, SysTPduToFrameMappingRef=HUT17
        HUT34_oB30_for_SC_CAN_V3_2_1cb697de_Tx: DynamicLength=false, PduLength=8, SysTPduToFrameMappingRef=HUT34
        HUT6_oB30_for_SC_CAN_V3_2_52c6e404_Tx: DynamicLength=false, PduLength=8, SysTPduToFrameMappingRef=HUT6
        Frame_LinTr_HUT2_oLIN00_542a3cb9_Tx: DynamicLength=false, PduLength=3
        AMP4_ANC1_oB30_for_SC_CAN_V3_2_e4b31b97_Rx: DynamicLength=false, PduLength=8, SysTPduToFrameMappingRef=AMP4_ANC1
        CSA3_oB30_for_SC_CAN_V3_2_eb741019_Rx: DynamicLength=false, PduLength=8, SysTPduToFrameMappingRef=CSA3
        DCT3_oB30_for_SC_CAN_V3_2_50b784e2_Rx: DynamicLength=false, PduLength=8, SysTPduToFrameMappingRef=DCT3
        HUT_77e5191d_Rx: PduLength=8
        HUT13_oB30_for_SC_CAN_V3_2_d404bffe_Tx: DynamicLength=false, PduLength=8, SysTPduToFrameMappingRef=HUT13
        DSM1_oB30_for_SC_CAN_V3_2_24c7b7e3_Rx: DynamicLength=false, PduLength=8, SysTPduToFrameMappingRef=DSM1
        PDCM1_oB30_for_SC_CAN_V3_2_76a5c7ab_Rx: DynamicLength=false, PduLength=8, SysTPduToFrameMappingRef=PDCM1
        ECM20_oB30_for_SC_CAN_V3_2_2b350587_Rx: DynamicLength=false, PduLength=8, SysTPduToFrameMappingRef=ECM20
        HUT4_oB30_for_SC_CAN_V3_2_1dca0563_Tx: DynamicLength=false, PduLength=8, SysTPduToFrameMappingRef=HUT4
        GW_FD1_oB30_for_SC_CAN_V3_2_7270e594_Rx: DynamicLength=false, PduLength=64, SysTPduToFrameMappingRef=GW_FD1
        Frame_LinTr_RearECU_oLIN00_64640cc1_Rx: DynamicLength=false, PduLength=1, SysTPduToFrameMappingRef=Frame_LinTr_RearECU
        ECM4_oB30_for_SC_CAN_V3_2_f10a321c_Rx: DynamicLength=false, PduLength=8, SysTPduToFrameMappingRef=ECM4
        HUT19_oB30_for_SC_CAN_V3_2_7c4add44_Tx: DynamicLength=false, PduLength=8, SysTPduToFrameMappingRef=HUT19
        ABS2_oB30_for_SC_CAN_V3_2_25753a3c_Rx: DynamicLength=false, PduLength=8, SysTPduToFrameMappingRef=ABS2
        HUT21_oB30_for_SC_CAN_V3_2_215d5a8e_Tx: DynamicLength=false, PduLength=8, SysTPduToFrameMappingRef=HUT21
        AC2_oB30_for_SC_CAN_V3_2_b771a69a_Rx: DynamicLength=false, PduLength=8, SysTPduToFrameMappingRef=AC2
        IFC_FD3_oB30_for_SC_CAN_V3_2_4c625c72_Rx: DynamicLength=false, PduLength=64, SysTPduToFrameMappingRef=IFC_FD3
        HUT2_oB30_for_SC_CAN_V3_2_ccdf26ca_Tx: DynamicLength=false, PduLength=8, SysTPduToFrameMappingRef=HUT2
        RSDS_FD1_oB30_for_SC_CAN_V3_2_b597372e_Rx: DynamicLength=false, PduLength=64, SysTPduToFrameMappingRef=RSDS_FD1
        ABS1_oB30_for_SC_CAN_V3_2_a04728c8_Rx: DynamicLength=false, PduLength=8, SysTPduToFrameMappingRef=ABS1
        AEB_FD1_oB30_for_SC_CAN_V3_2_c284a95c_Rx: DynamicLength=false, PduLength=64, SysTPduToFrameMappingRef=AEB_FD1
        DCT5_oB30_for_SC_CAN_V3_2_81a2a74b_Rx: DynamicLength=false, PduLength=8, SysTPduToFrameMappingRef=DCT5
        BCM12_oB30_for_SC_CAN_V3_2_3066f987_Rx: DynamicLength=false, PduLength=8, SysTPduToFrameMappingRef=BCM12
        HUT10_oB30_for_SC_CAN_V3_2_5136ad0a_Tx: DynamicLength=false, PduLength=8, SysTPduToFrameMappingRef=HUT10
        HCU_HC7_oB30_for_SC_CAN_V3_2_7b235adf_Rx: DynamicLength=false, PduLength=8, SysTPduToFrameMappingRef=HCU_HC7
        ECM1_oB30_for_SC_CAN_V3_2_a52d0341_Rx: DynamicLength=false, PduLength=8, SysTPduToFrameMappingRef=ECM1
        HUT3_oB30_for_SC_CAN_V3_2_06e1d559_Tx: DynamicLength=false, PduLength=8, SysTPduToFrameMappingRef=HUT3
        CSA1_oB30_for_SC_CAN_V3_2_a478f17e_Rx: DynamicLength=false, PduLength=8, SysTPduToFrameMappingRef=CSA1
        ABM2_oB30_for_SC_CAN_V3_2_5851072c_Rx: DynamicLength=false, PduLength=8, SysTPduToFrameMappingRef=ABM2
        BCM8_oB30_for_SC_CAN_V3_2_8c292f0d_Rx: DynamicLength=false, PduLength=8, SysTPduToFrameMappingRef=BCM8
        PEPS2_oB30_for_SC_CAN_V3_2_8c308c2e_Rx: DynamicLength=false, PduLength=8, SysTPduToFrameMappingRef=PEPS2
        EPB1_oB30_for_SC_CAN_V3_2_9899d01e_Rx: DynamicLength=false, PduLength=8, SysTPduToFrameMappingRef=EPB1
        HUT1_oB30_for_SC_CAN_V3_2_49ed343e_Tx: DynamicLength=false, PduLength=8, SysTPduToFrameMappingRef=HUT1
        ECM11_oB30_for_SC_CAN_V3_2_5b5ef203_Rx: DynamicLength=false, PduLength=8, SysTPduToFrameMappingRef=ECM11
        HCU_PT4_oB30_for_SC_CAN_V3_2_d214f642_Rx: DynamicLength=false, PduLength=8, SysTPduToFrameMappingRef=HCU_PT4
        AC1_oB30_for_SC_CAN_V3_2_3243b46e_Rx: DynamicLength=false, PduLength=8, SysTPduToFrameMappingRef=AC1
        Frame_LinTr_HUT_oLIN00_10562d73_Tx: DynamicLength=false, PduLength=1
        MasterReq_oLIN00_4a2bb011_Tx: DynamicLength=true, PduLength=8
        ECM2_oB30_for_SC_CAN_V3_2_201f11b5_Rx: DynamicLength=false, PduLength=8, SysTPduToFrameMappingRef=ECM2
        SlaveResp_RearECU_oLIN00_c13bc529_Rx: DynamicLength=true, PduLength=8
        HUT20_oB30_for_SC_CAN_V3_2_eb63a91d_Tx: DynamicLength=false, PduLength=8, SysTPduToFrameMappingRef=HUT20
        HUT16_oB30_for_SC_CAN_V3_2_80238ea3_Tx: DynamicLength=false, PduLength=8, SysTPduToFrameMappingRef=HUT16
        HUD1_oB30_for_SC_CAN_V3_2_6397ebab_Rx: DynamicLength=false, PduLength=8, SysTPduToFrameMappingRef=HUD1
        ECM7_oB30_for_SC_CAN_V3_2_743820e8_Rx: DynamicLength=false, PduLength=8, SysTPduToFrameMappingRef=ECM7
        SlaveResp_Slave3_oLIN00_97811d8d_Rx: DynamicLength=true, PduLength=8
        DDCM1_oB30_for_SC_CAN_V3_2_b3033028_Rx: DynamicLength=false, PduLength=8, SysTPduToFrameMappingRef=DDCM1
        HAP_FD2_oB30_for_SC_CAN_V3_2_e5b1e853_Rx: DynamicLength=false, PduLength=64, SysTPduToFrameMappingRef=HAP_FD2
        HAP_FD3_oB30_for_SC_CAN_V3_2_2f8f1bc0_Rx: DynamicLength=false, PduLength=64, SysTPduToFrameMappingRef=HAP_FD3
        HUT33_oB30_for_SC_CAN_V3_2_079d47e4_Tx: DynamicLength=false, PduLength=8, SysTPduToFrameMappingRef=HUT33
        MasterReq_RearECU_oLIN00_8ed7799b_Tx: DynamicLength=true, PduLength=8
        Frame_LinTr_Slave3_oLIN00_bac14905_Rx: DynamicLength=false, PduLength=3
        HUT32_oB30_for_SC_CAN_V3_2_cda3b477_Tx: DynamicLength=false, PduLength=8, SysTPduToFrameMappingRef=HUT32
        HAP_FD1_oB30_for_SC_CAN_V3_2_6083faa7_Rx: DynamicLength=false, PduLength=64, SysTPduToFrameMappingRef=HAP_FD1
        HUT22_oB30_for_SC_CAN_V3_2_a46f487a_Tx: DynamicLength=false, PduLength=8, SysTPduToFrameMappingRef=HUT22
        HCU_PT7_oB30_for_SC_CAN_V3_2_5726e4b6_Rx: DynamicLength=false, PduLength=8, SysTPduToFrameMappingRef=HCU_PT7
        ESP8_oB30_for_SC_CAN_V3_2_cf6f571c_Rx: DynamicLength=false, PduLength=8, SysTPduToFrameMappingRef=ESP8
        EEM1_oB30_for_SC_CAN_V3_2_788fa486_Rx: DynamicLength=false, PduLength=8, SysTPduToFrameMappingRef=EEM1
        HUT25_oB30_for_SC_CAN_V3_2_bf449840_Tx: DynamicLength=false, PduLength=8, SysTPduToFrameMappingRef=HUT25
        Frame_LinTr_Slave3_oLIN00_eb2bd0ab_Rx: DynamicLength=false, PduLength=3, SysTPduToFrameMappingRef=Frame_LinTr_Slave3
        PEPS4_oB30_for_SC_CAN_V3_2_5d25af87_Rx: DynamicLength=false, PduLength=8, SysTPduToFrameMappingRef=PEPS4
        ECM19_oB30_for_SC_CAN_V3_2_bc1c71de_Rx: DynamicLength=false, PduLength=8, SysTPduToFrameMappingRef=ECM19
        HUT23_oB30_for_SC_CAN_V3_2_6e51bbe9_Tx: DynamicLength=false, PduLength=8, SysTPduToFrameMappingRef=HUT23
        AMP1_oB30_for_SC_CAN_V3_2_f94fb5d3_Rx: DynamicLength=false, PduLength=8, SysTPduToFrameMappingRef=AMP1
        CSA2_oB30_for_SC_CAN_V3_2_214ae38a_Rx: DynamicLength=false, PduLength=8, SysTPduToFrameMappingRef=CSA2
        Pdu_Nm_userData_Tx: PduLength=6
        CR_FD1_oB30_for_SC_CAN_V3_2_ae29d598_Rx: DynamicLength=false, PduLength=64, SysTPduToFrameMappingRef=CR_FD1
        ACC_FD3_oB30_for_SC_CAN_V3_2_e2f593d9_Rx: DynamicLength=false, PduLength=64, SysTPduToFrameMappingRef=ACC_FD3
        DVR_FD1_oB30_for_SC_CAN_V3_2_d1b20623_Tx: DynamicLength=false, PduLength=64, SysTPduToFrameMappingRef=DVR_FD1
        RSDS_FD2_oB30_for_SC_CAN_V3_2_30a525da_Rx: DynamicLength=false, PduLength=64, SysTPduToFrameMappingRef=RSDS_FD2
        HUT39_oB30_for_SC_CAN_V3_2_afd3255e_Tx: DynamicLength=false, PduLength=8, SysTPduToFrameMappingRef=HUT39
        CR_FD1_oB30_for_SC_CAN_V3_2_da926426_Rx: DynamicLength=false, PduLength=64
        IFC_FD6_oB30_for_SC_CAN_V3_2_9a342755_Rx: DynamicLength=false, PduLength=64
        IFC1_oB30_for_SC_CAN_V3_2_a7037da8_Rx: DynamicLength=false, PduLength=8, SysTPduToFrameMappingRef=IFC1
        ACC_FD4_oB30_for_SC_CAN_V3_2_b6067639_Rx: DynamicLength=false, PduLength=64
        IFC_FD6_oB30_for_SC_CAN_V3_2_18456d2f_Rx: DynamicLength=false, PduLength=64, SysTPduToFrameMappingRef=IFC_FD6
        IFC_FD5_oB30_for_SC_CAN_V3_2_9d777fdb_Rx: DynamicLength=false, PduLength=64, SysTPduToFrameMappingRef=IFC_FD5
        RSDS_FD2_oB30_for_SC_CAN_V3_2_a1379e70_Rx: DynamicLength=false, PduLength=64
        HUT39_oB30_for_SC_CAN_V3_2_dc19868c_Tx: DynamicLength=false, PduLength=8
        IFC1_oB30_for_SC_CAN_V3_2_787af09a_Rx: DynamicLength=false, PduLength=8
        ACC_FD3_oB30_for_SC_CAN_V3_2_d3df4879_Rx: DynamicLength=false, PduLength=64
        IFC_FD5_oB30_for_SC_CAN_V3_2_a34c8a15_Rx: DynamicLength=false, PduLength=64
        DVR_FD1_oB30_for_SC_CAN_V3_2_e61bae2e_Tx: DynamicLength=false, PduLength=64
        ACC_FD4_oB30_for_SC_CAN_V3_2_f9de43e3_Rx: DynamicLength=false, PduLength=64, SysTPduToFrameMappingRef=ACC_FD4
        NMRange_oB30_for_SC_CAN_V3_2_ac4231d8_Rx: DynamicLength=false, PduLength=8
        HAP_FD6_oB30_for_SC_CAN_V3_2_11512a4e_Rx: DynamicLength=false, PduLength=64
        HUT_FD2_oB30_for_SC_CAN_V3_2_19cb507e_Tx: DynamicLength=false, PduLength=64, SysTPduToFrameMappingRef=HUT_FD2
        HUT_FD2_oB30_for_SC_CAN_V3_2_5851ef80_Tx: DynamicLength=false, PduLength=64
        HUT_FD3_oB30_for_SC_CAN_V3_2_d3f5a3ed_Tx: DynamicLength=false, PduLength=64, SysTPduToFrameMappingRef=HUT_FD3
        HAP_FD6_oB30_for_SC_CAN_V3_2_7ba82a9d_Rx: DynamicLength=false, PduLength=64, SysTPduToFrameMappingRef=HAP_FD6
        HUT_FD3_oB30_for_SC_CAN_V3_2_4f798b40_Tx: DynamicLength=false, PduLength=64
        IFC_FD2_Sc_oB30_for_SC_CAN_V3_2_3e25ea9f_Rx: DynamicLength=false, PduLength=64, SysTPduToFrameMappingRef=IFC_FD2_Sc
        BCM3_oB30_for_SC_CAN_V3_2_4a9cd6da_Rx: DynamicLength=false, PduLength=8
        AMP2_Sc_oB30_for_SC_CAN_V3_2_b40eb813_Rx: DynamicLength=false, PduLength=16
        ACC_FD2_Sc_oB30_for_SC_CAN_V3_2_c90195d6_Rx: DynamicLength=false, PduLength=64, SysTPduToFrameMappingRef=ACC_FD2_Sc
        IFC_FD2_oB30_for_SC_CAN_V3_2_c695b455_Rx: DynamicLength=false, PduLength=56
        TPMS2_Sc_oB30_for_SC_CAN_V3_2_00821b00_Rx: DynamicLength=false, PduLength=16, SysTPduToFrameMappingRef=TPMS2_Sc
        BCM1_oB30_for_SC_CAN_V3_2_64cc1f5a_Rx: DynamicLength=false, PduLength=8
        AEB_FD2_Sc_oB30_for_SC_CAN_V3_2_2f1f8022_Rx: DynamicLength=false, PduLength=64, SysTPduToFrameMappingRef=AEB_FD2_Sc
        AMP2_oB30_for_SC_CAN_V3_2_908de48a_Rx: DynamicLength=false, PduLength=8
        ABM1_oB30_for_SC_CAN_V3_2_d004cc2e_Rx: DynamicLength=false, PduLength=8
        IFC_FD2_Sc_oB30_for_SC_CAN_V3_2_9b0c0f4a_Rx: DynamicLength=false, PduLength=64
        ABM1_Sc_oB30_for_SC_CAN_V3_2_a346d8c1_Rx: DynamicLength=false, PduLength=16
        HUT15_Sc_oB30_for_SC_CAN_V3_2_d2d608b6_Tx: DynamicLength=false, PduLength=16
        TPMS1_oB30_for_SC_CAN_V3_2_c5efa96f_Rx: DynamicLength=false, PduLength=8
        ESP_FD2_oB30_for_SC_CAN_V3_2_c451c518_Rx: DynamicLength=false, PduLength=56
        BCM1_Sc_oB30_for_SC_CAN_V3_2_cf14c4a7_Rx: DynamicLength=false, PduLength=16
        TPMS1_Sc_oB30_for_SC_CAN_V3_2_fd4c9b31_Rx: DynamicLength=false, PduLength=16
        HUT_FD1_oB30_for_SC_CAN_V3_2_612942c0_Tx: DynamicLength=false, PduLength=56
        TPMS2_oB30_for_SC_CAN_V3_2_fc97042f_Rx: DynamicLength=false, PduLength=8
        HUT15_Sc_oB30_for_SC_CAN_V3_2_03f030a3_Tx: DynamicLength=false, PduLength=16, SysTPduToFrameMappingRef=HUT15_Sc
        AEB_FD2_Sc_oB30_for_SC_CAN_V3_2_cb95b5fe_Rx: DynamicLength=false, PduLength=64
        TPMS1_Sc_oB30_for_SC_CAN_V3_2_026ce1da_Rx: DynamicLength=false, PduLength=16, SysTPduToFrameMappingRef=TPMS1_Sc
        AMP2_Sc_oB30_for_SC_CAN_V3_2_2fb79ac1_Rx: DynamicLength=false, PduLength=16, SysTPduToFrameMappingRef=AMP2_Sc
        ACC_FD2_Sc_oB30_for_SC_CAN_V3_2_21d026ea_Rx: DynamicLength=false, PduLength=64
        HUT_FD1_Sc_oB30_for_SC_CAN_V3_2_e0e5cc6a_Tx: DynamicLength=false, PduLength=64
        TPMS2_Sc_oB30_for_SC_CAN_V3_2_c8a12d62_Rx: DynamicLength=false, PduLength=16
        BCM1_Sc_oB30_for_SC_CAN_V3_2_89b93aaf_Rx: DynamicLength=false, PduLength=16, SysTPduToFrameMappingRef=BCM1_Sc
        ABM1_Sc_oB30_for_SC_CAN_V3_2_bdd35fd4_Rx: DynamicLength=false, PduLength=16, SysTPduToFrameMappingRef=ABM1_Sc
        BCM3_Sc_oB30_for_SC_CAN_V3_2_8af269c3_Rx: DynamicLength=false, PduLength=16, SysTPduToFrameMappingRef=BCM3_Sc
        HUT_FD1_Sc_oB30_for_SC_CAN_V3_2_37cb1482_Tx: DynamicLength=false, PduLength=64, SysTPduToFrameMappingRef=HUT_FD1_Sc
        BCM3_Sc_oB30_for_SC_CAN_V3_2_5f72e2fa_Rx: DynamicLength=false, PduLength=16
        ACC_FD2_oB30_for_SC_CAN_V3_2_c4f72cb9_Rx: DynamicLength=false, PduLength=56
        HUT15_oB30_for_SC_CAN_V3_2_d46de065_Tx: DynamicLength=false, PduLength=8
        AEB_FD2_oB30_for_SC_CAN_V3_2_9fb3d7e9_Rx: DynamicLength=false, PduLength=56
        HUT35_oB30_for_SC_CAN_V3_2_39fb338c_Tx: DynamicLength=false, PduLength=8
        HUT35_oB30_for_SC_CAN_V3_2_d688644d_Tx: DynamicLength=false, PduLength=8, SysTPduToFrameMappingRef=HUT35
        DDCM3_oB30_for_SC_CAN_V3_2_6c768ffc_Rx: DynamicLength=false, PduLength=8
        IP2_Sc_oB30_for_SC_CAN_V3_2_3598fa68_Tx: DynamicLength=false, PduLength=16, SysTPduToFrameMappingRef=IP2_Sc
        DMS_FD1_oB30_for_SC_CAN_V3_2_3b8624c3_Tx: DynamicLength=false, PduLength=64, SysTPduToFrameMappingRef=DMS_FD1
        DCT_FD4_oB30_for_SC_CAN_V3_2_c3f55f0e_Rx: DynamicLength=false, PduLength=64
        DMS_FD1_oB30_for_SC_CAN_V3_2_2e6458a5_Tx: DynamicLength=false, PduLength=64
        IP2_Sc_oB30_for_SC_CAN_V3_2_bf1dcb66_Tx: DynamicLength=false, PduLength=16
        IP2_oB30_for_SC_CAN_V3_2_24e97840_Tx: DynamicLength=false, PduLength=8
        IP1_oB30_for_SC_CAN_V3_2_e24be166_Tx: DynamicLength=false, PduLength=8, SysTPduToFrameMappingRef=IP1
        DDCM3_oB30_for_SC_CAN_V3_2_fc0fd14f_Rx: DynamicLength=false, PduLength=8, SysTPduToFrameMappingRef=DDCM3
        IP1_oB30_for_SC_CAN_V3_2_1d91d500_Tx: DynamicLength=false, PduLength=8
        IP3_oB30_for_SC_CAN_V3_2_33c11c80_Tx: DynamicLength=false, PduLength=16
        IP3_oB30_for_SC_CAN_V3_2_ad470001_Tx: DynamicLength=false, PduLength=16, SysTPduToFrameMappingRef=IP3
        DiagFuncReq_oB30_for_SC_CAN_V3_2_20_4d8be182_Rx: DynamicLength=true, PduLength=7
        HUT_Phy_Resp_oB30_for_SC_CAN_V3_2_20_bf18e38e_Tx: DynamicLength=true, PduLength=8
        HUT_Phy_Resp_Tp_oB30_for_SC_CAN_V3_2_20_4bbb4ddf_Tx: DynamicLength=false, PduLength=8, SysTPduToFrameMappingRef=HUT_Phy_Resp_Tp
        DiagFuncReq_oB30_for_SC_CAN_V3_2_92cf4cbf_Rx: DynamicLength=true, PduLength=7
        HUT_Phy_Resp_Tp_oB30_for_SC_CAN_V3_2_b970c45d_Tx: DynamicLength=false, PduLength=8, SysTPduToFrameMappingRef=HUT_Phy_Resp_Tp
        HUT_Phy_Req_oB30_for_SC_CAN_V3_2_20_98e0d928_Rx: DynamicLength=true, PduLength=8
        HUT_Phy_Req_oB30_for_SC_CAN_V3_2_c7e62b5b_Rx: DynamicLength=true, PduLength=8
        DiagFuncReq_oB30_for_SC_CAN_V3_2_20_ca1db2d5_Rx: DynamicLength=true, PduLength=7
        HUT_Phy_Resp_oB30_for_SC_CAN_V3_2_9074f696_Tx: DynamicLength=true, PduLength=8
        GW_Sync_Req_oB30_for_SC_CAN_V3_2_6800966b_Rx: DynamicLength=false, PduLength=0
        DiagFuncReq_Tp_oB30_for_SC_CAN_V3_2_16517e6b_Rx: DynamicLength=false, PduLength=8, SysTPduToFrameMappingRef=DiagFuncReq_Tp
        GW_Sync_Req_Sc_oB30_for_SC_CAN_V3_2_922ee695_Rx: DynamicLength=false, PduLength=16
        HUT_Phy_Resp_oB30_for_SC_CAN_V3_2_20_e2aa5bb4_Tx: DynamicLength=true, PduLength=8
        HUT_Phy_Resp_oB30_for_SC_CAN_V3_2_69356df1_Tx: DynamicLength=true, PduLength=8
        HUT_Phy_Req_oB30_for_SC_CAN_V3_2_6551238f_Rx: DynamicLength=true, PduLength=8
        GW_Sync_Req_Sc_oB30_for_SC_CAN_V3_2_21657c6a_Rx: DynamicLength=false, PduLength=16, SysTPduToFrameMappingRef=GW_Sync_Req_Sc
        DiagFuncReq_Tp_oB30_for_SC_CAN_V3_2_20_391e823e_Rx: DynamicLength=false, PduLength=8, SysTPduToFrameMappingRef=DiagFuncReq_Tp
        HUT_Phy_Req_Tp_oB30_for_SC_CAN_V3_2_c33a46c1_Rx: DynamicLength=false, PduLength=8, SysTPduToFrameMappingRef=HUT_Phy_Req_Tp
        DiagFuncReq_oB30_for_SC_CAN_V3_2_93239eac_Rx: DynamicLength=true, PduLength=7
        HUT_Phy_Req_oB30_for_SC_CAN_V3_2_20_0cf8aff0_Rx: DynamicLength=true, PduLength=8
        HUT_Phy_Req_Tp_oB30_for_SC_CAN_V3_2_20_200e5e76_Rx: DynamicLength=false, PduLength=8, SysTPduToFrameMappingRef=HUT_Phy_Req_Tp
        HUT_NM_oB30_for_SC_CAN_V3_2_00cca29e_Tx: DynamicLength=false, PduLength=8, SysTPduToFrameMappingRef=HUT_NM
        TOD1_oB30_for_SC_CAN_V3_2_77c15f81_Rx: DynamicLength=false, PduLength=8
        HCU_HC16_oB30_for_SC_CAN_V3_2_f8c79c4c_Rx: DynamicLength=false, PduLength=8, SysTPduToFrameMappingRef=HCU_HC16
        HUT26_oB30_for_SC_CAN_V3_2_9bf07418_Tx: DynamicLength=false, PduLength=8
        HUT45_oB30_for_SC_CAN_V3_2_4f42ab22_Tx: DynamicLength=false, PduLength=8
        CP1_oB30_for_SC_CAN_V3_2_5fdd0f6e_Rx: DynamicLength=false, PduLength=8, SysTPduToFrameMappingRef=CP1
        ELD1_oB30_for_SC_CAN_V3_2_d7398aaa_Rx: DynamicLength=false, PduLength=8, SysTPduToFrameMappingRef=ELD1
        HUT42_oB30_for_SC_CAN_V3_2_0bb44615_Tx: DynamicLength=false, PduLength=8, SysTPduToFrameMappingRef=HUT42
        BCM11_oB30_for_SC_CAN_V3_2_b554eb73_Rx: DynamicLength=false, PduLength=8, SysTPduToFrameMappingRef=BCM11
        ECM16_oB30_for_SC_CAN_V3_2_40752239_Rx: DynamicLength=false, PduLength=8, SysTPduToFrameMappingRef=ECM16
        ESCL2_oB30_for_SC_CAN_V3_2_63dcaaa3_Rx: DynamicLength=false, PduLength=8, SysTPduToFrameMappingRef=ESCL2
        BCM14_oB30_for_SC_CAN_V3_2_9ca98f1a_Rx: DynamicLength=false, PduLength=8
        AC4_oB30_for_SC_CAN_V3_2_f382a10f_Rx: DynamicLength=false, PduLength=8
        AC8_oB30_for_SC_CAN_V3_2_1f3fc420_Rx: DynamicLength=false, PduLength=8, SysTPduToFrameMappingRef=AC8
        BCM11_oB30_for_SC_CAN_V3_2_d72078da_Rx: DynamicLength=false, PduLength=8
        AC6_oB30_for_SC_CAN_V3_2_ddd2688f_Rx: DynamicLength=false, PduLength=8
        BCM14_oB30_for_SC_CAN_V3_2_e173da2e_Rx: DynamicLength=false, PduLength=8, SysTPduToFrameMappingRef=BCM14
        HUT12_oB30_for_SC_CAN_V3_2_b1b4de25_Tx: DynamicLength=false, PduLength=8
        AC4_oB30_for_SC_CAN_V3_2_66648533_Rx: DynamicLength=false, PduLength=8, SysTPduToFrameMappingRef=AC4
        AC6_oB30_for_SC_CAN_V3_2_29686454_Rx: DynamicLength=false, PduLength=8, SysTPduToFrameMappingRef=AC6
        AC7_oB30_for_SC_CAN_V3_2_cafa0c4f_Rx: DynamicLength=false, PduLength=8
        Trailer1_oB30_for_SC_CAN_V3_2_7da566bd_Rx: DynamicLength=false, PduLength=8
        CP1_oB30_for_SC_CAN_V3_2_16a725b1_Rx: DynamicLength=false, PduLength=8
        AC3_oB30_for_SC_CAN_V3_2_965b9f4f_Rx: DynamicLength=false, PduLength=8
        Ibooster_FD2_oB30_for_SC_CAN_V3_2_e9e18adf_Rx: DynamicLength=false, PduLength=64
        HUT42_oB30_for_SC_CAN_V3_2_2a9b9562_Tx: DynamicLength=false, PduLength=8
        AC7_oB30_for_SC_CAN_V3_2_e35697c7_Rx: DynamicLength=false, PduLength=8, SysTPduToFrameMappingRef=AC7
        BMS65_oB30_for_SC_CAN_V3_2_a7b39db6_Rx: DynamicLength=false, PduLength=8
        HUT38_oB30_for_SC_CAN_V3_2_cb31e24c_Tx: DynamicLength=false, PduLength=8
        BMS65_oB30_for_SC_CAN_V3_2_f8605782_Rx: DynamicLength=false, PduLength=8, SysTPduToFrameMappingRef=BMS65
        T_BOX_FD4_oB30_for_SC_CAN_V3_2_b9da4418_Rx: DynamicLength=false, PduLength=16, SysTPduToFrameMappingRef=T_BOX_FD4
        ECM16_oB30_for_SC_CAN_V3_2_6a3a3dbc_Rx: DynamicLength=false, PduLength=8
        HCU_HC16_oB30_for_SC_CAN_V3_2_a481d524_Rx: DynamicLength=false, PduLength=8
        HUT12_oB30_for_SC_CAN_V3_2_1e3a4c6d_Tx: DynamicLength=false, PduLength=8, SysTPduToFrameMappingRef=HUT12
        TOD1_oB30_for_SC_CAN_V3_2_4faf68bf_Rx: DynamicLength=false, PduLength=8, SysTPduToFrameMappingRef=TOD1
        HUT43_oB30_for_SC_CAN_V3_2_3db3f1a2_Tx: DynamicLength=false, PduLength=8
        AC3_oB30_for_SC_CAN_V3_2_7d4f5509_Rx: DynamicLength=false, PduLength=8, SysTPduToFrameMappingRef=AC3
        ESCL2_oB30_for_SC_CAN_V3_2_91777cb9_Rx: DynamicLength=false, PduLength=8
        Trailer1_oB30_for_SC_CAN_V3_2_f8a7c92e_Rx: DynamicLength=false, PduLength=8, SysTPduToFrameMappingRef=Trailer1
        HUT38_oB30_for_SC_CAN_V3_2_65edd6cd_Tx: DynamicLength=false, PduLength=8, SysTPduToFrameMappingRef=HUT38
        T_BOX_FD4_oB30_for_SC_CAN_V3_2_f4d43aba_Rx: DynamicLength=false, PduLength=16
        AC8_oB30_for_SC_CAN_V3_2_1660140f_Rx: DynamicLength=false, PduLength=8
        ESP_FD2_Sc_oB30_for_SC_CAN_V3_2_49635fc5_Rx: DynamicLength=false, PduLength=64
        HUT31_oB30_for_SC_CAN_V3_2_655aa08c_Tx: DynamicLength=false, PduLength=8
        HUT45_oB30_for_SC_CAN_V3_2_109f962f_Tx: DynamicLength=false, PduLength=8, SysTPduToFrameMappingRef=HUT45
        ESP_FD2_Sc_oB30_for_SC_CAN_V3_2_dec71f3e_Rx: DynamicLength=false, PduLength=64, SysTPduToFrameMappingRef=ESP_FD2_Sc
        HUT26_oB30_for_SC_CAN_V3_2_3a768ab4_Tx: DynamicLength=false, PduLength=8, SysTPduToFrameMappingRef=HUT26
        HUT31_oB30_for_SC_CAN_V3_2_4891a683_Tx: DynamicLength=false, PduLength=8, SysTPduToFrameMappingRef=HUT31
        Ibooster_FD2_oB30_for_SC_CAN_V3_2_055eeaf7_Rx: DynamicLength=false, PduLength=64, SysTPduToFrameMappingRef=Ibooster_FD2
        ELD1_oB30_for_SC_CAN_V3_2_d24341c9_Rx: DynamicLength=false, PduLength=8
        HUT43_oB30_for_SC_CAN_V3_2_c18ab586_Tx: DynamicLength=false, PduLength=8, SysTPduToFrameMappingRef=HUT43
        T_BOX_FD1_Sc_oB30_for_SC_CAN_V3_2_c35f86d3_Rx: DynamicLength=false, PduLength=16
        T_BOX_FD3_oB30_for_SC_CAN_V3_2_910d04fa_Rx: DynamicLength=false, PduLength=8
        T_BOX_FD3_Sc_oB30_for_SC_CAN_V3_2_3919f2cf_Rx: DynamicLength=false, PduLength=16, SysTPduToFrameMappingRef=T_BOX_FD3_Sc
        T_BOX_FD3_Sc_oB30_for_SC_CAN_V3_2_5339a08e_Rx: DynamicLength=false, PduLength=16
        T_BOX_FD1_oB30_for_SC_CAN_V3_2_bf5dcd7a_Rx: DynamicLength=false, PduLength=8
        HUT_Sync_Req_oB30_for_SC_CAN_V3_2_850087bd_Tx: DynamicLength=false, PduLength=16, SysTPduToFrameMappingRef=HUT_Sync_Req
        EPS_FD1_oB30_for_SC_CAN_V3_2_bceaa863_Rx: DynamicLength=false, PduLength=64
        EPS_FD1_oB30_for_SC_CAN_V3_2_a6650fa5_Rx: DynamicLength=false, PduLength=64, SysTPduToFrameMappingRef=EPS_FD1
        HUT_Sync_Req_oB30_for_SC_CAN_V3_2_c00563cb_Tx: DynamicLength=false, PduLength=16
        T_BOX_FD1_Sc_oB30_for_SC_CAN_V3_2_3a52a1a3_Rx: DynamicLength=false, PduLength=16, SysTPduToFrameMappingRef=T_BOX_FD1_Sc
        DSC4_oB30_for_SC_CAN_V3_2_27be643b_Rx: DynamicLength=false, PduLength=8, SysTPduToFrameMappingRef=DSC4
        HUT_FD5_oB30_for_SC_CAN_V3_2_02e08044_Tx: DynamicLength=false, PduLength=64, SysTPduToFrameMappingRef=HUT_FD5
        DWD1_oB30_for_SC_CAN_V3_2_959d6041_Rx: DynamicLength=false, PduLength=8, SysTPduToFrameMappingRef=DWD1
        DWD1_oB30_for_SC_CAN_V3_2_82b03b6c_Rx: DynamicLength=false, PduLength=8
        DOCK2_oB30_for_SC_CAN_V3_2_96299bd9_Rx: DynamicLength=false, PduLength=64, SysTPduToFrameMappingRef=DOCK2
        HUT36_oB30_for_SC_CAN_V3_2_00839ecc_Tx: DynamicLength=false, PduLength=8
        DSC4_oB30_for_SC_CAN_V3_2_d686ca5d_Rx: DynamicLength=false, PduLength=8
        HUT7_oB30_for_SC_CAN_V3_2_98f81797_Tx: DynamicLength=false, PduLength=8, SysTPduToFrameMappingRef=HUT7
        HUT40_oB30_for_SC_CAN_V3_2_04cb5ce2_Tx: DynamicLength=false, PduLength=8
        HUT41_oB30_for_SC_CAN_V3_2_8e8654e1_Tx: DynamicLength=false, PduLength=8, SysTPduToFrameMappingRef=HUT41
        HUT37_oB30_for_SC_CAN_V3_2_17abfa0c_Tx: DynamicLength=false, PduLength=8
        HUT46_oB30_for_SC_CAN_V3_2_95ad84db_Tx: DynamicLength=false, PduLength=8, SysTPduToFrameMappingRef=HUT46
        HUT37_oB30_for_SC_CAN_V3_2_9984852a_Tx: DynamicLength=false, PduLength=8, SysTPduToFrameMappingRef=HUT37
        DOCK1_oB30_for_SC_CAN_V3_2_131b892d_Rx: DynamicLength=false, PduLength=64, SysTPduToFrameMappingRef=DOCK1
        DOCK1_oB30_for_SC_CAN_V3_2_b60a11e2_Rx: DynamicLength=false, PduLength=64
        HUT40_oB30_for_SC_CAN_V3_2_44b8a772_Tx: DynamicLength=false, PduLength=8, SysTPduToFrameMappingRef=HUT40
        HUT7_oB30_for_SC_CAN_V3_2_ffbef2e3_Tx: DynamicLength=false, PduLength=8
        HUT41_oB30_for_SC_CAN_V3_2_13e33822_Tx: DynamicLength=false, PduLength=8
        HUT_FD5_oB30_for_SC_CAN_V3_2_3d88d1c0_Tx: DynamicLength=false, PduLength=64
        HUT46_oB30_for_SC_CAN_V3_2_763a0662_Tx: DynamicLength=false, PduLength=8
        DOCK2_oB30_for_SC_CAN_V3_2_8f72bca2_Rx: DynamicLength=false, PduLength=64
        HUT36_oB30_for_SC_CAN_V3_2_53ba76b9_Tx: DynamicLength=false, PduLength=8, SysTPduToFrameMappingRef=HUT36
        P2M1_oB30_for_SC_CAN_V3_2_f19378e0_Rx: DynamicLength=false, PduLength=8, SysTPduToFrameMappingRef=P2M1
        HCU_PT8_oB30_for_SC_CAN_V3_2_ab4fb751_Rx: DynamicLength=false, PduLength=8, SysTPduToFrameMappingRef=HCU_PT8
        BMS30_oB30_for_SC_CAN_V3_2_b9c96ca7_Rx: DynamicLength=false, PduLength=8, SysTPduToFrameMappingRef=BMS30
        P2M3_oB30_for_SC_CAN_V3_2_be9f9987_Rx: DynamicLength=false, PduLength=8, SysTPduToFrameMappingRef=P2M3
        BMS22_oB30_for_SC_CAN_V3_2_9f0971cd_Rx: DynamicLength=false, PduLength=8, SysTPduToFrameMappingRef=BMS22
        P2M3_oB30_for_SC_CAN_V3_2_a4a9c93c_Rx: DynamicLength=false, PduLength=8
        P2M1_oB30_for_SC_CAN_V3_2_8af900bc_Rx: DynamicLength=false, PduLength=8
        BMS66_oB30_for_SC_CAN_V3_2_7d524576_Rx: DynamicLength=false, PduLength=8, SysTPduToFrameMappingRef=BMS66
        ECM_PT6_oB30_for_SC_CAN_V3_2_a48bbaf3_Rx: DynamicLength=false, PduLength=8, SysTPduToFrameMappingRef=ECM_PT6
        ECM_PT6_oB30_for_SC_CAN_V3_2_3a5210e1_Rx: DynamicLength=false, PduLength=8
        EBOOSTER_FD1_oB30_for_SC_CAN_V3_2_683305cd_Rx: DynamicLength=false, PduLength=64
        BMS22_oB30_for_SC_CAN_V3_2_c2360265_Rx: DynamicLength=false, PduLength=8
        BMS66_oB30_for_SC_CAN_V3_2_9ecb30f6_Rx: DynamicLength=false, PduLength=8
        BMS19_oB30_for_SC_CAN_V3_2_472ce4f3_Rx: DynamicLength=false, PduLength=8, SysTPduToFrameMappingRef=BMS19
        EBOOSTER_FD1_oB30_for_SC_CAN_V3_2_9ce048b8_Rx: DynamicLength=false, PduLength=64, SysTPduToFrameMappingRef=EBOOSTER_FD1
        ECM_PT7_oB30_for_SC_CAN_V3_2_2d7a7421_Rx: DynamicLength=false, PduLength=8
        HCU_HP8_oB30_for_SC_CAN_V3_2_1765d2ba_Rx: DynamicLength=false, PduLength=8, SysTPduToFrameMappingRef=HCU_HP8
        T_BOX_FD9_oB30_for_SC_CAN_V3_2_061eeb7a_Rx: DynamicLength=false, PduLength=8
        HCU_FD1_oB30_for_SC_CAN_V3_2_641912c5_Rx: DynamicLength=false, PduLength=64
        BMS30_oB30_for_SC_CAN_V3_2_77152131_Rx: DynamicLength=false, PduLength=8
        HCU_PT5_oB30_for_SC_CAN_V3_2_f69c2ae4_Rx: DynamicLength=false, PduLength=8
        BMS8_oB30_for_SC_CAN_V3_2_6c883b50_Rx: DynamicLength=false, PduLength=8, SysTPduToFrameMappingRef=BMS8
        BMS8_oB30_for_SC_CAN_V3_2_44968464_Rx: DynamicLength=false, PduLength=8
        ECM_PT7_oB30_for_SC_CAN_V3_2_6eb54960_Rx: DynamicLength=false, PduLength=8, SysTPduToFrameMappingRef=ECM_PT7
        ECM_PT5_oB30_for_SC_CAN_V3_2_21b9a807_Rx: DynamicLength=false, PduLength=8, SysTPduToFrameMappingRef=ECM_PT5
        HCU_HC6_oB30_for_SC_CAN_V3_2_b11da94c_Rx: DynamicLength=false, PduLength=8, SysTPduToFrameMappingRef=HCU_HC6
        HCU_HC8_oB30_for_SC_CAN_V3_2_874a0938_Rx: DynamicLength=false, PduLength=8, SysTPduToFrameMappingRef=HCU_HC8
        HCU_HC6_oB30_for_SC_CAN_V3_2_1549dac5_Rx: DynamicLength=false, PduLength=8
        HCU_FD1_oB30_for_SC_CAN_V3_2_f1a4a259_Rx: DynamicLength=false, PduLength=64, SysTPduToFrameMappingRef=HCU_FD1
        HCU_HC8_oB30_for_SC_CAN_V3_2_defba645_Rx: DynamicLength=false, PduLength=8
        ECM_PT5_oB30_for_SC_CAN_V3_2_032abda1_Rx: DynamicLength=false, PduLength=8
        HCU_PT8_oB30_for_SC_CAN_V3_2_0456fb24_Rx: DynamicLength=false, PduLength=8
        HCU_HC3_oB30_for_SC_CAN_V3_2_5ec02d05_Rx: DynamicLength=false, PduLength=8
        HCU_PT5_oB30_for_SC_CAN_V3_2_182a05d1_Rx: DynamicLength=false, PduLength=8, SysTPduToFrameMappingRef=HCU_PT5
        BMS_FD14_oB30_for_SC_CAN_V3_2_20801849_Rx: DynamicLength=false, PduLength=8
        BMS19_oB30_for_SC_CAN_V3_2_34e8b018_Rx: DynamicLength=false, PduLength=8
        HCU_HC3_oB30_for_SC_CAN_V3_2_e53a9811_Rx: DynamicLength=false, PduLength=8, SysTPduToFrameMappingRef=HCU_HC3
        BMS_FD14_oB30_for_SC_CAN_V3_2_69b2ad5e_Rx: DynamicLength=false, PduLength=8, SysTPduToFrameMappingRef=BMS_FD14
        T_BOX_FD9_oB30_for_SC_CAN_V3_2_0abff698_Rx: DynamicLength=false, PduLength=8, SysTPduToFrameMappingRef=T_BOX_FD9
        HCU_HP8_oB30_for_SC_CAN_V3_2_a96c1934_Rx: DynamicLength=false, PduLength=8
        BCM18_oB30_for_SC_CAN_V3_2_98289b3d_Rx: DynamicLength=false, PduLength=8, SysTPduToFrameMappingRef=BCM18
        ECM24_oB30_for_SC_CAN_V3_2_328fcd01_Rx: DynamicLength=false, PduLength=8
        BCM18_oB30_for_SC_CAN_V3_2_794b3a1a_Rx: DynamicLength=false, PduLength=8
        HCU_HP6_oB30_for_SC_CAN_V3_2_213272ce_Rx: DynamicLength=false, PduLength=8, SysTPduToFrameMappingRef=HCU_HP6
        ECM24_oB30_for_SC_CAN_V3_2_b52cc749_Rx: DynamicLength=false, PduLength=8, SysTPduToFrameMappingRef=ECM24
        HCU_HP6_oB30_for_SC_CAN_V3_2_62de65b4_Rx: DynamicLength=false, PduLength=8
        HUT_FD4_oB30_for_SC_CAN_V3_2_c8de73d7_Tx: DynamicLength=false, PduLength=64, SysTPduToFrameMappingRef=HUT_FD4
        BLE1_oB30_for_SC_CAN_V3_2_ba8d2aa5_Rx: DynamicLength=false, PduLength=8, SysTPduToFrameMappingRef=BLE1
        SCM1_oB30_for_SC_CAN_V3_2_9950a83a_Rx: DynamicLength=false, PduLength=8
        HUT_FD4_oB30_for_SC_CAN_V3_2_2aa0b500_Tx: DynamicLength=false, PduLength=64
        HCU_HP5_oB30_for_SC_CAN_V3_2_5ba6c8f4_Rx: DynamicLength=false, PduLength=8
        BLE5_oB30_for_SC_CAN_V3_2_dbc1c4b5_Rx: DynamicLength=false, PduLength=8
        T_BOX_FD10_oB30_for_SC_CAN_V3_2_fbbdad00_Rx: DynamicLength=false, PduLength=64
        BCM7_oB30_for_SC_CAN_V3_2_70407cea_Rx: DynamicLength=false, PduLength=8, SysTPduToFrameMappingRef=BCM7
        SCM1_oB30_for_SC_CAN_V3_2_baaa6d95_Rx: DynamicLength=false, PduLength=8, SysTPduToFrameMappingRef=SCM1
        AC14_oB30_for_SC_CAN_V3_2_a43f90b0_Rx: DynamicLength=false, PduLength=8, SysTPduToFrameMappingRef=AC14
        GW_OTA_oB30_for_SC_CAN_V3_2_cf261bba_Rx: DynamicLength=false, PduLength=8
        BLE5_oB30_for_SC_CAN_V3_2_2494e86b_Rx: DynamicLength=false, PduLength=8, SysTPduToFrameMappingRef=BLE5
        T_BOX_FD10_oB30_for_SC_CAN_V3_2_964515ff_Rx: DynamicLength=false, PduLength=64, SysTPduToFrameMappingRef=T_BOX_FD10
        BLE1_oB30_for_SC_CAN_V3_2_876057b5_Rx: DynamicLength=false, PduLength=8
        HAP_FD7_oB30_for_SC_CAN_V3_2_06794e8e_Rx: DynamicLength=false, PduLength=64
        GW_OTA_oB30_for_SC_CAN_V3_2_0f39012b_Rx: DynamicLength=false, PduLength=8, SysTPduToFrameMappingRef=GW_OTA
        BCM7_oB30_for_SC_CAN_V3_2_163d45da_Rx: DynamicLength=false, PduLength=8
        HAP_FD7_oB30_for_SC_CAN_V3_2_b196d90e_Rx: DynamicLength=false, PduLength=64, SysTPduToFrameMappingRef=HAP_FD7
        AC14_oB30_for_SC_CAN_V3_2_1c102f98_Rx: DynamicLength=false, PduLength=8
        HCU_HP5_oB30_for_SC_CAN_V3_2_a400603a_Rx: DynamicLength=false, PduLength=8, SysTPduToFrameMappingRef=HCU_HP5
        HUT27_oB30_for_SC_CAN_V3_2_f0487927_Tx: DynamicLength=false, PduLength=8, SysTPduToFrameMappingRef=HUT27
        R_PBOX1_Sc_oB30_for_SC_CAN_V3_2_4d1c68c6_Rx: DynamicLength=false, PduLength=16, SysTPduToFrameMappingRef=R_PBOX1_Sc
        DCT_FD4_oB30_for_SC_CAN_V3_2_207dfaa4_Rx: DynamicLength=false, PduLength=64, SysTPduToFrameMappingRef=DCT_FD4
        HUT27_oB30_for_SC_CAN_V3_2_8cd810d8_Tx: DynamicLength=false, PduLength=8
        RFCM_R1_oB30_for_SC_CAN_V3_2_e349f4ab_Rx: DynamicLength=false, PduLength=8
        OBC2_oB30_for_SC_CAN_V3_2_07ff5dad_Rx: DynamicLength=false, PduLength=8, SysTPduToFrameMappingRef=OBC2
        OBC2_oB30_for_SC_CAN_V3_2_43dfaf23_Rx: DynamicLength=false, PduLength=8
        F_PBOX1_oB30_for_SC_CAN_V3_2_d5db6bdb_Rx: DynamicLength=false, PduLength=8, SysTPduToFrameMappingRef=F_PBOX1
        HCM_L1_oB30_for_SC_CAN_V3_2_02400631_Rx: DynamicLength=false, PduLength=8
        RFCM_R1_oB30_for_SC_CAN_V3_2_9c1b42b1_Rx: DynamicLength=false, PduLength=8, SysTPduToFrameMappingRef=RFCM_R1
        ETC4_oB30_for_SC_CAN_V3_2_42156d24_Rx: DynamicLength=false, PduLength=8
        HUT49_oB30_for_SC_CAN_V3_2_aaa01e22_Tx: DynamicLength=false, PduLength=8
        ALS1_oB30_for_SC_CAN_V3_2_5e3515d0_Rx: DynamicLength=false, PduLength=16
        BMS35_oB30_for_SC_CAN_V3_2_edee5dfa_Rx: DynamicLength=false, PduLength=8, SysTPduToFrameMappingRef=BMS35
        OBC1_oB30_for_SC_CAN_V3_2_7aa70263_Rx: DynamicLength=false, PduLength=8
        ETC2_oB30_for_SC_CAN_V3_2_5474f9a2_Rx: DynamicLength=false, PduLength=8, SysTPduToFrameMappingRef=ETC2
        ETC3_oB30_for_SC_CAN_V3_2_27cc5364_Rx: DynamicLength=false, PduLength=8
        R_PBOX1_oB30_for_SC_CAN_V3_2_3929a458_Rx: DynamicLength=false, PduLength=8
        BMS35_oB30_for_SC_CAN_V3_2_3c9cd6f1_Rx: DynamicLength=false, PduLength=8
        HCM_R1_oB30_for_SC_CAN_V3_2_ee41b121_Rx: DynamicLength=false, PduLength=8
        HUT49_oB30_for_SC_CAN_V3_2_69c4d73c_Tx: DynamicLength=false, PduLength=8, SysTPduToFrameMappingRef=HUT49
        HCM_R1_oB30_for_SC_CAN_V3_2_2995cda3_Rx: DynamicLength=false, PduLength=8, SysTPduToFrameMappingRef=HCM_R1
        F_PBOX1_oB30_for_SC_CAN_V3_2_24a181fc_Rx: DynamicLength=false, PduLength=8
        HCM_L1_oB30_for_SC_CAN_V3_2_54b1f0b3_Rx: DynamicLength=false, PduLength=8, SysTPduToFrameMappingRef=HCM_L1
        HCM_R2_oB30_for_SC_CAN_V3_2_d7391c61_Rx: DynamicLength=false, PduLength=8
        HCM_L2_oB30_for_SC_CAN_V3_2_3b38ab71_Rx: DynamicLength=false, PduLength=8
        RFCM_L1_oB30_for_SC_CAN_V3_2_0f4843bb_Rx: DynamicLength=false, PduLength=8
        HCM_R2_oB30_for_SC_CAN_V3_2_aca7df57_Rx: DynamicLength=false, PduLength=8, SysTPduToFrameMappingRef=HCM_R2
        ETC2_oB30_for_SC_CAN_V3_2_30e437a4_Rx: DynamicLength=false, PduLength=8
        OBC1_oB30_for_SC_CAN_V3_2_82cd4f59_Rx: DynamicLength=false, PduLength=8, SysTPduToFrameMappingRef=OBC1
        ETC3_oB30_for_SC_CAN_V3_2_9e4a0a31_Rx: DynamicLength=false, PduLength=8, SysTPduToFrameMappingRef=ETC3
        ETC4_oB30_for_SC_CAN_V3_2_8561da0b_Rx: DynamicLength=false, PduLength=8, SysTPduToFrameMappingRef=ETC4
        R_PBOX1_Sc_oB30_for_SC_CAN_V3_2_1bc17110_Rx: DynamicLength=false, PduLength=16
        RFCM_L1_oB30_for_SC_CAN_V3_2_e13f7fa1_Rx: DynamicLength=false, PduLength=8, SysTPduToFrameMappingRef=RFCM_L1
        ALS1_oB30_for_SC_CAN_V3_2_3dc20185_Rx: DynamicLength=false, PduLength=16, SysTPduToFrameMappingRef=ALS1
        HCM_L2_oB30_for_SC_CAN_V3_2_d183e247_Rx: DynamicLength=false, PduLength=8, SysTPduToFrameMappingRef=HCM_L2
        ZCluster_Debug_Msg_0x7AB_Tx: PduLength=64
        ZCluster_Debug_Msg_0x7AC_Tx: PduLength=64
        ZCluster_Debug_Msg_0x7AD_Tx: PduLength=64
        ZCluster_Debug_Msg_0x7AE_Tx: PduLength=64
        ZCluster_Debug_Msg_0x7AF_Tx: PduLength=64
        BCM19_oB30_for_SC_CAN_V3_2_521668ae_Rx: DynamicLength=false, PduLength=8, SysTPduToFrameMappingRef=BCM19
        VMDR1_oB30_for_SC_CAN_V3_2_01b65f56_Rx: DynamicLength=false, PduLength=8, SysTPduToFrameMappingRef=VMDR1
        VMDR1_oB30_for_SC_CAN_V3_2_32d43f61_Rx: DynamicLength=false, PduLength=8
        GLO_NASS1_oB30_for_SC_CAN_V3_2_96a1bccc_Rx: DynamicLength=false, PduLength=8
        GLO_NASS1_oB30_for_SC_CAN_V3_2_c0d601c5_Rx: DynamicLength=false, PduLength=8, SysTPduToFrameMappingRef=GLO_NASS1
        BCM19_oB30_for_SC_CAN_V3_2_6e635eda_Rx: DynamicLength=false, PduLength=8
    EcucGeneral:
      CPUType = CPU32Bit
      SizeOfInt = Size32Bit
      ByteOrder = LITTLE_ENDIAN
      BitOrder = LSB_to_MSB
      AtomicBitAccessInBitfield = false
      AtomicVariableAccess = Atomic32BitAccess
      SizeOfEnum = Size32Bit
      SizeOfROMPointer = Size32Bit
      SizeOfRAMPointer = Size32Bit
      BitFieldDataType = INT
      StructAlignment = Auto
      ArrayAlignment = Auto
      StructInArrayAlignment = Auto
      DummyFunction = false
      EcuCSafeBswChecks = false
      DummyStatement = true
      DummyStatementKind = SelfAssignment
      ConditionalGenerating = true
      EcucBswImplementationCodeType = EcuCSourceCode
      EcuCUseStdReturnTypeForRte = false
      BswInitialization
        71 x InitFunction:
          BswM_Init: Header=BswM.h, InitPhase=NO_INIT, ConfigType=BswM_ConfigType, ConfigPtrName=BswM_Config_Ptr, ConfigPtrClass=BSWM_INIT_DATA, ModuleRef=BswM  # /ActiveEcuC/BswM PLAIN_TEXT Init function description of BswM in UnfilteredViewInInvariantProject (UnfilteredInvariantProjectModelView) .
          BswM_PreInit: Header=BswM.h, InitPhase=INIT_ONE, ConfigType=BswM_ConfigType, ConfigPtrName=BswM_Config_Ptr, ConfigPtrClass=BSWM_INIT_DATA, ModuleRef=BswM  # /ActiveEcuC/BswM PLAIN_TEXT PreInit function description of BswM in UnfilteredViewInInvariantProject (UnfilteredInvariantProjectModelView) .
          BswM_InitMemory: Header=BswM.h, InitPhase=INIT_MEMORY, ModuleRef=BswM  # /ActiveEcuC/BswM PLAIN_TEXT InitMemory function description of BswM in UnfilteredViewInInvariantProject (UnfilteredInvariantProjectModelView) .
          CanIf_Init: Header=CanIf.h, InitPhase=INIT_TWO_IF, ConfigType=CanIf_ConfigType, ConfigPtrName=CanIf_Config_Ptr, ConfigPtrClass=CANIF_INIT_DATA, ModuleRef=CanIf  # /ActiveEcuC/CanIf PLAIN_TEXT Init function description of CanIf in UnfilteredViewInInvariantProject (UnfilteredInvariantProjectModelView) .
          CanIf_InitMemory: Header=CanIf.h, InitPhase=INIT_MEMORY, ModuleRef=CanIf  # /ActiveEcuC/CanIf PLAIN_TEXT InitMemory function description of CanIf in UnfilteredViewInInvariantProject (UnfilteredInvariantProjectModelView) .
          CanNm_Init: Header=CanNm.h, InitPhase=INIT_TWO_NM, ConfigType=CanNm_ConfigType, ConfigPtrName=CanNm_Config_Ptr, ConfigPtrClass=CANNM_INIT_DATA, ModuleRef=CanNm  # /ActiveEcuC/CanNm PLAIN_TEXT Init function description of CanNm in UnfilteredViewInInvariantProject (UnfilteredInvariantProjectModelView) .
          CanNm_InitMemory: Header=CanNm.h, InitPhase=INIT_MEMORY, ModuleRef=CanNm  # /ActiveEcuC/CanNm PLAIN_TEXT InitMemory function description of CanNm in UnfilteredViewInInvariantProject (UnfilteredInvariantProjectModelView) .
          CanSM_InitMemory: Header=CanSM_EcuM.h, InitPhase=INIT_MEMORY, ModuleRef=CanSM  # /ActiveEcuC/CanSM PLAIN_TEXT InitMemory function description of CanSM in UnfilteredViewInInvariantProject (UnfilteredInvariantProjectModelView) .
          CanSM_Init: Header=CanSM_EcuM.h, InitPhase=INIT_TWO_SM, ConfigType=CanSM_ConfigType, ConfigPtrName=CanSM_Config_Ptr, ConfigPtrClass=CANSM_INIT_DATA, ModuleRef=CanSM  # /ActiveEcuC/CanSM PLAIN_TEXT Init function description of CanSM in UnfilteredViewInInvariantProject (UnfilteredInvariantProjectModelView) .
          CanTp_InitMemory: Header=CanTp.h, InitPhase=INIT_MEMORY, ModuleRef=CanTp  # /ActiveEcuC/CanTp PLAIN_TEXT InitMemory function description of CanTp in UnfilteredViewInInvariantProject (UnfilteredInvariantProjectModelView) .
          CanTp_Init: Header=CanTp.h, InitPhase=INIT_TWO_TP, ConfigType=CanTp_ConfigType, ConfigPtrName=CanTp_Config_Ptr, ConfigPtrClass=CANTP_INIT_DATA, ModuleRef=CanTp  # /ActiveEcuC/CanTp PLAIN_TEXT Init function description of CanTp in UnfilteredViewInInvariantProject (UnfilteredInvariantProjectModelView) .
          Can_Init: Header=Can.h, InitPhase=INIT_TWO_DRV, ConfigType=Can_ConfigType, ConfigPtrName=Can_Config_Ptr, ConfigPtrClass=CAN_INIT_DATA, ModuleRef=Can  # /ActiveEcuC/Can PLAIN_TEXT Init function description of Can in UnfilteredViewInInvariantProject (UnfilteredInvariantProjectModelView) .
          Can_InitMemory: Header=Can.h, InitPhase=INIT_MEMORY, ModuleRef=Can  # /ActiveEcuC/Can PLAIN_TEXT InitMemory function description of Can in UnfilteredViewInInvariantProject (UnfilteredInvariantProjectModelView) .
          ComM_Init: Header=ComM.h, InitPhase=INIT_TWO_POST_NVMREADALL, ModuleRef=ComM  # /ActiveEcuC/ComM PLAIN_TEXT Init function description of ComM
          ComM_InitMemory: Header=ComM.h, InitPhase=INIT_MEMORY, ModuleRef=ComM  # /ActiveEcuC/ComM PLAIN_TEXT Initializes variables of Communication Manager
          Com_Init: Header=Com.h, InitPhase=INIT_TWO_COM, ConfigType=Com_ConfigType, ConfigPtrName=Com_Config_Ptr, ConfigPtrClass=COM_INIT_DATA, ModuleRef=Com  # /ActiveEcuC/Com PLAIN_TEXT Init function description of Com in UnfilteredViewInInvariantProject (UnfilteredInvariantProjectModelView) .
          Com_InitMemory: Header=Com.h, InitPhase=INIT_MEMORY, ModuleRef=Com  # /ActiveEcuC/Com PLAIN_TEXT InitMemory function description of Com in UnfilteredViewInInvariantProject (UnfilteredInvariantProjectModelView) .
          Dcm_InitMemory: Header=Dcm.h, InitPhase=INIT_MEMORY, ModuleRef=Dcm  # /ActiveEcuC/Dcm PLAIN_TEXT Dcm_InitMemory function description
          Dcm_Init: Header=Dcm.h, InitPhase=INIT_TWO_POST_NVMREADALL, ConfigType=Dcm_ConfigType, ConfigPtrName=NULL_PTR, ConfigPtrClass=DCM_CONST, ModuleRef=Dcm  # /ActiveEcuC/Dcm PLAIN_TEXT Dcm_Init function description
          Det_Init: Header=Det.h, InitPhase=INIT_ZERO, ConfigType=Det_ConfigType, ConfigPtrName=Det_Config_Ptr, ConfigPtrClass=DET_INIT_DATA, ModuleRef=Det  # /ActiveEcuC/Det PLAIN_TEXT Init function description of Det in UnfilteredViewInInvariantProject (UnfilteredInvariantProjectModelView) .
          Det_InitMemory: Header=Det.h, InitPhase=INIT_MEMORY, ModuleRef=Det  # /ActiveEcuC/Det PLAIN_TEXT InitMemory function description of Det in UnfilteredViewInInvariantProject (UnfilteredInvariantProjectModelView) .
          EcuM_Init: Header=EcuM.h, InitPhase=NO_INIT, ConfigType=EcuM_PbConfigType, ConfigPtrName=EcuM_Config_Ptr, ConfigPtrClass=ECUM_INIT_DATA, ModuleRef=EcuM  # /ActiveEcuC/EcuM PLAIN_TEXT Init function description of EcuM in UnfilteredViewInInvariantProject (UnfilteredInvariantProjectModelView) .
          LinTrcv_30_Tle7259_Init: Header=LinTrcv_30_Tle7259.h, InitPhase=INIT_TWO_TRCV, ConfigType=LinTrcv_30_Tle7259_ConfigType, ConfigPtrName=LinTrcv_30_Tle7259_Config_Ptr, ConfigPtrClass=LINTRCV_30_TLE7259_INIT_DATA, ModuleRef=LinTrcv  # /ActiveEcuC/LinTrcv PLAIN_TEXT Init function description of LinTrcv_30_Tle7259 in UnfilteredViewInInvariantProject (UnfilteredInvariantProjectModelView) .
          LinTrcv_30_Tle7259_InitMemory: Header=LinTrcv_30_Tle7259.h, InitPhase=INIT_MEMORY, ModuleRef=LinTrcv  # /ActiveEcuC/LinTrcv PLAIN_TEXT InitMemory function description of LinTrcv_30_Tle7259 in UnfilteredViewInInvariantProject (UnfilteredInvariantProjectModelView) .
          Lin_InitMemory: Header=Lin.h, InitPhase=INIT_MEMORY, ModuleRef=Lin  # /ActiveEcuC/Lin PLAIN_TEXT InitMemory function description of Lin in UnfilteredViewInInvariantProject (UnfilteredInvariantProjectModelView) .
          Lin_Init: Header=Lin.h, InitPhase=INIT_TWO_DRV, ConfigType=Lin_ConfigType, ConfigPtrName=Lin_Config_Ptr, ConfigPtrClass=LIN_INIT_DATA, ModuleRef=Lin  # /ActiveEcuC/Lin PLAIN_TEXT Init function description of Lin in UnfilteredViewInInvariantProject (UnfilteredInvariantProjectModelView) .
          Mcu_Init: Header=Mcu.h, InitPhase=INIT_ONE_EARLY, ConfigType=Mcu_ConfigType, ConfigPtrName=McuModuleConfiguration, ConfigPtrClass=MCU_APPL_CONST, AdditionalInitCode=Mcu_InitClock(0);while (MCU_PLL_LOCKED != Mcu_GetPllStatus());Mcu_DistributePllClock();, ModuleRef=Mcu  # /ActiveEcuC/Mcu PLAIN_TEXT Created Mcu_Init by Extended Init XML Service
          Nm_Init: Header=Nm.h, InitPhase=INIT_TWO_NM, ModuleRef=Nm  # /ActiveEcuC/Nm PLAIN_TEXT Initialization of the Network Management and its internal state machine
          Nm_InitMemory: Header=Nm.h, InitPhase=INIT_MEMORY, ModuleRef=Nm  # /ActiveEcuC/Nm PLAIN_TEXT Pre-Initialization of the Network Management and its internal state machine
          PduR_InitMemory: Header=PduR.h, InitPhase=INIT_MEMORY, ModuleRef=PduR  # /ActiveEcuC/PduR PLAIN_TEXT InitMemory function description of PduR in UnfilteredViewInInvariantProject (UnfilteredInvariantProjectModelView) .
          PduR_Init: Header=PduR.h, InitPhase=INIT_TWO_COM, ConfigType=PduR_PBConfigType, ConfigPtrName=PduR_Config_Ptr, ConfigPtrClass=PDUR_INIT_DATA, ModuleRef=PduR  # /ActiveEcuC/PduR PLAIN_TEXT Init function description of PduR in UnfilteredViewInInvariantProject (UnfilteredInvariantProjectModelView) .
          PduR_PreInit: Header=PduR.h, InitPhase=INIT_ONE, ConfigType=PduR_PBConfigType, ConfigPtrName=PduR_Config_Ptr, ConfigPtrClass=PDUR_INIT_DATA, ModuleRef=PduR  # /ActiveEcuC/PduR PLAIN_TEXT PreInit function description of PduR in UnfilteredViewInInvariantProject (UnfilteredInvariantProjectModelView) .
          SchM_Init: Header=Rte_Main.h, InitPhase=NO_INIT, ModuleRef=Rte  # /ActiveEcuC/Rte PLAIN_TEXT Automatically generated by EcuCBswInitFctConfigurationService.
          Rte_StartTiming: Header=Rte_Main.h, InitPhase=NO_INIT, ModuleRef=Rte  # /ActiveEcuC/Rte PLAIN_TEXT Automatically generated by EcuCBswInitFctConfigurationService.
          Rte_InitMemory: Header=Rte_Main.h, InitPhase=INIT_MEMORY, ModuleRef=Rte  # /ActiveEcuC/Rte PLAIN_TEXT Automatically generated by EcuCBswInitFctConfigurationService.
          Rte_Start: Header=Rte_Main.h, InitPhase=INIT_THREE, ModuleRef=Rte  # /ActiveEcuC/Rte PLAIN_TEXT Automatically generated by EcuCBswInitFctConfigurationService.
          Dio_Init: Header=Dio.h, InitPhase=NO_INIT, ModuleRef=Dio  # /ActiveEcuC/Dio PLAIN_TEXT Created Dio_Init by Extended Init XML Service
          Fee_30_SmallSector_Init: Header=Fee_30_SmallSector.h, InitPhase=INIT_TWO_IF, ModuleRef=Fee  # /ActiveEcuC/Fee PLAIN_TEXT Initialization of Small Sector FEE
          Fls_Init: Header=Fls.h, InitPhase=INIT_ONE_LATE, ConfigType=Fls_ConfigType, ConfigPtrName=FlsConfigSet, ConfigPtrClass=FLS_APPL_CONST, ModuleRef=Fls  # /ActiveEcuC/Fls PLAIN_TEXT Created Fls_Init by Extended Init XML Service
          Port_Init: Header=Port.h, InitPhase=INIT_ONE_EARLY, ConfigType=Port_ConfigType, ConfigPtrName=PortConfig_Normal, ConfigPtrClass=PORT_APPL_CONST, ModuleRef=Port  # /ActiveEcuC/Port PLAIN_TEXT Created Port_Init by Extended Init XML Service
          NvM_Init: Header=NvM.h, InitPhase=INIT_TWO_SYS, ModuleRef=NvM  # /ActiveEcuC/NvM PLAIN_TEXT Initialization of the NVRAM Manager, to make it ready for NvM_ReadAll being requested
          Brs_Init: Header=, InitPhase=NO_INIT, ModuleRef=vBRS  # /ActiveEcuC/vBRS PLAIN_TEXT Automatically generated by EcuCBswInitFctConfigurationService.
          vBaseEnv_Init: Header=, InitPhase=NO_INIT, ModuleRef=vBaseEnv  # /ActiveEcuC/vBaseEnv PLAIN_TEXT Created vBaseEnv_Init by Extended Init XML Service
          vLinkGen_Init: Header=vLinkGen_Lcfg.h, InitPhase=NO_INIT, ModuleRef=vLinkGen  # /ActiveEcuC/vLinkGen PLAIN_TEXT Dummy initialization of the vLinkGen
          Dem_InitMemory: Header=Dem.h, InitPhase=INIT_MEMORY, ModuleRef=Dem  # /ActiveEcuC/Dem PLAIN_TEXT InitMemory function description of Dem in UnfilteredViewInInvariantProject (UnfilteredInvariantProjectModelView) .
          Dem_Init: Header=Dem.h, InitPhase=INIT_TWO_POST_NVMREADALL, ConfigType=Dem_ConfigType, ConfigPtrName=Dem_Config_Ptr, ConfigPtrClass=DEM_INIT_DATA, ModuleRef=Dem  # /ActiveEcuC/Dem PLAIN_TEXT Init function description of Dem in UnfilteredViewInInvariantProject (UnfilteredInvariantProjectModelView) .
          Dem_PreInit: Header=Dem.h, InitPhase=INIT_ZERO, ConfigType=Dem_ConfigType, ConfigPtrName=Dem_Config_Ptr, ConfigPtrClass=DEM_INIT_DATA, ModuleRef=Dem  # /ActiveEcuC/Dem PLAIN_TEXT PreInit function description of Dem in UnfilteredViewInInvariantProject (UnfilteredInvariantProjectModelView) .
          MemIf_Init: Header=MemIf.h, InitPhase=INIT_TWO_POST_NVMREADALL, ModuleRef=MemIf
          BrsHw_EnableHwAccess: Header=BrsHw.h, InitPhase=INIT_ONE_LATE, ModuleRef=vBRS  # /ActiveEcuC/vBRS PLAIN_TEXT Automatically generated by EcuCBswInitFctConfigurationService.
          Adc_Init: Header=Adc.h, InitPhase=INIT_ONE_LATE, ConfigType=Adc_ConfigType, ConfigPtrName=AdcConfigSet0, ConfigPtrClass=ADC_APPL_CONST, ModuleRef=Adc  # /ActiveEcuC/Adc PLAIN_TEXT Created Adc_Init by Extended Init XML Service
          Gpt_Init: Header=Gpt.h, InitPhase=INIT_ONE, ConfigType=Gpt_ConfigType, ConfigPtrName=GptChannelConfigSet0, ConfigPtrClass=GPT_APPL_CONST, ModuleRef=Gpt  # /ActiveEcuC/Gpt PLAIN_TEXT Created Gpt_Init by Extended Init XML Service
          Icu_Init: Header=Icu.h, InitPhase=INIT_ONE_LATE, ConfigType=Icu_ConfigType, ConfigPtrName=IcuConfigSet, ConfigPtrClass=ICU_APPL_CONST, ModuleRef=Icu  # /ActiveEcuC/Icu PLAIN_TEXT Created Icu_Init by Extended Init XML Service
          Pwm_Init: Header=Pwm.h, InitPhase=INIT_ONE, ConfigType=Pwm_ConfigType, ConfigPtrName=PwmChannelConfigSet0, ConfigPtrClass=PWM_APPL_CONST, ModuleRef=Pwm  # /ActiveEcuC/Pwm PLAIN_TEXT Created Pwm_Init by Extended Init XML Service
          Spi_Init: Header=Spi.h, InitPhase=INIT_ONE, ConfigType=Spi_ConfigType, ConfigPtrName=SpiDriver0, ConfigPtrClass=SPI_APPL_CONST, ModuleRef=Spi  # /ActiveEcuC/Spi PLAIN_TEXT Created Spi_Init by Extended Init XML Service
          WdgM_Init: Header=WdgM.h, InitPhase=INIT_TWO_IF, ConfigType=WdgM_ConfigType, ConfigPtrName=&WdgMConfig_Mode0_core0, ConfigPtrClass=WDGM_APPL_CONST, ModuleRef=WdgM  # /ActiveEcuC/WdgM PLAIN_TEXT Initialization of WdgM Module
          Wdg_59_DriverA_Init: Header=Wdg_59_DriverA.h, InitPhase=INIT_ONE, ConfigType=Wdg_59_DriverA_ConfigType, ConfigPtrName=WdgSettingsConfig, ConfigPtrClass=WDG_59_DRIVERA_APPL_CONST, ModuleRef=Wdg  # /ActiveEcuC/Wdg PLAIN_TEXT Created Wdg_59_DriverA_Init by Extended Init XML Service
          CanTrcv_30_Tja1040_Init: Header=CanTrcv_30_Tja1040.h, InitPhase=INIT_TWO_TRCV, ConfigType=CanTrcv_30_Tja1040_ConfigType, ConfigPtrName=CanTrcv_30_Tja1040_Config_Ptr, ConfigPtrClass=CANTRCV_30_TJA1040_INIT_DATA, ModuleRef=CanTrcv  # /ActiveEcuC/CanTrcv PLAIN_TEXT Init function description of CanTrcv_30_Tja1040 in UnfilteredViewInInvariantProject (UnfilteredInvariantProjectModelView) .
          CanTrcv_30_Tja1040_InitMemory: Header=CanTrcv_30_Tja1040.h, InitPhase=INIT_MEMORY, ModuleRef=CanTrcv  # /ActiveEcuC/CanTrcv PLAIN_TEXT InitMemory function description of CanTrcv_30_Tja1040 in UnfilteredViewInInvariantProject (UnfilteredInvariantProjectModelView) .
          CryIf_InitMemory: Header=CryIf.h, InitPhase=INIT_MEMORY, ModuleRef=CryIf  # /ActiveEcuC/CryIf PLAIN_TEXT Initializes variables of the Crypto Interface
          CryIf_Init: Header=CryIf.h, InitPhase=INIT_TWO_IF, ModuleRef=CryIf  # /ActiveEcuC/CryIf PLAIN_TEXT Initializes the Crypto Interface
          Crypto_30_vHsm_Init: Header=Crypto_30_vHsm.h, InitPhase=INIT_TWO_DRV, ModuleRef=Crypto  # /ActiveEcuC/Crypto PLAIN_TEXT Initializes the Crypto Driver
          Crypto_30_vHsm_InitMemory: Header=Crypto_30_vHsm.h, InitPhase=INIT_MEMORY, ModuleRef=Crypto  # /ActiveEcuC/Crypto PLAIN_TEXT Initializes variables of the Crypto Interface
          Csm_Init: Header=Csm.h, InitPhase=INIT_TWO_SYS, ModuleRef=Csm  # /ActiveEcuC/Csm PLAIN_TEXT Initializes the Crypto Service Manager
          Csm_InitMemory: Header=Csm.h, InitPhase=INIT_MEMORY, ModuleRef=Csm  # /ActiveEcuC/Csm PLAIN_TEXT Initializes variables of the Crypto Service Manager
          SecOC_InitMemory: Header=SecOC.h, InitPhase=INIT_MEMORY, ModuleRef=SecOC  # /ActiveEcuC/SecOC PLAIN_TEXT InitMemory function description of SecOC in UnfilteredViewInInvariantProject (UnfilteredInvariantProjectModelView) .
          SecOC_Init: Header=SecOC.h, InitPhase=INIT_TWO_COM, ConfigType=SecOC_ConfigType, ConfigPtrName=SecOC_Config_Ptr, ConfigPtrClass=SECOC_INIT_DATA, ModuleRef=SecOC  # /ActiveEcuC/SecOC PLAIN_TEXT Init function description of SecOC in UnfilteredViewInInvariantProject (UnfilteredInvariantProjectModelView) .
          FvM_Init: Header=FvM.h, InitPhase=INIT_TWO_POST_NVMREADALL, ConfigType=FvM_ConfigType, ConfigPtrName=FvM_Config_Ptr, ConfigPtrClass=FVM_INIT_DATA, ModuleRef=FvM  # /ActiveEcuC/FvM PLAIN_TEXT Init function description of FvM in UnfilteredViewInInvariantProject (UnfilteredInvariantProjectModelView) .
          FvM_InitMemory: Header=FvM.h, InitPhase=INIT_MEMORY, ModuleRef=FvM  # /ActiveEcuC/FvM PLAIN_TEXT InitMemory function description of FvM in UnfilteredViewInInvariantProject (UnfilteredInvariantProjectModelView) .
          CorTst_Init: Header=CorTst.h, InitPhase=INIT_ONE_LATE, ConfigType=CorTst_ConfigType, ConfigPtrName=NULL_PTR, ConfigPtrClass=CORTST_APPL_DATA, ModuleRef=CorTst  # /ActiveEcuC/CorTst PLAIN_TEXT Created CorTst_Init by Extended Init XML Service
          FlsTst_Init: Header=FlsTst.h, InitPhase=INIT_ONE_LATE, ConfigType=FlsTst_ConfigType, ConfigPtrName=FlsTstConfigSet, ConfigPtrClass=FLSTST_APPL_CONST, ModuleRef=FlsTst  # /ActiveEcuC/FlsTst PLAIN_TEXT Created FlsTst_Init by Extended Init XML Service
          RamTst_Init: Header=RamTst.h, InitPhase=INIT_ONE_LATE, ConfigType=RamTst_ConfigType, ConfigPtrName=NULL_PTR, ConfigPtrClass=RAMTST_CONST, ModuleRef=RamTst  # /ActiveEcuC/RamTst PLAIN_TEXT Created RamTst_Init by Extended Init XML Service
    EcucHardware
      EcucCoreDefinition: EcucCoreId=0
    EcucPartitionCollection
      EcucPartition_Trust (EcucPartition): EcucPartitionBswModuleExecution=true, PartitionCanBeRestarted=false, ASIL=D
      EcucPartition_NonTrust (EcucPartition): EcucPartitionBswModuleExecution=false, PartitionCanBeRestarted=false, ASIL=QM
