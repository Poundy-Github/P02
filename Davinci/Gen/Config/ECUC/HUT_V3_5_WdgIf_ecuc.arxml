AUTOSAR XML (schema 00046)
package /ActiveEcuC
  module config WdgIf: implementation-config-variant=VARIANT-PRE-COMPILE, module-description=WdgIf_Impl
    WdgIfDevice:
      WdgIfDeviceIndex = 0
      WdgIfDeviceIncludeFile = SRV_Wdg.h
      WdgIfDeviceSetMode = SRV_Wdg_SetMode
      WdgIfDeviceSetTriggerCondition = SRV_Wdg_SetTriggerCondition
      WdgIfDriverRef = WdgGeneral
    WdgIfGeneral: WdgIfDevErrorDetect=true, WdgIfVersionInfoApi=false, WdgIfUseStateCombiner=false
