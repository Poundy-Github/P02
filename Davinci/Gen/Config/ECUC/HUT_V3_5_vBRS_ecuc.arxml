AUTOSAR XML (schema 00046)
package /ActiveEcuC
  module config vBRS: implementation-config-variant=VARIANT-PRE-COMPILE, module-description=vBRS_Impl
    vBRSHwConfig:
      vBRSOscClock = 24000000
      vBRSPeriphClock = 40000000
      vBRSTimebaseClock = 240000000
      vBRSPeriphClockDescription = Initial value for Peripheral Clock: 40MHz (CPUCLK_L=CPLLOUT/4, with CPLLOUT=TimebaseClock) for OSTM0 timer of OS.
      vBRSEnablePortHandling = false
      vBRSEnableWatchdogHandling = false
      vBRSEnablePLLClocksHandling = false
      6 x vBRSEvalBoardInfo:
        Default: vBRSEvalBoard=DEFAULT, vBRSEvalBoardDescription=DEFAULT - Toggle Port 10 Pin 3
        F1X_064PIN: vBRSEvalBoard=F1X_064PIN, vBRSEvalBoardDescription=Toggle Port 8 Pin 0 TCM: Port 0 Pins 9-12
        F1X_100PIN: vBRSEvalBoard=F1X_100PIN, vBRSEvalBoardDescription=Toggle Port 8 Pin 0 TCM: Port 0 Pins 9-12
        F1X_144PIN: vBRSEvalBoard=F1X_144PIN, vBRSEvalBoardDescription=Toggle Port 8 Pin 0 TCM: Port 0 Pins 9-12
        F1X_176PIN: vBRSEvalBoard=F1X_176PIN, vBRSEvalBoardDescription=Toggle Port 8 Pin 0 TCM: Port 0 Pins 9-12
        F1x_StarterKit_V2: vBRSEvalBoard=F1X_STARTERKIT_V2, vBRSEvalBoardDescription=Toggle Port 0 Pin 11 --> LED1, set CAN0_EN and CAN1_EN to high
      vBRSDriverHandlingCAN:
        vBRSEnableDriverHandlingCAN = true
        vBRSDriverHandlingCAN_channel{0..9} = false
        vBRSDriverHandlingCAN_PeripheralClock = true
      vBRSDriverHandlingLIN:
        vBRSEnableDriverHandlingLIN = true
        vBRSDriverHandlingLIN_channel{0..9} = false
        vBRSDriverHandlingLIN_PeripheralClock = true
        vBRSDriverHandlingLIN_channel{10..22} = false
    vBRSGeneral:
      vBRSEnableSupportLEDs = false
      vBRSEnableSafeContextSupport = true
      vBRSEnableMultiCoreSupport = false
      vBRSEnableSupportToggleWdPin = false
      vBRSEnableSupportToggleCustomPin = false
      vBRSEnableEcuMStubGeneration = false
      vBRSDisableSetupSupport = false
      vBRSEnableSchmStubGeneration = false
      vBRSEnableSchmStubSupportDrvCanAN = true
      vBRSFblSupport = Disabled
      vBRSEnableHSMSupport = false
    vBRSMemoryInit: vBRSInitPatternBlocks=0, vBRSInitPatternHardResetBlocks=0, vBRSInitPatternAreas=0, vBRSInitPatternHardResetAreas=0
