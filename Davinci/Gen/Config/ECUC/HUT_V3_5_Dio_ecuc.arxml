AUTOSAR XML (schema 00046)
package /ActiveEcuC
  module config Dio: implementation-config-variant=VARIANT-LINK-TIME, module-description=Dio_Impl
    DioConfig0 (DioConfig)
      17 x DioPort:
        DioPortAnalog0: DioPortId=15, DioPortName=PORTGROUPANALOG_0_BITS_0_TO_15
        DioPort00: DioPortId=0, DioPortName=PORTGROUP_0_BITS_0_TO_14
          10 x DioChannel:
            VIP_CAN3_STB: DioChannelId=2, DioChannelBitPosition=10
            VIP_Gyro_INT1: DioChannelId=3, DioChannelBitPosition=6
            VIP_ChargeEN_ODH: DioChannelId=1, DioChannelBitPosition=9
            VIP_CAN0_RXD: DioChannelId=4, DioChannelBitPosition=1
            VIP_CAN1_RXD: DioChannelId=6, DioChannelBitPosition=2
            VIP_CAN3_RXD: DioChannelId=9, DioChannelBitPosition=7
            VIP_RLIN31_RXD: DioChannelId=7, DioChannelBitPosition=4
            VIP_RLIN31_TXD: DioChannelId=10, DioChannelBitPosition=5
            VIP_RLIN32_RXD: DioChannelId=11, DioChannelBitPosition=13
            VIP_RLIN32_TXD: DioChannelId=0, DioChannelBitPosition=14
        DioPort01_8To15: DioPortId=2, DioPortName=PORTGROUP_1_BITS_8_TO_15
          6 x DioChannel:
            VIP_CAN1_STB: DioChannelId=0, DioChannelBitPosition=11
            VIP_LVI_IDL: DioChannelId=1, DioChannelBitPosition=9
            VIP_PD_EN_ODH: DioChannelId=2, DioChannelBitPosition=15
            VIP_PWR_VG5V_M_EN: DioChannelId=3, DioChannelBitPosition=8
            VIP_RTC_INT: DioChannelId=4, DioChannelBitPosition=10
            VIP_VG3V3_VIP_EN: DioChannelId=5, DioChannelBitPosition=14
        DioPort02: DioPortId=3, DioPortName=PORTGROUP_2_BITS_0_TO_15
          14 x DioChannel:
            VIP_POC_PWREN: DioChannelId=0, DioChannelBitPosition=6
            VIP_RVC_PWREN: DioChannelId=1, DioChannelBitPosition=7
            VIP_GPS_RST: DioChannelId=2, DioChannelBitPosition=13
            VIP_GPSANT_POWER_EN_3V3: DioChannelId=3, DioChannelBitPosition=8
            VIP_HD_EN_ODH: DioChannelId=4, DioChannelBitPosition=5
            VIP_ID_EN_ODH: DioChannelId=5, DioChannelBitPosition=4
            VIP_PWR_VG10V_EN: DioChannelId=7, DioChannelBitPosition=2
            VIP_PWR_VG3V3_M_EN: DioChannelId=6, DioChannelBitPosition=15
            VIP_PWR_VGBOOST_EN: DioChannelId=8, DioChannelBitPosition=14
            VIP_RLIN31_SLP: DioChannelId=9, DioChannelBitPosition=9
            VIP_RLIN31_WAKE: DioChannelId=10, DioChannelBitPosition=10
            VIP_RLIN32_SLP: DioChannelId=11, DioChannelBitPosition=11
            VIP_RLIN32_WAKE: DioChannelId=12, DioChannelBitPosition=12
            VIP_VG1V8_M_EN: DioChannelId=13, DioChannelBitPosition=3
        DioPort03: DioPortId=4, DioPortName=PORTGROUP_3_BITS_0_TO_0
          VIP_CD_EN_ODH (DioChannel): DioChannelId=0, DioChannelBitPosition=0
        DioPort08: DioPortId=5, DioPortName=PORTGROUP_8_BITS_0_TO_12
          12 x DioChannel:
            SOC_VIP_CSIH1_REQ2: DioChannelId=1, DioChannelBitPosition=0
            SOC_VIP_CSIH2_REQ2: DioChannelId=2, DioChannelBitPosition=1
            VIP_WATCHDOG_WDI: DioChannelId=10, DioChannelBitPosition=11
            VBATT_VIP_DET_EN_3V3: DioChannelId=5, DioChannelBitPosition=2
            VIP_SOC_EDL_3V3: DioChannelId=3, DioChannelBitPosition=3
            PMIC_VIP_PSHOLD: DioChannelId=0, DioChannelBitPosition=4
            VIP_8532_DIAG3: DioChannelId=4, DioChannelBitPosition=5
            VIP_CAN0_STB: DioChannelId=6, DioChannelBitPosition=6
            VIP_Gyro_INT2: DioChannelId=8, DioChannelBitPosition=10
            VIP_WD_enable: DioChannelId=9, DioChannelBitPosition=7
            VIP_GPS_TXD: DioChannelId=7, DioChannelBitPosition=9
            VIP_ON_IDH: DioChannelId=11, DioChannelBitPosition=12
        DioPort09: DioPortId=6, DioPortName=PORTGROUP_9_BITS_0_TO_4
          SXM_VIP_STBY (DioChannel): DioChannelId=0, DioChannelBitPosition=2
          VIP_SOC3 (DioChannel): DioChannelId=2, DioChannelBitPosition=4
        DioPort10: DioPortId=7, DioPortName=PORTGROUP_10_BITS_0_TO_15
          9 x DioChannel:
            VIP_20098_EN: DioChannelId=1, DioChannelBitPosition=12
            VIP_20098_PG: DioChannelId=2, DioChannelBitPosition=13
            VIP_OPL_IDL: DioChannelId=4, DioChannelBitPosition=15
            VIP_SOC_CSIH1_REQ1: DioChannelId=6, DioChannelBitPosition=10
            VIP_SOC_CSIH2_REQ1: DioChannelId=7, DioChannelBitPosition=14
            VIP_SOC_SHUTDOWN: DioChannelId=8, DioChannelBitPosition=4
            VIP_SOC_UPDATA: DioChannelId=9, DioChannelBitPosition=3
            SI479XX_VIP_INT_3V3: DioChannelId=0, DioChannelBitPosition=9
            VIP_MIC_res_key: DioChannelId=3, DioChannelBitPosition=5
        DioPort11: DioPortId=8, DioPortName=PORTGROUP_11_BITS_0_TO_12
          7 x DioChannel:
            VIP_AMP8532_DIAG3: DioChannelId=0, DioChannelBitPosition=1
            VIP_47961_RST_3V3: DioChannelId=2, DioChannelBitPosition=8
            VIP_BSF_IDL: DioChannelId=3, DioChannelBitPosition=0
            VIP_ETN_1V_PWR_EN: DioChannelId=4, DioChannelBitPosition=12
            VIP_MIC_POWER_EN_3V3: DioChannelId=5, DioChannelBitPosition=10
            VIP_TUNER_ANT_EN_3V3: DioChannelId=9, DioChannelBitPosition=11
            SI4624_VIP_INT_3V3: DioChannelId=1, DioChannelBitPosition=9
        DioPort12: DioPortId=10, DioPortName=PORTGROUP_12_BITS_0_TO_5
          3 x DioChannel:
            VIP_479XX_RST_3V3: DioChannelId=1, DioChannelBitPosition=0
            VIP_4624_RST_3V3: DioChannelId=2, DioChannelBitPosition=1
            VIP_469X_RST_3V3: DioChannelId=0, DioChannelBitPosition=2
        DioPort13: DioPortId=11, DioPortName=PORTGROUP_13_BITS_0_TO_7
          7 x DioChannel:
            VIP_A2BPWR_EN: DioChannelId=0, DioChannelBitPosition=2
            VIP_PMIC_CBL: DioChannelId=1, DioChannelBitPosition=5
            VIP_PMIC_KPD: DioChannelId=2, DioChannelBitPosition=6
            VIP_PMIC_RST: DioChannelId=3, DioChannelBitPosition=7
            VIP_SDARS_RST_3V3: DioChannelId=4, DioChannelBitPosition=1
            VIP_SDARS_SHDN_3V3: DioChannelId=5, DioChannelBitPosition=0
            VIP_SWITCH_SPI_EN: DioChannelId=7, DioChannelBitPosition=3
        DioPort18: DioPortId=12, DioPortName=PORTGROUP_18_BITS_0_TO_15
          11 x DioChannel:
            SOC_VIP_FAST_BOOT: DioChannelId=0, DioChannelBitPosition=0
            VIP_AMP8531_DIAG1: DioChannelId=1, DioChannelBitPosition=10
            VIP_AMP8531_DIAG2: DioChannelId=2, DioChannelBitPosition=11
            VIP_AMP8531_EN: DioChannelId=4, DioChannelBitPosition=13
            VIP_AMP8531_MUTE: DioChannelId=5, DioChannelBitPosition=4
            VIP_AMP8532_DIAG1: DioChannelId=6, DioChannelBitPosition=5
            VIP_AMP8532_DIAG2: DioChannelId=7, DioChannelBitPosition=6
            VIP_AMP8532_EN: DioChannelId=9, DioChannelBitPosition=8
            VIP_AMP8532_MUTE: DioChannelId=10, DioChannelBitPosition=9
            VIP_DSP_REST_3V3: DioChannelId=11, DioChannelBitPosition=15
            VIP_DSP_SELE: DioChannelId=12, DioChannelBitPosition=14
        DioPort19: DioPortId=13, DioPortName=PORTGROUP_19_BITS_0_TO_3
          4 x DioChannel:
            VIP_ADC_M_REST: DioChannelId=1, DioChannelBitPosition=0
            VIP_REVERSE_IRQ: DioChannelId=2, DioChannelBitPosition=3
            VIP_RTC_FEN: DioChannelId=3, DioChannelBitPosition=1
            A2B_VIP_INT: DioChannelId=0, DioChannelBitPosition=2
        DioPort20: DioPortId=14, DioPortName=PORTGROUP_20_BITS_0_TO_5
          6 x DioChannel:
            PMIC_VIP_FAULT: DioChannelId=0, DioChannelBitPosition=0
            VIP_USB1_CTRL2: DioChannelId=1, DioChannelBitPosition=1
            VIP_TM_IDL: DioChannelId=2, DioChannelBitPosition=2
            VIP_USB1_CTRL1: DioChannelId=3, DioChannelBitPosition=5
            VIP_USB1_EN: DioChannelId=4, DioChannelBitPosition=4
            VIP_USB1_FAULT_N: DioChannelId=5, DioChannelBitPosition=3
        DioPortAnalog1: DioPortId=16, DioPortName=PORTGROUPANALOG_1_BITS_0_TO_15
          6 x DioChannel:
            SXM_VIP_FACT: DioChannelId=4, DioChannelBitPosition=13
            SXM_VIP_CTI: DioChannelId=5, DioChannelBitPosition=12
            Tuner_VIP_debug1: DioChannelId=0, DioChannelBitPosition=14
            Tuner_VIP_debug2: DioChannelId=1, DioChannelBitPosition=15
            VIP_ETN_0_9V_EN: DioChannelId=2, DioChannelBitPosition=10
            VIP_ETN_2_5V_EN: DioChannelId=3, DioChannelBitPosition=11
        DioPort01_0To5: DioPortId=1, DioPortName=PORTGROUP_1_BITS_0_TO_5
          3 x DioChannel:
            VIP_RLIN31_INH: DioChannelId=0, DioChannelBitPosition=1
            VIP_RLIN32_INH: DioChannelId=1, DioChannelBitPosition=3
            VIP_SI_IDH: DioChannelId=2, DioChannelBitPosition=0
        DioPort11_15To15: DioPortId=9, DioPortName=PORTGROUP_11_BITS_15_TO_15
          VIP_VG1V2_EN (DioChannel): DioChannelId=0, DioChannelBitPosition=15
    DioGeneral0 (DioGeneral):
      DioDevErrorDetect = false
      DioFlipChannelApi = false
      DioVersionInfoApi = false
      DioVersionCheckExternalModules = false
      DioCriticalSectionProtection = true
      DioDeviceName = R7F701651
      DioWriteVerify = WV_DISABLE
      DioRAMMirror = DISABLE
      DioUseWriteVerifyErrorInterface = false
      DioWriteVerifyErrorInterface = NULL
      DioMaskedWritePortApi = false
      DioReadChannelGroupOutputValueApi = false
      DioReadChannelOutputValueApi = false
