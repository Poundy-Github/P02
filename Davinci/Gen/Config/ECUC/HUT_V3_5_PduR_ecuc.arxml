AUTOSAR XML (schema 00046)
package /ActiveEcuC
  module config PduR: implementation-config-variant=VARIANT-PRE-COMPILE, module-description=PduR_Impl
    PduRGeneral:
      PduRDevErrorDetect = true
      PduRVersionInfoApi = false
      PduRMetaDataSupport = false
      PduRPduCallback = false
      PduRSwitching = false
      PduRSafeBswChecks = false
      PduREnableDeferredTransmission = false
      PduREnableDeferredReception = false
      PduRSupportMulticore = false
      PduRRoutingTypeGateway = false
      PduRSpinlockRetryCounter = 4294967295
      PduRExtendedErrorChecks = false
      PduRGeneration:
        PduROutOfBoundsWriteProtectionStrategy = NONE
        PduROutOfBoundsWriteSanitizer = false
        PduROutOfBoundsReadSanitizer = false
        PduRNumericalDataTypeMinimizationStrategy = WITH_CAST
        PduRReduceConstantData2Define = false
        PduRBoolDataInArrayOfStructStrategy = BITMASKING
        PduRDeduplicateIndirectedData = true
        PduRDataDeduplicationStrategy = WITH_CAST
        PduRReduceBoolDataByNegationThreshold = 2
        PduRReduceBoolDataByNumericalComparisonThreshold = 2
        PduRReduceBoolDataByNumericalRelationThreshold = 2
        PduRReduceBoolDataByNumericalOperandStrategy = WITH_ANY_VALUE
        PduRReduceNumericalDataByOffsetThreshold = 2
        PduRReduceNumericalDataByArraySubtractionThreshold = 2
        PduRReduceDataByStreaming = false
        PduRShortSymbols = false
        PduRInterfacesForDeactivatedData = false
        PduRReferringKeysInComments = false
    PduRRoutingTables: PduRConfigurationId=0
      PduRRoutingTable
        218 x PduRRoutingPath, all with PduRMulticoreRoutingPath=false, PduRLockRef=PduRLock_PduRExclusiveArea:
          AC2_oB30_for_SC_CAN_V3_2_b771a69a_Rx: PduRRoutingPathCommunicationType=COMMUNICATION_INTERFACE
            PduRSrcPdu_889f2060 (PduRSrcPdu): PduRSourcePduHandleId=6, PduRSrcPduDirection=RECEIVE, PduRSrcPduRef=AC2_oB30_for_SC_CAN_V3_2_b771a69a_Rx, PduRSrcPduPduRBswModulesRef=CanIf
            AC2_oB30_for_SC_CAN_V3_2_b771a69a_Rx_889f2060_Rx (PduRDestPdu):
              PduRDestPduHandleId = 6
              PduRDestPduDirection = RECEIVE
              PduRDestPduRoutingType = API_FORWARDING
              PduRDestPduDataProcessing = IMMEDIATE
              PduRPduLengthHandlingStrategy = IGNORE
              PduRTransmissionConfirmation = false
              PduRDestPduRef = AC2_oB30_for_SC_CAN_V3_2_b771a69a_Rx
              PduRDestPduPduRBswModulesRef = Com
          HUT19_oB30_for_SC_CAN_V3_2_318f5565_Tx: PduRRoutingPathCommunicationType=COMMUNICATION_INTERFACE
            HUT19_oB30_for_SC_CAN_V3_2_7c4add44_Tx (PduRDestPdu):
              PduRDestPduHandleId = 15
              PduRDestPduDirection = TRANSMIT
              PduRDestPduRoutingType = API_FORWARDING
              PduRDestPduDataProcessing = IMMEDIATE
              PduRPduLengthHandlingStrategy = IGNORE
              PduRDestPduDataProvision = PDUR_DIRECT
              PduRTransmissionConfirmation = true
              PduRDestPduRef = HUT19_oB30_for_SC_CAN_V3_2_7c4add44_Tx
              PduRDestPduPduRBswModulesRef = CanIf
            PduRSrcPdu_3a743072 (PduRSrcPdu): PduRSourcePduHandleId=15, PduRSrcPduDirection=TRANSMIT, PduRSrcPduRef=HUT19_oB30_for_SC_CAN_V3_2_7c4add44_Tx, PduRSrcPduPduRBswModulesRef=Com
          CSA3_oB30_for_SC_CAN_V3_2_eb741019_Rx: PduRRoutingPathCommunicationType=COMMUNICATION_INTERFACE
            PduRSrcPdu_9d6b32ca (PduRSrcPdu): PduRSourcePduHandleId=52, PduRSrcPduDirection=RECEIVE, PduRSrcPduRef=CSA3_oB30_for_SC_CAN_V3_2_eb741019_Rx, PduRSrcPduPduRBswModulesRef=CanIf
            CSA3_oB30_for_SC_CAN_V3_2_eb741019_Rx_9d6b32ca_Rx (PduRDestPdu):
              PduRDestPduHandleId = 52
              PduRDestPduDirection = RECEIVE
              PduRDestPduRoutingType = API_FORWARDING
              PduRDestPduDataProcessing = IMMEDIATE
              PduRPduLengthHandlingStrategy = IGNORE
              PduRTransmissionConfirmation = false
              PduRDestPduRef = CSA3_oB30_for_SC_CAN_V3_2_eb741019_Rx
              PduRDestPduPduRBswModulesRef = Com
          ABS2_oB30_for_SC_CAN_V3_2_25753a3c_Rx: PduRRoutingPathCommunicationType=COMMUNICATION_INTERFACE
            PduRSrcPdu_5424b305 (PduRSrcPdu): PduRSourcePduHandleId=4, PduRSrcPduDirection=RECEIVE, PduRSrcPduRef=ABS2_oB30_for_SC_CAN_V3_2_25753a3c_Rx, PduRSrcPduPduRBswModulesRef=CanIf
            ABS2_oB30_for_SC_CAN_V3_2_25753a3c_Rx_5424b305_Rx (PduRDestPdu):
              PduRDestPduHandleId = 4
              PduRDestPduDirection = RECEIVE
              PduRDestPduRoutingType = API_FORWARDING
              PduRDestPduDataProcessing = IMMEDIATE
              PduRPduLengthHandlingStrategy = IGNORE
              PduRTransmissionConfirmation = false
              PduRDestPduRef = ABS2_oB30_for_SC_CAN_V3_2_25753a3c_Rx
              PduRDestPduPduRBswModulesRef = Com
          ECM7_oB30_for_SC_CAN_V3_2_743820e8_Rx: PduRRoutingPathCommunicationType=COMMUNICATION_INTERFACE
            PduRSrcPdu_c2625a73 (PduRSrcPdu): PduRSourcePduHandleId=68, PduRSrcPduDirection=RECEIVE, PduRSrcPduRef=ECM7_oB30_for_SC_CAN_V3_2_743820e8_Rx, PduRSrcPduPduRBswModulesRef=CanIf
            ECM7_oB30_for_SC_CAN_V3_2_743820e8_Rx_c2625a73_Rx (PduRDestPdu):
              PduRDestPduHandleId = 68
              PduRDestPduDirection = RECEIVE
              PduRDestPduRoutingType = API_FORWARDING
              PduRDestPduDataProcessing = IMMEDIATE
              PduRPduLengthHandlingStrategy = IGNORE
              PduRTransmissionConfirmation = false
              PduRDestPduRef = ECM7_oB30_for_SC_CAN_V3_2_743820e8_Rx
              PduRDestPduPduRBswModulesRef = Com
          HCU_HC7_oB30_for_SC_CAN_V3_2_7b235adf_Rx: PduRRoutingPathCommunicationType=COMMUNICATION_INTERFACE
            PduRSrcPdu_41a1d6df (PduRSrcPdu): PduRSourcePduHandleId=108, PduRSrcPduDirection=RECEIVE, PduRSrcPduRef=HCU_HC7_oB30_for_SC_CAN_V3_2_7b235adf_Rx, PduRSrcPduPduRBswModulesRef=CanIf
            HCU_HC7_oB30_for_SC_CAN_V3_2_7b235adf_Rx_41a1d6df_Rx (PduRDestPdu):
              PduRDestPduHandleId = 108
              PduRDestPduDirection = RECEIVE
              PduRDestPduRoutingType = API_FORWARDING
              PduRDestPduDataProcessing = IMMEDIATE
              PduRPduLengthHandlingStrategy = IGNORE
              PduRTransmissionConfirmation = false
              PduRDestPduRef = HCU_HC7_oB30_for_SC_CAN_V3_2_7b235adf_Rx
              PduRDestPduPduRBswModulesRef = Com
          HUT33_oB30_for_SC_CAN_V3_2_4b0a690c_Tx: PduRRoutingPathCommunicationType=COMMUNICATION_INTERFACE
            HUT33_oB30_for_SC_CAN_V3_2_079d47e4_Tx (PduRDestPdu):
              PduRDestPduHandleId = 26
              PduRDestPduDirection = TRANSMIT
              PduRDestPduRoutingType = API_FORWARDING
              PduRDestPduDataProcessing = IMMEDIATE
              PduRPduLengthHandlingStrategy = IGNORE
              PduRDestPduDataProvision = PDUR_DIRECT
              PduRTransmissionConfirmation = true
              PduRDestPduRef = HUT33_oB30_for_SC_CAN_V3_2_079d47e4_Tx
              PduRDestPduPduRBswModulesRef = CanIf
            PduRSrcPdu_2557c8cf (PduRSrcPdu): PduRSourcePduHandleId=26, PduRSrcPduDirection=TRANSMIT, PduRSrcPduRef=HUT33_oB30_for_SC_CAN_V3_2_079d47e4_Tx, PduRSrcPduPduRBswModulesRef=Com
          HUT4_oB30_for_SC_CAN_V3_2_c6c65fa3_Tx: PduRRoutingPathCommunicationType=COMMUNICATION_INTERFACE
            HUT4_oB30_for_SC_CAN_V3_2_1dca0563_Tx (PduRDestPdu):
              PduRDestPduHandleId = 5
              PduRDestPduDirection = TRANSMIT
              PduRDestPduRoutingType = API_FORWARDING
              PduRDestPduDataProcessing = IMMEDIATE
              PduRPduLengthHandlingStrategy = IGNORE
              PduRDestPduDataProvision = PDUR_DIRECT
              PduRTransmissionConfirmation = true
              PduRDestPduRef = HUT4_oB30_for_SC_CAN_V3_2_1dca0563_Tx
              PduRDestPduPduRBswModulesRef = CanIf
            PduRSrcPdu_3fa05c2d (PduRSrcPdu): PduRSourcePduHandleId=5, PduRSrcPduDirection=TRANSMIT, PduRSrcPduRef=HUT4_oB30_for_SC_CAN_V3_2_1dca0563_Tx, PduRSrcPduPduRBswModulesRef=Com
          ECM4_oB30_for_SC_CAN_V3_2_f10a321c_Rx: PduRRoutingPathCommunicationType=COMMUNICATION_INTERFACE
            ECM4_oB30_for_SC_CAN_V3_2_f10a321c_Rx_b939ffb6_Rx (PduRDestPdu):
              PduRDestPduHandleId = 67
              PduRDestPduDirection = RECEIVE
              PduRDestPduRoutingType = API_FORWARDING
              PduRDestPduDataProcessing = IMMEDIATE
              PduRPduLengthHandlingStrategy = IGNORE
              PduRTransmissionConfirmation = false
              PduRDestPduRef = ECM4_oB30_for_SC_CAN_V3_2_f10a321c_Rx
              PduRDestPduPduRBswModulesRef = Com
            PduRSrcPdu_b939ffb6 (PduRSrcPdu): PduRSourcePduHandleId=67, PduRSrcPduDirection=RECEIVE, PduRSrcPduRef=ECM4_oB30_for_SC_CAN_V3_2_f10a321c_Rx, PduRSrcPduPduRBswModulesRef=CanIf
          HUD1_oB30_for_SC_CAN_V3_2_6397ebab_Rx: PduRRoutingPathCommunicationType=COMMUNICATION_INTERFACE
            PduRSrcPdu_9f68183c (PduRSrcPdu): PduRSourcePduHandleId=118, PduRSrcPduDirection=RECEIVE, PduRSrcPduRef=HUD1_oB30_for_SC_CAN_V3_2_6397ebab_Rx, PduRSrcPduPduRBswModulesRef=CanIf
            HUD1_oB30_for_SC_CAN_V3_2_6397ebab_Rx_9f68183c_Rx (PduRDestPdu):
              PduRDestPduHandleId = 118
              PduRDestPduDirection = RECEIVE
              PduRDestPduRoutingType = API_FORWARDING
              PduRDestPduDataProcessing = IMMEDIATE
              PduRPduLengthHandlingStrategy = IGNORE
              PduRTransmissionConfirmation = false
              PduRDestPduRef = HUD1_oB30_for_SC_CAN_V3_2_6397ebab_Rx
              PduRDestPduPduRBswModulesRef = Com
          HUT13_oB30_for_SC_CAN_V3_2_a69cbae5_Tx: PduRRoutingPathCommunicationType=COMMUNICATION_INTERFACE
            HUT13_oB30_for_SC_CAN_V3_2_d404bffe_Tx (PduRDestPdu):
              PduRDestPduHandleId = 10
              PduRDestPduDirection = TRANSMIT
              PduRDestPduRoutingType = API_FORWARDING
              PduRDestPduDataProcessing = IMMEDIATE
              PduRPduLengthHandlingStrategy = IGNORE
              PduRDestPduDataProvision = PDUR_DIRECT
              PduRTransmissionConfirmation = true
              PduRDestPduRef = HUT13_oB30_for_SC_CAN_V3_2_d404bffe_Tx
              PduRDestPduPduRBswModulesRef = CanIf
            PduRSrcPdu_1f585097 (PduRSrcPdu): PduRSourcePduHandleId=10, PduRSrcPduDirection=TRANSMIT, PduRSrcPduRef=HUT13_oB30_for_SC_CAN_V3_2_d404bffe_Tx, PduRSrcPduPduRBswModulesRef=Com
          HUT34_oB30_for_SC_CAN_V3_2_2ed3574c_Tx: PduRRoutingPathCommunicationType=COMMUNICATION_INTERFACE
            HUT34_oB30_for_SC_CAN_V3_2_1cb697de_Tx (PduRDestPdu):
              PduRDestPduHandleId = 27
              PduRDestPduDirection = TRANSMIT
              PduRDestPduRoutingType = API_FORWARDING
              PduRDestPduDataProcessing = IMMEDIATE
              PduRPduLengthHandlingStrategy = IGNORE
              PduRDestPduDataProvision = PDUR_DIRECT
              PduRTransmissionConfirmation = true
              PduRDestPduRef = HUT34_oB30_for_SC_CAN_V3_2_1cb697de_Tx
              PduRDestPduPduRBswModulesRef = CanIf
            PduRSrcPdu_166e979b (PduRSrcPdu): PduRSourcePduHandleId=27, PduRSrcPduDirection=TRANSMIT, PduRSrcPduRef=HUT34_oB30_for_SC_CAN_V3_2_1cb697de_Tx, PduRSrcPduPduRBswModulesRef=Com
          HUT6_oB30_for_SC_CAN_V3_2_e8969623_Tx: PduRRoutingPathCommunicationType=COMMUNICATION_INTERFACE
            HUT6_oB30_for_SC_CAN_V3_2_52c6e404_Tx (PduRDestPdu):
              PduRDestPduHandleId = 6
              PduRDestPduDirection = TRANSMIT
              PduRDestPduRoutingType = API_FORWARDING
              PduRDestPduDataProcessing = IMMEDIATE
              PduRPduLengthHandlingStrategy = IGNORE
              PduRDestPduDataProvision = PDUR_DIRECT
              PduRTransmissionConfirmation = true
              PduRDestPduRef = HUT6_oB30_for_SC_CAN_V3_2_52c6e404_Tx
              PduRDestPduPduRBswModulesRef = CanIf
            PduRSrcPdu_d33918c1 (PduRSrcPdu): PduRSourcePduHandleId=6, PduRSrcPduDirection=TRANSMIT, PduRSrcPduRef=HUT6_oB30_for_SC_CAN_V3_2_52c6e404_Tx, PduRSrcPduPduRBswModulesRef=Com
          AMP3_oB30_for_SC_CAN_V3_2_b64354b4_Rx: PduRRoutingPathCommunicationType=COMMUNICATION_INTERFACE
            PduRSrcPdu_d7346016 (PduRSrcPdu): PduRSourcePduHandleId=24, PduRSrcPduDirection=RECEIVE, PduRSrcPduRef=AMP3_oB30_for_SC_CAN_V3_2_b64354b4_Rx, PduRSrcPduPduRBswModulesRef=CanIf
            AMP3_oB30_for_SC_CAN_V3_2_b64354b4_Rx_d7346016_Rx (PduRDestPdu):
              PduRDestPduHandleId = 24
              PduRDestPduDirection = RECEIVE
              PduRDestPduRoutingType = API_FORWARDING
              PduRDestPduDataProcessing = IMMEDIATE
              PduRPduLengthHandlingStrategy = IGNORE
              PduRTransmissionConfirmation = false
              PduRDestPduRef = AMP3_oB30_for_SC_CAN_V3_2_b64354b4_Rx
              PduRDestPduPduRBswModulesRef = Com
          PEPS2_oB30_for_SC_CAN_V3_2_8c308c2e_Rx: PduRRoutingPathCommunicationType=COMMUNICATION_INTERFACE
            PduRSrcPdu_9304c641 (PduRSrcPdu): PduRSourcePduHandleId=131, PduRSrcPduDirection=RECEIVE, PduRSrcPduRef=PEPS2_oB30_for_SC_CAN_V3_2_8c308c2e_Rx, PduRSrcPduPduRBswModulesRef=CanIf
            PEPS2_oB30_for_SC_CAN_V3_2_8c308c2e_Rx_9304c641_Rx (PduRDestPdu):
              PduRDestPduHandleId = 131
              PduRDestPduDirection = RECEIVE
              PduRDestPduRoutingType = API_FORWARDING
              PduRDestPduDataProcessing = IMMEDIATE
              PduRPduLengthHandlingStrategy = IGNORE
              PduRTransmissionConfirmation = false
              PduRDestPduRef = PEPS2_oB30_for_SC_CAN_V3_2_8c308c2e_Rx
              PduRDestPduPduRBswModulesRef = Com
          EPB1_oB30_for_SC_CAN_V3_2_9899d01e_Rx: PduRRoutingPathCommunicationType=COMMUNICATION_INTERFACE
            PduRSrcPdu_f0fd4aaa (PduRSrcPdu): PduRSourcePduHandleId=80, PduRSrcPduDirection=RECEIVE, PduRSrcPduRef=EPB1_oB30_for_SC_CAN_V3_2_9899d01e_Rx, PduRSrcPduPduRBswModulesRef=CanIf
            EPB1_oB30_for_SC_CAN_V3_2_9899d01e_Rx_f0fd4aaa_Rx (PduRDestPdu):
              PduRDestPduHandleId = 80
              PduRDestPduDirection = RECEIVE
              PduRDestPduRoutingType = API_FORWARDING
              PduRDestPduDataProcessing = IMMEDIATE
              PduRPduLengthHandlingStrategy = IGNORE
              PduRTransmissionConfirmation = false
              PduRDestPduRef = EPB1_oB30_for_SC_CAN_V3_2_9899d01e_Rx
              PduRDestPduPduRBswModulesRef = Com
          AC1_oB30_for_SC_CAN_V3_2_3243b46e_Rx: PduRRoutingPathCommunicationType=COMMUNICATION_INTERFACE
            PduRSrcPdu_b0ba9a32 (PduRSrcPdu): PduRSourcePduHandleId=5, PduRSrcPduDirection=RECEIVE, PduRSrcPduRef=AC1_oB30_for_SC_CAN_V3_2_3243b46e_Rx, PduRSrcPduPduRBswModulesRef=CanIf
            AC1_oB30_for_SC_CAN_V3_2_3243b46e_Rx_b0ba9a32_Rx (PduRDestPdu):
              PduRDestPduHandleId = 5
              PduRDestPduDirection = RECEIVE
              PduRDestPduRoutingType = API_FORWARDING
              PduRDestPduDataProcessing = IMMEDIATE
              PduRPduLengthHandlingStrategy = IGNORE
              PduRTransmissionConfirmation = false
              PduRDestPduRef = AC1_oB30_for_SC_CAN_V3_2_3243b46e_Rx
              PduRDestPduPduRBswModulesRef = Com
          GW_FD1_oB30_for_SC_CAN_V3_2_7270e594_Rx: PduRRoutingPathCommunicationType=COMMUNICATION_INTERFACE
            PduRSrcPdu_c82f5918 (PduRSrcPdu): PduRSourcePduHandleId=92, PduRSrcPduDirection=RECEIVE, PduRSrcPduRef=GW_FD1_oB30_for_SC_CAN_V3_2_7270e594_Rx, PduRSrcPduPduRBswModulesRef=CanIf
            GW_FD1_oB30_for_SC_CAN_V3_2_7270e594_Rx_c82f5918_Rx (PduRDestPdu):
              PduRDestPduHandleId = 92
              PduRDestPduDirection = RECEIVE
              PduRDestPduRoutingType = API_FORWARDING
              PduRDestPduDataProcessing = IMMEDIATE
              PduRPduLengthHandlingStrategy = IGNORE
              PduRTransmissionConfirmation = false
              PduRDestPduRef = GW_FD1_oB30_for_SC_CAN_V3_2_7270e594_Rx
              PduRDestPduPduRBswModulesRef = Com
          DDCM1_oB30_for_SC_CAN_V3_2_b3033028_Rx: PduRRoutingPathCommunicationType=COMMUNICATION_INTERFACE
            PduRSrcPdu_79c46baf (PduRSrcPdu): PduRSourcePduHandleId=56, PduRSrcPduDirection=RECEIVE, PduRSrcPduRef=DDCM1_oB30_for_SC_CAN_V3_2_b3033028_Rx, PduRSrcPduPduRBswModulesRef=CanIf
            DDCM1_oB30_for_SC_CAN_V3_2_b3033028_Rx_79c46baf_Rx (PduRDestPdu):
              PduRDestPduHandleId = 56
              PduRDestPduDirection = RECEIVE
              PduRDestPduRoutingType = API_FORWARDING
              PduRDestPduDataProcessing = IMMEDIATE
              PduRPduLengthHandlingStrategy = IGNORE
              PduRTransmissionConfirmation = false
              PduRDestPduRef = DDCM1_oB30_for_SC_CAN_V3_2_b3033028_Rx
              PduRDestPduPduRBswModulesRef = Com
          HUT17_oB30_for_SC_CAN_V3_2_fa3d29e5_Tx: PduRRoutingPathCommunicationType=COMMUNICATION_INTERFACE
            HUT17_oB30_for_SC_CAN_V3_2_4a1d7d30_Tx (PduRDestPdu):
              PduRDestPduHandleId = 14
              PduRDestPduDirection = TRANSMIT
              PduRDestPduRoutingType = API_FORWARDING
              PduRDestPduDataProcessing = IMMEDIATE
              PduRPduLengthHandlingStrategy = IGNORE
              PduRDestPduDataProvision = PDUR_DIRECT
              PduRTransmissionConfirmation = true
              PduRDestPduRef = HUT17_oB30_for_SC_CAN_V3_2_4a1d7d30_Tx
              PduRDestPduPduRBswModulesRef = CanIf
            PduRSrcPdu_a3417c57 (PduRSrcPdu): PduRSourcePduHandleId=14, PduRSrcPduDirection=TRANSMIT, PduRSrcPduRef=HUT17_oB30_for_SC_CAN_V3_2_4a1d7d30_Tx, PduRSrcPduPduRBswModulesRef=Com
          HUT3_oB30_for_SC_CAN_V3_2_a31f61e3_Tx: PduRRoutingPathCommunicationType=COMMUNICATION_INTERFACE
            HUT3_oB30_for_SC_CAN_V3_2_06e1d559_Tx (PduRDestPdu):
              PduRDestPduHandleId = 4
              PduRDestPduDirection = TRANSMIT
              PduRDestPduRoutingType = API_FORWARDING
              PduRDestPduDataProcessing = IMMEDIATE
              PduRPduLengthHandlingStrategy = IGNORE
              PduRDestPduDataProvision = PDUR_DIRECT
              PduRTransmissionConfirmation = true
              PduRDestPduRef = HUT3_oB30_for_SC_CAN_V3_2_06e1d559_Tx
              PduRDestPduPduRBswModulesRef = CanIf
            PduRSrcPdu_a20b870e (PduRSrcPdu): PduRSourcePduHandleId=4, PduRSrcPduDirection=TRANSMIT, PduRSrcPduRef=HUT3_oB30_for_SC_CAN_V3_2_06e1d559_Tx, PduRSrcPduPduRBswModulesRef=Com
          ABM2_oB30_for_SC_CAN_V3_2_5851072c_Rx: PduRRoutingPathCommunicationType=COMMUNICATION_INTERFACE
            PduRSrcPdu_bd6a4cb0 (PduRSrcPdu): PduRSourcePduHandleId=2, PduRSrcPduDirection=RECEIVE, PduRSrcPduRef=ABM2_oB30_for_SC_CAN_V3_2_5851072c_Rx, PduRSrcPduPduRBswModulesRef=CanIf
            ABM2_oB30_for_SC_CAN_V3_2_5851072c_Rx_bd6a4cb0_Rx (PduRDestPdu):
              PduRDestPduHandleId = 2
              PduRDestPduDirection = RECEIVE
              PduRDestPduRoutingType = API_FORWARDING
              PduRDestPduDataProcessing = IMMEDIATE
              PduRPduLengthHandlingStrategy = IGNORE
              PduRTransmissionConfirmation = false
              PduRDestPduRef = ABM2_oB30_for_SC_CAN_V3_2_5851072c_Rx
              PduRDestPduPduRBswModulesRef = Com
          CSA2_oB30_for_SC_CAN_V3_2_214ae38a_Rx: PduRRoutingPathCommunicationType=COMMUNICATION_INTERFACE
            PduRSrcPdu_cca3ad41 (PduRSrcPdu): PduRSourcePduHandleId=51, PduRSrcPduDirection=RECEIVE, PduRSrcPduRef=CSA2_oB30_for_SC_CAN_V3_2_214ae38a_Rx, PduRSrcPduPduRBswModulesRef=CanIf
            CSA2_oB30_for_SC_CAN_V3_2_214ae38a_Rx_cca3ad41_Rx (PduRDestPdu):
              PduRDestPduHandleId = 51
              PduRDestPduDirection = RECEIVE
              PduRDestPduRoutingType = API_FORWARDING
              PduRDestPduDataProcessing = IMMEDIATE
              PduRPduLengthHandlingStrategy = IGNORE
              PduRTransmissionConfirmation = false
              PduRDestPduRef = CSA2_oB30_for_SC_CAN_V3_2_214ae38a_Rx
              PduRDestPduPduRBswModulesRef = Com
          HUT21_oB30_for_SC_CAN_V3_2_fe294a58_Tx: PduRRoutingPathCommunicationType=COMMUNICATION_INTERFACE
            PduRSrcPdu_6a585e62 (PduRSrcPdu): PduRSourcePduHandleId=17, PduRSrcPduDirection=TRANSMIT, PduRSrcPduRef=HUT21_oB30_for_SC_CAN_V3_2_215d5a8e_Tx, PduRSrcPduPduRBswModulesRef=Com
            HUT21_oB30_for_SC_CAN_V3_2_215d5a8e_Tx (PduRDestPdu):
              PduRDestPduHandleId = 17
              PduRDestPduDirection = TRANSMIT
              PduRDestPduRoutingType = API_FORWARDING
              PduRDestPduDataProcessing = IMMEDIATE
              PduRPduLengthHandlingStrategy = IGNORE
              PduRDestPduDataProvision = PDUR_DIRECT
              PduRTransmissionConfirmation = true
              PduRDestPduRef = HUT21_oB30_for_SC_CAN_V3_2_215d5a8e_Tx
              PduRDestPduPduRBswModulesRef = CanIf
          EEM1_oB30_for_SC_CAN_V3_2_788fa486_Rx: PduRRoutingPathCommunicationType=COMMUNICATION_INTERFACE
            EEM1_oB30_for_SC_CAN_V3_2_788fa486_Rx_a19a19e9_Rx (PduRDestPdu):
              PduRDestPduHandleId = 78
              PduRDestPduDirection = RECEIVE
              PduRDestPduRoutingType = API_FORWARDING
              PduRDestPduDataProcessing = IMMEDIATE
              PduRPduLengthHandlingStrategy = IGNORE
              PduRTransmissionConfirmation = false
              PduRDestPduRef = EEM1_oB30_for_SC_CAN_V3_2_788fa486_Rx
              PduRDestPduPduRBswModulesRef = Com
            PduRSrcPdu_a19a19e9 (PduRSrcPdu): PduRSourcePduHandleId=78, PduRSrcPduDirection=RECEIVE, PduRSrcPduRef=EEM1_oB30_for_SC_CAN_V3_2_788fa486_Rx, PduRSrcPduPduRBswModulesRef=CanIf
          HUT10_oB30_for_SC_CAN_V3_2_9fe417a5_Tx: PduRRoutingPathCommunicationType=COMMUNICATION_INTERFACE
            PduRSrcPdu_ff58ef59 (PduRSrcPdu): PduRSourcePduHandleId=8, PduRSrcPduDirection=TRANSMIT, PduRSrcPduRef=HUT10_oB30_for_SC_CAN_V3_2_5136ad0a_Tx, PduRSrcPduPduRBswModulesRef=Com
            HUT10_oB30_for_SC_CAN_V3_2_5136ad0a_Tx (PduRDestPdu):
              PduRDestPduHandleId = 8
              PduRDestPduDirection = TRANSMIT
              PduRDestPduRoutingType = API_FORWARDING
              PduRDestPduDataProcessing = IMMEDIATE
              PduRPduLengthHandlingStrategy = IGNORE
              PduRDestPduDataProvision = PDUR_DIRECT
              PduRTransmissionConfirmation = true
              PduRDestPduRef = HUT10_oB30_for_SC_CAN_V3_2_5136ad0a_Tx
              PduRDestPduPduRBswModulesRef = CanIf
          ECM19_oB30_for_SC_CAN_V3_2_bc1c71de_Rx: PduRRoutingPathCommunicationType=COMMUNICATION_INTERFACE
            PduRSrcPdu_ba5a64c9 (PduRSrcPdu): PduRSourcePduHandleId=72, PduRSrcPduDirection=RECEIVE, PduRSrcPduRef=ECM19_oB30_for_SC_CAN_V3_2_bc1c71de_Rx, PduRSrcPduPduRBswModulesRef=CanIf
            ECM19_oB30_for_SC_CAN_V3_2_bc1c71de_Rx_ba5a64c9_Rx (PduRDestPdu):
              PduRDestPduHandleId = 72
              PduRDestPduDirection = RECEIVE
              PduRDestPduRoutingType = API_FORWARDING
              PduRDestPduDataProcessing = IMMEDIATE
              PduRPduLengthHandlingStrategy = IGNORE
              PduRTransmissionConfirmation = false
              PduRDestPduRef = ECM19_oB30_for_SC_CAN_V3_2_bc1c71de_Rx
              PduRDestPduPduRBswModulesRef = Com
          AEB_FD1_oB30_for_SC_CAN_V3_2_c284a95c_Rx: PduRRoutingPathCommunicationType=COMMUNICATION_INTERFACE
            AEB_FD1_oB30_for_SC_CAN_V3_2_c284a95c_Rx_c16dc352_Rx (PduRDestPdu):
              PduRDestPduHandleId = 17
              PduRDestPduDirection = RECEIVE
              PduRDestPduRoutingType = API_FORWARDING
              PduRDestPduDataProcessing = IMMEDIATE
              PduRPduLengthHandlingStrategy = IGNORE
              PduRTransmissionConfirmation = false
              PduRDestPduRef = AEB_FD1_oB30_for_SC_CAN_V3_2_c284a95c_Rx
              PduRDestPduPduRBswModulesRef = Com
            PduRSrcPdu_c16dc352 (PduRSrcPdu): PduRSourcePduHandleId=17, PduRSrcPduDirection=RECEIVE, PduRSrcPduRef=AEB_FD1_oB30_for_SC_CAN_V3_2_c284a95c_Rx, PduRSrcPduPduRBswModulesRef=CanIf
          DCT5_oB30_for_SC_CAN_V3_2_81a2a74b_Rx: PduRRoutingPathCommunicationType=COMMUNICATION_INTERFACE
            PduRSrcPdu_57f99d13 (PduRSrcPdu): PduRSourcePduHandleId=54, PduRSrcPduDirection=RECEIVE, PduRSrcPduRef=DCT5_oB30_for_SC_CAN_V3_2_81a2a74b_Rx, PduRSrcPduPduRBswModulesRef=CanIf
            DCT5_oB30_for_SC_CAN_V3_2_81a2a74b_Rx_57f99d13_Rx (PduRDestPdu):
              PduRDestPduHandleId = 54
              PduRDestPduDirection = RECEIVE
              PduRDestPduRoutingType = API_FORWARDING
              PduRDestPduDataProcessing = IMMEDIATE
              PduRPduLengthHandlingStrategy = IGNORE
              PduRTransmissionConfirmation = false
              PduRDestPduRef = DCT5_oB30_for_SC_CAN_V3_2_81a2a74b_Rx
              PduRDestPduPduRBswModulesRef = Com
          AMP1_oB30_for_SC_CAN_V3_2_f94fb5d3_Rx: PduRRoutingPathCommunicationType=COMMUNICATION_INTERFACE
            AMP1_oB30_for_SC_CAN_V3_2_f94fb5d3_Rx_fd9dde52_Rx (PduRDestPdu):
              PduRDestPduHandleId = 21
              PduRDestPduDirection = RECEIVE
              PduRDestPduRoutingType = API_FORWARDING
              PduRDestPduDataProcessing = IMMEDIATE
              PduRPduLengthHandlingStrategy = IGNORE
              PduRTransmissionConfirmation = false
              PduRDestPduRef = AMP1_oB30_for_SC_CAN_V3_2_f94fb5d3_Rx
              PduRDestPduPduRBswModulesRef = Com
            PduRSrcPdu_fd9dde52 (PduRSrcPdu): PduRSourcePduHandleId=21, PduRSrcPduDirection=RECEIVE, PduRSrcPduRef=AMP1_oB30_for_SC_CAN_V3_2_f94fb5d3_Rx, PduRSrcPduPduRBswModulesRef=CanIf
          IFC_FD3_oB30_for_SC_CAN_V3_2_4c625c72_Rx: PduRRoutingPathCommunicationType=COMMUNICATION_INTERFACE
            PduRSrcPdu_d6092b8e (PduRSrcPdu): PduRSourcePduHandleId=122, PduRSrcPduDirection=RECEIVE, PduRSrcPduRef=IFC_FD3_oB30_for_SC_CAN_V3_2_4c625c72_Rx, PduRSrcPduPduRBswModulesRef=CanIf
            IFC_FD3_oB30_for_SC_CAN_V3_2_4c625c72_Rx_d6092b8e_Rx (PduRDestPdu):
              PduRDestPduHandleId = 122
              PduRDestPduDirection = RECEIVE
              PduRDestPduRoutingType = API_FORWARDING
              PduRDestPduDataProcessing = IMMEDIATE
              PduRPduLengthHandlingStrategy = IGNORE
              PduRTransmissionConfirmation = false
              PduRDestPduRef = IFC_FD3_oB30_for_SC_CAN_V3_2_4c625c72_Rx
              PduRDestPduPduRBswModulesRef = Com
          HUT23_oB30_for_SC_CAN_V3_2_d07983d8_Tx: PduRRoutingPathCommunicationType=COMMUNICATION_INTERFACE
            HUT23_oB30_for_SC_CAN_V3_2_6e51bbe9_Tx (PduRDestPdu):
              PduRDestPduHandleId = 19
              PduRDestPduDirection = TRANSMIT
              PduRDestPduRoutingType = API_FORWARDING
              PduRDestPduDataProcessing = IMMEDIATE
              PduRPduLengthHandlingStrategy = IGNORE
              PduRDestPduDataProvision = PDUR_DIRECT
              PduRTransmissionConfirmation = true
              PduRDestPduRef = HUT23_oB30_for_SC_CAN_V3_2_6e51bbe9_Tx
              PduRDestPduPduRBswModulesRef = CanIf
            PduRSrcPdu_ed0f687f (PduRSrcPdu): PduRSourcePduHandleId=19, PduRSrcPduDirection=TRANSMIT, PduRSrcPduRef=HUT23_oB30_for_SC_CAN_V3_2_6e51bbe9_Tx, PduRSrcPduPduRBswModulesRef=Com
          ESP8_oB30_for_SC_CAN_V3_2_cf6f571c_Rx: PduRRoutingPathCommunicationType=COMMUNICATION_INTERFACE
            PduRSrcPdu_97f4128e (PduRSrcPdu): PduRSourcePduHandleId=83, PduRSrcPduDirection=RECEIVE, PduRSrcPduRef=ESP8_oB30_for_SC_CAN_V3_2_cf6f571c_Rx, PduRSrcPduPduRBswModulesRef=CanIf
            ESP8_oB30_for_SC_CAN_V3_2_cf6f571c_Rx_97f4128e_Rx (PduRDestPdu):
              PduRDestPduHandleId = 83
              PduRDestPduDirection = RECEIVE
              PduRDestPduRoutingType = API_FORWARDING
              PduRDestPduDataProcessing = IMMEDIATE
              PduRPduLengthHandlingStrategy = IGNORE
              PduRTransmissionConfirmation = false
              PduRDestPduRef = ESP8_oB30_for_SC_CAN_V3_2_cf6f571c_Rx
              PduRDestPduPduRBswModulesRef = Com
          ECM3_oB30_for_SC_CAN_V3_2_ea21e226_Rx: PduRRoutingPathCommunicationType=COMMUNICATION_INTERFACE
            PduRSrcPdu_e6e62af0 (PduRSrcPdu): PduRSourcePduHandleId=66, PduRSrcPduDirection=RECEIVE, PduRSrcPduRef=ECM3_oB30_for_SC_CAN_V3_2_ea21e226_Rx, PduRSrcPduPduRBswModulesRef=CanIf
            ECM3_oB30_for_SC_CAN_V3_2_ea21e226_Rx_e6e62af0_Rx (PduRDestPdu):
              PduRDestPduHandleId = 66
              PduRDestPduDirection = RECEIVE
              PduRDestPduRoutingType = API_FORWARDING
              PduRDestPduDataProcessing = IMMEDIATE
              PduRPduLengthHandlingStrategy = IGNORE
              PduRTransmissionConfirmation = false
              PduRDestPduRef = ECM3_oB30_for_SC_CAN_V3_2_ea21e226_Rx
              PduRDestPduPduRBswModulesRef = Com
          HUT22_oB30_for_SC_CAN_V3_2_c751e718_Tx: PduRRoutingPathCommunicationType=COMMUNICATION_INTERFACE
            HUT22_oB30_for_SC_CAN_V3_2_a46f487a_Tx (PduRDestPdu):
              PduRDestPduHandleId = 18
              PduRDestPduDirection = TRANSMIT
              PduRDestPduRoutingType = API_FORWARDING
              PduRDestPduDataProcessing = IMMEDIATE
              PduRPduLengthHandlingStrategy = IGNORE
              PduRDestPduDataProvision = PDUR_DIRECT
              PduRTransmissionConfirmation = true
              PduRDestPduRef = HUT22_oB30_for_SC_CAN_V3_2_a46f487a_Tx
              PduRDestPduPduRBswModulesRef = CanIf
            PduRSrcPdu_d6198e5a (PduRSrcPdu): PduRSourcePduHandleId=18, PduRSrcPduDirection=TRANSMIT, PduRSrcPduRef=HUT22_oB30_for_SC_CAN_V3_2_a46f487a_Tx, PduRSrcPduPduRBswModulesRef=Com
          HCU_PT7_oB30_for_SC_CAN_V3_2_5726e4b6_Rx: PduRRoutingPathCommunicationType=COMMUNICATION_INTERFACE
            HCU_PT7_oB30_for_SC_CAN_V3_2_5726e4b6_Rx_e8995c05_Rx (PduRDestPdu):
              PduRDestPduHandleId = 116
              PduRDestPduDirection = RECEIVE
              PduRDestPduRoutingType = API_FORWARDING
              PduRDestPduDataProcessing = IMMEDIATE
              PduRPduLengthHandlingStrategy = IGNORE
              PduRTransmissionConfirmation = false
              PduRDestPduRef = HCU_PT7_oB30_for_SC_CAN_V3_2_5726e4b6_Rx
              PduRDestPduPduRBswModulesRef = Com
            PduRSrcPdu_e8995c05 (PduRSrcPdu): PduRSourcePduHandleId=116, PduRSrcPduDirection=RECEIVE, PduRSrcPduRef=HCU_PT7_oB30_for_SC_CAN_V3_2_5726e4b6_Rx, PduRSrcPduPduRBswModulesRef=CanIf
          HUT20_oB30_for_SC_CAN_V3_2_e9012e98_Tx: PduRRoutingPathCommunicationType=COMMUNICATION_INTERFACE
            HUT20_oB30_for_SC_CAN_V3_2_eb63a91d_Tx (PduRDestPdu):
              PduRDestPduHandleId = 16
              PduRDestPduDirection = TRANSMIT
              PduRDestPduRoutingType = API_FORWARDING
              PduRDestPduDataProcessing = IMMEDIATE
              PduRPduLengthHandlingStrategy = IGNORE
              PduRDestPduDataProvision = PDUR_DIRECT
              PduRTransmissionConfirmation = true
              PduRDestPduRef = HUT20_oB30_for_SC_CAN_V3_2_eb63a91d_Tx
              PduRDestPduPduRBswModulesRef = CanIf
            PduRSrcPdu_b4b2a68d (PduRSrcPdu): PduRSourcePduHandleId=16, PduRSrcPduDirection=TRANSMIT, PduRSrcPduRef=HUT20_oB30_for_SC_CAN_V3_2_eb63a91d_Tx, PduRSrcPduPduRBswModulesRef=Com
          HUT2_oB30_for_SC_CAN_V3_2_b4370523_Tx: PduRRoutingPathCommunicationType=COMMUNICATION_INTERFACE
            PduRSrcPdu_38bf1469 (PduRSrcPdu): PduRSourcePduHandleId=3, PduRSrcPduDirection=TRANSMIT, PduRSrcPduRef=HUT2_oB30_for_SC_CAN_V3_2_ccdf26ca_Tx, PduRSrcPduPduRBswModulesRef=Com
            HUT2_oB30_for_SC_CAN_V3_2_ccdf26ca_Tx (PduRDestPdu):
              PduRDestPduHandleId = 3
              PduRDestPduDirection = TRANSMIT
              PduRDestPduRoutingType = API_FORWARDING
              PduRDestPduDataProcessing = IMMEDIATE
              PduRPduLengthHandlingStrategy = IGNORE
              PduRDestPduDataProvision = PDUR_DIRECT
              PduRTransmissionConfirmation = true
              PduRDestPduRef = HUT2_oB30_for_SC_CAN_V3_2_ccdf26ca_Tx
              PduRDestPduPduRBswModulesRef = CanIf
          HAP_FD2_oB30_for_SC_CAN_V3_2_e5b1e853_Rx: PduRRoutingPathCommunicationType=COMMUNICATION_INTERFACE
            HAP_FD2_oB30_for_SC_CAN_V3_2_e5b1e853_Rx_bcb0e91f_Rx (PduRDestPdu):
              PduRDestPduHandleId = 97
              PduRDestPduDirection = RECEIVE
              PduRDestPduRoutingType = API_FORWARDING
              PduRDestPduDataProcessing = IMMEDIATE
              PduRPduLengthHandlingStrategy = IGNORE
              PduRTransmissionConfirmation = false
              PduRDestPduRef = HAP_FD2_oB30_for_SC_CAN_V3_2_e5b1e853_Rx
              PduRDestPduPduRBswModulesRef = Com
            PduRSrcPdu_bcb0e91f (PduRSrcPdu): PduRSourcePduHandleId=97, PduRSrcPduDirection=RECEIVE, PduRSrcPduRef=HAP_FD2_oB30_for_SC_CAN_V3_2_e5b1e853_Rx, PduRSrcPduPduRBswModulesRef=CanIf
          BCM12_oB30_for_SC_CAN_V3_2_3066f987_Rx: PduRRoutingPathCommunicationType=COMMUNICATION_INTERFACE
            PduRSrcPdu_5945cf07 (PduRSrcPdu): PduRSourcePduHandleId=33, PduRSrcPduDirection=RECEIVE, PduRSrcPduRef=BCM12_oB30_for_SC_CAN_V3_2_3066f987_Rx, PduRSrcPduPduRBswModulesRef=CanIf
            BCM12_oB30_for_SC_CAN_V3_2_3066f987_Rx_5945cf07_Rx (PduRDestPdu):
              PduRDestPduHandleId = 33
              PduRDestPduDirection = RECEIVE
              PduRDestPduRoutingType = API_FORWARDING
              PduRDestPduDataProcessing = IMMEDIATE
              PduRPduLengthHandlingStrategy = IGNORE
              PduRTransmissionConfirmation = false
              PduRDestPduRef = BCM12_oB30_for_SC_CAN_V3_2_3066f987_Rx
              PduRDestPduPduRBswModulesRef = Com
          PDCM1_oB30_for_SC_CAN_V3_2_76a5c7ab_Rx: PduRRoutingPathCommunicationType=COMMUNICATION_INTERFACE
            PduRSrcPdu_3e9300cb (PduRSrcPdu): PduRSourcePduHandleId=130, PduRSrcPduDirection=RECEIVE, PduRSrcPduRef=PDCM1_oB30_for_SC_CAN_V3_2_76a5c7ab_Rx, PduRSrcPduPduRBswModulesRef=CanIf
            PDCM1_oB30_for_SC_CAN_V3_2_76a5c7ab_Rx_3e9300cb_Rx (PduRDestPdu):
              PduRDestPduHandleId = 130
              PduRDestPduDirection = RECEIVE
              PduRDestPduRoutingType = API_FORWARDING
              PduRDestPduDataProcessing = IMMEDIATE
              PduRPduLengthHandlingStrategy = IGNORE
              PduRTransmissionConfirmation = false
              PduRDestPduRef = PDCM1_oB30_for_SC_CAN_V3_2_76a5c7ab_Rx
              PduRDestPduPduRBswModulesRef = Com
          ECM11_oB30_for_SC_CAN_V3_2_5b5ef203_Rx: PduRRoutingPathCommunicationType=COMMUNICATION_INTERFACE
            PduRSrcPdu_403eb9f2 (PduRSrcPdu): PduRSourcePduHandleId=70, PduRSrcPduDirection=RECEIVE, PduRSrcPduRef=ECM11_oB30_for_SC_CAN_V3_2_5b5ef203_Rx, PduRSrcPduPduRBswModulesRef=CanIf
            ECM11_oB30_for_SC_CAN_V3_2_5b5ef203_Rx_403eb9f2_Rx (PduRDestPdu):
              PduRDestPduHandleId = 70
              PduRDestPduDirection = RECEIVE
              PduRDestPduRoutingType = API_FORWARDING
              PduRDestPduDataProcessing = IMMEDIATE
              PduRPduLengthHandlingStrategy = IGNORE
              PduRTransmissionConfirmation = false
              PduRDestPduRef = ECM11_oB30_for_SC_CAN_V3_2_5b5ef203_Rx
              PduRDestPduPduRBswModulesRef = Com
          DCT3_oB30_for_SC_CAN_V3_2_50b784e2_Rx: PduRRoutingPathCommunicationType=COMMUNICATION_INTERFACE
            PduRSrcPdu_2768582c (PduRSrcPdu): PduRSourcePduHandleId=53, PduRSrcPduDirection=RECEIVE, PduRSrcPduRef=DCT3_oB30_for_SC_CAN_V3_2_50b784e2_Rx, PduRSrcPduPduRBswModulesRef=CanIf
            DCT3_oB30_for_SC_CAN_V3_2_50b784e2_Rx_2768582c_Rx (PduRDestPdu):
              PduRDestPduHandleId = 53
              PduRDestPduDirection = RECEIVE
              PduRDestPduRoutingType = API_FORWARDING
              PduRDestPduDataProcessing = IMMEDIATE
              PduRPduLengthHandlingStrategy = IGNORE
              PduRTransmissionConfirmation = false
              PduRDestPduRef = DCT3_oB30_for_SC_CAN_V3_2_50b784e2_Rx
              PduRDestPduPduRBswModulesRef = Com
          BCM8_oB30_for_SC_CAN_V3_2_8c292f0d_Rx: PduRRoutingPathCommunicationType=COMMUNICATION_INTERFACE
            BCM8_oB30_for_SC_CAN_V3_2_8c292f0d_Rx_4ea26dbe_Rx (PduRDestPdu):
              PduRDestPduHandleId = 31
              PduRDestPduDirection = RECEIVE
              PduRDestPduRoutingType = API_FORWARDING
              PduRDestPduDataProcessing = IMMEDIATE
              PduRPduLengthHandlingStrategy = IGNORE
              PduRTransmissionConfirmation = false
              PduRDestPduRef = BCM8_oB30_for_SC_CAN_V3_2_8c292f0d_Rx
              PduRDestPduPduRBswModulesRef = Com
            PduRSrcPdu_4ea26dbe (PduRSrcPdu): PduRSourcePduHandleId=31, PduRSrcPduDirection=RECEIVE, PduRSrcPduRef=BCM8_oB30_for_SC_CAN_V3_2_8c292f0d_Rx, PduRSrcPduPduRBswModulesRef=CanIf
          ECM1_oB30_for_SC_CAN_V3_2_a52d0341_Rx: PduRRoutingPathCommunicationType=COMMUNICATION_INTERFACE
            ECM1_oB30_for_SC_CAN_V3_2_a52d0341_Rx_1a24f822_Rx (PduRDestPdu):
              PduRDestPduHandleId = 64
              PduRDestPduDirection = RECEIVE
              PduRDestPduRoutingType = API_FORWARDING
              PduRDestPduDataProcessing = IMMEDIATE
              PduRPduLengthHandlingStrategy = IGNORE
              PduRTransmissionConfirmation = false
              PduRDestPduRef = ECM1_oB30_for_SC_CAN_V3_2_a52d0341_Rx
              PduRDestPduPduRBswModulesRef = Com
            PduRSrcPdu_1a24f822 (PduRSrcPdu): PduRSourcePduHandleId=64, PduRSrcPduDirection=RECEIVE, PduRSrcPduRef=ECM1_oB30_for_SC_CAN_V3_2_a52d0341_Rx, PduRSrcPduPduRBswModulesRef=CanIf
          HUT25_oB30_for_SC_CAN_V3_2_a288d958_Tx: PduRRoutingPathCommunicationType=COMMUNICATION_INTERFACE
            HUT25_oB30_for_SC_CAN_V3_2_bf449840_Tx (PduRDestPdu):
              PduRDestPduHandleId = 20
              PduRDestPduDirection = TRANSMIT
              PduRDestPduRoutingType = API_FORWARDING
              PduRDestPduDataProcessing = IMMEDIATE
              PduRPduLengthHandlingStrategy = IGNORE
              PduRDestPduDataProvision = PDUR_DIRECT
              PduRTransmissionConfirmation = true
              PduRDestPduRef = HUT25_oB30_for_SC_CAN_V3_2_bf449840_Tx
              PduRDestPduPduRBswModulesRef = CanIf
            PduRSrcPdu_102e7b25 (PduRSrcPdu): PduRSourcePduHandleId=20, PduRSrcPduDirection=TRANSMIT, PduRSrcPduRef=HUT25_oB30_for_SC_CAN_V3_2_bf449840_Tx, PduRSrcPduPduRBswModulesRef=Com
          DSM1_oB30_for_SC_CAN_V3_2_24c7b7e3_Rx: PduRRoutingPathCommunicationType=COMMUNICATION_INTERFACE
            PduRSrcPdu_4b2a6812 (PduRSrcPdu): PduRSourcePduHandleId=61, PduRSrcPduDirection=RECEIVE, PduRSrcPduRef=DSM1_oB30_for_SC_CAN_V3_2_24c7b7e3_Rx, PduRSrcPduPduRBswModulesRef=CanIf
            DSM1_oB30_for_SC_CAN_V3_2_24c7b7e3_Rx_4b2a6812_Rx (PduRDestPdu):
              PduRDestPduHandleId = 61
              PduRDestPduDirection = RECEIVE
              PduRDestPduRoutingType = API_FORWARDING
              PduRDestPduDataProcessing = IMMEDIATE
              PduRPduLengthHandlingStrategy = IGNORE
              PduRTransmissionConfirmation = false
              PduRDestPduRef = DSM1_oB30_for_SC_CAN_V3_2_24c7b7e3_Rx
              PduRDestPduPduRBswModulesRef = Com
          HAP_FD3_oB30_for_SC_CAN_V3_2_2f8f1bc0_Rx: PduRRoutingPathCommunicationType=COMMUNICATION_INTERFACE
            HAP_FD3_oB30_for_SC_CAN_V3_2_2f8f1bc0_Rx_fc620f42_Rx (PduRDestPdu):
              PduRDestPduHandleId = 98
              PduRDestPduDirection = RECEIVE
              PduRDestPduRoutingType = API_FORWARDING
              PduRDestPduDataProcessing = IMMEDIATE
              PduRPduLengthHandlingStrategy = IGNORE
              PduRTransmissionConfirmation = false
              PduRDestPduRef = HAP_FD3_oB30_for_SC_CAN_V3_2_2f8f1bc0_Rx
              PduRDestPduPduRBswModulesRef = Com
            PduRSrcPdu_fc620f42 (PduRSrcPdu): PduRSourcePduHandleId=98, PduRSrcPduDirection=RECEIVE, PduRSrcPduRef=HAP_FD3_oB30_for_SC_CAN_V3_2_2f8f1bc0_Rx, PduRSrcPduPduRBswModulesRef=CanIf
          PEPS4_oB30_for_SC_CAN_V3_2_5d25af87_Rx: PduRRoutingPathCommunicationType=COMMUNICATION_INTERFACE
            PduRSrcPdu_f3ee8ef3 (PduRSrcPdu): PduRSourcePduHandleId=132, PduRSrcPduDirection=RECEIVE, PduRSrcPduRef=PEPS4_oB30_for_SC_CAN_V3_2_5d25af87_Rx, PduRSrcPduPduRBswModulesRef=CanIf
            PEPS4_oB30_for_SC_CAN_V3_2_5d25af87_Rx_f3ee8ef3_Rx (PduRDestPdu):
              PduRDestPduHandleId = 132
              PduRDestPduDirection = RECEIVE
              PduRDestPduRoutingType = API_FORWARDING
              PduRDestPduDataProcessing = IMMEDIATE
              PduRPduLengthHandlingStrategy = IGNORE
              PduRTransmissionConfirmation = false
              PduRDestPduRef = PEPS4_oB30_for_SC_CAN_V3_2_5d25af87_Rx
              PduRDestPduPduRBswModulesRef = Com
          AMP4_ANC1_oB30_for_SC_CAN_V3_2_e4b31b97_Rx: PduRRoutingPathCommunicationType=COMMUNICATION_INTERFACE
            PduRSrcPdu_a3a226e0 (PduRSrcPdu): PduRSourcePduHandleId=25, PduRSrcPduDirection=RECEIVE, PduRSrcPduRef=AMP4_ANC1_oB30_for_SC_CAN_V3_2_e4b31b97_Rx, PduRSrcPduPduRBswModulesRef=CanIf
            AMP4_ANC1_oB30_for_SC_CAN_V3_2_e4b31b97_Rx_a3a226e0_Rx (PduRDestPdu):
              PduRDestPduHandleId = 25
              PduRDestPduDirection = RECEIVE
              PduRDestPduRoutingType = API_FORWARDING
              PduRDestPduDataProcessing = IMMEDIATE
              PduRPduLengthHandlingStrategy = IGNORE
              PduRTransmissionConfirmation = false
              PduRDestPduRef = AMP4_ANC1_oB30_for_SC_CAN_V3_2_e4b31b97_Rx
              PduRDestPduPduRBswModulesRef = Com
          ECM20_oB30_for_SC_CAN_V3_2_2b350587_Rx: PduRRoutingPathCommunicationType=COMMUNICATION_INTERFACE
            ECM20_oB30_for_SC_CAN_V3_2_2b350587_Rx_027a79b1_Rx (PduRDestPdu):
              PduRDestPduHandleId = 73
              PduRDestPduDirection = RECEIVE
              PduRDestPduRoutingType = API_FORWARDING
              PduRDestPduDataProcessing = IMMEDIATE
              PduRPduLengthHandlingStrategy = IGNORE
              PduRTransmissionConfirmation = false
              PduRDestPduRef = ECM20_oB30_for_SC_CAN_V3_2_2b350587_Rx
              PduRDestPduPduRBswModulesRef = Com
            PduRSrcPdu_027a79b1 (PduRSrcPdu): PduRSourcePduHandleId=73, PduRSrcPduDirection=RECEIVE, PduRSrcPduRef=ECM20_oB30_for_SC_CAN_V3_2_2b350587_Rx, PduRSrcPduPduRBswModulesRef=CanIf
          CSA1_oB30_for_SC_CAN_V3_2_a478f17e_Rx: PduRRoutingPathCommunicationType=COMMUNICATION_INTERFACE
            PduRSrcPdu_a4a64142 (PduRSrcPdu): PduRSourcePduHandleId=50, PduRSrcPduDirection=RECEIVE, PduRSrcPduRef=CSA1_oB30_for_SC_CAN_V3_2_a478f17e_Rx, PduRSrcPduPduRBswModulesRef=CanIf
            CSA1_oB30_for_SC_CAN_V3_2_a478f17e_Rx_a4a64142_Rx (PduRDestPdu):
              PduRDestPduHandleId = 50
              PduRDestPduDirection = RECEIVE
              PduRDestPduRoutingType = API_FORWARDING
              PduRDestPduDataProcessing = IMMEDIATE
              PduRPduLengthHandlingStrategy = IGNORE
              PduRTransmissionConfirmation = false
              PduRDestPduRef = CSA1_oB30_for_SC_CAN_V3_2_a478f17e_Rx
              PduRDestPduPduRBswModulesRef = Com
          ESP11_oB30_for_SC_CAN_V3_2_dfa78df9_Rx: PduRRoutingPathCommunicationType=COMMUNICATION_INTERFACE
            ESP11_oB30_for_SC_CAN_V3_2_dfa78df9_Rx_e7765f6f_Rx (PduRDestPdu):
              PduRDestPduHandleId = 84
              PduRDestPduDirection = RECEIVE
              PduRDestPduRoutingType = API_FORWARDING
              PduRDestPduDataProcessing = IMMEDIATE
              PduRPduLengthHandlingStrategy = IGNORE
              PduRTransmissionConfirmation = false
              PduRDestPduRef = ESP11_oB30_for_SC_CAN_V3_2_dfa78df9_Rx
              PduRDestPduPduRBswModulesRef = Com
            PduRSrcPdu_e7765f6f (PduRSrcPdu): PduRSourcePduHandleId=84, PduRSrcPduDirection=RECEIVE, PduRSrcPduRef=ESP11_oB30_for_SC_CAN_V3_2_dfa78df9_Rx, PduRSrcPduPduRBswModulesRef=CanIf
          HUT30_oB30_for_SC_CAN_V3_2_7272c44c_Tx: PduRRoutingPathCommunicationType=COMMUNICATION_INTERFACE
            HUT30_oB30_for_SC_CAN_V3_2_82af5510_Tx (PduRDestPdu):
              PduRDestPduHandleId = 23
              PduRDestPduDirection = TRANSMIT
              PduRDestPduRoutingType = API_FORWARDING
              PduRDestPduDataProcessing = IMMEDIATE
              PduRPduLengthHandlingStrategy = IGNORE
              PduRDestPduDataProvision = PDUR_DIRECT
              PduRTransmissionConfirmation = true
              PduRDestPduRef = HUT30_oB30_for_SC_CAN_V3_2_82af5510_Tx
              PduRDestPduPduRBswModulesRef = CanIf
            PduRSrcPdu_ef1c313e (PduRSrcPdu): PduRSourcePduHandleId=23, PduRSrcPduDirection=TRANSMIT, PduRSrcPduRef=HUT30_oB30_for_SC_CAN_V3_2_82af5510_Tx, PduRSrcPduPduRBswModulesRef=Com
          HUT32_oB30_for_SC_CAN_V3_2_5c220dcc_Tx: PduRRoutingPathCommunicationType=COMMUNICATION_INTERFACE
            PduRSrcPdu_76b56aac (PduRSrcPdu): PduRSourcePduHandleId=25, PduRSrcPduDirection=TRANSMIT, PduRSrcPduRef=HUT32_oB30_for_SC_CAN_V3_2_cda3b477_Tx, PduRSrcPduPduRBswModulesRef=Com
            HUT32_oB30_for_SC_CAN_V3_2_cda3b477_Tx (PduRDestPdu):
              PduRDestPduHandleId = 25
              PduRDestPduDirection = TRANSMIT
              PduRDestPduRoutingType = API_FORWARDING
              PduRDestPduDataProcessing = IMMEDIATE
              PduRPduLengthHandlingStrategy = IGNORE
              PduRDestPduDataProvision = PDUR_DIRECT
              PduRTransmissionConfirmation = true
              PduRDestPduRef = HUT32_oB30_for_SC_CAN_V3_2_cda3b477_Tx
              PduRDestPduPduRBswModulesRef = CanIf
          HUT16_oB30_for_SC_CAN_V3_2_ed154d25_Tx: PduRRoutingPathCommunicationType=COMMUNICATION_INTERFACE
            HUT16_oB30_for_SC_CAN_V3_2_80238ea3_Tx (PduRDestPdu):
              PduRDestPduHandleId = 13
              PduRDestPduDirection = TRANSMIT
              PduRDestPduRoutingType = API_FORWARDING
              PduRDestPduDataProcessing = IMMEDIATE
              PduRPduLengthHandlingStrategy = IGNORE
              PduRDestPduDataProvision = PDUR_DIRECT
              PduRTransmissionConfirmation = true
              PduRDestPduRef = HUT16_oB30_for_SC_CAN_V3_2_80238ea3_Tx
              PduRDestPduPduRBswModulesRef = CanIf
            PduRSrcPdu_16816632 (PduRSrcPdu): PduRSourcePduHandleId=13, PduRSrcPduDirection=TRANSMIT, PduRSrcPduRef=HUT16_oB30_for_SC_CAN_V3_2_80238ea3_Tx, PduRSrcPduPduRBswModulesRef=Com
          BMS4_oB30_for_SC_CAN_V3_2_15d37a43_Rx: PduRRoutingPathCommunicationType=COMMUNICATION_INTERFACE
            BMS4_oB30_for_SC_CAN_V3_2_15d37a43_Rx_60681d02_Rx (PduRDestPdu):
              PduRDestPduHandleId = 39
              PduRDestPduDirection = RECEIVE
              PduRDestPduRoutingType = API_FORWARDING
              PduRDestPduDataProcessing = IMMEDIATE
              PduRPduLengthHandlingStrategy = IGNORE
              PduRTransmissionConfirmation = false
              PduRDestPduRef = BMS4_oB30_for_SC_CAN_V3_2_15d37a43_Rx
              PduRDestPduPduRBswModulesRef = Com
            PduRSrcPdu_60681d02 (PduRSrcPdu): PduRSourcePduHandleId=39, PduRSrcPduDirection=RECEIVE, PduRSrcPduRef=BMS4_oB30_for_SC_CAN_V3_2_15d37a43_Rx, PduRSrcPduPduRBswModulesRef=CanIf
          ECM9_oB30_for_SC_CAN_V3_2_426f809c_Rx: PduRRoutingPathCommunicationType=COMMUNICATION_INTERFACE
            PduRSrcPdu_3d5474ec (PduRSrcPdu): PduRSourcePduHandleId=69, PduRSrcPduDirection=RECEIVE, PduRSrcPduRef=ECM9_oB30_for_SC_CAN_V3_2_426f809c_Rx, PduRSrcPduPduRBswModulesRef=CanIf
            ECM9_oB30_for_SC_CAN_V3_2_426f809c_Rx_3d5474ec_Rx (PduRDestPdu):
              PduRDestPduHandleId = 69
              PduRDestPduDirection = RECEIVE
              PduRDestPduRoutingType = API_FORWARDING
              PduRDestPduDataProcessing = IMMEDIATE
              PduRPduLengthHandlingStrategy = IGNORE
              PduRTransmissionConfirmation = false
              PduRDestPduRef = ECM9_oB30_for_SC_CAN_V3_2_426f809c_Rx
              PduRDestPduPduRBswModulesRef = Com
          HAP_FD1_oB30_for_SC_CAN_V3_2_6083faa7_Rx: PduRRoutingPathCommunicationType=COMMUNICATION_INTERFACE
            HAP_FD1_oB30_for_SC_CAN_V3_2_6083faa7_Rx_2b821b4f_Rx (PduRDestPdu):
              PduRDestPduHandleId = 96
              PduRDestPduDirection = RECEIVE
              PduRDestPduRoutingType = API_FORWARDING
              PduRDestPduDataProcessing = IMMEDIATE
              PduRPduLengthHandlingStrategy = IGNORE
              PduRTransmissionConfirmation = false
              PduRDestPduRef = HAP_FD1_oB30_for_SC_CAN_V3_2_6083faa7_Rx
              PduRDestPduPduRBswModulesRef = Com
            PduRSrcPdu_2b821b4f (PduRSrcPdu): PduRSourcePduHandleId=96, PduRSrcPduDirection=RECEIVE, PduRSrcPduRef=HAP_FD1_oB30_for_SC_CAN_V3_2_6083faa7_Rx, PduRSrcPduPduRBswModulesRef=CanIf
          ABS1_oB30_for_SC_CAN_V3_2_a04728c8_Rx: PduRRoutingPathCommunicationType=COMMUNICATION_INTERFACE
            PduRSrcPdu_ec961e65 (PduRSrcPdu): PduRSourcePduHandleId=3, PduRSrcPduDirection=RECEIVE, PduRSrcPduRef=ABS1_oB30_for_SC_CAN_V3_2_a04728c8_Rx, PduRSrcPduPduRBswModulesRef=CanIf
            ABS1_oB30_for_SC_CAN_V3_2_a04728c8_Rx_ec961e65_Rx (PduRDestPdu):
              PduRDestPduHandleId = 3
              PduRDestPduDirection = RECEIVE
              PduRDestPduRoutingType = API_FORWARDING
              PduRDestPduDataProcessing = IMMEDIATE
              PduRPduLengthHandlingStrategy = IGNORE
              PduRTransmissionConfirmation = false
              PduRDestPduRef = ABS1_oB30_for_SC_CAN_V3_2_a04728c8_Rx
              PduRDestPduPduRBswModulesRef = Com
          HUT1_oB30_for_SC_CAN_V3_2_8d4fa863_Tx: PduRRoutingPathCommunicationType=COMMUNICATION_INTERFACE
            PduRSrcPdu_476d2d57 (PduRSrcPdu): PduRSourcePduHandleId=2, PduRSrcPduDirection=TRANSMIT, PduRSrcPduRef=HUT1_oB30_for_SC_CAN_V3_2_49ed343e_Tx, PduRSrcPduPduRBswModulesRef=Com
            HUT1_oB30_for_SC_CAN_V3_2_49ed343e_Tx (PduRDestPdu):
              PduRDestPduHandleId = 2
              PduRDestPduDirection = TRANSMIT
              PduRDestPduRoutingType = API_FORWARDING
              PduRDestPduDataProcessing = IMMEDIATE
              PduRPduLengthHandlingStrategy = IGNORE
              PduRDestPduDataProvision = PDUR_DIRECT
              PduRTransmissionConfirmation = true
              PduRDestPduRef = HUT1_oB30_for_SC_CAN_V3_2_49ed343e_Tx
              PduRDestPduPduRBswModulesRef = CanIf
          RSDS_FD1_oB30_for_SC_CAN_V3_2_b597372e_Rx: PduRRoutingPathCommunicationType=COMMUNICATION_INTERFACE
            RSDS_FD1_oB30_for_SC_CAN_V3_2_b597372e_Rx_7ec73d99_Rx (PduRDestPdu):
              PduRDestPduHandleId = 135
              PduRDestPduDirection = RECEIVE
              PduRDestPduRoutingType = API_FORWARDING
              PduRDestPduDataProcessing = IMMEDIATE
              PduRPduLengthHandlingStrategy = IGNORE
              PduRTransmissionConfirmation = false
              PduRDestPduRef = RSDS_FD1_oB30_for_SC_CAN_V3_2_b597372e_Rx
              PduRDestPduPduRBswModulesRef = Com
            PduRSrcPdu_7ec73d99 (PduRSrcPdu): PduRSourcePduHandleId=135, PduRSrcPduDirection=RECEIVE, PduRSrcPduRef=RSDS_FD1_oB30_for_SC_CAN_V3_2_b597372e_Rx, PduRSrcPduPduRBswModulesRef=CanIf
          HCU_PT4_oB30_for_SC_CAN_V3_2_d214f642_Rx: PduRRoutingPathCommunicationType=COMMUNICATION_INTERFACE
            HCU_PT4_oB30_for_SC_CAN_V3_2_d214f642_Rx_e5bf4bed_Rx (PduRDestPdu):
              PduRDestPduHandleId = 114
              PduRDestPduDirection = RECEIVE
              PduRDestPduRoutingType = API_FORWARDING
              PduRDestPduDataProcessing = IMMEDIATE
              PduRPduLengthHandlingStrategy = IGNORE
              PduRTransmissionConfirmation = false
              PduRDestPduRef = HCU_PT4_oB30_for_SC_CAN_V3_2_d214f642_Rx
              PduRDestPduPduRBswModulesRef = Com
            PduRSrcPdu_e5bf4bed (PduRSrcPdu): PduRSourcePduHandleId=114, PduRSrcPduDirection=RECEIVE, PduRSrcPduRef=HCU_PT4_oB30_for_SC_CAN_V3_2_d214f642_Rx, PduRSrcPduPduRBswModulesRef=CanIf
          ECM2_oB30_for_SC_CAN_V3_2_201f11b5_Rx: PduRRoutingPathCommunicationType=COMMUNICATION_INTERFACE
            ECM2_oB30_for_SC_CAN_V3_2_201f11b5_Rx_d8f14722_Rx (PduRDestPdu):
              PduRDestPduHandleId = 65
              PduRDestPduDirection = RECEIVE
              PduRDestPduRoutingType = API_FORWARDING
              PduRDestPduDataProcessing = IMMEDIATE
              PduRPduLengthHandlingStrategy = IGNORE
              PduRTransmissionConfirmation = false
              PduRDestPduRef = ECM2_oB30_for_SC_CAN_V3_2_201f11b5_Rx
              PduRDestPduPduRBswModulesRef = Com
            PduRSrcPdu_d8f14722 (PduRSrcPdu): PduRSourcePduHandleId=65, PduRSrcPduDirection=RECEIVE, PduRSrcPduRef=ECM2_oB30_for_SC_CAN_V3_2_201f11b5_Rx, PduRSrcPduPduRBswModulesRef=CanIf
          WPC1_oB30_for_SC_CAN_V3_2_e844e41f_Rx: PduRRoutingPathCommunicationType=COMMUNICATION_INTERFACE
            WPC1_oB30_for_SC_CAN_V3_2_e844e41f_Rx_b0737289_Rx (PduRDestPdu):
              PduRDestPduHandleId = 154
              PduRDestPduDirection = RECEIVE
              PduRDestPduRoutingType = API_FORWARDING
              PduRDestPduDataProcessing = IMMEDIATE
              PduRPduLengthHandlingStrategy = IGNORE
              PduRTransmissionConfirmation = false
              PduRDestPduRef = WPC1_oB30_for_SC_CAN_V3_2_e844e41f_Rx
              PduRDestPduPduRBswModulesRef = Com
            PduRSrcPdu_b0737289 (PduRSrcPdu): PduRSourcePduHandleId=154, PduRSrcPduDirection=RECEIVE, PduRSrcPduRef=WPC1_oB30_for_SC_CAN_V3_2_e844e41f_Rx, PduRSrcPduPduRBswModulesRef=CanIf
          PduRRoutingPath_userdata_tx: PduRRoutingPathCommunicationType=COMMUNICATION_INTERFACE
            PduRDestPdu:
              PduRDestPduHandleId = 51
              PduRDestPduDirection = TRANSMIT
              PduRDestPduRoutingType = API_FORWARDING
              PduRDestPduDataProcessing = IMMEDIATE
              PduRPduLengthHandlingStrategy = IGNORE
              PduRTransmissionConfirmation = false
              PduRDestPduDataProvision = PDUR_TRIGGERTRANSMIT
              PduRDestPduRef = Pdu_Nm_userData_Tx
              PduRDestPduPduRBswModulesRef = CanNm
            PduRSrcPdu: PduRSourcePduHandleId=53, PduRSrcPduDirection=TRANSMIT, PduRSrcPduRef=Pdu_Nm_userData_Tx, PduRSrcPduPduRBswModulesRef=Com
          RSDS_FD2_oB30_for_SC_CAN_V3_2_30a525da_Rx: PduRRoutingPathCommunicationType=COMMUNICATION_INTERFACE
            RSDS_FD2_oB30_for_SC_CAN_V3_2_30a525da_Rx_1479e4f3_Rx (PduRDestPdu):
              PduRDestPduHandleId = 136
              PduRDestPduDirection = RECEIVE
              PduRDestPduRoutingType = API_FORWARDING
              PduRDestPduDataProcessing = IMMEDIATE
              PduRPduLengthHandlingStrategy = IGNORE
              PduRTransmissionConfirmation = false
              PduRDestPduRef = RSDS_FD2_oB30_for_SC_CAN_V3_2_a1379e70_Rx
              PduRDestPduPduRBswModulesRef = Com
            PduRSrcPdu_1479e4f3 (PduRSrcPdu): PduRSourcePduHandleId=136, PduRSrcPduDirection=RECEIVE, PduRSrcPduRef=RSDS_FD2_oB30_for_SC_CAN_V3_2_30a525da_Rx, PduRSrcPduPduRBswModulesRef=CanIf
          DVR_FD1_oB30_for_SC_CAN_V3_2_e61bae2e_Tx: PduRRoutingPathCommunicationType=COMMUNICATION_INTERFACE
            PduRSrcPdu_8fde98af (PduRSrcPdu): PduRSourcePduHandleId=1, PduRSrcPduDirection=TRANSMIT, PduRSrcPduRef=DVR_FD1_oB30_for_SC_CAN_V3_2_e61bae2e_Tx, PduRSrcPduPduRBswModulesRef=Com
            DVR_FD1_oB30_for_SC_CAN_V3_2_d1b20623_Tx (PduRDestPdu):
              PduRDestPduHandleId = 1
              PduRDestPduDirection = TRANSMIT
              PduRDestPduRoutingType = API_FORWARDING
              PduRDestPduDataProcessing = IMMEDIATE
              PduRPduLengthHandlingStrategy = IGNORE
              PduRTransmissionConfirmation = true
              PduRDestPduDataProvision = PDUR_DIRECT
              PduRDestPduRef = DVR_FD1_oB30_for_SC_CAN_V3_2_d1b20623_Tx
              PduRDestPduPduRBswModulesRef = CanIf
          IFC_FD6_oB30_for_SC_CAN_V3_2_18456d2f_Rx: PduRRoutingPathCommunicationType=COMMUNICATION_INTERFACE
            IFC_FD6_oB30_for_SC_CAN_V3_2_18456d2f_Rx_d470f3a2_Rx (PduRDestPdu):
              PduRDestPduHandleId = 124
              PduRDestPduDirection = RECEIVE
              PduRDestPduRoutingType = API_FORWARDING
              PduRDestPduDataProcessing = IMMEDIATE
              PduRPduLengthHandlingStrategy = IGNORE
              PduRTransmissionConfirmation = false
              PduRDestPduRef = IFC_FD6_oB30_for_SC_CAN_V3_2_9a342755_Rx
              PduRDestPduPduRBswModulesRef = Com
            PduRSrcPdu_d470f3a2 (PduRSrcPdu): PduRSourcePduHandleId=124, PduRSrcPduDirection=RECEIVE, PduRSrcPduRef=IFC_FD6_oB30_for_SC_CAN_V3_2_18456d2f_Rx, PduRSrcPduPduRBswModulesRef=CanIf
          ACC_FD3_oB30_for_SC_CAN_V3_2_e2f593d9_Rx: PduRRoutingPathCommunicationType=COMMUNICATION_INTERFACE
            ACC_FD3_oB30_for_SC_CAN_V3_2_e2f593d9_Rx_f74b7e59_Rx (PduRDestPdu):
              PduRDestPduHandleId = 15
              PduRDestPduDirection = RECEIVE
              PduRDestPduRoutingType = API_FORWARDING
              PduRDestPduDataProcessing = IMMEDIATE
              PduRPduLengthHandlingStrategy = IGNORE
              PduRTransmissionConfirmation = false
              PduRDestPduRef = ACC_FD3_oB30_for_SC_CAN_V3_2_d3df4879_Rx
              PduRDestPduPduRBswModulesRef = Com
            PduRSrcPdu_f74b7e59 (PduRSrcPdu): PduRSourcePduHandleId=15, PduRSrcPduDirection=RECEIVE, PduRSrcPduRef=ACC_FD3_oB30_for_SC_CAN_V3_2_e2f593d9_Rx, PduRSrcPduPduRBswModulesRef=CanIf
          IFC_FD5_oB30_for_SC_CAN_V3_2_9d777fdb_Rx: PduRRoutingPathCommunicationType=COMMUNICATION_INTERFACE
            IFC_FD5_oB30_for_SC_CAN_V3_2_9d777fdb_Rx_083bbb40_Rx (PduRDestPdu):
              PduRDestPduHandleId = 123
              PduRDestPduDirection = RECEIVE
              PduRDestPduRoutingType = API_FORWARDING
              PduRDestPduDataProcessing = IMMEDIATE
              PduRPduLengthHandlingStrategy = IGNORE
              PduRTransmissionConfirmation = false
              PduRDestPduRef = IFC_FD5_oB30_for_SC_CAN_V3_2_a34c8a15_Rx
              PduRDestPduPduRBswModulesRef = Com
            PduRSrcPdu_083bbb40 (PduRSrcPdu): PduRSourcePduHandleId=123, PduRSrcPduDirection=RECEIVE, PduRSrcPduRef=IFC_FD5_oB30_for_SC_CAN_V3_2_9d777fdb_Rx, PduRSrcPduPduRBswModulesRef=CanIf
          CR_FD1_oB30_for_SC_CAN_V3_2_ae29d598_Rx: PduRRoutingPathCommunicationType=COMMUNICATION_INTERFACE
            CR_FD1_oB30_for_SC_CAN_V3_2_ae29d598_Rx_8df8116a_Rx (PduRDestPdu):
              PduRDestPduHandleId = 49
              PduRDestPduDirection = RECEIVE
              PduRDestPduRoutingType = API_FORWARDING
              PduRDestPduDataProcessing = IMMEDIATE
              PduRPduLengthHandlingStrategy = IGNORE
              PduRTransmissionConfirmation = false
              PduRDestPduRef = CR_FD1_oB30_for_SC_CAN_V3_2_da926426_Rx
              PduRDestPduPduRBswModulesRef = Com
            PduRSrcPdu_8df8116a (PduRSrcPdu): PduRSourcePduHandleId=49, PduRSrcPduDirection=RECEIVE, PduRSrcPduRef=CR_FD1_oB30_for_SC_CAN_V3_2_ae29d598_Rx, PduRSrcPduPduRBswModulesRef=CanIf
          ACC_FD4_oB30_for_SC_CAN_V3_2_f9de43e3_Rx: PduRRoutingPathCommunicationType=COMMUNICATION_INTERFACE
            ACC_FD4_oB30_for_SC_CAN_V3_2_f9de43e3_Rx_211c2779_Rx (PduRDestPdu):
              PduRDestPduHandleId = 16
              PduRDestPduDirection = RECEIVE
              PduRDestPduRoutingType = API_FORWARDING
              PduRDestPduDataProcessing = IMMEDIATE
              PduRPduLengthHandlingStrategy = IGNORE
              PduRTransmissionConfirmation = false
              PduRDestPduRef = ACC_FD4_oB30_for_SC_CAN_V3_2_b6067639_Rx
              PduRDestPduPduRBswModulesRef = Com
            PduRSrcPdu_211c2779 (PduRSrcPdu): PduRSourcePduHandleId=16, PduRSrcPduDirection=RECEIVE, PduRSrcPduRef=ACC_FD4_oB30_for_SC_CAN_V3_2_f9de43e3_Rx, PduRSrcPduPduRBswModulesRef=CanIf
          HUT39_oB30_for_SC_CAN_V3_2_dc19868c_Tx: PduRRoutingPathCommunicationType=COMMUNICATION_INTERFACE
            PduRSrcPdu_04ed2d31 (PduRSrcPdu): PduRSourcePduHandleId=32, PduRSrcPduDirection=TRANSMIT, PduRSrcPduRef=HUT39_oB30_for_SC_CAN_V3_2_dc19868c_Tx, PduRSrcPduPduRBswModulesRef=Com
            HUT39_oB30_for_SC_CAN_V3_2_afd3255e_Tx (PduRDestPdu):
              PduRDestPduHandleId = 32
              PduRDestPduDirection = TRANSMIT
              PduRDestPduRoutingType = API_FORWARDING
              PduRDestPduDataProcessing = IMMEDIATE
              PduRPduLengthHandlingStrategy = IGNORE
              PduRTransmissionConfirmation = true
              PduRDestPduDataProvision = PDUR_DIRECT
              PduRDestPduRef = HUT39_oB30_for_SC_CAN_V3_2_afd3255e_Tx
              PduRDestPduPduRBswModulesRef = CanIf
          IFC1_oB30_for_SC_CAN_V3_2_a7037da8_Rx: PduRRoutingPathCommunicationType=COMMUNICATION_INTERFACE
            PduRSrcPdu_2f545f03 (PduRSrcPdu): PduRSourcePduHandleId=119, PduRSrcPduDirection=RECEIVE, PduRSrcPduRef=IFC1_oB30_for_SC_CAN_V3_2_a7037da8_Rx, PduRSrcPduPduRBswModulesRef=CanIf
            IFC1_oB30_for_SC_CAN_V3_2_a7037da8_Rx_2f545f03_Rx (PduRDestPdu):
              PduRDestPduHandleId = 119
              PduRDestPduDirection = RECEIVE
              PduRDestPduRoutingType = API_FORWARDING
              PduRDestPduDataProcessing = IMMEDIATE
              PduRPduLengthHandlingStrategy = IGNORE
              PduRTransmissionConfirmation = false
              PduRDestPduRef = IFC1_oB30_for_SC_CAN_V3_2_787af09a_Rx
              PduRDestPduPduRBswModulesRef = Com
          HAP_FD6_oB30_for_SC_CAN_V3_2_7ba82a9d_Rx: PduRRoutingPathCommunicationType=COMMUNICATION_INTERFACE
            HAP_FD6_oB30_for_SC_CAN_V3_2_7ba82a9d_Rx_2db827e1_Rx (PduRDestPdu):
              PduRDestPduHandleId = 99
              PduRDestPduDirection = RECEIVE
              PduRDestPduRoutingType = API_FORWARDING
              PduRDestPduDataProcessing = IMMEDIATE
              PduRPduLengthHandlingStrategy = IGNORE
              PduRTransmissionConfirmation = false
              PduRDestPduRef = HAP_FD6_oB30_for_SC_CAN_V3_2_11512a4e_Rx
              PduRDestPduPduRBswModulesRef = Com
            PduRSrcPdu_2db827e1 (PduRSrcPdu): PduRSourcePduHandleId=99, PduRSrcPduDirection=RECEIVE, PduRSrcPduRef=HAP_FD6_oB30_for_SC_CAN_V3_2_7ba82a9d_Rx, PduRSrcPduPduRBswModulesRef=CanIf
          HUT_FD2_oB30_for_SC_CAN_V3_2_5851ef80_Tx: PduRRoutingPathCommunicationType=COMMUNICATION_INTERFACE
            PduRSrcPdu_246b4cd2 (PduRSrcPdu): PduRSourcePduHandleId=42, PduRSrcPduDirection=TRANSMIT, PduRSrcPduRef=HUT_FD2_oB30_for_SC_CAN_V3_2_5851ef80_Tx, PduRSrcPduPduRBswModulesRef=Com
            HUT_FD2_oB30_for_SC_CAN_V3_2_19cb507e_Tx (PduRDestPdu):
              PduRDestPduHandleId = 42
              PduRDestPduDirection = TRANSMIT
              PduRDestPduRoutingType = API_FORWARDING
              PduRDestPduDataProcessing = IMMEDIATE
              PduRPduLengthHandlingStrategy = IGNORE
              PduRTransmissionConfirmation = true
              PduRDestPduDataProvision = PDUR_DIRECT
              PduRDestPduRef = HUT_FD2_oB30_for_SC_CAN_V3_2_19cb507e_Tx
              PduRDestPduPduRBswModulesRef = CanIf
          HUT_FD3_oB30_for_SC_CAN_V3_2_4f798b40_Tx: PduRRoutingPathCommunicationType=COMMUNICATION_INTERFACE
            HUT_FD3_oB30_for_SC_CAN_V3_2_d3f5a3ed_Tx (PduRDestPdu):
              PduRDestPduHandleId = 43
              PduRDestPduDirection = TRANSMIT
              PduRDestPduRoutingType = API_FORWARDING
              PduRDestPduDataProcessing = IMMEDIATE
              PduRPduLengthHandlingStrategy = IGNORE
              PduRTransmissionConfirmation = true
              PduRDestPduDataProvision = PDUR_DIRECT
              PduRDestPduRef = HUT_FD3_oB30_for_SC_CAN_V3_2_d3f5a3ed_Tx
              PduRDestPduPduRBswModulesRef = CanIf
            PduRSrcPdu_87ca608c (PduRSrcPdu): PduRSourcePduHandleId=43, PduRSrcPduDirection=TRANSMIT, PduRSrcPduRef=HUT_FD3_oB30_for_SC_CAN_V3_2_4f798b40_Tx, PduRSrcPduPduRBswModulesRef=Com
          ACC_FD2_oB30_for_SC_CAN_V3_2_c4f72cb9_Rx: PduRRoutingPathCommunicationType=COMMUNICATION_INTERFACE
            PduRSrcPdu_f58e3bbb (PduRSrcPdu): PduRSourcePduHandleId=14, PduRSrcPduDirection=RECEIVE, PduRSrcPduRef=ACC_FD2_oB30_for_SC_CAN_V3_2_c4f72cb9_Rx, PduRSrcPduPduRBswModulesRef=SecOC
            ACC_FD2_oB30_for_SC_CAN_V3_2_c4f72cb9_Rx (PduRDestPdu):
              PduRDestPduHandleId = 14
              PduRDestPduDirection = RECEIVE
              PduRDestPduRoutingType = API_FORWARDING
              PduRDestPduDataProcessing = IMMEDIATE
              PduRPduLengthHandlingStrategy = IGNORE
              PduRTransmissionConfirmation = false
              PduRDestPduRef = ACC_FD2_oB30_for_SC_CAN_V3_2_c4f72cb9_Rx
              PduRDestPduPduRBswModulesRef = Com
          HUT15_Sc_oB30_for_SC_CAN_V3_2_d2d608b6_Tx: PduRRoutingPathCommunicationType=COMMUNICATION_INTERFACE
            PduRSrcPdu_bee506b7 (PduRSrcPdu): PduRSourcePduHandleId=11, PduRSrcPduDirection=TRANSMIT, PduRSrcPduRef=HUT15_Sc_oB30_for_SC_CAN_V3_2_d2d608b6_Tx, PduRSrcPduPduRBswModulesRef=SecOC
            HUT15_Sc_oB30_for_SC_CAN_V3_2_03f030a3_Tx (PduRDestPdu):
              PduRDestPduHandleId = 11
              PduRDestPduDirection = TRANSMIT
              PduRDestPduRoutingType = API_FORWARDING
              PduRDestPduDataProcessing = IMMEDIATE
              PduRPduLengthHandlingStrategy = IGNORE
              PduRDestPduDataProvision = PDUR_DIRECT
              PduRTransmissionConfirmation = true
              PduRDestPduRef = HUT15_Sc_oB30_for_SC_CAN_V3_2_03f030a3_Tx
              PduRDestPduPduRBswModulesRef = CanIf
          TPMS2_Sc_oB30_for_SC_CAN_V3_2_00821b00_Rx: PduRRoutingPathCommunicationType=COMMUNICATION_INTERFACE
            TPMS2_Sc_oB30_for_SC_CAN_V3_2_00821b00_Rx_ddd1fb68_Rx (PduRDestPdu):
              PduRDestPduHandleId = 143
              PduRDestPduDirection = RECEIVE
              PduRDestPduRoutingType = API_FORWARDING
              PduRDestPduDataProcessing = IMMEDIATE
              PduRPduLengthHandlingStrategy = IGNORE
              PduRTransmissionConfirmation = false
              PduRDestPduRef = TPMS2_Sc_oB30_for_SC_CAN_V3_2_c8a12d62_Rx
              PduRDestPduPduRBswModulesRef = SecOC
            PduRSrcPdu_ddd1fb68 (PduRSrcPdu): PduRSourcePduHandleId=143, PduRSrcPduDirection=RECEIVE, PduRSrcPduRef=TPMS2_Sc_oB30_for_SC_CAN_V3_2_00821b00_Rx, PduRSrcPduPduRBswModulesRef=CanIf
          BCM1_Sc_oB30_for_SC_CAN_V3_2_89b93aaf_Rx: PduRRoutingPathCommunicationType=COMMUNICATION_INTERFACE
            BCM1_Sc_oB30_for_SC_CAN_V3_2_89b93aaf_Rx_0aa73261_Rx (PduRDestPdu):
              PduRDestPduHandleId = 26
              PduRDestPduDirection = RECEIVE
              PduRDestPduRoutingType = API_FORWARDING
              PduRDestPduDataProcessing = IMMEDIATE
              PduRPduLengthHandlingStrategy = IGNORE
              PduRTransmissionConfirmation = false
              PduRDestPduRef = BCM1_Sc_oB30_for_SC_CAN_V3_2_cf14c4a7_Rx
              PduRDestPduPduRBswModulesRef = SecOC
            PduRSrcPdu_0aa73261 (PduRSrcPdu): PduRSourcePduHandleId=26, PduRSrcPduDirection=RECEIVE, PduRSrcPduRef=BCM1_Sc_oB30_for_SC_CAN_V3_2_89b93aaf_Rx, PduRSrcPduPduRBswModulesRef=CanIf
          BCM3_Sc_oB30_for_SC_CAN_V3_2_8af269c3_Rx: PduRRoutingPathCommunicationType=COMMUNICATION_INTERFACE
            PduRSrcPdu_4e859835 (PduRSrcPdu): PduRSourcePduHandleId=28, PduRSrcPduDirection=RECEIVE, PduRSrcPduRef=BCM3_Sc_oB30_for_SC_CAN_V3_2_8af269c3_Rx, PduRSrcPduPduRBswModulesRef=CanIf
            BCM3_Sc_oB30_for_SC_CAN_V3_2_8af269c3_Rx_4e859835_Rx (PduRDestPdu):
              PduRDestPduHandleId = 28
              PduRDestPduDirection = RECEIVE
              PduRDestPduRoutingType = API_FORWARDING
              PduRDestPduDataProcessing = IMMEDIATE
              PduRPduLengthHandlingStrategy = IGNORE
              PduRTransmissionConfirmation = false
              PduRDestPduRef = BCM3_Sc_oB30_for_SC_CAN_V3_2_5f72e2fa_Rx
              PduRDestPduPduRBswModulesRef = SecOC
          AMP2_Sc_oB30_for_SC_CAN_V3_2_2fb79ac1_Rx: PduRRoutingPathCommunicationType=COMMUNICATION_INTERFACE
            PduRSrcPdu_fc5d70a1 (PduRSrcPdu): PduRSourcePduHandleId=22, PduRSrcPduDirection=RECEIVE, PduRSrcPduRef=AMP2_Sc_oB30_for_SC_CAN_V3_2_2fb79ac1_Rx, PduRSrcPduPduRBswModulesRef=CanIf
            AMP2_Sc_oB30_for_SC_CAN_V3_2_2fb79ac1_Rx_fc5d70a1_Rx (PduRDestPdu):
              PduRDestPduHandleId = 22
              PduRDestPduDirection = RECEIVE
              PduRDestPduRoutingType = API_FORWARDING
              PduRDestPduDataProcessing = IMMEDIATE
              PduRPduLengthHandlingStrategy = IGNORE
              PduRTransmissionConfirmation = false
              PduRDestPduRef = AMP2_Sc_oB30_for_SC_CAN_V3_2_b40eb813_Rx
              PduRDestPduPduRBswModulesRef = SecOC
          ABM1_oB30_for_SC_CAN_V3_2_d004cc2e_Rx: PduRRoutingPathCommunicationType=COMMUNICATION_INTERFACE
            PduRSrcPdu_d83550c6 (PduRSrcPdu): PduRSourcePduHandleId=1, PduRSrcPduDirection=RECEIVE, PduRSrcPduRef=ABM1_oB30_for_SC_CAN_V3_2_d004cc2e_Rx, PduRSrcPduPduRBswModulesRef=SecOC
            ABM1_oB30_for_SC_CAN_V3_2_d004cc2e_Rx (PduRDestPdu):
              PduRDestPduHandleId = 1
              PduRDestPduDirection = RECEIVE
              PduRDestPduRoutingType = API_FORWARDING
              PduRDestPduDataProcessing = IMMEDIATE
              PduRPduLengthHandlingStrategy = IGNORE
              PduRTransmissionConfirmation = false
              PduRDestPduRef = ABM1_oB30_for_SC_CAN_V3_2_d004cc2e_Rx
              PduRDestPduPduRBswModulesRef = Com
          HUT_FD1_oB30_for_SC_CAN_V3_2_612942c0_Tx: PduRRoutingPathCommunicationType=COMMUNICATION_INTERFACE
            PduRSrcPdu_c6e0d207 (PduRSrcPdu): PduRSourcePduHandleId=41, PduRSrcPduDirection=TRANSMIT, PduRSrcPduRef=HUT_FD1_oB30_for_SC_CAN_V3_2_612942c0_Tx, PduRSrcPduPduRBswModulesRef=Com
            HUT_FD1_oB30_for_SC_CAN_V3_2_612942c0_Tx (PduRDestPdu):
              PduRDestPduHandleId = 41
              PduRDestPduDirection = TRANSMIT
              PduRDestPduRoutingType = API_FORWARDING
              PduRDestPduDataProcessing = IMMEDIATE
              PduRPduLengthHandlingStrategy = IGNORE
              PduRDestPduDataProvision = PDUR_DIRECT
              PduRTransmissionConfirmation = true
              PduRDestPduRef = HUT_FD1_oB30_for_SC_CAN_V3_2_612942c0_Tx
              PduRDestPduPduRBswModulesRef = SecOC
          TPMS1_Sc_oB30_for_SC_CAN_V3_2_026ce1da_Rx: PduRRoutingPathCommunicationType=COMMUNICATION_INTERFACE
            TPMS1_Sc_oB30_for_SC_CAN_V3_2_026ce1da_Rx_31a98ace_Rx (PduRDestPdu):
              PduRDestPduHandleId = 141
              PduRDestPduDirection = RECEIVE
              PduRDestPduRoutingType = API_FORWARDING
              PduRDestPduDataProcessing = IMMEDIATE
              PduRPduLengthHandlingStrategy = IGNORE
              PduRTransmissionConfirmation = false
              PduRDestPduRef = TPMS1_Sc_oB30_for_SC_CAN_V3_2_fd4c9b31_Rx
              PduRDestPduPduRBswModulesRef = SecOC
            PduRSrcPdu_31a98ace (PduRSrcPdu): PduRSourcePduHandleId=141, PduRSrcPduDirection=RECEIVE, PduRSrcPduRef=TPMS1_Sc_oB30_for_SC_CAN_V3_2_026ce1da_Rx, PduRSrcPduPduRBswModulesRef=CanIf
          ABM1_Sc_oB30_for_SC_CAN_V3_2_bdd35fd4_Rx: PduRRoutingPathCommunicationType=COMMUNICATION_INTERFACE
            PduRSrcPdu_8d822981 (PduRSrcPdu): PduRSourcePduHandleId=0, PduRSrcPduDirection=RECEIVE, PduRSrcPduRef=ABM1_Sc_oB30_for_SC_CAN_V3_2_bdd35fd4_Rx, PduRSrcPduPduRBswModulesRef=CanIf
            ABM1_Sc_oB30_for_SC_CAN_V3_2_bdd35fd4_Rx_8d822981_Rx (PduRDestPdu):
              PduRDestPduHandleId = 0
              PduRDestPduDirection = RECEIVE
              PduRDestPduRoutingType = API_FORWARDING
              PduRDestPduDataProcessing = IMMEDIATE
              PduRPduLengthHandlingStrategy = IGNORE
              PduRTransmissionConfirmation = false
              PduRDestPduRef = ABM1_Sc_oB30_for_SC_CAN_V3_2_a346d8c1_Rx
              PduRDestPduPduRBswModulesRef = SecOC
          AMP2_oB30_for_SC_CAN_V3_2_908de48a_Rx: PduRRoutingPathCommunicationType=COMMUNICATION_INTERFACE
            PduRSrcPdu_b145d381 (PduRSrcPdu): PduRSourcePduHandleId=23, PduRSrcPduDirection=RECEIVE, PduRSrcPduRef=AMP2_oB30_for_SC_CAN_V3_2_908de48a_Rx, PduRSrcPduPduRBswModulesRef=SecOC
            AMP2_oB30_for_SC_CAN_V3_2_908de48a_Rx (PduRDestPdu):
              PduRDestPduHandleId = 23
              PduRDestPduDirection = RECEIVE
              PduRDestPduRoutingType = API_FORWARDING
              PduRDestPduDataProcessing = IMMEDIATE
              PduRPduLengthHandlingStrategy = IGNORE
              PduRTransmissionConfirmation = false
              PduRDestPduRef = AMP2_oB30_for_SC_CAN_V3_2_908de48a_Rx
              PduRDestPduPduRBswModulesRef = Com
          HUT_FD1_Sc_oB30_for_SC_CAN_V3_2_e0e5cc6a_Tx: PduRRoutingPathCommunicationType=COMMUNICATION_INTERFACE
            PduRSrcPdu_373da34d (PduRSrcPdu):
              PduRSourcePduHandleId = 40
              PduRSrcPduDirection = TRANSMIT
              PduRSrcPduRef = HUT_FD1_Sc_oB30_for_SC_CAN_V3_2_e0e5cc6a_Tx
              PduRSrcPduPduRBswModulesRef = SecOC
            HUT_FD1_Sc_oB30_for_SC_CAN_V3_2_37cb1482_Tx (PduRDestPdu):
              PduRDestPduHandleId = 40
              PduRDestPduDirection = TRANSMIT
              PduRDestPduRoutingType = API_FORWARDING
              PduRDestPduDataProcessing = IMMEDIATE
              PduRPduLengthHandlingStrategy = IGNORE
              PduRDestPduDataProvision = PDUR_DIRECT
              PduRTransmissionConfirmation = true
              PduRDestPduRef = HUT_FD1_Sc_oB30_for_SC_CAN_V3_2_37cb1482_Tx
              PduRDestPduPduRBswModulesRef = CanIf
          BCM1_oB30_for_SC_CAN_V3_2_64cc1f5a_Rx: PduRRoutingPathCommunicationType=COMMUNICATION_INTERFACE
            PduRSrcPdu_f3e4daaa (PduRSrcPdu): PduRSourcePduHandleId=27, PduRSrcPduDirection=RECEIVE, PduRSrcPduRef=BCM1_oB30_for_SC_CAN_V3_2_64cc1f5a_Rx, PduRSrcPduPduRBswModulesRef=SecOC
            BCM1_oB30_for_SC_CAN_V3_2_64cc1f5a_Rx (PduRDestPdu):
              PduRDestPduHandleId = 27
              PduRDestPduDirection = RECEIVE
              PduRDestPduRoutingType = API_FORWARDING
              PduRDestPduDataProcessing = IMMEDIATE
              PduRPduLengthHandlingStrategy = IGNORE
              PduRTransmissionConfirmation = false
              PduRDestPduRef = BCM1_oB30_for_SC_CAN_V3_2_64cc1f5a_Rx
              PduRDestPduPduRBswModulesRef = Com
          TPMS2_oB30_for_SC_CAN_V3_2_fc97042f_Rx: PduRRoutingPathCommunicationType=COMMUNICATION_INTERFACE
            PduRSrcPdu_fd18d504 (PduRSrcPdu): PduRSourcePduHandleId=144, PduRSrcPduDirection=RECEIVE, PduRSrcPduRef=TPMS2_oB30_for_SC_CAN_V3_2_fc97042f_Rx, PduRSrcPduPduRBswModulesRef=SecOC
            TPMS2_oB30_for_SC_CAN_V3_2_fc97042f_Rx (PduRDestPdu):
              PduRDestPduHandleId = 144
              PduRDestPduDirection = RECEIVE
              PduRDestPduRoutingType = API_FORWARDING
              PduRDestPduDataProcessing = IMMEDIATE
              PduRPduLengthHandlingStrategy = IGNORE
              PduRTransmissionConfirmation = false
              PduRDestPduRef = TPMS2_oB30_for_SC_CAN_V3_2_fc97042f_Rx
              PduRDestPduPduRBswModulesRef = Com
          AEB_FD2_oB30_for_SC_CAN_V3_2_9fb3d7e9_Rx: PduRRoutingPathCommunicationType=COMMUNICATION_INTERFACE
            AEB_FD2_oB30_for_SC_CAN_V3_2_9fb3d7e9_Rx (PduRDestPdu):
              PduRDestPduHandleId = 19
              PduRDestPduDirection = RECEIVE
              PduRDestPduRoutingType = API_FORWARDING
              PduRDestPduDataProcessing = IMMEDIATE
              PduRPduLengthHandlingStrategy = IGNORE
              PduRTransmissionConfirmation = false
              PduRDestPduRef = AEB_FD2_oB30_for_SC_CAN_V3_2_9fb3d7e9_Rx
              PduRDestPduPduRBswModulesRef = Com
            PduRSrcPdu_9f2d3fb1 (PduRSrcPdu): PduRSourcePduHandleId=19, PduRSrcPduDirection=RECEIVE, PduRSrcPduRef=AEB_FD2_oB30_for_SC_CAN_V3_2_9fb3d7e9_Rx, PduRSrcPduPduRBswModulesRef=SecOC
          IFC_FD2_Sc_oB30_for_SC_CAN_V3_2_3e25ea9f_Rx: PduRRoutingPathCommunicationType=COMMUNICATION_INTERFACE
            IFC_FD2_Sc_oB30_for_SC_CAN_V3_2_3e25ea9f_Rx_1086a37c_Rx (PduRDestPdu):
              PduRDestPduHandleId = 120
              PduRDestPduDirection = RECEIVE
              PduRDestPduRoutingType = API_FORWARDING
              PduRDestPduDataProcessing = IMMEDIATE
              PduRPduLengthHandlingStrategy = IGNORE
              PduRTransmissionConfirmation = false
              PduRDestPduRef = IFC_FD2_Sc_oB30_for_SC_CAN_V3_2_9b0c0f4a_Rx
              PduRDestPduPduRBswModulesRef = SecOC
            PduRSrcPdu_1086a37c (PduRSrcPdu):
              PduRSourcePduHandleId = 120
              PduRSrcPduDirection = RECEIVE
              PduRSrcPduRef = IFC_FD2_Sc_oB30_for_SC_CAN_V3_2_3e25ea9f_Rx
              PduRSrcPduPduRBswModulesRef = CanIf
          IFC_FD2_oB30_for_SC_CAN_V3_2_c695b455_Rx: PduRRoutingPathCommunicationType=COMMUNICATION_INTERFACE
            IFC_FD2_oB30_for_SC_CAN_V3_2_c695b455_Rx (PduRDestPdu):
              PduRDestPduHandleId = 121
              PduRDestPduDirection = RECEIVE
              PduRDestPduRoutingType = API_FORWARDING
              PduRDestPduDataProcessing = IMMEDIATE
              PduRPduLengthHandlingStrategy = IGNORE
              PduRTransmissionConfirmation = false
              PduRDestPduRef = IFC_FD2_oB30_for_SC_CAN_V3_2_c695b455_Rx
              PduRDestPduPduRBswModulesRef = Com
            PduRSrcPdu_39a1bd74 (PduRSrcPdu): PduRSourcePduHandleId=121, PduRSrcPduDirection=RECEIVE, PduRSrcPduRef=IFC_FD2_oB30_for_SC_CAN_V3_2_c695b455_Rx, PduRSrcPduPduRBswModulesRef=SecOC
          TPMS1_oB30_for_SC_CAN_V3_2_c5efa96f_Rx: PduRRoutingPathCommunicationType=COMMUNICATION_INTERFACE
            PduRSrcPdu_94956a34 (PduRSrcPdu): PduRSourcePduHandleId=142, PduRSrcPduDirection=RECEIVE, PduRSrcPduRef=TPMS1_oB30_for_SC_CAN_V3_2_c5efa96f_Rx, PduRSrcPduPduRBswModulesRef=SecOC
            TPMS1_oB30_for_SC_CAN_V3_2_c5efa96f_Rx (PduRDestPdu):
              PduRDestPduHandleId = 142
              PduRDestPduDirection = RECEIVE
              PduRDestPduRoutingType = API_FORWARDING
              PduRDestPduDataProcessing = IMMEDIATE
              PduRPduLengthHandlingStrategy = IGNORE
              PduRTransmissionConfirmation = false
              PduRDestPduRef = TPMS1_oB30_for_SC_CAN_V3_2_c5efa96f_Rx
              PduRDestPduPduRBswModulesRef = Com
          ACC_FD2_Sc_oB30_for_SC_CAN_V3_2_c90195d6_Rx: PduRRoutingPathCommunicationType=COMMUNICATION_INTERFACE
            PduRSrcPdu_0408d396 (PduRSrcPdu):
              PduRSourcePduHandleId = 13
              PduRSrcPduDirection = RECEIVE
              PduRSrcPduRef = ACC_FD2_Sc_oB30_for_SC_CAN_V3_2_c90195d6_Rx
              PduRSrcPduPduRBswModulesRef = CanIf
            ACC_FD2_Sc_oB30_for_SC_CAN_V3_2_c90195d6_Rx_0408d396_Rx (PduRDestPdu):
              PduRDestPduHandleId = 13
              PduRDestPduDirection = RECEIVE
              PduRDestPduRoutingType = API_FORWARDING
              PduRDestPduDataProcessing = IMMEDIATE
              PduRPduLengthHandlingStrategy = IGNORE
              PduRTransmissionConfirmation = false
              PduRDestPduRef = ACC_FD2_Sc_oB30_for_SC_CAN_V3_2_21d026ea_Rx
              PduRDestPduPduRBswModulesRef = SecOC
          BCM3_oB30_for_SC_CAN_V3_2_4a9cd6da_Rx: PduRRoutingPathCommunicationType=COMMUNICATION_INTERFACE
            BCM3_oB30_for_SC_CAN_V3_2_4a9cd6da_Rx (PduRDestPdu):
              PduRDestPduHandleId = 29
              PduRDestPduDirection = RECEIVE
              PduRDestPduRoutingType = API_FORWARDING
              PduRDestPduDataProcessing = IMMEDIATE
              PduRPduLengthHandlingStrategy = IGNORE
              PduRTransmissionConfirmation = false
              PduRDestPduRef = BCM3_oB30_for_SC_CAN_V3_2_4a9cd6da_Rx
              PduRDestPduPduRBswModulesRef = Com
            PduRSrcPdu_22dd6f7f (PduRSrcPdu): PduRSourcePduHandleId=29, PduRSrcPduDirection=RECEIVE, PduRSrcPduRef=BCM3_oB30_for_SC_CAN_V3_2_4a9cd6da_Rx, PduRSrcPduPduRBswModulesRef=SecOC
          HUT15_oB30_for_SC_CAN_V3_2_d46de065_Tx: PduRRoutingPathCommunicationType=COMMUNICATION_INTERFACE
            HUT15_oB30_for_SC_CAN_V3_2_d46de065_Tx (PduRDestPdu):
              PduRDestPduHandleId = 12
              PduRDestPduDirection = TRANSMIT
              PduRDestPduRoutingType = API_FORWARDING
              PduRDestPduDataProcessing = IMMEDIATE
              PduRPduLengthHandlingStrategy = IGNORE
              PduRDestPduDataProvision = PDUR_DIRECT
              PduRTransmissionConfirmation = true
              PduRDestPduRef = HUT15_oB30_for_SC_CAN_V3_2_d46de065_Tx
              PduRDestPduPduRBswModulesRef = SecOC
            PduRSrcPdu_194d5c53 (PduRSrcPdu): PduRSourcePduHandleId=12, PduRSrcPduDirection=TRANSMIT, PduRSrcPduRef=HUT15_oB30_for_SC_CAN_V3_2_d46de065_Tx, PduRSrcPduPduRBswModulesRef=Com
          AEB_FD2_Sc_oB30_for_SC_CAN_V3_2_2f1f8022_Rx: PduRRoutingPathCommunicationType=COMMUNICATION_INTERFACE
            AEB_FD2_Sc_oB30_for_SC_CAN_V3_2_2f1f8022_Rx_eb545357_Rx (PduRDestPdu):
              PduRDestPduHandleId = 18
              PduRDestPduDirection = RECEIVE
              PduRDestPduRoutingType = API_FORWARDING
              PduRDestPduDataProcessing = IMMEDIATE
              PduRPduLengthHandlingStrategy = IGNORE
              PduRTransmissionConfirmation = false
              PduRDestPduRef = AEB_FD2_Sc_oB30_for_SC_CAN_V3_2_cb95b5fe_Rx
              PduRDestPduPduRBswModulesRef = SecOC
            PduRSrcPdu_eb545357 (PduRSrcPdu):
              PduRSourcePduHandleId = 18
              PduRSrcPduDirection = RECEIVE
              PduRSrcPduRef = AEB_FD2_Sc_oB30_for_SC_CAN_V3_2_2f1f8022_Rx
              PduRSrcPduPduRBswModulesRef = CanIf
          HUT35_oB30_for_SC_CAN_V3_2_39fb338c_Tx: PduRRoutingPathCommunicationType=COMMUNICATION_INTERFACE
            PduRSrcPdu_da813e58 (PduRSrcPdu): PduRSourcePduHandleId=28, PduRSrcPduDirection=TRANSMIT, PduRSrcPduRef=HUT35_oB30_for_SC_CAN_V3_2_39fb338c_Tx, PduRSrcPduPduRBswModulesRef=Com
            HUT35_oB30_for_SC_CAN_V3_2_d688644d_Tx (PduRDestPdu):
              PduRDestPduHandleId = 28
              PduRDestPduDirection = TRANSMIT
              PduRDestPduRoutingType = API_FORWARDING
              PduRDestPduDataProcessing = IMMEDIATE
              PduRPduLengthHandlingStrategy = IGNORE
              PduRDestPduDataProvision = PDUR_DIRECT
              PduRTransmissionConfirmation = true
              PduRDestPduRef = HUT35_oB30_for_SC_CAN_V3_2_d688644d_Tx
              PduRDestPduPduRBswModulesRef = CanIf
          DMS_FD1_oB30_for_SC_CAN_V3_2_2e6458a5_Tx: PduRRoutingPathCommunicationType=COMMUNICATION_INTERFACE
            PduRSrcPdu_dc1a8f7b (PduRSrcPdu): PduRSourcePduHandleId=0, PduRSrcPduDirection=TRANSMIT, PduRSrcPduRef=DMS_FD1_oB30_for_SC_CAN_V3_2_2e6458a5_Tx, PduRSrcPduPduRBswModulesRef=Com
            DMS_FD1_oB30_for_SC_CAN_V3_2_3b8624c3_Tx (PduRDestPdu):
              PduRDestPduHandleId = 0
              PduRDestPduDirection = TRANSMIT
              PduRDestPduRoutingType = API_FORWARDING
              PduRDestPduDataProcessing = IMMEDIATE
              PduRPduLengthHandlingStrategy = IGNORE
              PduRDestPduDataProvision = PDUR_DIRECT
              PduRTransmissionConfirmation = true
              PduRDestPduRef = DMS_FD1_oB30_for_SC_CAN_V3_2_3b8624c3_Tx
              PduRDestPduPduRBswModulesRef = CanIf
          IP1_oB30_for_SC_CAN_V3_2_1d91d500_Tx: PduRRoutingPathCommunicationType=COMMUNICATION_INTERFACE
            IP1_oB30_for_SC_CAN_V3_2_e24be166_Tx (PduRDestPdu):
              PduRDestPduHandleId = 47
              PduRDestPduDirection = TRANSMIT
              PduRDestPduRoutingType = API_FORWARDING
              PduRDestPduDataProcessing = IMMEDIATE
              PduRPduLengthHandlingStrategy = IGNORE
              PduRTransmissionConfirmation = true
              PduRDestPduDataProvision = PDUR_DIRECT
              PduRDestPduRef = IP1_oB30_for_SC_CAN_V3_2_e24be166_Tx
              PduRDestPduPduRBswModulesRef = CanIf
            PduRSrcPdu_d67ab583 (PduRSrcPdu): PduRSourcePduHandleId=49, PduRSrcPduDirection=TRANSMIT, PduRSrcPduRef=IP1_oB30_for_SC_CAN_V3_2_1d91d500_Tx, PduRSrcPduPduRBswModulesRef=Com
          IP3_oB30_for_SC_CAN_V3_2_33c11c80_Tx: PduRRoutingPathCommunicationType=COMMUNICATION_INTERFACE
            PduRSrcPdu_e0ec9ecc (PduRSrcPdu): PduRSourcePduHandleId=52, PduRSrcPduDirection=TRANSMIT, PduRSrcPduRef=IP3_oB30_for_SC_CAN_V3_2_33c11c80_Tx, PduRSrcPduPduRBswModulesRef=Com
            IP3_oB30_for_SC_CAN_V3_2_ad470001_Tx (PduRDestPdu):
              PduRDestPduHandleId = 50
              PduRDestPduDirection = TRANSMIT
              PduRDestPduRoutingType = API_FORWARDING
              PduRDestPduDataProcessing = IMMEDIATE
              PduRPduLengthHandlingStrategy = IGNORE
              PduRTransmissionConfirmation = true
              PduRDestPduDataProvision = PDUR_DIRECT
              PduRDestPduRef = IP3_oB30_for_SC_CAN_V3_2_ad470001_Tx
              PduRDestPduPduRBswModulesRef = CanIf
          IP2_oB30_for_SC_CAN_V3_2_24e97840_Tx: PduRRoutingPathCommunicationType=COMMUNICATION_INTERFACE
            IP2_oB30_for_SC_CAN_V3_2_24e97840_Tx (PduRDestPdu):
              PduRDestPduHandleId = 49
              PduRDestPduDirection = TRANSMIT
              PduRDestPduRoutingType = API_FORWARDING
              PduRDestPduDataProcessing = IMMEDIATE
              PduRPduLengthHandlingStrategy = IGNORE
              PduRDestPduDataProvision = PDUR_DIRECT
              PduRTransmissionConfirmation = true
              PduRDestPduRef = IP2_oB30_for_SC_CAN_V3_2_24e97840_Tx
              PduRDestPduPduRBswModulesRef = SecOC
            PduRSrcPdu_87aa4973 (PduRSrcPdu): PduRSourcePduHandleId=51, PduRSrcPduDirection=TRANSMIT, PduRSrcPduRef=IP2_oB30_for_SC_CAN_V3_2_24e97840_Tx, PduRSrcPduPduRBswModulesRef=Com
          DDCM3_oB30_for_SC_CAN_V3_2_fc0fd14f_Rx: PduRRoutingPathCommunicationType=COMMUNICATION_INTERFACE
            PduRSrcPdu_ad774806 (PduRSrcPdu): PduRSourcePduHandleId=57, PduRSrcPduDirection=RECEIVE, PduRSrcPduRef=DDCM3_oB30_for_SC_CAN_V3_2_fc0fd14f_Rx, PduRSrcPduPduRBswModulesRef=CanIf
            DDCM3_oB30_for_SC_CAN_V3_2_fc0fd14f_Rx_ad774806_Rx (PduRDestPdu):
              PduRDestPduHandleId = 57
              PduRDestPduDirection = RECEIVE
              PduRDestPduRoutingType = API_FORWARDING
              PduRDestPduDataProcessing = IMMEDIATE
              PduRPduLengthHandlingStrategy = IGNORE
              PduRTransmissionConfirmation = false
              PduRDestPduRef = DDCM3_oB30_for_SC_CAN_V3_2_6c768ffc_Rx
              PduRDestPduPduRBswModulesRef = Com
          IP2_Sc_oB30_for_SC_CAN_V3_2_bf1dcb66_Tx: PduRRoutingPathCommunicationType=COMMUNICATION_INTERFACE
            IP2_Sc_oB30_for_SC_CAN_V3_2_3598fa68_Tx (PduRDestPdu):
              PduRDestPduHandleId = 48
              PduRDestPduDirection = TRANSMIT
              PduRDestPduRoutingType = API_FORWARDING
              PduRDestPduDataProcessing = IMMEDIATE
              PduRPduLengthHandlingStrategy = IGNORE
              PduRTransmissionConfirmation = true
              PduRDestPduDataProvision = PDUR_DIRECT
              PduRDestPduRef = IP2_Sc_oB30_for_SC_CAN_V3_2_3598fa68_Tx
              PduRDestPduPduRBswModulesRef = CanIf
            PduRSrcPdu_bb663806 (PduRSrcPdu): PduRSourcePduHandleId=50, PduRSrcPduDirection=TRANSMIT, PduRSrcPduRef=IP2_Sc_oB30_for_SC_CAN_V3_2_bf1dcb66_Tx, PduRSrcPduPduRBswModulesRef=SecOC
          HUT_Phy_Req_oB30_for_SC_CAN_V3_2_6551238f_Rx: PduRRoutingPathCommunicationType=TRANSPORT_PROTOCOL
            PduRSrcPdu_669c96c2 (PduRSrcPdu):
              PduRSourcePduHandleId = 3
              PduRSrcPduDirection = RECEIVE
              PduRSrcPduRef = HUT_Phy_Req_oB30_for_SC_CAN_V3_2_6551238f_Rx
              PduRSrcPduPduRBswModulesRef = CanTp
            HUT_Phy_Req_oB30_for_SC_CAN_V3_2_6551238f_Rx_669c96c2_Rx (PduRDestPdu):
              PduRDestPduHandleId = 3
              PduRDestPduDirection = RECEIVE
              PduRDestPduRoutingType = API_FORWARDING
              PduRDestPduDataProcessing = IMMEDIATE
              PduRPduLengthHandlingStrategy = UNUSED
              PduRDestPduRef = HUT_Phy_Req_oB30_for_SC_CAN_V3_2_c7e62b5b_Rx
              PduRDestPduPduRBswModulesRef = Dcm
          HUT_Phy_Resp_oB30_for_SC_CAN_V3_2_20_bf18e38e_Tx: PduRRoutingPathCommunicationType=TRANSPORT_PROTOCOL
            HUT_Phy_Resp_oB30_for_SC_CAN_V3_2_20_e2aa5bb4_Tx (PduRDestPdu):
              PduRDestPduHandleId = 0
              PduRDestPduDirection = TRANSMIT
              PduRDestPduRoutingType = API_FORWARDING
              PduRDestPduDataProcessing = IMMEDIATE
              PduRPduLengthHandlingStrategy = UNUSED
              PduRDestPduRef = HUT_Phy_Resp_oB30_for_SC_CAN_V3_2_20_e2aa5bb4_Tx
              PduRDestPduPduRBswModulesRef = CanTp
              PduRQueueRef = PduRQueue
            PduRSrcPdu_c66043fb (PduRSrcPdu):
              PduRSourcePduHandleId = 46
              PduRSrcPduDirection = TRANSMIT
              PduRSrcPduRef = HUT_Phy_Resp_oB30_for_SC_CAN_V3_2_20_bf18e38e_Tx
              PduRSrcPduPduRBswModulesRef = Dcm
          HUT_Phy_Resp_oB30_for_SC_CAN_V3_2_9074f696_Tx: PduRRoutingPathCommunicationType=TRANSPORT_PROTOCOL
            PduRSrcPdu_ccf5ed2e (PduRSrcPdu):
              PduRSourcePduHandleId = 47
              PduRSrcPduDirection = TRANSMIT
              PduRSrcPduRef = HUT_Phy_Resp_oB30_for_SC_CAN_V3_2_9074f696_Tx
              PduRSrcPduPduRBswModulesRef = Dcm
            HUT_Phy_Resp_oB30_for_SC_CAN_V3_2_69356df1_Tx (PduRDestPdu):
              PduRDestPduHandleId = 1
              PduRDestPduDirection = TRANSMIT
              PduRDestPduRoutingType = API_FORWARDING
              PduRDestPduDataProcessing = IMMEDIATE
              PduRPduLengthHandlingStrategy = UNUSED
              PduRDestPduRef = HUT_Phy_Resp_oB30_for_SC_CAN_V3_2_69356df1_Tx
              PduRDestPduPduRBswModulesRef = CanTp
          GW_Sync_Req_Sc_oB30_for_SC_CAN_V3_2_21657c6a_Rx: PduRRoutingPathCommunicationType=COMMUNICATION_INTERFACE
            GW_Sync_Req_Sc_oB30_for_SC_CAN_V3_2_21657c6a_Rx_9dcf459c_Rx (PduRDestPdu):
              PduRDestPduHandleId = 94
              PduRDestPduDirection = RECEIVE
              PduRDestPduRoutingType = API_FORWARDING
              PduRDestPduDataProcessing = IMMEDIATE
              PduRPduLengthHandlingStrategy = IGNORE
              PduRTransmissionConfirmation = false
              PduRDestPduRef = GW_Sync_Req_Sc_oB30_for_SC_CAN_V3_2_922ee695_Rx
              PduRDestPduPduRBswModulesRef = SecOC
            PduRSrcPdu_9dcf459c (PduRSrcPdu):
              PduRSourcePduHandleId = 94
              PduRSrcPduDirection = RECEIVE
              PduRSrcPduRef = GW_Sync_Req_Sc_oB30_for_SC_CAN_V3_2_21657c6a_Rx
              PduRSrcPduPduRBswModulesRef = CanIf
          HUT_Phy_Req_oB30_for_SC_CAN_V3_2_20_98e0d928_Rx: PduRRoutingPathCommunicationType=TRANSPORT_PROTOCOL
            HUT_Phy_Req_oB30_for_SC_CAN_V3_2_20_98e0d928_Rx_f0c5fe46_Rx (PduRDestPdu):
              PduRDestPduHandleId = 2
              PduRDestPduDirection = RECEIVE
              PduRDestPduRoutingType = API_FORWARDING
              PduRDestPduDataProcessing = IMMEDIATE
              PduRPduLengthHandlingStrategy = UNUSED
              PduRDestPduRef = HUT_Phy_Req_oB30_for_SC_CAN_V3_2_20_0cf8aff0_Rx
              PduRDestPduPduRBswModulesRef = Dcm
            PduRSrcPdu_f0c5fe46 (PduRSrcPdu):
              PduRSourcePduHandleId = 2
              PduRSrcPduDirection = RECEIVE
              PduRSrcPduRef = HUT_Phy_Req_oB30_for_SC_CAN_V3_2_20_98e0d928_Rx
              PduRSrcPduPduRBswModulesRef = CanTp
          GW_Sync_Req_oB30_for_SC_CAN_V3_2_6800966b_Rx: PduRRoutingPathCommunicationType=COMMUNICATION_INTERFACE
            GW_Sync_Req_oB30_for_SC_CAN_V3_2_6800966b_Rx (PduRDestPdu):
              PduRDestPduHandleId = 95
              PduRDestPduDirection = RECEIVE
              PduRDestPduRoutingType = API_FORWARDING
              PduRDestPduDataProcessing = IMMEDIATE
              PduRPduLengthHandlingStrategy = IGNORE
              PduRTransmissionConfirmation = false
              PduRDestPduRef = GW_Sync_Req_oB30_for_SC_CAN_V3_2_6800966b_Rx
              PduRDestPduPduRBswModulesRef = Com
            PduRSrcPdu_f6108157 (PduRSrcPdu):
              PduRSourcePduHandleId = 95
              PduRSrcPduDirection = RECEIVE
              PduRSrcPduRef = GW_Sync_Req_oB30_for_SC_CAN_V3_2_6800966b_Rx
              PduRSrcPduPduRBswModulesRef = SecOC
          DiagFuncReq_oB30_for_SC_CAN_V3_2_93239eac_Rx: PduRRoutingPathCommunicationType=TRANSPORT_PROTOCOL
            DiagFuncReq_oB30_for_SC_CAN_V3_2_93239eac_Rx_bdc20d60_Rx (PduRDestPdu):
              PduRDestPduHandleId = 1
              PduRDestPduDirection = RECEIVE
              PduRDestPduRoutingType = API_FORWARDING
              PduRDestPduDataProcessing = IMMEDIATE
              PduRPduLengthHandlingStrategy = UNUSED
              PduRDestPduRef = DiagFuncReq_oB30_for_SC_CAN_V3_2_92cf4cbf_Rx
              PduRDestPduPduRBswModulesRef = Dcm
            PduRSrcPdu_bdc20d60 (PduRSrcPdu):
              PduRSourcePduHandleId = 1
              PduRSrcPduDirection = RECEIVE
              PduRSrcPduRef = DiagFuncReq_oB30_for_SC_CAN_V3_2_93239eac_Rx
              PduRSrcPduPduRBswModulesRef = CanTp
          DiagFuncReq_oB30_for_SC_CAN_V3_2_20_4d8be182_Rx: PduRRoutingPathCommunicationType=TRANSPORT_PROTOCOL
            PduRSrcPdu_9ca86fd2 (PduRSrcPdu):
              PduRSourcePduHandleId = 0
              PduRSrcPduDirection = RECEIVE
              PduRSrcPduRef = DiagFuncReq_oB30_for_SC_CAN_V3_2_20_4d8be182_Rx
              PduRSrcPduPduRBswModulesRef = CanTp
            DiagFuncReq_oB30_for_SC_CAN_V3_2_20_4d8be182_Rx_9ca86fd2_Rx (PduRDestPdu):
              PduRDestPduHandleId = 0
              PduRDestPduDirection = RECEIVE
              PduRDestPduRoutingType = API_FORWARDING
              PduRDestPduDataProcessing = IMMEDIATE
              PduRPduLengthHandlingStrategy = UNUSED
              PduRDestPduRef = DiagFuncReq_oB30_for_SC_CAN_V3_2_20_ca1db2d5_Rx
              PduRDestPduPduRBswModulesRef = Dcm
          TOD1_oB30_for_SC_CAN_V3_2_4faf68bf_Rx: PduRRoutingPathCommunicationType=COMMUNICATION_INTERFACE
            PduRSrcPdu_0f6d129e (PduRSrcPdu): PduRSourcePduHandleId=140, PduRSrcPduDirection=RECEIVE, PduRSrcPduRef=TOD1_oB30_for_SC_CAN_V3_2_4faf68bf_Rx, PduRSrcPduPduRBswModulesRef=CanIf
            TOD1_oB30_for_SC_CAN_V3_2_4faf68bf_Rx_0f6d129e_Rx (PduRDestPdu):
              PduRDestPduHandleId = 140
              PduRDestPduDirection = RECEIVE
              PduRDestPduRoutingType = API_FORWARDING
              PduRDestPduDataProcessing = IMMEDIATE
              PduRPduLengthHandlingStrategy = IGNORE
              PduRTransmissionConfirmation = false
              PduRDestPduRef = TOD1_oB30_for_SC_CAN_V3_2_77c15f81_Rx
              PduRDestPduPduRBswModulesRef = Com
          BMS65_oB30_for_SC_CAN_V3_2_f8605782_Rx: PduRRoutingPathCommunicationType=COMMUNICATION_INTERFACE
            BMS65_oB30_for_SC_CAN_V3_2_f8605782_Rx_567eb873_Rx (PduRDestPdu):
              PduRDestPduHandleId = 45
              PduRDestPduDirection = RECEIVE
              PduRDestPduRoutingType = API_FORWARDING
              PduRDestPduDataProcessing = IMMEDIATE
              PduRPduLengthHandlingStrategy = IGNORE
              PduRTransmissionConfirmation = false
              PduRDestPduRef = BMS65_oB30_for_SC_CAN_V3_2_a7b39db6_Rx
              PduRDestPduPduRBswModulesRef = Com
            PduRSrcPdu_567eb873 (PduRSrcPdu): PduRSourcePduHandleId=45, PduRSrcPduDirection=RECEIVE, PduRSrcPduRef=BMS65_oB30_for_SC_CAN_V3_2_f8605782_Rx, PduRSrcPduPduRBswModulesRef=CanIf
          HUT42_oB30_for_SC_CAN_V3_2_2a9b9562_Tx: PduRRoutingPathCommunicationType=COMMUNICATION_INTERFACE
            HUT42_oB30_for_SC_CAN_V3_2_0bb44615_Tx (PduRDestPdu):
              PduRDestPduHandleId = 35
              PduRDestPduDirection = TRANSMIT
              PduRDestPduRoutingType = API_FORWARDING
              PduRDestPduDataProcessing = IMMEDIATE
              PduRPduLengthHandlingStrategy = IGNORE
              PduRDestPduDataProvision = PDUR_DIRECT
              PduRTransmissionConfirmation = true
              PduRDestPduRef = HUT42_oB30_for_SC_CAN_V3_2_0bb44615_Tx
              PduRDestPduPduRBswModulesRef = CanIf
            PduRSrcPdu_5e49194f (PduRSrcPdu): PduRSourcePduHandleId=35, PduRSrcPduDirection=TRANSMIT, PduRSrcPduRef=HUT42_oB30_for_SC_CAN_V3_2_2a9b9562_Tx, PduRSrcPduPduRBswModulesRef=Com
          AC6_oB30_for_SC_CAN_V3_2_29686454_Rx: PduRRoutingPathCommunicationType=COMMUNICATION_INTERFACE
            AC6_oB30_for_SC_CAN_V3_2_29686454_Rx_e64ce2e4_Rx (PduRDestPdu):
              PduRDestPduHandleId = 9
              PduRDestPduDirection = RECEIVE
              PduRDestPduRoutingType = API_FORWARDING
              PduRDestPduDataProcessing = IMMEDIATE
              PduRPduLengthHandlingStrategy = IGNORE
              PduRTransmissionConfirmation = false
              PduRDestPduRef = AC6_oB30_for_SC_CAN_V3_2_ddd2688f_Rx
              PduRDestPduPduRBswModulesRef = Com
            PduRSrcPdu_e64ce2e4 (PduRSrcPdu): PduRSourcePduHandleId=9, PduRSrcPduDirection=RECEIVE, PduRSrcPduRef=AC6_oB30_for_SC_CAN_V3_2_29686454_Rx, PduRSrcPduPduRBswModulesRef=CanIf
          HUT26_oB30_for_SC_CAN_V3_2_9bf07418_Tx: PduRRoutingPathCommunicationType=COMMUNICATION_INTERFACE
            PduRSrcPdu_3497f533 (PduRSrcPdu): PduRSourcePduHandleId=21, PduRSrcPduDirection=TRANSMIT, PduRSrcPduRef=HUT26_oB30_for_SC_CAN_V3_2_9bf07418_Tx, PduRSrcPduPduRBswModulesRef=Com
            HUT26_oB30_for_SC_CAN_V3_2_3a768ab4_Tx (PduRDestPdu):
              PduRDestPduHandleId = 21
              PduRDestPduDirection = TRANSMIT
              PduRDestPduRoutingType = API_FORWARDING
              PduRDestPduDataProcessing = IMMEDIATE
              PduRPduLengthHandlingStrategy = IGNORE
              PduRDestPduDataProvision = PDUR_DIRECT
              PduRTransmissionConfirmation = true
              PduRDestPduRef = HUT26_oB30_for_SC_CAN_V3_2_3a768ab4_Tx
              PduRDestPduPduRBswModulesRef = CanIf
          CP1_oB30_for_SC_CAN_V3_2_5fdd0f6e_Rx: PduRRoutingPathCommunicationType=COMMUNICATION_INTERFACE
            CP1_oB30_for_SC_CAN_V3_2_5fdd0f6e_Rx_05f449b1_Rx (PduRDestPdu):
              PduRDestPduHandleId = 48
              PduRDestPduDirection = RECEIVE
              PduRDestPduRoutingType = API_FORWARDING
              PduRDestPduDataProcessing = IMMEDIATE
              PduRPduLengthHandlingStrategy = IGNORE
              PduRTransmissionConfirmation = false
              PduRDestPduRef = CP1_oB30_for_SC_CAN_V3_2_16a725b1_Rx
              PduRDestPduPduRBswModulesRef = Com
            PduRSrcPdu_05f449b1 (PduRSrcPdu): PduRSourcePduHandleId=48, PduRSrcPduDirection=RECEIVE, PduRSrcPduRef=CP1_oB30_for_SC_CAN_V3_2_5fdd0f6e_Rx, PduRSrcPduPduRBswModulesRef=CanIf
          HUT38_oB30_for_SC_CAN_V3_2_cb31e24c_Tx: PduRRoutingPathCommunicationType=COMMUNICATION_INTERFACE
            HUT38_oB30_for_SC_CAN_V3_2_65edd6cd_Tx (PduRDestPdu):
              PduRDestPduHandleId = 31
              PduRDestPduDirection = TRANSMIT
              PduRDestPduRoutingType = API_FORWARDING
              PduRDestPduDataProcessing = IMMEDIATE
              PduRPduLengthHandlingStrategy = IGNORE
              PduRDestPduDataProvision = PDUR_DIRECT
              PduRTransmissionConfirmation = true
              PduRDestPduRef = HUT38_oB30_for_SC_CAN_V3_2_65edd6cd_Tx
              PduRDestPduPduRBswModulesRef = CanIf
            PduRSrcPdu_07e616e9 (PduRSrcPdu): PduRSourcePduHandleId=31, PduRSrcPduDirection=TRANSMIT, PduRSrcPduRef=HUT38_oB30_for_SC_CAN_V3_2_cb31e24c_Tx, PduRSrcPduPduRBswModulesRef=Com
          Trailer1_oB30_for_SC_CAN_V3_2_f8a7c92e_Rx: PduRRoutingPathCommunicationType=COMMUNICATION_INTERFACE
            Trailer1_oB30_for_SC_CAN_V3_2_f8a7c92e_Rx_4c55e876_Rx (PduRDestPdu):
              PduRDestPduHandleId = 152
              PduRDestPduDirection = RECEIVE
              PduRDestPduRoutingType = API_FORWARDING
              PduRDestPduDataProcessing = IMMEDIATE
              PduRPduLengthHandlingStrategy = IGNORE
              PduRTransmissionConfirmation = false
              PduRDestPduRef = Trailer1_oB30_for_SC_CAN_V3_2_7da566bd_Rx
              PduRDestPduPduRBswModulesRef = Com
            PduRSrcPdu_4c55e876 (PduRSrcPdu): PduRSourcePduHandleId=152, PduRSrcPduDirection=RECEIVE, PduRSrcPduRef=Trailer1_oB30_for_SC_CAN_V3_2_f8a7c92e_Rx, PduRSrcPduPduRBswModulesRef=CanIf
          AC7_oB30_for_SC_CAN_V3_2_e35697c7_Rx: PduRRoutingPathCommunicationType=COMMUNICATION_INTERFACE
            AC7_oB30_for_SC_CAN_V3_2_e35697c7_Rx_7d545289_Rx (PduRDestPdu):
              PduRDestPduHandleId = 10
              PduRDestPduDirection = RECEIVE
              PduRDestPduRoutingType = API_FORWARDING
              PduRDestPduDataProcessing = IMMEDIATE
              PduRPduLengthHandlingStrategy = IGNORE
              PduRTransmissionConfirmation = false
              PduRDestPduRef = AC7_oB30_for_SC_CAN_V3_2_cafa0c4f_Rx
              PduRDestPduPduRBswModulesRef = Com
            PduRSrcPdu_7d545289 (PduRSrcPdu): PduRSourcePduHandleId=10, PduRSrcPduDirection=RECEIVE, PduRSrcPduRef=AC7_oB30_for_SC_CAN_V3_2_e35697c7_Rx, PduRSrcPduPduRBswModulesRef=CanIf
          ESP_FD2_Sc_oB30_for_SC_CAN_V3_2_dec71f3e_Rx: PduRRoutingPathCommunicationType=COMMUNICATION_INTERFACE
            ESP_FD2_Sc_oB30_for_SC_CAN_V3_2_dec71f3e_Rx_84656837_Rx (PduRDestPdu):
              PduRDestPduHandleId = 85
              PduRDestPduDirection = RECEIVE
              PduRDestPduRoutingType = API_FORWARDING
              PduRDestPduDataProcessing = IMMEDIATE
              PduRPduLengthHandlingStrategy = IGNORE
              PduRTransmissionConfirmation = false
              PduRDestPduRef = ESP_FD2_Sc_oB30_for_SC_CAN_V3_2_49635fc5_Rx
              PduRDestPduPduRBswModulesRef = SecOC
            PduRSrcPdu_84656837 (PduRSrcPdu):
              PduRSourcePduHandleId = 85
              PduRSrcPduDirection = RECEIVE
              PduRSrcPduRef = ESP_FD2_Sc_oB30_for_SC_CAN_V3_2_dec71f3e_Rx
              PduRSrcPduPduRBswModulesRef = CanIf
          Ibooster_FD2_oB30_for_SC_CAN_V3_2_055eeaf7_Rx: PduRRoutingPathCommunicationType=COMMUNICATION_INTERFACE
            PduRSrcPdu_b05d026c (PduRSrcPdu):
              PduRSourcePduHandleId = 125
              PduRSrcPduDirection = RECEIVE
              PduRSrcPduRef = Ibooster_FD2_oB30_for_SC_CAN_V3_2_055eeaf7_Rx
              PduRSrcPduPduRBswModulesRef = CanIf
            Ibooster_FD2_oB30_for_SC_CAN_V3_2_055eeaf7_Rx_b05d026c_Rx (PduRDestPdu):
              PduRDestPduHandleId = 125
              PduRDestPduDirection = RECEIVE
              PduRDestPduRoutingType = API_FORWARDING
              PduRDestPduDataProcessing = IMMEDIATE
              PduRPduLengthHandlingStrategy = IGNORE
              PduRTransmissionConfirmation = false
              PduRDestPduRef = Ibooster_FD2_oB30_for_SC_CAN_V3_2_e9e18adf_Rx
              PduRDestPduPduRBswModulesRef = Com
          ELD1_oB30_for_SC_CAN_V3_2_d7398aaa_Rx: PduRRoutingPathCommunicationType=COMMUNICATION_INTERFACE
            PduRSrcPdu_d642fa01 (PduRSrcPdu): PduRSourcePduHandleId=79, PduRSrcPduDirection=RECEIVE, PduRSrcPduRef=ELD1_oB30_for_SC_CAN_V3_2_d7398aaa_Rx, PduRSrcPduPduRBswModulesRef=CanIf
            ELD1_oB30_for_SC_CAN_V3_2_d7398aaa_Rx_d642fa01_Rx (PduRDestPdu):
              PduRDestPduHandleId = 79
              PduRDestPduDirection = RECEIVE
              PduRDestPduRoutingType = API_FORWARDING
              PduRDestPduDataProcessing = IMMEDIATE
              PduRPduLengthHandlingStrategy = IGNORE
              PduRTransmissionConfirmation = false
              PduRDestPduRef = ELD1_oB30_for_SC_CAN_V3_2_d24341c9_Rx
              PduRDestPduPduRBswModulesRef = Com
          HUT45_oB30_for_SC_CAN_V3_2_4f42ab22_Tx: PduRRoutingPathCommunicationType=COMMUNICATION_INTERFACE
            HUT45_oB30_for_SC_CAN_V3_2_109f962f_Tx (PduRDestPdu):
              PduRDestPduHandleId = 37
              PduRDestPduDirection = TRANSMIT
              PduRDestPduRoutingType = API_FORWARDING
              PduRDestPduDataProcessing = IMMEDIATE
              PduRPduLengthHandlingStrategy = IGNORE
              PduRDestPduDataProvision = PDUR_DIRECT
              PduRTransmissionConfirmation = true
              PduRDestPduRef = HUT45_oB30_for_SC_CAN_V3_2_109f962f_Tx
              PduRDestPduPduRBswModulesRef = CanIf
            PduRSrcPdu_fbf75239 (PduRSrcPdu): PduRSourcePduHandleId=37, PduRSrcPduDirection=TRANSMIT, PduRSrcPduRef=HUT45_oB30_for_SC_CAN_V3_2_4f42ab22_Tx, PduRSrcPduPduRBswModulesRef=Com
          HUT31_oB30_for_SC_CAN_V3_2_655aa08c_Tx: PduRRoutingPathCommunicationType=COMMUNICATION_INTERFACE
            PduRSrcPdu_d46dc62c (PduRSrcPdu): PduRSourcePduHandleId=24, PduRSrcPduDirection=TRANSMIT, PduRSrcPduRef=HUT31_oB30_for_SC_CAN_V3_2_655aa08c_Tx, PduRSrcPduPduRBswModulesRef=Com
            HUT31_oB30_for_SC_CAN_V3_2_4891a683_Tx (PduRDestPdu):
              PduRDestPduHandleId = 24
              PduRDestPduDirection = TRANSMIT
              PduRDestPduRoutingType = API_FORWARDING
              PduRDestPduDataProcessing = IMMEDIATE
              PduRPduLengthHandlingStrategy = IGNORE
              PduRDestPduDataProvision = PDUR_DIRECT
              PduRTransmissionConfirmation = true
              PduRDestPduRef = HUT31_oB30_for_SC_CAN_V3_2_4891a683_Tx
              PduRDestPduPduRBswModulesRef = CanIf
          AC3_oB30_for_SC_CAN_V3_2_7d4f5509_Rx: PduRRoutingPathCommunicationType=COMMUNICATION_INTERFACE
            AC3_oB30_for_SC_CAN_V3_2_7d4f5509_Rx_c31e0157_Rx (PduRDestPdu):
              PduRDestPduHandleId = 7
              PduRDestPduDirection = RECEIVE
              PduRDestPduRoutingType = API_FORWARDING
              PduRDestPduDataProcessing = IMMEDIATE
              PduRPduLengthHandlingStrategy = IGNORE
              PduRTransmissionConfirmation = false
              PduRDestPduRef = AC3_oB30_for_SC_CAN_V3_2_965b9f4f_Rx
              PduRDestPduPduRBswModulesRef = Com
            PduRSrcPdu_c31e0157 (PduRSrcPdu): PduRSourcePduHandleId=7, PduRSrcPduDirection=RECEIVE, PduRSrcPduRef=AC3_oB30_for_SC_CAN_V3_2_7d4f5509_Rx, PduRSrcPduPduRBswModulesRef=CanIf
          BCM14_oB30_for_SC_CAN_V3_2_e173da2e_Rx: PduRRoutingPathCommunicationType=COMMUNICATION_INTERFACE
            BCM14_oB30_for_SC_CAN_V3_2_e173da2e_Rx_feec0bf6_Rx (PduRDestPdu):
              PduRDestPduHandleId = 34
              PduRDestPduDirection = RECEIVE
              PduRDestPduRoutingType = API_FORWARDING
              PduRDestPduDataProcessing = IMMEDIATE
              PduRPduLengthHandlingStrategy = IGNORE
              PduRTransmissionConfirmation = false
              PduRDestPduRef = BCM14_oB30_for_SC_CAN_V3_2_9ca98f1a_Rx
              PduRDestPduPduRBswModulesRef = Com
            PduRSrcPdu_feec0bf6 (PduRSrcPdu): PduRSourcePduHandleId=34, PduRSrcPduDirection=RECEIVE, PduRSrcPduRef=BCM14_oB30_for_SC_CAN_V3_2_e173da2e_Rx, PduRSrcPduPduRBswModulesRef=CanIf
          AC4_oB30_for_SC_CAN_V3_2_66648533_Rx: PduRRoutingPathCommunicationType=COMMUNICATION_INTERFACE
            AC4_oB30_for_SC_CAN_V3_2_66648533_Rx_30c11829_Rx (PduRDestPdu):
              PduRDestPduHandleId = 8
              PduRDestPduDirection = RECEIVE
              PduRDestPduRoutingType = API_FORWARDING
              PduRDestPduDataProcessing = IMMEDIATE
              PduRPduLengthHandlingStrategy = IGNORE
              PduRTransmissionConfirmation = false
              PduRDestPduRef = AC4_oB30_for_SC_CAN_V3_2_f382a10f_Rx
              PduRDestPduPduRBswModulesRef = Com
            PduRSrcPdu_30c11829 (PduRSrcPdu): PduRSourcePduHandleId=8, PduRSrcPduDirection=RECEIVE, PduRSrcPduRef=AC4_oB30_for_SC_CAN_V3_2_66648533_Rx, PduRSrcPduPduRBswModulesRef=CanIf
          HUT12_oB30_for_SC_CAN_V3_2_b1b4de25_Tx: PduRRoutingPathCommunicationType=COMMUNICATION_INTERFACE
            HUT12_oB30_for_SC_CAN_V3_2_1e3a4c6d_Tx (PduRDestPdu):
              PduRDestPduHandleId = 9
              PduRDestPduDirection = TRANSMIT
              PduRDestPduRoutingType = API_FORWARDING
              PduRDestPduDataProcessing = IMMEDIATE
              PduRPduLengthHandlingStrategy = IGNORE
              PduRTransmissionConfirmation = true
              PduRDestPduDataProvision = PDUR_DIRECT
              PduRDestPduRef = HUT12_oB30_for_SC_CAN_V3_2_1e3a4c6d_Tx
              PduRDestPduPduRBswModulesRef = CanIf
            PduRSrcPdu_9d723d5a (PduRSrcPdu): PduRSourcePduHandleId=9, PduRSrcPduDirection=TRANSMIT, PduRSrcPduRef=HUT12_oB30_for_SC_CAN_V3_2_b1b4de25_Tx, PduRSrcPduPduRBswModulesRef=Com
          T_BOX_FD4_oB30_for_SC_CAN_V3_2_b9da4418_Rx: PduRRoutingPathCommunicationType=COMMUNICATION_INTERFACE
            PduRSrcPdu_096bddaf (PduRSrcPdu):
              PduRSourcePduHandleId = 149
              PduRSrcPduDirection = RECEIVE
              PduRSrcPduRef = T_BOX_FD4_oB30_for_SC_CAN_V3_2_b9da4418_Rx
              PduRSrcPduPduRBswModulesRef = CanIf
            T_BOX_FD4_oB30_for_SC_CAN_V3_2_b9da4418_Rx_096bddaf_Rx (PduRDestPdu):
              PduRDestPduHandleId = 149
              PduRDestPduDirection = RECEIVE
              PduRDestPduRoutingType = API_FORWARDING
              PduRDestPduDataProcessing = IMMEDIATE
              PduRPduLengthHandlingStrategy = IGNORE
              PduRTransmissionConfirmation = false
              PduRDestPduRef = T_BOX_FD4_oB30_for_SC_CAN_V3_2_f4d43aba_Rx
              PduRDestPduPduRBswModulesRef = Com
          HUT43_oB30_for_SC_CAN_V3_2_3db3f1a2_Tx: PduRRoutingPathCommunicationType=COMMUNICATION_INTERFACE
            HUT43_oB30_for_SC_CAN_V3_2_c18ab586_Tx (PduRDestPdu):
              PduRDestPduHandleId = 36
              PduRDestPduDirection = TRANSMIT
              PduRDestPduRoutingType = API_FORWARDING
              PduRDestPduDataProcessing = IMMEDIATE
              PduRPduLengthHandlingStrategy = IGNORE
              PduRDestPduDataProvision = PDUR_DIRECT
              PduRTransmissionConfirmation = true
              PduRDestPduRef = HUT43_oB30_for_SC_CAN_V3_2_c18ab586_Tx
              PduRDestPduPduRBswModulesRef = CanIf
            PduRSrcPdu_f0d8b89d (PduRSrcPdu): PduRSourcePduHandleId=36, PduRSrcPduDirection=TRANSMIT, PduRSrcPduRef=HUT43_oB30_for_SC_CAN_V3_2_3db3f1a2_Tx, PduRSrcPduPduRBswModulesRef=Com
          BCM11_oB30_for_SC_CAN_V3_2_b554eb73_Rx: PduRRoutingPathCommunicationType=COMMUNICATION_INTERFACE
            PduRSrcPdu_4ae12c6a (PduRSrcPdu): PduRSourcePduHandleId=32, PduRSrcPduDirection=RECEIVE, PduRSrcPduRef=BCM11_oB30_for_SC_CAN_V3_2_b554eb73_Rx, PduRSrcPduPduRBswModulesRef=CanIf
            BCM11_oB30_for_SC_CAN_V3_2_b554eb73_Rx_4ae12c6a_Rx (PduRDestPdu):
              PduRDestPduHandleId = 32
              PduRDestPduDirection = RECEIVE
              PduRDestPduRoutingType = API_FORWARDING
              PduRDestPduDataProcessing = IMMEDIATE
              PduRPduLengthHandlingStrategy = IGNORE
              PduRTransmissionConfirmation = false
              PduRDestPduRef = BCM11_oB30_for_SC_CAN_V3_2_d72078da_Rx
              PduRDestPduPduRBswModulesRef = Com
          AC8_oB30_for_SC_CAN_V3_2_1f3fc420_Rx: PduRRoutingPathCommunicationType=COMMUNICATION_INTERFACE
            AC8_oB30_for_SC_CAN_V3_2_1f3fc420_Rx_554b1989_Rx (PduRDestPdu):
              PduRDestPduHandleId = 11
              PduRDestPduDirection = RECEIVE
              PduRDestPduRoutingType = API_FORWARDING
              PduRDestPduDataProcessing = IMMEDIATE
              PduRPduLengthHandlingStrategy = IGNORE
              PduRTransmissionConfirmation = false
              PduRDestPduRef = AC8_oB30_for_SC_CAN_V3_2_1660140f_Rx
              PduRDestPduPduRBswModulesRef = Com
            PduRSrcPdu_554b1989 (PduRSrcPdu): PduRSourcePduHandleId=11, PduRSrcPduDirection=RECEIVE, PduRSrcPduRef=AC8_oB30_for_SC_CAN_V3_2_1f3fc420_Rx, PduRSrcPduPduRBswModulesRef=CanIf
          ESP_FD2_oB30_for_SC_CAN_V3_2_c451c518_Rx: PduRRoutingPathCommunicationType=COMMUNICATION_INTERFACE
            ESP_FD2_oB30_for_SC_CAN_V3_2_c451c518_Rx (PduRDestPdu):
              PduRDestPduHandleId = 86
              PduRDestPduDirection = RECEIVE
              PduRDestPduRoutingType = API_FORWARDING
              PduRDestPduDataProcessing = IMMEDIATE
              PduRPduLengthHandlingStrategy = IGNORE
              PduRTransmissionConfirmation = false
              PduRDestPduRef = ESP_FD2_oB30_for_SC_CAN_V3_2_c451c518_Rx
              PduRDestPduPduRBswModulesRef = Com
            PduRSrcPdu_fb298bdb (PduRSrcPdu): PduRSourcePduHandleId=86, PduRSrcPduDirection=RECEIVE, PduRSrcPduRef=ESP_FD2_oB30_for_SC_CAN_V3_2_c451c518_Rx, PduRSrcPduPduRBswModulesRef=SecOC
          ECM16_oB30_for_SC_CAN_V3_2_40752239_Rx: PduRRoutingPathCommunicationType=COMMUNICATION_INTERFACE
            ECM16_oB30_for_SC_CAN_V3_2_40752239_Rx_47890b95_Rx (PduRDestPdu):
              PduRDestPduHandleId = 71
              PduRDestPduDirection = RECEIVE
              PduRDestPduRoutingType = API_FORWARDING
              PduRDestPduDataProcessing = IMMEDIATE
              PduRPduLengthHandlingStrategy = IGNORE
              PduRTransmissionConfirmation = false
              PduRDestPduRef = ECM16_oB30_for_SC_CAN_V3_2_6a3a3dbc_Rx
              PduRDestPduPduRBswModulesRef = Com
            PduRSrcPdu_47890b95 (PduRSrcPdu): PduRSourcePduHandleId=71, PduRSrcPduDirection=RECEIVE, PduRSrcPduRef=ECM16_oB30_for_SC_CAN_V3_2_40752239_Rx, PduRSrcPduPduRBswModulesRef=CanIf
          ESCL2_oB30_for_SC_CAN_V3_2_63dcaaa3_Rx: PduRRoutingPathCommunicationType=COMMUNICATION_INTERFACE
            PduRSrcPdu_698f1b71 (PduRSrcPdu): PduRSourcePduHandleId=82, PduRSrcPduDirection=RECEIVE, PduRSrcPduRef=ESCL2_oB30_for_SC_CAN_V3_2_63dcaaa3_Rx, PduRSrcPduPduRBswModulesRef=CanIf
            ESCL2_oB30_for_SC_CAN_V3_2_63dcaaa3_Rx_698f1b71_Rx (PduRDestPdu):
              PduRDestPduHandleId = 82
              PduRDestPduDirection = RECEIVE
              PduRDestPduRoutingType = API_FORWARDING
              PduRDestPduDataProcessing = IMMEDIATE
              PduRPduLengthHandlingStrategy = IGNORE
              PduRTransmissionConfirmation = false
              PduRDestPduRef = ESCL2_oB30_for_SC_CAN_V3_2_91777cb9_Rx
              PduRDestPduPduRBswModulesRef = Com
          HCU_HC16_oB30_for_SC_CAN_V3_2_f8c79c4c_Rx: PduRRoutingPathCommunicationType=COMMUNICATION_INTERFACE
            HCU_HC16_oB30_for_SC_CAN_V3_2_f8c79c4c_Rx_2b350323_Rx (PduRDestPdu):
              PduRDestPduHandleId = 110
              PduRDestPduDirection = RECEIVE
              PduRDestPduRoutingType = API_FORWARDING
              PduRDestPduDataProcessing = IMMEDIATE
              PduRPduLengthHandlingStrategy = IGNORE
              PduRTransmissionConfirmation = false
              PduRDestPduRef = HCU_HC16_oB30_for_SC_CAN_V3_2_a481d524_Rx
              PduRDestPduPduRBswModulesRef = Com
            PduRSrcPdu_2b350323 (PduRSrcPdu): PduRSourcePduHandleId=110, PduRSrcPduDirection=RECEIVE, PduRSrcPduRef=HCU_HC16_oB30_for_SC_CAN_V3_2_f8c79c4c_Rx, PduRSrcPduPduRBswModulesRef=CanIf
          T_BOX_FD1_oB30_for_SC_CAN_V3_2_bf5dcd7a_Rx: PduRRoutingPathCommunicationType=COMMUNICATION_INTERFACE
            T_BOX_FD1_oB30_for_SC_CAN_V3_2_bf5dcd7a_Rx (PduRDestPdu):
              PduRDestPduHandleId = 146
              PduRDestPduDirection = RECEIVE
              PduRDestPduRoutingType = API_FORWARDING
              PduRDestPduDataProcessing = IMMEDIATE
              PduRPduLengthHandlingStrategy = IGNORE
              PduRTransmissionConfirmation = false
              PduRDestPduRef = T_BOX_FD1_oB30_for_SC_CAN_V3_2_bf5dcd7a_Rx
              PduRDestPduPduRBswModulesRef = Com
            PduRSrcPdu_098f2493 (PduRSrcPdu):
              PduRSourcePduHandleId = 146
              PduRSrcPduDirection = RECEIVE
              PduRSrcPduRef = T_BOX_FD1_oB30_for_SC_CAN_V3_2_bf5dcd7a_Rx
              PduRSrcPduPduRBswModulesRef = SecOC
          T_BOX_FD3_oB30_for_SC_CAN_V3_2_910d04fa_Rx: PduRRoutingPathCommunicationType=COMMUNICATION_INTERFACE
            T_BOX_FD3_oB30_for_SC_CAN_V3_2_910d04fa_Rx (PduRDestPdu):
              PduRDestPduHandleId = 148
              PduRDestPduDirection = RECEIVE
              PduRDestPduRoutingType = API_FORWARDING
              PduRDestPduDataProcessing = IMMEDIATE
              PduRPduLengthHandlingStrategy = IGNORE
              PduRTransmissionConfirmation = false
              PduRDestPduRef = T_BOX_FD3_oB30_for_SC_CAN_V3_2_910d04fa_Rx
              PduRDestPduPduRBswModulesRef = Com
            PduRSrcPdu_118b1947 (PduRSrcPdu):
              PduRSourcePduHandleId = 148
              PduRSrcPduDirection = RECEIVE
              PduRSrcPduRef = T_BOX_FD3_oB30_for_SC_CAN_V3_2_910d04fa_Rx
              PduRSrcPduPduRBswModulesRef = SecOC
          EPS_FD1_oB30_for_SC_CAN_V3_2_a6650fa5_Rx: PduRRoutingPathCommunicationType=COMMUNICATION_INTERFACE
            EPS_FD1_oB30_for_SC_CAN_V3_2_a6650fa5_Rx_bbdca1bb_Rx (PduRDestPdu):
              PduRDestPduHandleId = 81
              PduRDestPduDirection = RECEIVE
              PduRDestPduRoutingType = API_FORWARDING
              PduRDestPduDataProcessing = IMMEDIATE
              PduRPduLengthHandlingStrategy = IGNORE
              PduRTransmissionConfirmation = false
              PduRDestPduRef = EPS_FD1_oB30_for_SC_CAN_V3_2_bceaa863_Rx
              PduRDestPduPduRBswModulesRef = Com
            PduRSrcPdu_bbdca1bb (PduRSrcPdu): PduRSourcePduHandleId=81, PduRSrcPduDirection=RECEIVE, PduRSrcPduRef=EPS_FD1_oB30_for_SC_CAN_V3_2_a6650fa5_Rx, PduRSrcPduPduRBswModulesRef=CanIf
          HUT_Sync_Req_oB30_for_SC_CAN_V3_2_c00563cb_Tx: PduRRoutingPathCommunicationType=COMMUNICATION_INTERFACE
            PduRSrcPdu_dab69b66 (PduRSrcPdu):
              PduRSourcePduHandleId = 48
              PduRSrcPduDirection = TRANSMIT
              PduRSrcPduRef = HUT_Sync_Req_oB30_for_SC_CAN_V3_2_c00563cb_Tx
              PduRSrcPduPduRBswModulesRef = Com
            HUT_Sync_Req_oB30_for_SC_CAN_V3_2_850087bd_Tx (PduRDestPdu):
              PduRDestPduHandleId = 46
              PduRDestPduDirection = TRANSMIT
              PduRDestPduRoutingType = API_FORWARDING
              PduRDestPduDataProcessing = IMMEDIATE
              PduRPduLengthHandlingStrategy = IGNORE
              PduRDestPduDataProvision = PDUR_DIRECT
              PduRTransmissionConfirmation = true
              PduRDestPduRef = HUT_Sync_Req_oB30_for_SC_CAN_V3_2_850087bd_Tx
              PduRDestPduPduRBswModulesRef = CanIf
          T_BOX_FD3_Sc_oB30_for_SC_CAN_V3_2_3919f2cf_Rx: PduRRoutingPathCommunicationType=COMMUNICATION_INTERFACE
            PduRSrcPdu_3e24f09b (PduRSrcPdu):
              PduRSourcePduHandleId = 147
              PduRSrcPduDirection = RECEIVE
              PduRSrcPduRef = T_BOX_FD3_Sc_oB30_for_SC_CAN_V3_2_3919f2cf_Rx
              PduRSrcPduPduRBswModulesRef = CanIf
            T_BOX_FD3_Sc_oB30_for_SC_CAN_V3_2_3919f2cf_Rx_3e24f09b_Rx (PduRDestPdu):
              PduRDestPduHandleId = 147
              PduRDestPduDirection = RECEIVE
              PduRDestPduRoutingType = API_FORWARDING
              PduRDestPduDataProcessing = IMMEDIATE
              PduRPduLengthHandlingStrategy = IGNORE
              PduRTransmissionConfirmation = false
              PduRDestPduRef = T_BOX_FD3_Sc_oB30_for_SC_CAN_V3_2_5339a08e_Rx
              PduRDestPduPduRBswModulesRef = SecOC
          T_BOX_FD1_Sc_oB30_for_SC_CAN_V3_2_3a52a1a3_Rx: PduRRoutingPathCommunicationType=COMMUNICATION_INTERFACE
            PduRSrcPdu_8bd0b3d2 (PduRSrcPdu):
              PduRSourcePduHandleId = 145
              PduRSrcPduDirection = RECEIVE
              PduRSrcPduRef = T_BOX_FD1_Sc_oB30_for_SC_CAN_V3_2_3a52a1a3_Rx
              PduRSrcPduPduRBswModulesRef = CanIf
            T_BOX_FD1_Sc_oB30_for_SC_CAN_V3_2_3a52a1a3_Rx_8bd0b3d2_Rx (PduRDestPdu):
              PduRDestPduHandleId = 145
              PduRDestPduDirection = RECEIVE
              PduRDestPduRoutingType = API_FORWARDING
              PduRDestPduDataProcessing = IMMEDIATE
              PduRPduLengthHandlingStrategy = IGNORE
              PduRTransmissionConfirmation = false
              PduRDestPduRef = T_BOX_FD1_Sc_oB30_for_SC_CAN_V3_2_c35f86d3_Rx
              PduRDestPduPduRBswModulesRef = SecOC
          DOCK1_oB30_for_SC_CAN_V3_2_131b892d_Rx: PduRRoutingPathCommunicationType=COMMUNICATION_INTERFACE
            PduRSrcPdu_f8ac6ad4 (PduRSrcPdu): PduRSourcePduHandleId=58, PduRSrcPduDirection=RECEIVE, PduRSrcPduRef=DOCK1_oB30_for_SC_CAN_V3_2_131b892d_Rx, PduRSrcPduPduRBswModulesRef=CanIf
            DOCK1_oB30_for_SC_CAN_V3_2_131b892d_Rx_f8ac6ad4_Rx (PduRDestPdu):
              PduRDestPduHandleId = 58
              PduRDestPduDirection = RECEIVE
              PduRDestPduRoutingType = API_FORWARDING
              PduRDestPduDataProcessing = IMMEDIATE
              PduRPduLengthHandlingStrategy = IGNORE
              PduRTransmissionConfirmation = false
              PduRDestPduRef = DOCK1_oB30_for_SC_CAN_V3_2_b60a11e2_Rx
              PduRDestPduPduRBswModulesRef = Com
          HUT_FD5_oB30_for_SC_CAN_V3_2_3d88d1c0_Tx: PduRRoutingPathCommunicationType=COMMUNICATION_INTERFACE
            PduRSrcPdu_86466688 (PduRSrcPdu): PduRSourcePduHandleId=45, PduRSrcPduDirection=TRANSMIT, PduRSrcPduRef=HUT_FD5_oB30_for_SC_CAN_V3_2_3d88d1c0_Tx, PduRSrcPduPduRBswModulesRef=Com
            HUT_FD5_oB30_for_SC_CAN_V3_2_02e08044_Tx (PduRDestPdu):
              PduRDestPduHandleId = 45
              PduRDestPduDirection = TRANSMIT
              PduRDestPduRoutingType = API_FORWARDING
              PduRDestPduDataProcessing = IMMEDIATE
              PduRPduLengthHandlingStrategy = IGNORE
              PduRDestPduDataProvision = PDUR_DIRECT
              PduRTransmissionConfirmation = true
              PduRDestPduRef = HUT_FD5_oB30_for_SC_CAN_V3_2_02e08044_Tx
              PduRDestPduPduRBswModulesRef = CanIf
          HUT40_oB30_for_SC_CAN_V3_2_04cb5ce2_Tx: PduRRoutingPathCommunicationType=COMMUNICATION_INTERFACE
            PduRSrcPdu_95a4b083 (PduRSrcPdu): PduRSourcePduHandleId=33, PduRSrcPduDirection=TRANSMIT, PduRSrcPduRef=HUT40_oB30_for_SC_CAN_V3_2_04cb5ce2_Tx, PduRSrcPduPduRBswModulesRef=Com
            HUT40_oB30_for_SC_CAN_V3_2_44b8a772_Tx (PduRDestPdu):
              PduRDestPduHandleId = 33
              PduRDestPduDirection = TRANSMIT
              PduRDestPduRoutingType = API_FORWARDING
              PduRDestPduDataProcessing = IMMEDIATE
              PduRPduLengthHandlingStrategy = IGNORE
              PduRDestPduDataProvision = PDUR_DIRECT
              PduRTransmissionConfirmation = true
              PduRDestPduRef = HUT40_oB30_for_SC_CAN_V3_2_44b8a772_Tx
              PduRDestPduPduRBswModulesRef = CanIf
          DSC4_oB30_for_SC_CAN_V3_2_27be643b_Rx: PduRRoutingPathCommunicationType=COMMUNICATION_INTERFACE
            PduRSrcPdu_859010d7 (PduRSrcPdu): PduRSourcePduHandleId=60, PduRSrcPduDirection=RECEIVE, PduRSrcPduRef=DSC4_oB30_for_SC_CAN_V3_2_27be643b_Rx, PduRSrcPduPduRBswModulesRef=CanIf
            DSC4_oB30_for_SC_CAN_V3_2_27be643b_Rx_859010d7_Rx (PduRDestPdu):
              PduRDestPduHandleId = 60
              PduRDestPduDirection = RECEIVE
              PduRDestPduRoutingType = API_FORWARDING
              PduRDestPduDataProcessing = IMMEDIATE
              PduRPduLengthHandlingStrategy = IGNORE
              PduRTransmissionConfirmation = false
              PduRDestPduRef = DSC4_oB30_for_SC_CAN_V3_2_d686ca5d_Rx
              PduRDestPduPduRBswModulesRef = Com
          HUT37_oB30_for_SC_CAN_V3_2_17abfa0c_Tx: PduRRoutingPathCommunicationType=COMMUNICATION_INTERFACE
            PduRSrcPdu_b19a5ca2 (PduRSrcPdu): PduRSourcePduHandleId=30, PduRSrcPduDirection=TRANSMIT, PduRSrcPduRef=HUT37_oB30_for_SC_CAN_V3_2_17abfa0c_Tx, PduRSrcPduPduRBswModulesRef=Com
            HUT37_oB30_for_SC_CAN_V3_2_9984852a_Tx (PduRDestPdu):
              PduRDestPduHandleId = 30
              PduRDestPduDirection = TRANSMIT
              PduRDestPduRoutingType = API_FORWARDING
              PduRDestPduDataProcessing = IMMEDIATE
              PduRPduLengthHandlingStrategy = IGNORE
              PduRDestPduDataProvision = PDUR_DIRECT
              PduRTransmissionConfirmation = true
              PduRDestPduRef = HUT37_oB30_for_SC_CAN_V3_2_9984852a_Tx
              PduRDestPduPduRBswModulesRef = CanIf
          HUT36_oB30_for_SC_CAN_V3_2_00839ecc_Tx: PduRRoutingPathCommunicationType=COMMUNICATION_INTERFACE
            PduRSrcPdu_c088a30b (PduRSrcPdu): PduRSourcePduHandleId=29, PduRSrcPduDirection=TRANSMIT, PduRSrcPduRef=HUT36_oB30_for_SC_CAN_V3_2_00839ecc_Tx, PduRSrcPduPduRBswModulesRef=Com
            HUT36_oB30_for_SC_CAN_V3_2_53ba76b9_Tx (PduRDestPdu):
              PduRDestPduHandleId = 29
              PduRDestPduDirection = TRANSMIT
              PduRDestPduRoutingType = API_FORWARDING
              PduRDestPduDataProcessing = IMMEDIATE
              PduRPduLengthHandlingStrategy = IGNORE
              PduRDestPduDataProvision = PDUR_DIRECT
              PduRTransmissionConfirmation = true
              PduRDestPduRef = HUT36_oB30_for_SC_CAN_V3_2_53ba76b9_Tx
              PduRDestPduPduRBswModulesRef = CanIf
          DOCK2_oB30_for_SC_CAN_V3_2_96299bd9_Rx: PduRRoutingPathCommunicationType=COMMUNICATION_INTERFACE
            DOCK2_oB30_for_SC_CAN_V3_2_96299bd9_Rx_b60b7e4e_Rx (PduRDestPdu):
              PduRDestPduHandleId = 59
              PduRDestPduDirection = RECEIVE
              PduRDestPduRoutingType = API_FORWARDING
              PduRDestPduDataProcessing = IMMEDIATE
              PduRPduLengthHandlingStrategy = IGNORE
              PduRTransmissionConfirmation = false
              PduRDestPduRef = DOCK2_oB30_for_SC_CAN_V3_2_8f72bca2_Rx
              PduRDestPduPduRBswModulesRef = Com
            PduRSrcPdu_b60b7e4e (PduRSrcPdu): PduRSourcePduHandleId=59, PduRSrcPduDirection=RECEIVE, PduRSrcPduRef=DOCK2_oB30_for_SC_CAN_V3_2_96299bd9_Rx, PduRSrcPduPduRBswModulesRef=CanIf
          HUT7_oB30_for_SC_CAN_V3_2_ffbef2e3_Tx: PduRRoutingPathCommunicationType=COMMUNICATION_INTERFACE
            HUT7_oB30_for_SC_CAN_V3_2_98f81797_Tx (PduRDestPdu):
              PduRDestPduHandleId = 7
              PduRDestPduDirection = TRANSMIT
              PduRDestPduRoutingType = API_FORWARDING
              PduRDestPduDataProcessing = IMMEDIATE
              PduRPduLengthHandlingStrategy = IGNORE
              PduRDestPduDataProvision = PDUR_DIRECT
              PduRTransmissionConfirmation = true
              PduRDestPduRef = HUT7_oB30_for_SC_CAN_V3_2_98f81797_Tx
              PduRDestPduPduRBswModulesRef = CanIf
            PduRSrcPdu_26157a10 (PduRSrcPdu): PduRSourcePduHandleId=7, PduRSrcPduDirection=TRANSMIT, PduRSrcPduRef=HUT7_oB30_for_SC_CAN_V3_2_ffbef2e3_Tx, PduRSrcPduPduRBswModulesRef=Com
          HUT46_oB30_for_SC_CAN_V3_2_763a0662_Tx: PduRRoutingPathCommunicationType=COMMUNICATION_INTERFACE
            PduRSrcPdu_ee72d6e4 (PduRSrcPdu): PduRSourcePduHandleId=38, PduRSrcPduDirection=TRANSMIT, PduRSrcPduRef=HUT46_oB30_for_SC_CAN_V3_2_763a0662_Tx, PduRSrcPduPduRBswModulesRef=Com
            HUT46_oB30_for_SC_CAN_V3_2_95ad84db_Tx (PduRDestPdu):
              PduRDestPduHandleId = 38
              PduRDestPduDirection = TRANSMIT
              PduRDestPduRoutingType = API_FORWARDING
              PduRDestPduDataProcessing = IMMEDIATE
              PduRPduLengthHandlingStrategy = IGNORE
              PduRDestPduDataProvision = PDUR_DIRECT
              PduRTransmissionConfirmation = true
              PduRDestPduRef = HUT46_oB30_for_SC_CAN_V3_2_95ad84db_Tx
              PduRDestPduPduRBswModulesRef = CanIf
          DWD1_oB30_for_SC_CAN_V3_2_959d6041_Rx: PduRRoutingPathCommunicationType=COMMUNICATION_INTERFACE
            DWD1_oB30_for_SC_CAN_V3_2_959d6041_Rx_e3728613_Rx (PduRDestPdu):
              PduRDestPduHandleId = 62
              PduRDestPduDirection = RECEIVE
              PduRDestPduRoutingType = API_FORWARDING
              PduRDestPduDataProcessing = IMMEDIATE
              PduRPduLengthHandlingStrategy = IGNORE
              PduRTransmissionConfirmation = false
              PduRDestPduRef = DWD1_oB30_for_SC_CAN_V3_2_82b03b6c_Rx
              PduRDestPduPduRBswModulesRef = Com
            PduRSrcPdu_e3728613 (PduRSrcPdu): PduRSourcePduHandleId=62, PduRSrcPduDirection=RECEIVE, PduRSrcPduRef=DWD1_oB30_for_SC_CAN_V3_2_959d6041_Rx, PduRSrcPduPduRBswModulesRef=CanIf
          HUT41_oB30_for_SC_CAN_V3_2_13e33822_Tx: PduRRoutingPathCommunicationType=COMMUNICATION_INTERFACE
            HUT41_oB30_for_SC_CAN_V3_2_8e8654e1_Tx (PduRDestPdu):
              PduRDestPduHandleId = 34
              PduRDestPduDirection = TRANSMIT
              PduRDestPduRoutingType = API_FORWARDING
              PduRDestPduDataProcessing = IMMEDIATE
              PduRPduLengthHandlingStrategy = IGNORE
              PduRTransmissionConfirmation = true
              PduRDestPduDataProvision = PDUR_DIRECT
              PduRDestPduRef = HUT41_oB30_for_SC_CAN_V3_2_8e8654e1_Tx
              PduRDestPduPduRBswModulesRef = CanIf
            PduRSrcPdu_f748710b (PduRSrcPdu): PduRSourcePduHandleId=34, PduRSrcPduDirection=TRANSMIT, PduRSrcPduRef=HUT41_oB30_for_SC_CAN_V3_2_13e33822_Tx, PduRSrcPduPduRBswModulesRef=Com
          BMS_FD14_oB30_for_SC_CAN_V3_2_69b2ad5e_Rx: PduRRoutingPathCommunicationType=COMMUNICATION_INTERFACE
            PduRSrcPdu_fe5d78f6 (PduRSrcPdu): PduRSourcePduHandleId=47, PduRSrcPduDirection=RECEIVE, PduRSrcPduRef=BMS_FD14_oB30_for_SC_CAN_V3_2_69b2ad5e_Rx, PduRSrcPduPduRBswModulesRef=CanIf
            BMS_FD14_oB30_for_SC_CAN_V3_2_69b2ad5e_Rx_fe5d78f6_Rx (PduRDestPdu):
              PduRDestPduHandleId = 47
              PduRDestPduDirection = RECEIVE
              PduRDestPduRoutingType = API_FORWARDING
              PduRDestPduDataProcessing = IMMEDIATE
              PduRPduLengthHandlingStrategy = IGNORE
              PduRTransmissionConfirmation = false
              PduRDestPduRef = BMS_FD14_oB30_for_SC_CAN_V3_2_20801849_Rx
              PduRDestPduPduRBswModulesRef = Com
          ECM_PT5_oB30_for_SC_CAN_V3_2_21b9a807_Rx: PduRRoutingPathCommunicationType=COMMUNICATION_INTERFACE
            ECM_PT5_oB30_for_SC_CAN_V3_2_21b9a807_Rx_504d8e4d_Rx (PduRDestPdu):
              PduRDestPduHandleId = 75
              PduRDestPduDirection = RECEIVE
              PduRDestPduRoutingType = API_FORWARDING
              PduRDestPduDataProcessing = IMMEDIATE
              PduRPduLengthHandlingStrategy = IGNORE
              PduRTransmissionConfirmation = false
              PduRDestPduRef = ECM_PT5_oB30_for_SC_CAN_V3_2_032abda1_Rx
              PduRDestPduPduRBswModulesRef = Com
            PduRSrcPdu_504d8e4d (PduRSrcPdu): PduRSourcePduHandleId=75, PduRSrcPduDirection=RECEIVE, PduRSrcPduRef=ECM_PT5_oB30_for_SC_CAN_V3_2_21b9a807_Rx, PduRSrcPduPduRBswModulesRef=CanIf
          P2M3_oB30_for_SC_CAN_V3_2_be9f9987_Rx: PduRRoutingPathCommunicationType=COMMUNICATION_INTERFACE
            P2M3_oB30_for_SC_CAN_V3_2_be9f9987_Rx_b5841b10_Rx (PduRDestPdu):
              PduRDestPduHandleId = 129
              PduRDestPduDirection = RECEIVE
              PduRDestPduRoutingType = API_FORWARDING
              PduRDestPduDataProcessing = IMMEDIATE
              PduRPduLengthHandlingStrategy = IGNORE
              PduRTransmissionConfirmation = false
              PduRDestPduRef = P2M3_oB30_for_SC_CAN_V3_2_a4a9c93c_Rx
              PduRDestPduPduRBswModulesRef = Com
            PduRSrcPdu_b5841b10 (PduRSrcPdu): PduRSourcePduHandleId=129, PduRSrcPduDirection=RECEIVE, PduRSrcPduRef=P2M3_oB30_for_SC_CAN_V3_2_be9f9987_Rx, PduRSrcPduPduRBswModulesRef=CanIf
          HCU_FD1_oB30_for_SC_CAN_V3_2_f1a4a259_Rx: PduRRoutingPathCommunicationType=COMMUNICATION_INTERFACE
            HCU_FD1_oB30_for_SC_CAN_V3_2_f1a4a259_Rx_41111e75_Rx (PduRDestPdu):
              PduRDestPduHandleId = 105
              PduRDestPduDirection = RECEIVE
              PduRDestPduRoutingType = API_FORWARDING
              PduRDestPduDataProcessing = IMMEDIATE
              PduRPduLengthHandlingStrategy = IGNORE
              PduRTransmissionConfirmation = false
              PduRDestPduRef = HCU_FD1_oB30_for_SC_CAN_V3_2_641912c5_Rx
              PduRDestPduPduRBswModulesRef = Com
            PduRSrcPdu_41111e75 (PduRSrcPdu): PduRSourcePduHandleId=105, PduRSrcPduDirection=RECEIVE, PduRSrcPduRef=HCU_FD1_oB30_for_SC_CAN_V3_2_f1a4a259_Rx, PduRSrcPduPduRBswModulesRef=CanIf
          HCU_HC3_oB30_for_SC_CAN_V3_2_e53a9811_Rx: PduRRoutingPathCommunicationType=COMMUNICATION_INTERFACE
            HCU_HC3_oB30_for_SC_CAN_V3_2_e53a9811_Rx_e2c2cfc0_Rx (PduRDestPdu):
              PduRDestPduHandleId = 106
              PduRDestPduDirection = RECEIVE
              PduRDestPduRoutingType = API_FORWARDING
              PduRDestPduDataProcessing = IMMEDIATE
              PduRPduLengthHandlingStrategy = IGNORE
              PduRTransmissionConfirmation = false
              PduRDestPduRef = HCU_HC3_oB30_for_SC_CAN_V3_2_5ec02d05_Rx
              PduRDestPduPduRBswModulesRef = Com
            PduRSrcPdu_e2c2cfc0 (PduRSrcPdu): PduRSourcePduHandleId=106, PduRSrcPduDirection=RECEIVE, PduRSrcPduRef=HCU_HC3_oB30_for_SC_CAN_V3_2_e53a9811_Rx, PduRSrcPduPduRBswModulesRef=CanIf
          BMS30_oB30_for_SC_CAN_V3_2_b9c96ca7_Rx: PduRRoutingPathCommunicationType=COMMUNICATION_INTERFACE
            BMS30_oB30_for_SC_CAN_V3_2_b9c96ca7_Rx_7b4ae3ad_Rx (PduRDestPdu):
              PduRDestPduHandleId = 43
              PduRDestPduDirection = RECEIVE
              PduRDestPduRoutingType = API_FORWARDING
              PduRDestPduDataProcessing = IMMEDIATE
              PduRPduLengthHandlingStrategy = IGNORE
              PduRTransmissionConfirmation = false
              PduRDestPduRef = BMS30_oB30_for_SC_CAN_V3_2_77152131_Rx
              PduRDestPduPduRBswModulesRef = Com
            PduRSrcPdu_7b4ae3ad (PduRSrcPdu): PduRSourcePduHandleId=43, PduRSrcPduDirection=RECEIVE, PduRSrcPduRef=BMS30_oB30_for_SC_CAN_V3_2_b9c96ca7_Rx, PduRSrcPduPduRBswModulesRef=CanIf
          HCU_HP8_oB30_for_SC_CAN_V3_2_1765d2ba_Rx: PduRRoutingPathCommunicationType=COMMUNICATION_INTERFACE
            HCU_HP8_oB30_for_SC_CAN_V3_2_1765d2ba_Rx_b4401e79_Rx (PduRDestPdu):
              PduRDestPduHandleId = 113
              PduRDestPduDirection = RECEIVE
              PduRDestPduRoutingType = API_FORWARDING
              PduRDestPduDataProcessing = IMMEDIATE
              PduRPduLengthHandlingStrategy = IGNORE
              PduRTransmissionConfirmation = false
              PduRDestPduRef = HCU_HP8_oB30_for_SC_CAN_V3_2_a96c1934_Rx
              PduRDestPduPduRBswModulesRef = Com
            PduRSrcPdu_b4401e79 (PduRSrcPdu): PduRSourcePduHandleId=113, PduRSrcPduDirection=RECEIVE, PduRSrcPduRef=HCU_HP8_oB30_for_SC_CAN_V3_2_1765d2ba_Rx, PduRSrcPduPduRBswModulesRef=CanIf
          HCU_HC8_oB30_for_SC_CAN_V3_2_874a0938_Rx: PduRRoutingPathCommunicationType=COMMUNICATION_INTERFACE
            HCU_HC8_oB30_for_SC_CAN_V3_2_874a0938_Rx_fa951420_Rx (PduRDestPdu):
              PduRDestPduHandleId = 109
              PduRDestPduDirection = RECEIVE
              PduRDestPduRoutingType = API_FORWARDING
              PduRDestPduDataProcessing = IMMEDIATE
              PduRPduLengthHandlingStrategy = IGNORE
              PduRTransmissionConfirmation = false
              PduRDestPduRef = HCU_HC8_oB30_for_SC_CAN_V3_2_defba645_Rx
              PduRDestPduPduRBswModulesRef = Com
            PduRSrcPdu_fa951420 (PduRSrcPdu): PduRSourcePduHandleId=109, PduRSrcPduDirection=RECEIVE, PduRSrcPduRef=HCU_HC8_oB30_for_SC_CAN_V3_2_874a0938_Rx, PduRSrcPduPduRBswModulesRef=CanIf
          BMS66_oB30_for_SC_CAN_V3_2_7d524576_Rx: PduRRoutingPathCommunicationType=COMMUNICATION_INTERFACE
            PduRSrcPdu_bcc5be8a (PduRSrcPdu): PduRSourcePduHandleId=46, PduRSrcPduDirection=RECEIVE, PduRSrcPduRef=BMS66_oB30_for_SC_CAN_V3_2_7d524576_Rx, PduRSrcPduPduRBswModulesRef=CanIf
            BMS66_oB30_for_SC_CAN_V3_2_7d524576_Rx_bcc5be8a_Rx (PduRDestPdu):
              PduRDestPduHandleId = 46
              PduRDestPduDirection = RECEIVE
              PduRDestPduRoutingType = API_FORWARDING
              PduRDestPduDataProcessing = IMMEDIATE
              PduRPduLengthHandlingStrategy = IGNORE
              PduRTransmissionConfirmation = false
              PduRDestPduRef = BMS66_oB30_for_SC_CAN_V3_2_9ecb30f6_Rx
              PduRDestPduPduRBswModulesRef = Com
          P2M1_oB30_for_SC_CAN_V3_2_f19378e0_Rx: PduRRoutingPathCommunicationType=COMMUNICATION_INTERFACE
            PduRSrcPdu_27578a55 (PduRSrcPdu): PduRSourcePduHandleId=128, PduRSrcPduDirection=RECEIVE, PduRSrcPduRef=P2M1_oB30_for_SC_CAN_V3_2_f19378e0_Rx, PduRSrcPduPduRBswModulesRef=CanIf
            P2M1_oB30_for_SC_CAN_V3_2_f19378e0_Rx_27578a55_Rx (PduRDestPdu):
              PduRDestPduHandleId = 128
              PduRDestPduDirection = RECEIVE
              PduRDestPduRoutingType = API_FORWARDING
              PduRDestPduDataProcessing = IMMEDIATE
              PduRPduLengthHandlingStrategy = IGNORE
              PduRTransmissionConfirmation = false
              PduRDestPduRef = P2M1_oB30_for_SC_CAN_V3_2_8af900bc_Rx
              PduRDestPduPduRBswModulesRef = Com
          HCU_HC6_oB30_for_SC_CAN_V3_2_b11da94c_Rx: PduRRoutingPathCommunicationType=COMMUNICATION_INTERFACE
            PduRSrcPdu_600d7519 (PduRSrcPdu): PduRSourcePduHandleId=107, PduRSrcPduDirection=RECEIVE, PduRSrcPduRef=HCU_HC6_oB30_for_SC_CAN_V3_2_b11da94c_Rx, PduRSrcPduPduRBswModulesRef=CanIf
            HCU_HC6_oB30_for_SC_CAN_V3_2_b11da94c_Rx_600d7519_Rx (PduRDestPdu):
              PduRDestPduHandleId = 107
              PduRDestPduDirection = RECEIVE
              PduRDestPduRoutingType = API_FORWARDING
              PduRDestPduDataProcessing = IMMEDIATE
              PduRPduLengthHandlingStrategy = IGNORE
              PduRTransmissionConfirmation = false
              PduRDestPduRef = HCU_HC6_oB30_for_SC_CAN_V3_2_1549dac5_Rx
              PduRDestPduPduRBswModulesRef = Com
          ECM_PT7_oB30_for_SC_CAN_V3_2_6eb54960_Rx: PduRRoutingPathCommunicationType=COMMUNICATION_INTERFACE
            PduRSrcPdu_e6e6b472 (PduRSrcPdu): PduRSourcePduHandleId=77, PduRSrcPduDirection=RECEIVE, PduRSrcPduRef=ECM_PT7_oB30_for_SC_CAN_V3_2_6eb54960_Rx, PduRSrcPduPduRBswModulesRef=CanIf
            ECM_PT7_oB30_for_SC_CAN_V3_2_6eb54960_Rx_e6e6b472_Rx (PduRDestPdu):
              PduRDestPduHandleId = 77
              PduRDestPduDirection = RECEIVE
              PduRDestPduRoutingType = API_FORWARDING
              PduRDestPduDataProcessing = IMMEDIATE
              PduRPduLengthHandlingStrategy = IGNORE
              PduRTransmissionConfirmation = false
              PduRDestPduRef = ECM_PT7_oB30_for_SC_CAN_V3_2_2d7a7421_Rx
              PduRDestPduPduRBswModulesRef = Com
          EBOOSTER_FD1_oB30_for_SC_CAN_V3_2_9ce048b8_Rx: PduRRoutingPathCommunicationType=COMMUNICATION_INTERFACE
            EBOOSTER_FD1_oB30_for_SC_CAN_V3_2_9ce048b8_Rx_3dbe82da_Rx (PduRDestPdu):
              PduRDestPduHandleId = 63
              PduRDestPduDirection = RECEIVE
              PduRDestPduRoutingType = API_FORWARDING
              PduRDestPduDataProcessing = IMMEDIATE
              PduRPduLengthHandlingStrategy = IGNORE
              PduRTransmissionConfirmation = false
              PduRDestPduRef = EBOOSTER_FD1_oB30_for_SC_CAN_V3_2_683305cd_Rx
              PduRDestPduPduRBswModulesRef = Com
            PduRSrcPdu_3dbe82da (PduRSrcPdu):
              PduRSourcePduHandleId = 63
              PduRSrcPduDirection = RECEIVE
              PduRSrcPduRef = EBOOSTER_FD1_oB30_for_SC_CAN_V3_2_9ce048b8_Rx
              PduRSrcPduPduRBswModulesRef = CanIf
          HCU_PT5_oB30_for_SC_CAN_V3_2_182a05d1_Rx: PduRRoutingPathCommunicationType=COMMUNICATION_INTERFACE
            PduRSrcPdu_178af415 (PduRSrcPdu): PduRSourcePduHandleId=115, PduRSrcPduDirection=RECEIVE, PduRSrcPduRef=HCU_PT5_oB30_for_SC_CAN_V3_2_182a05d1_Rx, PduRSrcPduPduRBswModulesRef=CanIf
            HCU_PT5_oB30_for_SC_CAN_V3_2_182a05d1_Rx_178af415_Rx (PduRDestPdu):
              PduRDestPduHandleId = 115
              PduRDestPduDirection = RECEIVE
              PduRDestPduRoutingType = API_FORWARDING
              PduRDestPduDataProcessing = IMMEDIATE
              PduRPduLengthHandlingStrategy = IGNORE
              PduRTransmissionConfirmation = false
              PduRDestPduRef = HCU_PT5_oB30_for_SC_CAN_V3_2_f69c2ae4_Rx
              PduRDestPduPduRBswModulesRef = Com
          T_BOX_FD9_oB30_for_SC_CAN_V3_2_0abff698_Rx: PduRRoutingPathCommunicationType=COMMUNICATION_INTERFACE
            T_BOX_FD9_oB30_for_SC_CAN_V3_2_0abff698_Rx_7abf872e_Rx (PduRDestPdu):
              PduRDestPduHandleId = 150
              PduRDestPduDirection = RECEIVE
              PduRDestPduRoutingType = API_FORWARDING
              PduRDestPduDataProcessing = IMMEDIATE
              PduRPduLengthHandlingStrategy = IGNORE
              PduRTransmissionConfirmation = false
              PduRDestPduRef = T_BOX_FD9_oB30_for_SC_CAN_V3_2_061eeb7a_Rx
              PduRDestPduPduRBswModulesRef = Com
            PduRSrcPdu_7abf872e (PduRSrcPdu):
              PduRSourcePduHandleId = 150
              PduRSrcPduDirection = RECEIVE
              PduRSrcPduRef = T_BOX_FD9_oB30_for_SC_CAN_V3_2_0abff698_Rx
              PduRSrcPduPduRBswModulesRef = CanIf
          BMS22_oB30_for_SC_CAN_V3_2_9f0971cd_Rx: PduRRoutingPathCommunicationType=COMMUNICATION_INTERFACE
            BMS22_oB30_for_SC_CAN_V3_2_9f0971cd_Rx_e1c6fd7b_Rx (PduRDestPdu):
              PduRDestPduHandleId = 42
              PduRDestPduDirection = RECEIVE
              PduRDestPduRoutingType = API_FORWARDING
              PduRDestPduDataProcessing = IMMEDIATE
              PduRPduLengthHandlingStrategy = IGNORE
              PduRTransmissionConfirmation = false
              PduRDestPduRef = BMS22_oB30_for_SC_CAN_V3_2_c2360265_Rx
              PduRDestPduPduRBswModulesRef = Com
            PduRSrcPdu_e1c6fd7b (PduRSrcPdu): PduRSourcePduHandleId=42, PduRSrcPduDirection=RECEIVE, PduRSrcPduRef=BMS22_oB30_for_SC_CAN_V3_2_9f0971cd_Rx, PduRSrcPduPduRBswModulesRef=CanIf
          ECM_PT6_oB30_for_SC_CAN_V3_2_a48bbaf3_Rx: PduRRoutingPathCommunicationType=COMMUNICATION_INTERFACE
            ECM_PT6_oB30_for_SC_CAN_V3_2_a48bbaf3_Rx_f7d6c790_Rx (PduRDestPdu):
              PduRDestPduHandleId = 76
              PduRDestPduDirection = RECEIVE
              PduRDestPduRoutingType = API_FORWARDING
              PduRDestPduDataProcessing = IMMEDIATE
              PduRPduLengthHandlingStrategy = IGNORE
              PduRTransmissionConfirmation = false
              PduRDestPduRef = ECM_PT6_oB30_for_SC_CAN_V3_2_3a5210e1_Rx
              PduRDestPduPduRBswModulesRef = Com
            PduRSrcPdu_f7d6c790 (PduRSrcPdu): PduRSourcePduHandleId=76, PduRSrcPduDirection=RECEIVE, PduRSrcPduRef=ECM_PT6_oB30_for_SC_CAN_V3_2_a48bbaf3_Rx, PduRSrcPduPduRBswModulesRef=CanIf
          BMS19_oB30_for_SC_CAN_V3_2_472ce4f3_Rx: PduRRoutingPathCommunicationType=COMMUNICATION_INTERFACE
            PduRSrcPdu_f51f0976 (PduRSrcPdu): PduRSourcePduHandleId=41, PduRSrcPduDirection=RECEIVE, PduRSrcPduRef=BMS19_oB30_for_SC_CAN_V3_2_472ce4f3_Rx, PduRSrcPduPduRBswModulesRef=CanIf
            BMS19_oB30_for_SC_CAN_V3_2_472ce4f3_Rx_f51f0976_Rx (PduRDestPdu):
              PduRDestPduHandleId = 41
              PduRDestPduDirection = RECEIVE
              PduRDestPduRoutingType = API_FORWARDING
              PduRDestPduDataProcessing = IMMEDIATE
              PduRPduLengthHandlingStrategy = DISCARD
              PduRTransmissionConfirmation = false
              PduRDestPduRef = BMS19_oB30_for_SC_CAN_V3_2_34e8b018_Rx
              PduRDestPduPduRBswModulesRef = Com
          HCU_PT8_oB30_for_SC_CAN_V3_2_ab4fb751_Rx: PduRRoutingPathCommunicationType=COMMUNICATION_INTERFACE
            HCU_PT8_oB30_for_SC_CAN_V3_2_ab4fb751_Rx_0dc46ad2_Rx (PduRDestPdu):
              PduRDestPduHandleId = 117
              PduRDestPduDirection = RECEIVE
              PduRDestPduRoutingType = API_FORWARDING
              PduRDestPduDataProcessing = IMMEDIATE
              PduRPduLengthHandlingStrategy = IGNORE
              PduRTransmissionConfirmation = false
              PduRDestPduRef = HCU_PT8_oB30_for_SC_CAN_V3_2_0456fb24_Rx
              PduRDestPduPduRBswModulesRef = Com
            PduRSrcPdu_0dc46ad2 (PduRSrcPdu): PduRSourcePduHandleId=117, PduRSrcPduDirection=RECEIVE, PduRSrcPduRef=HCU_PT8_oB30_for_SC_CAN_V3_2_ab4fb751_Rx, PduRSrcPduPduRBswModulesRef=CanIf
          BMS8_oB30_for_SC_CAN_V3_2_6c883b50_Rx: PduRRoutingPathCommunicationType=COMMUNICATION_INTERFACE
            PduRSrcPdu_04314b70 (PduRSrcPdu): PduRSourcePduHandleId=40, PduRSrcPduDirection=RECEIVE, PduRSrcPduRef=BMS8_oB30_for_SC_CAN_V3_2_6c883b50_Rx, PduRSrcPduPduRBswModulesRef=CanIf
            BMS8_oB30_for_SC_CAN_V3_2_6c883b50_Rx_04314b70_Rx (PduRDestPdu):
              PduRDestPduHandleId = 40
              PduRDestPduDirection = RECEIVE
              PduRDestPduRoutingType = API_FORWARDING
              PduRDestPduDataProcessing = IMMEDIATE
              PduRPduLengthHandlingStrategy = IGNORE
              PduRTransmissionConfirmation = false
              PduRDestPduRef = BMS8_oB30_for_SC_CAN_V3_2_44968464_Rx
              PduRDestPduPduRBswModulesRef = Com
          ECM24_oB30_for_SC_CAN_V3_2_b52cc749_Rx: PduRRoutingPathCommunicationType=COMMUNICATION_INTERFACE
            ECM24_oB30_for_SC_CAN_V3_2_b52cc749_Rx_4ded5b6d_Rx (PduRDestPdu):
              PduRDestPduHandleId = 74
              PduRDestPduDirection = RECEIVE
              PduRDestPduRoutingType = API_FORWARDING
              PduRDestPduDataProcessing = IMMEDIATE
              PduRPduLengthHandlingStrategy = IGNORE
              PduRTransmissionConfirmation = false
              PduRDestPduRef = ECM24_oB30_for_SC_CAN_V3_2_328fcd01_Rx
              PduRDestPduPduRBswModulesRef = Com
            PduRSrcPdu_4ded5b6d (PduRSrcPdu): PduRSourcePduHandleId=74, PduRSrcPduDirection=RECEIVE, PduRSrcPduRef=ECM24_oB30_for_SC_CAN_V3_2_b52cc749_Rx, PduRSrcPduPduRBswModulesRef=CanIf
          BCM18_oB30_for_SC_CAN_V3_2_98289b3d_Rx: PduRRoutingPathCommunicationType=COMMUNICATION_INTERFACE
            PduRSrcPdu_4b8049e3 (PduRSrcPdu): PduRSourcePduHandleId=35, PduRSrcPduDirection=RECEIVE, PduRSrcPduRef=BCM18_oB30_for_SC_CAN_V3_2_98289b3d_Rx, PduRSrcPduPduRBswModulesRef=CanIf
            BCM18_oB30_for_SC_CAN_V3_2_98289b3d_Rx_4b8049e3_Rx (PduRDestPdu):
              PduRDestPduHandleId = 35
              PduRDestPduDirection = RECEIVE
              PduRDestPduRoutingType = API_FORWARDING
              PduRDestPduDataProcessing = IMMEDIATE
              PduRPduLengthHandlingStrategy = IGNORE
              PduRTransmissionConfirmation = false
              PduRDestPduRef = BCM18_oB30_for_SC_CAN_V3_2_794b3a1a_Rx
              PduRDestPduPduRBswModulesRef = Com
          HCU_HP6_oB30_for_SC_CAN_V3_2_213272ce_Rx: PduRRoutingPathCommunicationType=COMMUNICATION_INTERFACE
            PduRSrcPdu_e4bf60e1 (PduRSrcPdu): PduRSourcePduHandleId=112, PduRSrcPduDirection=RECEIVE, PduRSrcPduRef=HCU_HP6_oB30_for_SC_CAN_V3_2_213272ce_Rx, PduRSrcPduPduRBswModulesRef=CanIf
            HCU_HP6_oB30_for_SC_CAN_V3_2_213272ce_Rx_e4bf60e1_Rx (PduRDestPdu):
              PduRDestPduHandleId = 112
              PduRDestPduDirection = RECEIVE
              PduRDestPduRoutingType = API_FORWARDING
              PduRDestPduDataProcessing = IMMEDIATE
              PduRPduLengthHandlingStrategy = IGNORE
              PduRTransmissionConfirmation = false
              PduRDestPduRef = HCU_HP6_oB30_for_SC_CAN_V3_2_62de65b4_Rx
              PduRDestPduPduRBswModulesRef = Com
          HUT_FD4_oB30_for_SC_CAN_V3_2_2aa0b500_Tx: PduRRoutingPathCommunicationType=COMMUNICATION_INTERFACE
            HUT_FD4_oB30_for_SC_CAN_V3_2_c8de73d7_Tx (PduRDestPdu):
              PduRDestPduHandleId = 44
              PduRDestPduDirection = TRANSMIT
              PduRDestPduRoutingType = API_FORWARDING
              PduRDestPduDataProcessing = IMMEDIATE
              PduRPduLengthHandlingStrategy = IGNORE
              PduRTransmissionConfirmation = true
              PduRDestPduDataProvision = PDUR_DIRECT
              PduRDestPduRef = HUT_FD4_oB30_for_SC_CAN_V3_2_c8de73d7_Tx
              PduRDestPduPduRBswModulesRef = CanIf
            PduRSrcPdu_0f850d95 (PduRSrcPdu): PduRSourcePduHandleId=44, PduRSrcPduDirection=TRANSMIT, PduRSrcPduRef=HUT_FD4_oB30_for_SC_CAN_V3_2_2aa0b500_Tx, PduRSrcPduPduRBswModulesRef=Com
          SCM1_oB30_for_SC_CAN_V3_2_baaa6d95_Rx: PduRRoutingPathCommunicationType=COMMUNICATION_INTERFACE
            SCM1_oB30_for_SC_CAN_V3_2_baaa6d95_Rx_e351b728_Rx (PduRDestPdu):
              PduRDestPduHandleId = 139
              PduRDestPduDirection = RECEIVE
              PduRDestPduRoutingType = API_FORWARDING
              PduRDestPduDataProcessing = IMMEDIATE
              PduRPduLengthHandlingStrategy = IGNORE
              PduRTransmissionConfirmation = false
              PduRDestPduRef = SCM1_oB30_for_SC_CAN_V3_2_9950a83a_Rx
              PduRDestPduPduRBswModulesRef = Com
            PduRSrcPdu_e351b728 (PduRSrcPdu): PduRSourcePduHandleId=139, PduRSrcPduDirection=RECEIVE, PduRSrcPduRef=SCM1_oB30_for_SC_CAN_V3_2_baaa6d95_Rx, PduRSrcPduPduRBswModulesRef=CanIf
          BLE5_oB30_for_SC_CAN_V3_2_2494e86b_Rx: PduRRoutingPathCommunicationType=COMMUNICATION_INTERFACE
            BLE5_oB30_for_SC_CAN_V3_2_2494e86b_Rx_3bf59e98_Rx (PduRDestPdu):
              PduRDestPduHandleId = 38
              PduRDestPduDirection = RECEIVE
              PduRDestPduRoutingType = API_FORWARDING
              PduRDestPduDataProcessing = IMMEDIATE
              PduRPduLengthHandlingStrategy = IGNORE
              PduRTransmissionConfirmation = false
              PduRDestPduRef = BLE5_oB30_for_SC_CAN_V3_2_dbc1c4b5_Rx
              PduRDestPduPduRBswModulesRef = Com
            PduRSrcPdu_3bf59e98 (PduRSrcPdu): PduRSourcePduHandleId=38, PduRSrcPduDirection=RECEIVE, PduRSrcPduRef=BLE5_oB30_for_SC_CAN_V3_2_2494e86b_Rx, PduRSrcPduPduRBswModulesRef=CanIf
          AC14_oB30_for_SC_CAN_V3_2_a43f90b0_Rx: PduRRoutingPathCommunicationType=COMMUNICATION_INTERFACE
            PduRSrcPdu_12ca8017 (PduRSrcPdu): PduRSourcePduHandleId=12, PduRSrcPduDirection=RECEIVE, PduRSrcPduRef=AC14_oB30_for_SC_CAN_V3_2_a43f90b0_Rx, PduRSrcPduPduRBswModulesRef=CanIf
            AC14_oB30_for_SC_CAN_V3_2_a43f90b0_Rx_12ca8017_Rx (PduRDestPdu):
              PduRDestPduHandleId = 12
              PduRDestPduDirection = RECEIVE
              PduRDestPduRoutingType = API_FORWARDING
              PduRDestPduDataProcessing = IMMEDIATE
              PduRPduLengthHandlingStrategy = IGNORE
              PduRTransmissionConfirmation = false
              PduRDestPduRef = AC14_oB30_for_SC_CAN_V3_2_1c102f98_Rx
              PduRDestPduPduRBswModulesRef = Com
          BLE1_oB30_for_SC_CAN_V3_2_ba8d2aa5_Rx: PduRRoutingPathCommunicationType=COMMUNICATION_INTERFACE
            PduRSrcPdu_dd38072b (PduRSrcPdu): PduRSourcePduHandleId=37, PduRSrcPduDirection=RECEIVE, PduRSrcPduRef=BLE1_oB30_for_SC_CAN_V3_2_ba8d2aa5_Rx, PduRSrcPduPduRBswModulesRef=CanIf
            BLE1_oB30_for_SC_CAN_V3_2_ba8d2aa5_Rx_dd38072b_Rx (PduRDestPdu):
              PduRDestPduHandleId = 37
              PduRDestPduDirection = RECEIVE
              PduRDestPduRoutingType = API_FORWARDING
              PduRDestPduDataProcessing = IMMEDIATE
              PduRPduLengthHandlingStrategy = IGNORE
              PduRTransmissionConfirmation = false
              PduRDestPduRef = BLE1_oB30_for_SC_CAN_V3_2_876057b5_Rx
              PduRDestPduPduRBswModulesRef = Com
          GW_OTA_oB30_for_SC_CAN_V3_2_0f39012b_Rx: PduRRoutingPathCommunicationType=COMMUNICATION_INTERFACE
            PduRSrcPdu_32aaa87e (PduRSrcPdu): PduRSourcePduHandleId=93, PduRSrcPduDirection=RECEIVE, PduRSrcPduRef=GW_OTA_oB30_for_SC_CAN_V3_2_0f39012b_Rx, PduRSrcPduPduRBswModulesRef=CanIf
            GW_OTA_oB30_for_SC_CAN_V3_2_0f39012b_Rx_32aaa87e_Rx (PduRDestPdu):
              PduRDestPduHandleId = 93
              PduRDestPduDirection = RECEIVE
              PduRDestPduRoutingType = API_FORWARDING
              PduRDestPduDataProcessing = IMMEDIATE
              PduRPduLengthHandlingStrategy = IGNORE
              PduRTransmissionConfirmation = false
              PduRDestPduRef = GW_OTA_oB30_for_SC_CAN_V3_2_cf261bba_Rx
              PduRDestPduPduRBswModulesRef = Com
          T_BOX_FD10_oB30_for_SC_CAN_V3_2_964515ff_Rx: PduRRoutingPathCommunicationType=COMMUNICATION_INTERFACE
            T_BOX_FD10_oB30_for_SC_CAN_V3_2_964515ff_Rx_67c45ddd_Rx (PduRDestPdu):
              PduRDestPduHandleId = 151
              PduRDestPduDirection = RECEIVE
              PduRDestPduRoutingType = API_FORWARDING
              PduRDestPduDataProcessing = IMMEDIATE
              PduRPduLengthHandlingStrategy = IGNORE
              PduRTransmissionConfirmation = false
              PduRDestPduRef = T_BOX_FD10_oB30_for_SC_CAN_V3_2_fbbdad00_Rx
              PduRDestPduPduRBswModulesRef = Com
            PduRSrcPdu_67c45ddd (PduRSrcPdu):
              PduRSourcePduHandleId = 151
              PduRSrcPduDirection = RECEIVE
              PduRSrcPduRef = T_BOX_FD10_oB30_for_SC_CAN_V3_2_964515ff_Rx
              PduRSrcPduPduRBswModulesRef = CanIf
          BCM7_oB30_for_SC_CAN_V3_2_70407cea_Rx: PduRRoutingPathCommunicationType=COMMUNICATION_INTERFACE
            PduRSrcPdu_2618f07c (PduRSrcPdu): PduRSourcePduHandleId=30, PduRSrcPduDirection=RECEIVE, PduRSrcPduRef=BCM7_oB30_for_SC_CAN_V3_2_70407cea_Rx, PduRSrcPduPduRBswModulesRef=CanIf
            BCM7_oB30_for_SC_CAN_V3_2_70407cea_Rx_2618f07c_Rx (PduRDestPdu):
              PduRDestPduHandleId = 30
              PduRDestPduDirection = RECEIVE
              PduRDestPduRoutingType = API_FORWARDING
              PduRDestPduDataProcessing = IMMEDIATE
              PduRPduLengthHandlingStrategy = IGNORE
              PduRTransmissionConfirmation = false
              PduRDestPduRef = BCM7_oB30_for_SC_CAN_V3_2_163d45da_Rx
              PduRDestPduPduRBswModulesRef = Com
          HCU_HP5_oB30_for_SC_CAN_V3_2_a400603a_Rx: PduRRoutingPathCommunicationType=COMMUNICATION_INTERFACE
            HCU_HP5_oB30_for_SC_CAN_V3_2_a400603a_Rx_a92a2a41_Rx (PduRDestPdu):
              PduRDestPduHandleId = 111
              PduRDestPduDirection = RECEIVE
              PduRDestPduRoutingType = API_FORWARDING
              PduRDestPduDataProcessing = IMMEDIATE
              PduRPduLengthHandlingStrategy = IGNORE
              PduRTransmissionConfirmation = false
              PduRDestPduRef = HCU_HP5_oB30_for_SC_CAN_V3_2_5ba6c8f4_Rx
              PduRDestPduPduRBswModulesRef = Com
            PduRSrcPdu_a92a2a41 (PduRSrcPdu): PduRSourcePduHandleId=111, PduRSrcPduDirection=RECEIVE, PduRSrcPduRef=HCU_HP5_oB30_for_SC_CAN_V3_2_a400603a_Rx, PduRSrcPduPduRBswModulesRef=CanIf
          HAP_FD7_oB30_for_SC_CAN_V3_2_b196d90e_Rx: PduRRoutingPathCommunicationType=COMMUNICATION_INTERFACE
            PduRSrcPdu_9b8498a5 (PduRSrcPdu): PduRSourcePduHandleId=100, PduRSrcPduDirection=RECEIVE, PduRSrcPduRef=HAP_FD7_oB30_for_SC_CAN_V3_2_b196d90e_Rx, PduRSrcPduPduRBswModulesRef=CanIf
            HAP_FD7_oB30_for_SC_CAN_V3_2_b196d90e_Rx_9b8498a5_Rx (PduRDestPdu):
              PduRDestPduHandleId = 100
              PduRDestPduDirection = RECEIVE
              PduRDestPduRoutingType = API_FORWARDING
              PduRDestPduDataProcessing = IMMEDIATE
              PduRPduLengthHandlingStrategy = IGNORE
              PduRTransmissionConfirmation = false
              PduRDestPduRef = HAP_FD7_oB30_for_SC_CAN_V3_2_06794e8e_Rx
              PduRDestPduPduRBswModulesRef = Com
          OBC2_oB30_for_SC_CAN_V3_2_07ff5dad_Rx: PduRRoutingPathCommunicationType=COMMUNICATION_INTERFACE
            OBC2_oB30_for_SC_CAN_V3_2_07ff5dad_Rx_7dbaec87_Rx (PduRDestPdu):
              PduRDestPduHandleId = 127
              PduRDestPduDirection = RECEIVE
              PduRDestPduRoutingType = API_FORWARDING
              PduRDestPduDataProcessing = IMMEDIATE
              PduRPduLengthHandlingStrategy = IGNORE
              PduRTransmissionConfirmation = false
              PduRDestPduRef = OBC2_oB30_for_SC_CAN_V3_2_43dfaf23_Rx
              PduRDestPduPduRBswModulesRef = Com
            PduRSrcPdu_7dbaec87 (PduRSrcPdu): PduRSourcePduHandleId=127, PduRSrcPduDirection=RECEIVE, PduRSrcPduRef=OBC2_oB30_for_SC_CAN_V3_2_07ff5dad_Rx, PduRSrcPduPduRBswModulesRef=CanIf
          ETC2_oB30_for_SC_CAN_V3_2_5474f9a2_Rx: PduRRoutingPathCommunicationType=COMMUNICATION_INTERFACE
            PduRSrcPdu_f70df294 (PduRSrcPdu): PduRSourcePduHandleId=87, PduRSrcPduDirection=RECEIVE, PduRSrcPduRef=ETC2_oB30_for_SC_CAN_V3_2_5474f9a2_Rx, PduRSrcPduPduRBswModulesRef=CanIf
            ETC2_oB30_for_SC_CAN_V3_2_5474f9a2_Rx_f70df294_Rx (PduRDestPdu):
              PduRDestPduHandleId = 87
              PduRDestPduDirection = RECEIVE
              PduRDestPduRoutingType = API_FORWARDING
              PduRDestPduDataProcessing = IMMEDIATE
              PduRPduLengthHandlingStrategy = IGNORE
              PduRTransmissionConfirmation = false
              PduRDestPduRef = ETC2_oB30_for_SC_CAN_V3_2_30e437a4_Rx
              PduRDestPduPduRBswModulesRef = Com
          ETC3_oB30_for_SC_CAN_V3_2_9e4a0a31_Rx: PduRRoutingPathCommunicationType=COMMUNICATION_INTERFACE
            PduRSrcPdu_5bb67826 (PduRSrcPdu): PduRSourcePduHandleId=88, PduRSrcPduDirection=RECEIVE, PduRSrcPduRef=ETC3_oB30_for_SC_CAN_V3_2_9e4a0a31_Rx, PduRSrcPduPduRBswModulesRef=CanIf
            ETC3_oB30_for_SC_CAN_V3_2_9e4a0a31_Rx_5bb67826_Rx (PduRDestPdu):
              PduRDestPduHandleId = 88
              PduRDestPduDirection = RECEIVE
              PduRDestPduRoutingType = API_FORWARDING
              PduRDestPduDataProcessing = IMMEDIATE
              PduRPduLengthHandlingStrategy = IGNORE
              PduRTransmissionConfirmation = false
              PduRDestPduRef = ETC3_oB30_for_SC_CAN_V3_2_27cc5364_Rx
              PduRDestPduPduRBswModulesRef = Com
          DCT_FD4_oB30_for_SC_CAN_V3_2_207dfaa4_Rx: PduRRoutingPathCommunicationType=COMMUNICATION_INTERFACE
            PduRSrcPdu_d36fcffa (PduRSrcPdu): PduRSourcePduHandleId=55, PduRSrcPduDirection=RECEIVE, PduRSrcPduRef=DCT_FD4_oB30_for_SC_CAN_V3_2_207dfaa4_Rx, PduRSrcPduPduRBswModulesRef=CanIf
            DCT_FD4_oB30_for_SC_CAN_V3_2_207dfaa4_Rx_d36fcffa_Rx (PduRDestPdu):
              PduRDestPduHandleId = 55
              PduRDestPduDirection = RECEIVE
              PduRDestPduRoutingType = API_FORWARDING
              PduRDestPduDataProcessing = IMMEDIATE
              PduRPduLengthHandlingStrategy = IGNORE
              PduRTransmissionConfirmation = false
              PduRDestPduRef = DCT_FD4_oB30_for_SC_CAN_V3_2_c3f55f0e_Rx
              PduRDestPduPduRBswModulesRef = Com
          HCM_R1_oB30_for_SC_CAN_V3_2_2995cda3_Rx: PduRRoutingPathCommunicationType=COMMUNICATION_INTERFACE
            PduRSrcPdu_0a0aa92e (PduRSrcPdu): PduRSourcePduHandleId=103, PduRSrcPduDirection=RECEIVE, PduRSrcPduRef=HCM_R1_oB30_for_SC_CAN_V3_2_2995cda3_Rx, PduRSrcPduPduRBswModulesRef=CanIf
            HCM_R1_oB30_for_SC_CAN_V3_2_2995cda3_Rx_0a0aa92e_Rx (PduRDestPdu):
              PduRDestPduHandleId = 103
              PduRDestPduDirection = RECEIVE
              PduRDestPduRoutingType = API_FORWARDING
              PduRDestPduDataProcessing = IMMEDIATE
              PduRPduLengthHandlingStrategy = IGNORE
              PduRTransmissionConfirmation = false
              PduRDestPduRef = HCM_R1_oB30_for_SC_CAN_V3_2_ee41b121_Rx
              PduRDestPduPduRBswModulesRef = Com
          HUT27_oB30_for_SC_CAN_V3_2_8cd810d8_Tx: PduRRoutingPathCommunicationType=COMMUNICATION_INTERFACE
            HUT27_oB30_for_SC_CAN_V3_2_f0487927_Tx (PduRDestPdu):
              PduRDestPduHandleId = 22
              PduRDestPduDirection = TRANSMIT
              PduRDestPduRoutingType = API_FORWARDING
              PduRDestPduDataProcessing = IMMEDIATE
              PduRPduLengthHandlingStrategy = IGNORE
              PduRDestPduDataProvision = PDUR_DIRECT
              PduRTransmissionConfirmation = true
              PduRDestPduRef = HUT27_oB30_for_SC_CAN_V3_2_f0487927_Tx
              PduRDestPduPduRBswModulesRef = CanIf
            PduRSrcPdu_cbf8145f (PduRSrcPdu): PduRSourcePduHandleId=22, PduRSrcPduDirection=TRANSMIT, PduRSrcPduRef=HUT27_oB30_for_SC_CAN_V3_2_8cd810d8_Tx, PduRSrcPduPduRBswModulesRef=Com
          F_PBOX1_oB30_for_SC_CAN_V3_2_d5db6bdb_Rx: PduRRoutingPathCommunicationType=COMMUNICATION_INTERFACE
            PduRSrcPdu_b00d5adc (PduRSrcPdu): PduRSourcePduHandleId=90, PduRSrcPduDirection=RECEIVE, PduRSrcPduRef=F_PBOX1_oB30_for_SC_CAN_V3_2_d5db6bdb_Rx, PduRSrcPduPduRBswModulesRef=CanIf
            F_PBOX1_oB30_for_SC_CAN_V3_2_d5db6bdb_Rx_b00d5adc_Rx (PduRDestPdu):
              PduRDestPduHandleId = 90
              PduRDestPduDirection = RECEIVE
              PduRDestPduRoutingType = API_FORWARDING
              PduRDestPduDataProcessing = IMMEDIATE
              PduRPduLengthHandlingStrategy = IGNORE
              PduRTransmissionConfirmation = false
              PduRDestPduRef = F_PBOX1_oB30_for_SC_CAN_V3_2_24a181fc_Rx
              PduRDestPduPduRBswModulesRef = Com
          R_PBOX1_Sc_oB30_for_SC_CAN_V3_2_4d1c68c6_Rx: PduRRoutingPathCommunicationType=COMMUNICATION_INTERFACE
            R_PBOX1_Sc_oB30_for_SC_CAN_V3_2_4d1c68c6_Rx_6da5275e_Rx (PduRDestPdu):
              PduRDestPduHandleId = 137
              PduRDestPduDirection = RECEIVE
              PduRDestPduRoutingType = API_FORWARDING
              PduRDestPduDataProcessing = IMMEDIATE
              PduRPduLengthHandlingStrategy = IGNORE
              PduRTransmissionConfirmation = false
              PduRDestPduRef = R_PBOX1_Sc_oB30_for_SC_CAN_V3_2_1bc17110_Rx
              PduRDestPduPduRBswModulesRef = SecOC
            PduRSrcPdu_6da5275e (PduRSrcPdu):
              PduRSourcePduHandleId = 137
              PduRSrcPduDirection = RECEIVE
              PduRSrcPduRef = R_PBOX1_Sc_oB30_for_SC_CAN_V3_2_4d1c68c6_Rx
              PduRSrcPduPduRBswModulesRef = CanIf
          HCM_L1_oB30_for_SC_CAN_V3_2_54b1f0b3_Rx: PduRRoutingPathCommunicationType=COMMUNICATION_INTERFACE
            PduRSrcPdu_696d66e7 (PduRSrcPdu): PduRSourcePduHandleId=101, PduRSrcPduDirection=RECEIVE, PduRSrcPduRef=HCM_L1_oB30_for_SC_CAN_V3_2_54b1f0b3_Rx, PduRSrcPduPduRBswModulesRef=CanIf
            HCM_L1_oB30_for_SC_CAN_V3_2_54b1f0b3_Rx_696d66e7_Rx (PduRDestPdu):
              PduRDestPduHandleId = 101
              PduRDestPduDirection = RECEIVE
              PduRDestPduRoutingType = API_FORWARDING
              PduRDestPduDataProcessing = IMMEDIATE
              PduRPduLengthHandlingStrategy = IGNORE
              PduRTransmissionConfirmation = false
              PduRDestPduRef = HCM_L1_oB30_for_SC_CAN_V3_2_02400631_Rx
              PduRDestPduPduRBswModulesRef = Com
          HUT49_oB30_for_SC_CAN_V3_2_aaa01e22_Tx: PduRRoutingPathCommunicationType=COMMUNICATION_INTERFACE
            PduRSrcPdu_39982944 (PduRSrcPdu): PduRSourcePduHandleId=39, PduRSrcPduDirection=TRANSMIT, PduRSrcPduRef=HUT49_oB30_for_SC_CAN_V3_2_aaa01e22_Tx, PduRSrcPduPduRBswModulesRef=Com
            HUT49_oB30_for_SC_CAN_V3_2_69c4d73c_Tx (PduRDestPdu):
              PduRDestPduHandleId = 39
              PduRDestPduDirection = TRANSMIT
              PduRDestPduRoutingType = API_FORWARDING
              PduRDestPduDataProcessing = IMMEDIATE
              PduRPduLengthHandlingStrategy = IGNORE
              PduRDestPduDataProvision = PDUR_DIRECT
              PduRTransmissionConfirmation = true
              PduRDestPduRef = HUT49_oB30_for_SC_CAN_V3_2_69c4d73c_Tx
              PduRDestPduPduRBswModulesRef = CanIf
          RFCM_L1_oB30_for_SC_CAN_V3_2_e13f7fa1_Rx: PduRRoutingPathCommunicationType=COMMUNICATION_INTERFACE
            RFCM_L1_oB30_for_SC_CAN_V3_2_e13f7fa1_Rx_b0c290b6_Rx (PduRDestPdu):
              PduRDestPduHandleId = 133
              PduRDestPduDirection = RECEIVE
              PduRDestPduRoutingType = API_FORWARDING
              PduRDestPduDataProcessing = IMMEDIATE
              PduRPduLengthHandlingStrategy = IGNORE
              PduRTransmissionConfirmation = false
              PduRDestPduRef = RFCM_L1_oB30_for_SC_CAN_V3_2_0f4843bb_Rx
              PduRDestPduPduRBswModulesRef = Com
            PduRSrcPdu_b0c290b6 (PduRSrcPdu): PduRSourcePduHandleId=133, PduRSrcPduDirection=RECEIVE, PduRSrcPduRef=RFCM_L1_oB30_for_SC_CAN_V3_2_e13f7fa1_Rx, PduRSrcPduPduRBswModulesRef=CanIf
          R_PBOX1_oB30_for_SC_CAN_V3_2_3929a458_Rx: PduRRoutingPathCommunicationType=COMMUNICATION_INTERFACE
            PduRSrcPdu_4bb0d0d6 (PduRSrcPdu): PduRSourcePduHandleId=138, PduRSrcPduDirection=RECEIVE, PduRSrcPduRef=R_PBOX1_oB30_for_SC_CAN_V3_2_3929a458_Rx, PduRSrcPduPduRBswModulesRef=SecOC
            R_PBOX1_oB30_for_SC_CAN_V3_2_3929a458_Rx (PduRDestPdu):
              PduRDestPduHandleId = 138
              PduRDestPduDirection = RECEIVE
              PduRDestPduRoutingType = API_FORWARDING
              PduRDestPduDataProcessing = IMMEDIATE
              PduRPduLengthHandlingStrategy = IGNORE
              PduRTransmissionConfirmation = false
              PduRDestPduRef = R_PBOX1_oB30_for_SC_CAN_V3_2_3929a458_Rx
              PduRDestPduPduRBswModulesRef = Com
          HCM_L2_oB30_for_SC_CAN_V3_2_d183e247_Rx: PduRRoutingPathCommunicationType=COMMUNICATION_INTERFACE
            HCM_L2_oB30_for_SC_CAN_V3_2_d183e247_Rx_baba8622_Rx (PduRDestPdu):
              PduRDestPduHandleId = 102
              PduRDestPduDirection = RECEIVE
              PduRDestPduRoutingType = API_FORWARDING
              PduRDestPduDataProcessing = IMMEDIATE
              PduRPduLengthHandlingStrategy = IGNORE
              PduRTransmissionConfirmation = false
              PduRDestPduRef = HCM_L2_oB30_for_SC_CAN_V3_2_3b38ab71_Rx
              PduRDestPduPduRBswModulesRef = Com
            PduRSrcPdu_baba8622 (PduRSrcPdu): PduRSourcePduHandleId=102, PduRSrcPduDirection=RECEIVE, PduRSrcPduRef=HCM_L2_oB30_for_SC_CAN_V3_2_d183e247_Rx, PduRSrcPduPduRBswModulesRef=CanIf
          OBC1_oB30_for_SC_CAN_V3_2_82cd4f59_Rx: PduRRoutingPathCommunicationType=COMMUNICATION_INTERFACE
            OBC1_oB30_for_SC_CAN_V3_2_82cd4f59_Rx_5b2f6325_Rx (PduRDestPdu):
              PduRDestPduHandleId = 126
              PduRDestPduDirection = RECEIVE
              PduRDestPduRoutingType = API_FORWARDING
              PduRDestPduDataProcessing = IMMEDIATE
              PduRPduLengthHandlingStrategy = IGNORE
              PduRTransmissionConfirmation = false
              PduRDestPduRef = OBC1_oB30_for_SC_CAN_V3_2_7aa70263_Rx
              PduRDestPduPduRBswModulesRef = Com
            PduRSrcPdu_5b2f6325 (PduRSrcPdu): PduRSourcePduHandleId=126, PduRSrcPduDirection=RECEIVE, PduRSrcPduRef=OBC1_oB30_for_SC_CAN_V3_2_82cd4f59_Rx, PduRSrcPduPduRBswModulesRef=CanIf
          HCM_R2_oB30_for_SC_CAN_V3_2_aca7df57_Rx: PduRRoutingPathCommunicationType=COMMUNICATION_INTERFACE
            HCM_R2_oB30_for_SC_CAN_V3_2_aca7df57_Rx_69d7721a_Rx (PduRDestPdu):
              PduRDestPduHandleId = 104
              PduRDestPduDirection = RECEIVE
              PduRDestPduRoutingType = API_FORWARDING
              PduRDestPduDataProcessing = IMMEDIATE
              PduRPduLengthHandlingStrategy = IGNORE
              PduRTransmissionConfirmation = false
              PduRDestPduRef = HCM_R2_oB30_for_SC_CAN_V3_2_d7391c61_Rx
              PduRDestPduPduRBswModulesRef = Com
            PduRSrcPdu_69d7721a (PduRSrcPdu): PduRSourcePduHandleId=104, PduRSrcPduDirection=RECEIVE, PduRSrcPduRef=HCM_R2_oB30_for_SC_CAN_V3_2_aca7df57_Rx, PduRSrcPduPduRBswModulesRef=CanIf
          ETC4_oB30_for_SC_CAN_V3_2_8561da0b_Rx: PduRRoutingPathCommunicationType=COMMUNICATION_INTERFACE
            ETC4_oB30_for_SC_CAN_V3_2_8561da0b_Rx_eef15a54_Rx (PduRDestPdu):
              PduRDestPduHandleId = 89
              PduRDestPduDirection = RECEIVE
              PduRDestPduRoutingType = API_FORWARDING
              PduRDestPduDataProcessing = IMMEDIATE
              PduRPduLengthHandlingStrategy = IGNORE
              PduRTransmissionConfirmation = false
              PduRDestPduRef = ETC4_oB30_for_SC_CAN_V3_2_42156d24_Rx
              PduRDestPduPduRBswModulesRef = Com
            PduRSrcPdu_eef15a54 (PduRSrcPdu): PduRSourcePduHandleId=89, PduRSrcPduDirection=RECEIVE, PduRSrcPduRef=ETC4_oB30_for_SC_CAN_V3_2_8561da0b_Rx, PduRSrcPduPduRBswModulesRef=CanIf
          RFCM_R1_oB30_for_SC_CAN_V3_2_9c1b42b1_Rx: PduRRoutingPathCommunicationType=COMMUNICATION_INTERFACE
            PduRSrcPdu_7d041acd (PduRSrcPdu): PduRSourcePduHandleId=134, PduRSrcPduDirection=RECEIVE, PduRSrcPduRef=RFCM_R1_oB30_for_SC_CAN_V3_2_9c1b42b1_Rx, PduRSrcPduPduRBswModulesRef=CanIf
            RFCM_R1_oB30_for_SC_CAN_V3_2_9c1b42b1_Rx_7d041acd_Rx (PduRDestPdu):
              PduRDestPduHandleId = 134
              PduRDestPduDirection = RECEIVE
              PduRDestPduRoutingType = API_FORWARDING
              PduRDestPduDataProcessing = IMMEDIATE
              PduRPduLengthHandlingStrategy = IGNORE
              PduRTransmissionConfirmation = false
              PduRDestPduRef = RFCM_R1_oB30_for_SC_CAN_V3_2_e349f4ab_Rx
              PduRDestPduPduRBswModulesRef = Com
          BMS35_oB30_for_SC_CAN_V3_2_edee5dfa_Rx: PduRRoutingPathCommunicationType=COMMUNICATION_INTERFACE
            PduRSrcPdu_a928d770 (PduRSrcPdu): PduRSourcePduHandleId=44, PduRSrcPduDirection=RECEIVE, PduRSrcPduRef=BMS35_oB30_for_SC_CAN_V3_2_edee5dfa_Rx, PduRSrcPduPduRBswModulesRef=CanIf
            BMS35_oB30_for_SC_CAN_V3_2_edee5dfa_Rx_a928d770_Rx (PduRDestPdu):
              PduRDestPduHandleId = 44
              PduRDestPduDirection = RECEIVE
              PduRDestPduRoutingType = API_FORWARDING
              PduRDestPduDataProcessing = IMMEDIATE
              PduRPduLengthHandlingStrategy = IGNORE
              PduRTransmissionConfirmation = false
              PduRDestPduRef = BMS35_oB30_for_SC_CAN_V3_2_3c9cd6f1_Rx
              PduRDestPduPduRBswModulesRef = Com
          ALS1_oB30_for_SC_CAN_V3_2_3dc20185_Rx: PduRRoutingPathCommunicationType=COMMUNICATION_INTERFACE
            ALS1_oB30_for_SC_CAN_V3_2_3dc20185_Rx_96315e5d_Rx (PduRDestPdu):
              PduRDestPduHandleId = 20
              PduRDestPduDirection = RECEIVE
              PduRDestPduRoutingType = API_FORWARDING
              PduRDestPduDataProcessing = IMMEDIATE
              PduRPduLengthHandlingStrategy = IGNORE
              PduRTransmissionConfirmation = false
              PduRDestPduRef = ALS1_oB30_for_SC_CAN_V3_2_5e3515d0_Rx
              PduRDestPduPduRBswModulesRef = Com
            PduRSrcPdu_96315e5d (PduRSrcPdu): PduRSourcePduHandleId=20, PduRSrcPduDirection=RECEIVE, PduRSrcPduRef=ALS1_oB30_for_SC_CAN_V3_2_3dc20185_Rx, PduRSrcPduPduRBswModulesRef=CanIf
          ZCluster_Debug_Msg_0x7AB_Tx: PduRRoutingPathCommunicationType=COMMUNICATION_INTERFACE
            SRC_ZCluster_Debug_Msg_0x7AB_Tx (PduRSrcPdu): PduRSourcePduHandleId=54, PduRSrcPduDirection=TRANSMIT, PduRSrcPduRef=ZCluster_Debug_Msg_0x7AB_Tx, PduRSrcPduPduRBswModulesRef=Com
            DST_ZCluster_Debug_Msg_0x7AB_Tx (PduRDestPdu):
              PduRDestPduHandleId = 52
              PduRDestPduDirection = TRANSMIT
              PduRDestPduRoutingType = API_FORWARDING
              PduRDestPduDataProcessing = IMMEDIATE
              PduRPduLengthHandlingStrategy = IGNORE
              PduRDestPduDataProvision = PDUR_DIRECT
              PduRTransmissionConfirmation = true
              PduRDestPduRef = ZCluster_Debug_Msg_0x7AB_Tx
              PduRDestPduPduRBswModulesRef = CanIf
          ZCluster_Debug_Msg_0x7AC_Tx: PduRRoutingPathCommunicationType=COMMUNICATION_INTERFACE
            SRC_ZCluster_Debug_Msg_0x7AC_Tx (PduRSrcPdu): PduRSourcePduHandleId=55, PduRSrcPduDirection=TRANSMIT, PduRSrcPduRef=ZCluster_Debug_Msg_0x7AC_Tx, PduRSrcPduPduRBswModulesRef=Com
            DST_ZCluster_Debug_Msg_0x7AC_Tx (PduRDestPdu):
              PduRDestPduHandleId = 53
              PduRDestPduDirection = TRANSMIT
              PduRDestPduRoutingType = API_FORWARDING
              PduRDestPduDataProcessing = IMMEDIATE
              PduRPduLengthHandlingStrategy = IGNORE
              PduRTransmissionConfirmation = true
              PduRDestPduDataProvision = PDUR_DIRECT
              PduRDestPduRef = ZCluster_Debug_Msg_0x7AC_Tx
              PduRDestPduPduRBswModulesRef = CanIf
          ZCluster_Debug_Msg_0x7AD_Tx: PduRRoutingPathCommunicationType=COMMUNICATION_INTERFACE
            SRC_ZCluster_Debug_Msg_0x7AD_Tx (PduRSrcPdu): PduRSourcePduHandleId=56, PduRSrcPduDirection=TRANSMIT, PduRSrcPduRef=ZCluster_Debug_Msg_0x7AD_Tx, PduRSrcPduPduRBswModulesRef=Com
            DST_ZCluster_Debug_Msg_0x7AD_Tx (PduRDestPdu):
              PduRDestPduHandleId = 54
              PduRDestPduDirection = TRANSMIT
              PduRDestPduRoutingType = API_FORWARDING
              PduRDestPduDataProcessing = IMMEDIATE
              PduRPduLengthHandlingStrategy = IGNORE
              PduRTransmissionConfirmation = true
              PduRDestPduDataProvision = PDUR_DIRECT
              PduRDestPduRef = ZCluster_Debug_Msg_0x7AD_Tx
              PduRDestPduPduRBswModulesRef = CanIf
          ZCluster_Debug_Msg_0x7AE_Tx: PduRRoutingPathCommunicationType=COMMUNICATION_INTERFACE
            SRC_ZCluster_Debug_Msg_0x7AE_Tx (PduRSrcPdu): PduRSourcePduHandleId=57, PduRSrcPduDirection=TRANSMIT, PduRSrcPduRef=ZCluster_Debug_Msg_0x7AE_Tx, PduRSrcPduPduRBswModulesRef=Com
            DST_ZCluster_Debug_Msg_0x7AE_Tx (PduRDestPdu):
              PduRDestPduHandleId = 55
              PduRDestPduDirection = TRANSMIT
              PduRDestPduRoutingType = API_FORWARDING
              PduRDestPduDataProcessing = IMMEDIATE
              PduRPduLengthHandlingStrategy = IGNORE
              PduRDestPduDataProvision = PDUR_DIRECT
              PduRTransmissionConfirmation = true
              PduRDestPduRef = ZCluster_Debug_Msg_0x7AE_Tx
              PduRDestPduPduRBswModulesRef = CanIf
          ZCluster_Debug_Msg_0x7AF_Tx: PduRRoutingPathCommunicationType=COMMUNICATION_INTERFACE
            SRC_ZCluster_Debug_Msg_0x7AF_Tx (PduRSrcPdu): PduRSourcePduHandleId=58, PduRSrcPduDirection=TRANSMIT, PduRSrcPduRef=ZCluster_Debug_Msg_0x7AF_Tx, PduRSrcPduPduRBswModulesRef=Com
            DST_ZCluster_Debug_Msg_0x7AF_Tx (PduRDestPdu):
              PduRDestPduHandleId = 56
              PduRDestPduDirection = TRANSMIT
              PduRDestPduRoutingType = API_FORWARDING
              PduRDestPduDataProcessing = IMMEDIATE
              PduRPduLengthHandlingStrategy = IGNORE
              PduRDestPduDataProvision = PDUR_DIRECT
              PduRTransmissionConfirmation = true
              PduRDestPduRef = ZCluster_Debug_Msg_0x7AF_Tx
              PduRDestPduPduRBswModulesRef = CanIf
          VMDR1_oB30_for_SC_CAN_V3_2_01b65f56_Rx: PduRRoutingPathCommunicationType=COMMUNICATION_INTERFACE
            VMDR1_oB30_for_SC_CAN_V3_2_01b65f56_Rx_519dd205_Rx (PduRDestPdu):
              PduRDestPduHandleId = 153
              PduRDestPduDirection = RECEIVE
              PduRDestPduRoutingType = API_FORWARDING
              PduRDestPduDataProcessing = IMMEDIATE
              PduRPduLengthHandlingStrategy = IGNORE
              PduRTransmissionConfirmation = false
              PduRDestPduRef = VMDR1_oB30_for_SC_CAN_V3_2_32d43f61_Rx
              PduRDestPduPduRBswModulesRef = Com
            PduRSrcPdu_519dd205 (PduRSrcPdu): PduRSourcePduHandleId=153, PduRSrcPduDirection=RECEIVE, PduRSrcPduRef=VMDR1_oB30_for_SC_CAN_V3_2_01b65f56_Rx, PduRSrcPduPduRBswModulesRef=CanIf
          BCM19_oB30_for_SC_CAN_V3_2_521668ae_Rx: PduRRoutingPathCommunicationType=COMMUNICATION_INTERFACE
            PduRSrcPdu_ff0f949a (PduRSrcPdu): PduRSourcePduHandleId=36, PduRSrcPduDirection=RECEIVE, PduRSrcPduRef=BCM19_oB30_for_SC_CAN_V3_2_521668ae_Rx, PduRSrcPduPduRBswModulesRef=CanIf
            BCM19_oB30_for_SC_CAN_V3_2_521668ae_Rx_ff0f949a_Rx (PduRDestPdu):
              PduRDestPduHandleId = 36
              PduRDestPduDirection = RECEIVE
              PduRDestPduRoutingType = API_FORWARDING
              PduRDestPduDataProcessing = IMMEDIATE
              PduRPduLengthHandlingStrategy = IGNORE
              PduRTransmissionConfirmation = false
              PduRDestPduRef = BCM19_oB30_for_SC_CAN_V3_2_6e635eda_Rx
              PduRDestPduPduRBswModulesRef = Com
          GLO_NASS1_oB30_for_SC_CAN_V3_2_c0d601c5_Rx: PduRRoutingPathCommunicationType=COMMUNICATION_INTERFACE
            PduRSrcPdu_49fe1e9a (PduRSrcPdu): PduRSourcePduHandleId=91, PduRSrcPduDirection=RECEIVE, PduRSrcPduRef=GLO_NASS1_oB30_for_SC_CAN_V3_2_c0d601c5_Rx, PduRSrcPduPduRBswModulesRef=CanIf
            GLO_NASS1_oB30_for_SC_CAN_V3_2_c0d601c5_Rx_49fe1e9a_Rx (PduRDestPdu):
              PduRDestPduHandleId = 91
              PduRDestPduDirection = RECEIVE
              PduRDestPduRoutingType = API_FORWARDING
              PduRDestPduDataProcessing = IMMEDIATE
              PduRPduLengthHandlingStrategy = IGNORE
              PduRTransmissionConfirmation = false
              PduRDestPduRef = GLO_NASS1_oB30_for_SC_CAN_V3_2_96a1bccc_Rx
              PduRDestPduPduRBswModulesRef = Com
      PduRLock_PduRExclusiveArea (PduRLock)
        PduRExclusiveArea: PduRExclusiveAreaId=0
      PduRQueue
        PduRSharedBufferQueue: PduRQueueDepth=1, PduRTpThreshold=4095, PduRImplicitTxBufferRef=PduRTxBuffer
      PduRTxBufferTable
        PduRTxBuffer: PduRPduMaxLength=4095, PduRTxBufferUsageType=IMPLICIT_BUFFER
    6 x PduRBswModules, all with PduRCancelReceive=false, PduRCancelTransmit=false, PduRChangeParameterRequestApi=false:
      CanIf: PduRCommunicationInterface=true, PduRLowerModule=true, PduRTransportProtocol=false, PduRTriggertransmit=false, PduRTxConfirmation=true, PduRUpperModule=false, PduRUseTag=false, PduRBswModuleRef=CanIf
      CanNm: PduRCommunicationInterface=true, PduRLowerModule=true, PduRTransportProtocol=false, PduRTriggertransmit=true, PduRTxConfirmation=false, PduRUpperModule=false, PduRUseTag=false, PduRBswModuleRef=CanNm
      CanTp: PduRCommunicationInterface=false, PduRTransportProtocol=true, PduRTriggertransmit=false, PduRTxConfirmation=false, PduRUpperModule=false, PduRUseTag=false, PduRLowerModule=true, PduRBswModuleRef=CanTp
      Com: PduRCommunicationInterface=true, PduRLowerModule=false, PduRTransportProtocol=false, PduRTriggertransmit=true, PduRTxConfirmation=true, PduRUpperModule=true, PduRUseTag=false, PduRBswModuleRef=Com
      Dcm: PduRCommunicationInterface=false, PduRLowerModule=false, PduRTransportProtocol=true, PduRTriggertransmit=false, PduRTxConfirmation=false, PduRUpperModule=true, PduRUseTag=true, PduRBswModuleRef=Dcm
      SecOC: PduRCommunicationInterface=true, PduRLowerModule=true, PduRTransportProtocol=false, PduRTriggertransmit=false, PduRTxConfirmation=true, PduRUpperModule=true, PduRUseTag=false, PduRBswModuleRef=SecOC
