AUTOSAR XML (schema 00046)
package /ActiveEcuC
  module config Mcu: implementation-config-variant=VARIANT-POST-BUILD, module-description=Mcu_Impl
    McuModuleConfiguration:
      McuClockSrcFailureNotification = DISABLED
      McuCyclicRunModeBaseAddress = 4273963008
      McuLviDetectionLevel = DETECTION_LEVEL_0
      McuLviResetMask = RESET_REQUEST
      McuNumberOfMcuModes = 1
      McuRamSectors = 1
      McuRetentionRamAddress = 4273963008
      McuModeSettingConf_normal (McuModeSettingConf):
        McuMainOscOperation = false
        McuMode = 0
        McuModeTransitionReq = true
        McuModeType = DEEPSTOP_MODE
        McuWakeUpFactor0 = true
        McuWakeUpFactor1 = true
        McuWakeUpFactor2 = false
        McuWakeUpFactorIso0 = false
        McuWakeUpFactor0Details: McuWakeUpFactor0Name=INTP3_WUF0_9
      McuDemEventParameterRefs:
        MCU_E_CLOCK_FAILURE = AutoCreatedDemEvent_McuDemEventParameterRefs_MCU_E_CLOCK_FAILURE
        MCU_E_CVM_SETTING_FAILURE = AutoCreatedDemEvent_McuDemEventParameterRefs_MCU_E_CVM_SETTING_FAILURE
        MCU_E_INCONCISTENCY_RESF_FAILURE = AutoCreatedDemEvent_McuDemEventParameterRefs_MCU_E_INCONCISTENCY_RESF_FAILURE
        MCU_E_WRITE_TIMEOUT_FAILURE = AutoCreatedDemEvent_McuDemEventParameterRefs_MCU_E_WRITE_TIMEOUT_FAILURE
        MCU_E_REG_WRITE_VERIFY = AutoCreatedDemEvent_McuDemEventParameterRefs_MCU_E_REG_WRITE_VERIFY
        MCU_E_LVI_FAILURE = AutoCreatedDemEvent_McuDemEventParameterRefs_MCU_E_LVI_FAILURE
      McuClockSettingConfig:
        Mcu8MhzRingStopRequestMask = false
        McuClkModeSelect = MCU_CPLL0CLK_ID_0
        McuClockSettingId = 0
        McuCpuClockDivider = DIVBY_1_ID_1
        McuCpuMainSysClk = 240000000
        McuOPBT0 = 3123183567
        McuUnitName = CPUCLK
        McuClockReferencePoint_OSC (McuClockReferencePoint): McuClockReferencePointFrequency=24000000
        McuClockReferencePoint_LIN (McuClockReferencePoint): McuClockReferencePointFrequency=40000000
        McuAwoWdta: McuDivClockSel=DIVBY_128_ID_1, McuPeripheralClock=1875, McuStopRequestMask=false, McuUnitName=WDTA
        McuAwoRtca: McuDivClockSel=DIVBY_1_ID_1, McuPeripheralClock=24000000, McuSrcClockSel=FX_ID_2, McuStopRequestMask=true, McuUnitName=RTCA
        McuAwoTauj: McuDivClockSel=DIVBY_1_ID_1, McuPeripheralClock=40000000, McuSrcClockSel=PPLLCLK_DIVBY_2_ID_4, McuStopRequestMask=false, McuUnitName=TAUJ
        McuIsoCan: McuPeripheralClock=80000000, McuSrcClockSel=PPLLCLK_DIVBY_1_ID_3, McuStopRequestMask=false, McuUnitName=CAN
        McuIsoCanosc: McuDivClockSel=DIVBY_1_ID_1, McuPeripheralClock=24000000, McuStopRequestMask=false, McuUnitName=CANOSC
        McuIsoCsi: McuPeripheralClock=80000000, McuSrcClockSel=PPLLCLK_DIVBY_1_ID_2, McuUnitName=CSI
        McuIsoEth: McuPeripheralClock=60000000, McuSrcClockSel=CPUCLK_DIVBY_4, McuUnitName=ETH
        McuIsoIics: McuPeripheralClock=40000000, McuSrcClockSel=PPLLCLK_DIVBY_2_ID_1, McuUnitName=IICS
        McuIsoLin: McuPeripheralClock=40000000, McuSrcClockSel=PPLLCLK_DIVBY_2_ID_1, McuStopRequestMask=false, McuUnitName=LIN
        McuIsoLin3: McuDivClockSel=DIVBY_1_ID_1, McuPeripheralClock=40000000, McuUnitName=LIN3
        McuIsoLrosc: McuPeripheralClock=240000
        McuIsoPeri1: McuPeripheralClock=80000000, McuSrcClockSel=PPLLCLK_DIVBY_1_ID_2, McuUnitName=PERI1
        McuIsoPeri2: McuPeripheralClock=40000000, McuSrcClockSel=PPLLCLK_DIVBY_2_ID_2, McuUnitName=PERI2
        McuMainOscSetting: McuMainOscAmplificationGain=HIGH_ID_0, McuMainOsciFrequency=24000000, McuMainOscStabTimeSetting=131071, McuMainOscStopRequestMask=true
        McuPll0Setting:
          McuCpll0Clk = 240000000
          McuCpllDivider = P_VALUE_2
          McuPll0Divider = DIV_BY_6
          McuPll0InputClockSelection = MCU_SELECT_MOSC
          McuPll0MrValue = 3
          McuPll0NrValue = NR_VAL_60
          McuPll0Out = 80000000
          McuPllFreqModCycleSetting = 10
          McuPllFreqModRange = 0
        McuPllSetting:
          McuCpllClk = 120000000
          McuCpllDivider = P_VALUE_2
          McuPllInputClockSelection = MCU_SELECT_MOSC
          McuPllMrValue = 3
          McuPllNrValue = NR_VAL_60
          McuPpllClk = 80000000
          McuPpllDivider = DIV_BY_6
          McuPpllOut = 80000000
          McuPpllSrcClock = MCU_PPLLOUT_ID_3
        McuSubOscSetting: McuSubOscFrequency=32768, McuSubOscStabTimeSetting=1
        6 x McuClockReferencePoint:
          McuClockReferencePoint_CAN: McuClockReferencePointFrequency=40000000
          McuClockReferencePoint_TAUB: McuClockReferencePointFrequency=40000000
          McuClockReferencePoint_TAUJ_0_2: McuClockReferencePointFrequency=40000000
          McuClockReferencePoint_TAUD0: McuClockReferencePointFrequency=80000000
          McuClockReferencePoint_TAUJ_1_3: McuClockReferencePointFrequency=80000000
          McuClockReferencePoint_OSTM: McuClockReferencePointFrequency=60000000
        McuAwoAdca0: McuDivClockSel=DIVBY_1_ID_1, McuPeripheralClock=40000000, McuSrcClockSel=PPLLCLK_DIVBY_2_ID_3, McuStopRequestMask=false, McuUnitName=ADCA
        McuIsoAdca1: McuDivClockSel=DIVBY_1_ID_1, McuPeripheralClock=40000000, McuSrcClockSel=PPLLCLK_DIVBY_2_ID_3, McuUnitName=ADCA
      McuModeSettingConf_lvi (McuModeSettingConf):
        McuMainOscOperation = false
        McuMode = 1
        McuModeTransitionReq = true
        McuModeType = DEEPSTOP_MODE
        McuWakeUpFactor0 = true
        McuWakeUpFactor1 = true
        McuWakeUpFactor2 = false
        McuWakeUpFactorIso0 = false
        McuWakeUpFactor1Details: McuWakeUpFactor1Name=INTP21_WUF1_5
    McuGeneralConfiguration:
      McuClm0MonitoringClockAccuracy = 9
      McuClm0Operation = true
      McuClm0SamplingClockAccuracy = 9
      McuClm1MonitoringClockAccuracy = 5
      McuClm1Operation = true
      McuClm1SamplingClockAccuracy = 8
      McuClm2MonitoringClockAccuracy = 14
      McuClm2Operation = false
      McuClm2SamplingClockAccuracy = 14
      McuClm3MonitoringClockAccuracy = 14
      McuClm3Operation = false
      McuClm3SamplingClockAccuracy = 14
      McuCopyToSection = true
      McuCriticalSectionProtection = false
      McuCvmHighVoltageDetect = false
      McuCvmLowVoltageDetect = false
      McuDevErrorDetect = true
      McuDeviceName = R7F701651
      McuGetRamStateApi = true
      McuInitClock = true
      McuLoopCount = 5
      McuLowPowerSequencerOperation = false
      McuNoPll = false
      McuPerformResetApi = true
      McuPortGroupStatusBackUp = false
      McuRAMMirror = DISABLE
      McuResetReasonMultipleResets = true
      McuRetentionRamSourceAddress = 65536
      McuSwResetCallApi = false
      McuUseWriteVerifyErrorInterface = false
      McuVersionCheckExternalModules = false
      McuVersionInfoApi = false
      McuWakeUpFactorClearIsr = true
      McuWakeUpFactorsClearCentralised = true
      McuWriteVerify = WV_DISABLE
      McuWriteVerifyErrorInterface = NULL_PTR
    McuPublishedInformation
      McuRstRsnConfClm3: McuResetReason=15
      McuRstRsnConfResf13: McuResetReason=14
      McuRstRsnConfLvi: McuResetReason=7
      McuRstRsnConfSwRst: McuResetReason=1
      McuRstRsnConfTer: McuResetReason=9
      McuRstRsnConfMultipleResets: McuResetReason=17
      McuRstRsnConfUnknown: McuResetReason=18
      McuRstRsnConfIso: McuResetReason=11
      McuRstRsnConfClm0: McuResetReason=4
      McuRstRsnConfClm1: McuResetReason=5
      McuRstRsnConfResf11: McuResetReason=12
      McuRstRsnConfWdta1: McuResetReason=3
      McuRstRsnConfUndef: McuResetReason=16
      McuRstRsnConfWdta0: McuResetReason=2
      McuRstRsnConfCvm: McuResetReason=8
      McuRstRsnConfPOR: McuResetReason=10
      McuRstRsnConfResf12: McuResetReason=13
      McuResetReasonConfSwRst (McuResetReasonConf): McuResetReason=1
      McuRstRsnConfClm2: McuResetReason=6
      5 x McuResetReasonConf:
        McuResetReasonConfWdta0: McuResetReason=2
        McuResetReasonConfWdta1: McuResetReason=3
        McuResetReasonConfWakeup: McuResetReason=11
        McuResetReasonConfLvi: McuResetReason=7
        McuResetReasonConfPOR: McuResetReason=10
    McuRamInitConfiguration: McuRamInitBaseAddress=4273733632, McuRamInitSize=256, McuRamInitValue=255, McuRamTypeSelection=CPU_LOCAL_RAM, McuRamWriteSizeSel=BIT_8
