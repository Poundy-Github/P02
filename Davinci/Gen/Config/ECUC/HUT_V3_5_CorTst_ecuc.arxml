AUTOSAR XML (schema 00046)
package /ActiveEcuC
  module config CorTst: implementation-config-variant=VARIANT-PRE-COMPILE, module-description=CorTst_Impl
    CorTstGeneral:
      CorTstVersionChkExternalModules = false
      CorTstAlreadyInitDetCheck = true
      CorTstCriticalSectionProtection = true
      CorTstDevErrorDetect = false
      CorTstDeviceName = R7F701651
      CorTstFgndTestNumber = 1
      CorTstNotificationSupported = true
      CorTstTestResultMode = false
      CorTst_SWG3KH:
        CorTst_CST_EXECUTE_FETRAP_TEST = 1
        CorTst_CST_EXECUTE_MAE_TEST = 1
        CorTst_CST_EXECUTE_TRAP0_TEST = 1
        CorTst_CST_EXECUTE_TRAP1_TEST = 1
        CorTst_CST_RAM_ADDRESS_A = 4278091776
        CorTst_CST_RAM_ADDRESS_B = 4278092288
        CorTst_CST_RAM_ADDRESS_C = 4278092800
        CorTst_CST_RAM_ADDRESS_L = 4278093312
        CorTst_G3KH_IntEnable = 1
    CorTstConfigApiServices:
      CorTstAbortApi = false
      CorTstGetCurrentStatus = true
      CorTstGetFgndSignature = true
      CorTstGetSignature = true
      CorTstGetStateApi = true
      CorTstStartApi = true
      CorTstVersionInfoApi = false
    CorTstDemEventParameterRefs: CORTST_E_CORE_FAILURE=AutoCreatedDemEvent_CortstDemEventParameterRefs_RAMTST_E_Core
    CorTstForegroundConfigSet: CorTstTestIdFgnd=0
      CorTstModuleSelection:
        CorTstModule_CST_CPU_arithmetic_{1..4} = true
        CorTstModule_CST_CPU_bit_1 = true
        CorTstModule_CST_CPU_bit_2 = true
        CorTstModule_CST_CPU_bitinsert_1 = true
        CorTstModule_CST_CPU_bitsearch_1 = true
        CorTstModule_CST_CPU_boolean_1 = true
        CorTstModule_CST_CPU_branch_1 = true
        CorTstModule_CST_CPU_cond_br_1 = true
        CorTstModule_CST_CPU_cond_data_{1..3} = true
        CorTstModule_CST_CPU_condition_1 = true
        CorTstModule_CST_CPU_condition_2 = true
        CorTstModule_CST_CPU_data_1 = true
        CorTstModule_CST_CPU_data_2 = true
        CorTstModule_CST_CPU_div_1 = true
        CorTstModule_CST_CPU_div_2 = true
        CorTstModule_CST_CPU_hsdiv_1 = true
        CorTstModule_CST_CPU_ifu_1 = true
        CorTstModule_CST_CPU_ipu_1 = true
        CorTstModule_CST_CPU_jump_1 = true
        CorTstModule_CST_CPU_load_1 = true
        CorTstModule_CST_CPU_load_2 = true
        CorTstModule_CST_CPU_loadlink_1 = true
        CorTstModule_CST_CPU_loadstore_1 = true
        CorTstModule_CST_CPU_loop_1 = true
        CorTstModule_CST_CPU_lsu_1 = true
        CorTstModule_CST_CPU_lsu_2 = true
        CorTstModule_CST_CPU_mac_1 = true
        CorTstModule_CST_CPU_memory_1 = true
        CorTstModule_CST_CPU_memory_2 = true
        CorTstModule_CST_CPU_mul_{1..4} = true
        CorTstModule_CST_CPU_saturated_{1..4} = true
        CorTstModule_CST_CPU_shift_{1..4} = true
        CorTstModule_CST_CPU_special_{1..4} = true
        CorTstModule_CST_CPU_special_5 = false
        CorTstModule_CST_CPU_special_6 = true
        CorTstModule_CST_CPU_special_7 = true
        CorTstModule_CST_CPU_store_1 = true
        CorTstModule_CST_CPU_store_2 = true
        CorTstModule_CST_CPU_syscall_1 = true
        CorTstModule_CST_CPU_trap_1 = false
        CorTstModule_CST_CPU_trap_2 = true
        CorTstModule_CST_FPU_calc_1 = true
        CorTstModule_CST_FPU_calc_2 = true
        CorTstModule_CST_FPU_calc_3 = false
        CorTstModule_CST_FPU_calc_4 = false
        CorTstModule_CST_FPU_calc_5 = true
        CorTstModule_CST_FPU_calc_6 = false
        CorTstModule_CST_FPU_cmov_1 = true
        CorTstModule_CST_FPU_cmov_2 = false
        CorTstModule_CST_FPU_cmp_1 = true
        CorTstModule_CST_FPU_cmp_2 = false
        CorTstModule_CST_FPU_cvt_{1..3} = true
        CorTstModule_CST_FPU_fmul_{1..4} = true
        CorTstModule_CST_FPU_roundoff_1 = true
        CorTstModule_CST_FPU_roundoff_2 = false
        CorTstModule_CST_FPU_roundoff_3 = true
        CorTstModule_CST_SRU_exc_1 = true
        CorTstModule_CST_SRU_fpu_1 = true
        CorTstModule_CST_SRU_fpu_2 = false
        CorTstModule_CST_SRU_loadstore_{1..3} = true
        CorTstModule_CST_SRU_loadstore_4 = false
        CorTstModule_CST_SRU_loadstore_{5..7} = true
        CorTstModule_CST_SRU_loadstore_8 = false
        CorTstModule_CST_SRU_mpu_1 = true
      CorTstSelect: CorTstAddress=true, CorTstAlu=true, CorTstCache=true, CorTstInterrupt=true, CorTstMemoryIf=true, CorTstMpu=true, CorTstRegister=true
