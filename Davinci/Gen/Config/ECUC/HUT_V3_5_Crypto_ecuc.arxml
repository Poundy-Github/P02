AUTOSAR XML (schema 00046)
package /ActiveEcuC
  module config Crypto: implementation-config-variant=VARIANT-PRE-COMPILE, module-description=Crypto_Impl
    CryptoGeneral: CryptoDevErrorDetect=true, CryptoVersionInfoApi=false, CryptoMainFunctionPeriod=0.005, CryptoSafeBswChecks=false
    CryptoKeyElements
      80 x CryptoKeyElement:
        vHsmDummyKeyElement: CryptoKeyElementSize=1, CryptoKeyElementAllowPartialAccess=true, CryptoKeyElementId=0, CryptoKeyElementPersist=false, CryptoKeyElementReadAccess=RA_ALLOWED, CryptoKeyElementWriteAccess=WA_ALLOWED
        Crypto_30_LibCv_vHsm_SecureBootSegment_BM_0_Sanction_Sync: CryptoKeyElementAllowPartialAccess=false, CryptoKeyElementPersist=true, CryptoKeyElementId=3027, CryptoKeyElementSize=1, CryptoKeyElementReadAccess=RA_ALLOWED, CryptoKeyElementWriteAccess=WA_ALLOWED
        Crypto_30_LibCv_vHsm_SecureBootSegment_BM_0_Mode_Sync: CryptoKeyElementAllowPartialAccess=false, CryptoKeyElementPersist=true, CryptoKeyElementId=3039, CryptoKeyElementSize=1, CryptoKeyElementReadAccess=RA_ALLOWED, CryptoKeyElementWriteAccess=WA_ALLOWED
        Crypto_30_LibCv_vHsm_SecureBootSegment_BM_0_Address_Sync: CryptoKeyElementAllowPartialAccess=false, CryptoKeyElementPersist=true, CryptoKeyElementId=3024, CryptoKeyElementSize=4, CryptoKeyElementReadAccess=RA_ALLOWED, CryptoKeyElementWriteAccess=WA_ALLOWED
        Crypto_30_LibCv_vHsm_SecureBootSegment_BM_0_Length_Sync: CryptoKeyElementAllowPartialAccess=false, CryptoKeyElementPersist=true, CryptoKeyElementId=3025, CryptoKeyElementSize=4, CryptoKeyElementReadAccess=RA_ALLOWED, CryptoKeyElementWriteAccess=WA_ALLOWED
        Crypto_30_LibCv_vHsm_SecureBootSegment_BM_0_CMAC_Sync: CryptoKeyElementAllowPartialAccess=true, CryptoKeyElementPersist=true, CryptoKeyElementId=3026, CryptoKeyElementSize=16, CryptoKeyElementReadAccess=RA_ALLOWED, CryptoKeyElementWriteAccess=WA_ALLOWED
        Crypto_30_LibCv_vHsm_SecureBootSegment_APPL_2_Sanction_Sync: CryptoKeyElementAllowPartialAccess=false, CryptoKeyElementPersist=true, CryptoKeyElementId=3027, CryptoKeyElementSize=1, CryptoKeyElementReadAccess=RA_ALLOWED, CryptoKeyElementWriteAccess=WA_DENIED
        Crypto_30_LibCv_vHsm_SecureBootSegment_APPL_2_Mode_Sync: CryptoKeyElementAllowPartialAccess=false, CryptoKeyElementPersist=true, CryptoKeyElementId=3039, CryptoKeyElementSize=1, CryptoKeyElementReadAccess=RA_ALLOWED, CryptoKeyElementWriteAccess=WA_DENIED
        Crypto_30_LibCv_vHsm_SecureBootSegment_APPL_2_Address_Sync: CryptoKeyElementAllowPartialAccess=false, CryptoKeyElementPersist=true, CryptoKeyElementId=3024, CryptoKeyElementSize=4, CryptoKeyElementReadAccess=RA_ALLOWED, CryptoKeyElementWriteAccess=WA_DENIED
        Crypto_30_LibCv_vHsm_SecureBootSegment_APPL_2_Length_Sync: CryptoKeyElementAllowPartialAccess=false, CryptoKeyElementPersist=true, CryptoKeyElementId=3025, CryptoKeyElementSize=4, CryptoKeyElementReadAccess=RA_ALLOWED, CryptoKeyElementWriteAccess=WA_DENIED
        Crypto_30_LibCv_vHsm_SecureBootSegment_APPL_2_CMAC_Sync: CryptoKeyElementAllowPartialAccess=true, CryptoKeyElementPersist=true, CryptoKeyElementId=3026, CryptoKeyElementSize=16, CryptoKeyElementReadAccess=RA_ALLOWED, CryptoKeyElementWriteAccess=WA_DENIED
        Crypto_30_LibCv_vHsm_SecureBootSegment_APPL_0_Sanction_Sync: CryptoKeyElementAllowPartialAccess=false, CryptoKeyElementPersist=true, CryptoKeyElementId=3027, CryptoKeyElementSize=1, CryptoKeyElementReadAccess=RA_DENIED, CryptoKeyElementWriteAccess=WA_DENIED
        Crypto_30_LibCv_vHsm_SecureBootSegment_APPL_0_Mode_Sync: CryptoKeyElementAllowPartialAccess=false, CryptoKeyElementPersist=true, CryptoKeyElementId=3039, CryptoKeyElementSize=1, CryptoKeyElementReadAccess=RA_DENIED, CryptoKeyElementWriteAccess=WA_DENIED
        Crypto_30_LibCv_vHsm_SecureBootSegment_APPL_0_Address_Sync: CryptoKeyElementAllowPartialAccess=false, CryptoKeyElementPersist=true, CryptoKeyElementId=3024, CryptoKeyElementSize=4, CryptoKeyElementReadAccess=RA_DENIED, CryptoKeyElementWriteAccess=WA_DENIED
        Crypto_30_LibCv_vHsm_SecureBootSegment_APPL_0_Length_Sync: CryptoKeyElementAllowPartialAccess=false, CryptoKeyElementPersist=true, CryptoKeyElementId=3025, CryptoKeyElementSize=4, CryptoKeyElementReadAccess=RA_DENIED, CryptoKeyElementWriteAccess=WA_DENIED
        Crypto_30_LibCv_vHsm_SecureBootSegment_APPL_0_CMAC_Sync: CryptoKeyElementAllowPartialAccess=true, CryptoKeyElementPersist=true, CryptoKeyElementId=3026, CryptoKeyElementSize=16, CryptoKeyElementReadAccess=RA_DENIED, CryptoKeyElementWriteAccess=WA_DENIED
        Crypto_30_LibCv_vHsm_SecureBootSegment_APPL_1_Sanction_Sync: CryptoKeyElementAllowPartialAccess=false, CryptoKeyElementPersist=true, CryptoKeyElementId=3027, CryptoKeyElementSize=1, CryptoKeyElementReadAccess=RA_DENIED, CryptoKeyElementWriteAccess=WA_DENIED
        Crypto_30_LibCv_vHsm_SecureBootSegment_APPL_1_Mode_Sync: CryptoKeyElementAllowPartialAccess=false, CryptoKeyElementPersist=true, CryptoKeyElementId=3039, CryptoKeyElementSize=1, CryptoKeyElementReadAccess=RA_DENIED, CryptoKeyElementWriteAccess=WA_DENIED
        Crypto_30_LibCv_vHsm_SecureBootSegment_APPL_1_Address_Sync: CryptoKeyElementAllowPartialAccess=false, CryptoKeyElementPersist=true, CryptoKeyElementId=3024, CryptoKeyElementSize=4, CryptoKeyElementReadAccess=RA_DENIED, CryptoKeyElementWriteAccess=WA_DENIED
        Crypto_30_LibCv_vHsm_SecureBootSegment_APPL_1_Length_Sync: CryptoKeyElementAllowPartialAccess=false, CryptoKeyElementPersist=true, CryptoKeyElementId=3025, CryptoKeyElementSize=4, CryptoKeyElementReadAccess=RA_DENIED, CryptoKeyElementWriteAccess=WA_DENIED
        Crypto_30_LibCv_vHsm_SecureBootSegment_APPL_1_CMAC_Sync: CryptoKeyElementAllowPartialAccess=true, CryptoKeyElementPersist=true, CryptoKeyElementId=3026, CryptoKeyElementSize=16, CryptoKeyElementReadAccess=RA_DENIED, CryptoKeyElementWriteAccess=WA_DENIED
        Crypto_30_LibCv_vHsm_SecureBoot_Key_Sync: CryptoKeyElementAllowPartialAccess=false, CryptoKeyElementPersist=true, CryptoKeyElementId=1, CryptoKeyElementSize=16, CryptoKeyElementReadAccess=RA_ALLOWED, CryptoKeyElementWriteAccess=WA_ALLOWED
        Crypto_30_LibCv_vHsm_SecureBootSegment_FBL_0_Sanction_Sync: CryptoKeyElementAllowPartialAccess=false, CryptoKeyElementPersist=true, CryptoKeyElementId=3027, CryptoKeyElementSize=1, CryptoKeyElementReadAccess=RA_DENIED, CryptoKeyElementWriteAccess=WA_DENIED
        Crypto_30_LibCv_vHsm_SecureBootSegment_FBL_0_Mode_Sync: CryptoKeyElementAllowPartialAccess=false, CryptoKeyElementPersist=true, CryptoKeyElementId=3039, CryptoKeyElementSize=1, CryptoKeyElementReadAccess=RA_DENIED, CryptoKeyElementWriteAccess=WA_DENIED
        Crypto_30_LibCv_vHsm_SecureBootSegment_FBL_0_Address_Sync: CryptoKeyElementAllowPartialAccess=false, CryptoKeyElementPersist=true, CryptoKeyElementId=3024, CryptoKeyElementSize=4, CryptoKeyElementReadAccess=RA_DENIED, CryptoKeyElementWriteAccess=WA_DENIED
        Crypto_30_LibCv_vHsm_SecureBootSegment_FBL_0_Length_Sync: CryptoKeyElementAllowPartialAccess=false, CryptoKeyElementPersist=true, CryptoKeyElementId=3025, CryptoKeyElementSize=4, CryptoKeyElementReadAccess=RA_DENIED, CryptoKeyElementWriteAccess=WA_DENIED
        Crypto_30_LibCv_vHsm_SecureBootSegment_FBL_0_CMAC_Sync: CryptoKeyElementAllowPartialAccess=true, CryptoKeyElementPersist=true, CryptoKeyElementId=3026, CryptoKeyElementSize=16, CryptoKeyElementReadAccess=RA_DENIED, CryptoKeyElementWriteAccess=WA_DENIED
        vHsm_Hal_FlashOperation_Sync: CryptoKeyElementAllowPartialAccess=false, CryptoKeyElementPersist=false, CryptoKeyElementId=3032, CryptoKeyElementSize=16, CryptoKeyElementReadAccess=RA_ALLOWED, CryptoKeyElementWriteAccess=WA_ALLOWED, CryptoKeyElementInitValue=1 2 3 4 5 6 7 8 9 8 7 6 5 4 3 2
        Crypto_30_LibCv_Signature_Key_Sync: CryptoKeyElementAllowPartialAccess=false, CryptoKeyElementPersist=false, CryptoKeyElementId=1, CryptoKeyElementSize=32, CryptoKeyElementReadAccess=RA_ALLOWED, CryptoKeyElementWriteAccess=WA_ALLOWED
        Crypto_30_LibCv_Cipher_Key_Sync: CryptoKeyElementAllowPartialAccess=false, CryptoKeyElementPersist=false, CryptoKeyElementId=1, CryptoKeyElementSize=16, CryptoKeyElementReadAccess=RA_ALLOWED, CryptoKeyElementWriteAccess=WA_ALLOWED
        Crypto_30_LibCv_Cipher_IV_Sync: CryptoKeyElementAllowPartialAccess=false, CryptoKeyElementPersist=false, CryptoKeyElementId=5, CryptoKeyElementSize=16, CryptoKeyElementReadAccess=RA_ALLOWED, CryptoKeyElementWriteAccess=WA_ALLOWED
        Crypto_30_LibCv_Cipher_Proof_Sync: CryptoKeyElementAllowPartialAccess=false, CryptoKeyElementPersist=false, CryptoKeyElementId=6, CryptoKeyElementSize=48, CryptoKeyElementReadAccess=RA_ALLOWED, CryptoKeyElementWriteAccess=WA_ALLOWED
        Crypto_30_LibCv_Random_Algorithm_Nist_800_90A_DRBG_AES128_Sync: CryptoKeyElementAllowPartialAccess=false, CryptoKeyElementPersist=false, CryptoKeyElementId=4, CryptoKeyElementSize=1, CryptoKeyElementReadAccess=RA_ALLOWED, CryptoKeyElementWriteAccess=WA_ALLOWED
        Crypto_30_LibCv_Random_PrivateString_Sync: CryptoKeyElementAllowPartialAccess=false, CryptoKeyElementPersist=false, CryptoKeyElementId=3015, CryptoKeyElementSize=16, CryptoKeyElementReadAccess=RA_ALLOWED, CryptoKeyElementWriteAccess=WA_ALLOWED
        Crypto_30_LibCv_Random_Reseed_Counter_Sync: CryptoKeyElementAllowPartialAccess=false, CryptoKeyElementPersist=true, CryptoKeyElementId=3018, CryptoKeyElementSize=4, CryptoKeyElementReadAccess=RA_ALLOWED, CryptoKeyElementWriteAccess=WA_DENIED
        Crypto_30_LibCv_Random_Seed_Nist_800_90A_DRBG_AES128_Sync: CryptoKeyElementAllowPartialAccess=false, CryptoKeyElementPersist=true, CryptoKeyElementId=3, CryptoKeyElementSize=32, CryptoKeyElementReadAccess=RA_DENIED, CryptoKeyElementWriteAccess=WA_ALLOWED
        Crypto_30_LibCv_Random_AdditionalInput_Sync: CryptoKeyElementAllowPartialAccess=false, CryptoKeyElementPersist=false, CryptoKeyElementId=3016, CryptoKeyElementSize=16, CryptoKeyElementReadAccess=RA_ALLOWED, CryptoKeyElementWriteAccess=WA_ALLOWED
        Crypto_30_LibCv_vHsm_LazyPersistKey_Sync: CryptoKeyElementAllowPartialAccess=false, CryptoKeyElementPersist=true, CryptoKeyElementId=1, CryptoKeyElementSize=16, CryptoKeyElementReadAccess=RA_ALLOWED, CryptoKeyElementWriteAccess=WA_ALLOWED
        Crypto_30_LibCv_Mac_Key_Sync: CryptoKeyElementAllowPartialAccess=false, CryptoKeyElementPersist=false, CryptoKeyElementId=1, CryptoKeyElementSize=16, CryptoKeyElementReadAccess=RA_ALLOWED, CryptoKeyElementWriteAccess=WA_ALLOWED
        Crypto_30_LibCv_Mac_Proof_Sync: CryptoKeyElementAllowPartialAccess=false, CryptoKeyElementPersist=false, CryptoKeyElementId=2, CryptoKeyElementSize=48, CryptoKeyElementReadAccess=RA_ALLOWED, CryptoKeyElementWriteAccess=WA_ALLOWED
        Crypto_30_LibCv_Mac_Key_She_Sync: CryptoKeyElementAllowPartialAccess=false, CryptoKeyElementPersist=true, CryptoKeyElementId=1, CryptoKeyElementSize=16, CryptoKeyElementReadAccess=RA_DENIED, CryptoKeyElementWriteAccess=WA_ENCRYPTED
        Crypto_30_LibCv_She_Counter_Sync: CryptoKeyElementAllowPartialAccess=false, CryptoKeyElementPersist=false, CryptoKeyElementId=3019, CryptoKeyElementSize=4, CryptoKeyElementReadAccess=RA_ALLOWED, CryptoKeyElementWriteAccess=WA_DENIED
        Crypto_30_LibCv_Cipher_Key_She_Sync: CryptoKeyElementAllowPartialAccess=false, CryptoKeyElementPersist=true, CryptoKeyElementId=1, CryptoKeyElementSize=16, CryptoKeyElementReadAccess=RA_DENIED, CryptoKeyElementWriteAccess=WA_ENCRYPTED
        Crypto_30_LibCv_She_UId_Sync: CryptoKeyElementAllowPartialAccess=false, CryptoKeyElementPersist=false, CryptoKeyElementId=3021, CryptoKeyElementSize=15, CryptoKeyElementReadAccess=RA_ALLOWED, CryptoKeyElementWriteAccess=WA_DENIED
        Crypto_30_LibCv_She_BootProtection_Sync: CryptoKeyElementAllowPartialAccess=false, CryptoKeyElementPersist=false, CryptoKeyElementId=3056, CryptoKeyElementSize=1, CryptoKeyElementReadAccess=RA_ALLOWED, CryptoKeyElementWriteAccess=WA_ALLOWED
        Crypto_30_LibCv_She_DebuggerProtection_Sync: CryptoKeyElementAllowPartialAccess=false, CryptoKeyElementPersist=false, CryptoKeyElementId=3057, CryptoKeyElementSize=1, CryptoKeyElementReadAccess=RA_ALLOWED, CryptoKeyElementWriteAccess=WA_ALLOWED
        vHsm_Core_vHsmInfo_Version_Sync: CryptoKeyElementAllowPartialAccess=false, CryptoKeyElementPersist=false, CryptoKeyElementId=3020, CryptoKeyElementSize=3, CryptoKeyElementReadAccess=RA_ALLOWED, CryptoKeyElementWriteAccess=WA_DENIED
        vHsm_Core_vHsmInfo_PerformPersist_Sync: CryptoKeyElementAllowPartialAccess=false, CryptoKeyElementPersist=false, CryptoKeyElementId=3022, CryptoKeyElementSize=1, CryptoKeyElementReadAccess=RA_ALLOWED, CryptoKeyElementWriteAccess=WA_DENIED
        vHsm_Core_vHsmInfo_PerformRepersist_Sync: CryptoKeyElementAllowPartialAccess=false, CryptoKeyElementPersist=false, CryptoKeyElementId=3036, CryptoKeyElementSize=1, CryptoKeyElementReadAccess=RA_DENIED, CryptoKeyElementWriteAccess=WA_ALLOWED
        vHsm_Core_vHsmInfo_StartFirmwareUpdater_Sync: CryptoKeyElementAllowPartialAccess=false, CryptoKeyElementPersist=false, CryptoKeyElementId=3038, CryptoKeyElementSize=1, CryptoKeyElementReadAccess=RA_DENIED, CryptoKeyElementWriteAccess=WA_ALLOWED
        vHsm_Core_vHsmInfo_SecureBootEnd_Sync: CryptoKeyElementAllowPartialAccess=false, CryptoKeyElementPersist=false, CryptoKeyElementId=3028, CryptoKeyElementSize=1, CryptoKeyElementReadAccess=RA_ALLOWED, CryptoKeyElementWriteAccess=WA_ALLOWED
        vHsm_Core_vHsmInfo_SecureBootResult_Sync: CryptoKeyElementAllowPartialAccess=false, CryptoKeyElementPersist=false, CryptoKeyElementId=3037, CryptoKeyElementSize=1, CryptoKeyElementReadAccess=RA_ALLOWED, CryptoKeyElementWriteAccess=WA_DENIED
        vHsm_Core_vHsmSecureBootInfo_GroupState_Sync: CryptoKeyElementAllowPartialAccess=false, CryptoKeyElementPersist=false, CryptoKeyElementId=0, CryptoKeyElementSize=2, CryptoKeyElementReadAccess=RA_ALLOWED, CryptoKeyElementWriteAccess=WA_DENIED
        Crypto_30_LibCv_KeyM_CertificateData_Sync: CryptoKeyElementAllowPartialAccess=false, CryptoKeyElementPersist=false, CryptoKeyElementId=0, CryptoKeyElementSize=1500, CryptoKeyElementReadAccess=RA_ALLOWED, CryptoKeyElementWriteAccess=WA_ALLOWED
        vHsm_Hal_RomKey_Sync: CryptoKeyElementAllowPartialAccess=false, CryptoKeyElementPersist=false, CryptoKeyElementId=1, CryptoKeyElementSize=16, CryptoKeyElementReadAccess=RA_DENIED, CryptoKeyElementWriteAccess=WA_DENIED, CryptoKeyElementInitValue=0
        Crypto_30_LibCv_vHsm_Info_Uid_Sync: CryptoKeyElementAllowPartialAccess=true, CryptoKeyElementPersist=true, CryptoKeyElementId=3021, CryptoKeyElementSize=16, CryptoKeyElementReadAccess=RA_ALLOWED, CryptoKeyElementWriteAccess=WA_ALLOWED
        Crypto_30_LibCv_vHsm_Info_ErrorLog_Sync: CryptoKeyElementAllowPartialAccess=true, CryptoKeyElementPersist=true, CryptoKeyElementId=3023, CryptoKeyElementSize=32, CryptoKeyElementReadAccess=RA_ALLOWED, CryptoKeyElementWriteAccess=WA_ALLOWED
        Crypto_30_LibCv_vHsm_Info_TestCounterPersisted_Sync: CryptoKeyElementAllowPartialAccess=false, CryptoKeyElementPersist=true, CryptoKeyElementId=5000, CryptoKeyElementSize=1, CryptoKeyElementReadAccess=RA_ALLOWED, CryptoKeyElementWriteAccess=WA_ALLOWED
        Crypto_30_LibCv_vHsm_Info_TestCounterVolatile_Sync: CryptoKeyElementAllowPartialAccess=false, CryptoKeyElementPersist=false, CryptoKeyElementId=5001, CryptoKeyElementSize=1, CryptoKeyElementReadAccess=RA_ALLOWED, CryptoKeyElementWriteAccess=WA_ALLOWED
        vHsm_Hal_CMAC_Sync: CryptoKeyElementAllowPartialAccess=false, CryptoKeyElementPersist=true, CryptoKeyElementId=1, CryptoKeyElementSize=16, CryptoKeyElementReadAccess=RA_ALLOWED, CryptoKeyElementWriteAccess=WA_ALLOWED
        Crypto_30_LibCv_SecOC_CMAC_Sync: CryptoKeyElementAllowPartialAccess=true, CryptoKeyElementPersist=true, CryptoKeyElementId=1, CryptoKeyElementSize=16, CryptoKeyElementReadAccess=RA_ALLOWED, CryptoKeyElementWriteAccess=WA_ALLOWED
        Crypto_30_LibCv_CryptoKey_GetKeyState_Sync: CryptoKeyElementAllowPartialAccess=false, CryptoKeyElementPersist=false, CryptoKeyElementId=3909, CryptoKeyElementSize=1, CryptoKeyElementReadAccess=RA_ALLOWED, CryptoKeyElementWriteAccess=WA_ALLOWED
        Crypto_30_LibCv_CryptoKeyElement_Aes128_Sync: CryptoKeyElementAllowPartialAccess=true, CryptoKeyElementPersist=true, CryptoKeyElementId=1, CryptoKeyElementSize=16, CryptoKeyElementReadAccess=RA_ALLOWED, CryptoKeyElementWriteAccess=WA_ALLOWED
        Crypto_30_LibCv_CryptoKeyElement_Aes128_IV_Sync: CryptoKeyElementAllowPartialAccess=true, CryptoKeyElementPersist=true, CryptoKeyElementId=5, CryptoKeyElementSize=16, CryptoKeyElementReadAccess=RA_ALLOWED, CryptoKeyElementWriteAccess=WA_ALLOWED
        vHsm_Hal_CryptoKey_Random_Sync: CryptoKeyElementAllowPartialAccess=false, CryptoKeyElementPersist=false, CryptoKeyElementId=1, CryptoKeyElementSize=16, CryptoKeyElementReadAccess=RA_ALLOWED, CryptoKeyElementWriteAccess=WA_ALLOWED
        Crypto_30_LibCv_vHsm_SecureBootSegment_APPL_A_Sanction_Sync: CryptoKeyElementAllowPartialAccess=false, CryptoKeyElementPersist=true, CryptoKeyElementId=3027, CryptoKeyElementSize=1, CryptoKeyElementReadAccess=RA_ALLOWED, CryptoKeyElementWriteAccess=WA_ALLOWED
        Crypto_30_LibCv_vHsm_SecureBootSegment_APPL_A_Mode_Sync: CryptoKeyElementAllowPartialAccess=false, CryptoKeyElementPersist=true, CryptoKeyElementId=3039, CryptoKeyElementSize=1, CryptoKeyElementReadAccess=RA_ALLOWED, CryptoKeyElementWriteAccess=WA_ALLOWED
        Crypto_30_LibCv_vHsm_SecureBootSegment_APPL_A_Address_Sync: CryptoKeyElementAllowPartialAccess=false, CryptoKeyElementPersist=true, CryptoKeyElementId=3024, CryptoKeyElementSize=4, CryptoKeyElementReadAccess=RA_ALLOWED, CryptoKeyElementWriteAccess=WA_ALLOWED
        Crypto_30_LibCv_vHsm_SecureBootSegment_APPL_A_Length_Sync: CryptoKeyElementAllowPartialAccess=false, CryptoKeyElementPersist=true, CryptoKeyElementId=3025, CryptoKeyElementSize=4, CryptoKeyElementReadAccess=RA_ALLOWED, CryptoKeyElementWriteAccess=WA_ALLOWED
        Crypto_30_LibCv_vHsm_SecureBootSegment_APPL_A_CMAC_Sync: CryptoKeyElementAllowPartialAccess=true, CryptoKeyElementPersist=true, CryptoKeyElementId=3026, CryptoKeyElementSize=16, CryptoKeyElementReadAccess=RA_ALLOWED, CryptoKeyElementWriteAccess=WA_ALLOWED
        Crypto_30_LibCv_vHsm_SecureBootSegment_APPL_B_Sanction_Sync: CryptoKeyElementAllowPartialAccess=false, CryptoKeyElementPersist=true, CryptoKeyElementId=3027, CryptoKeyElementSize=1, CryptoKeyElementReadAccess=RA_ALLOWED, CryptoKeyElementWriteAccess=WA_ALLOWED
        Crypto_30_LibCv_vHsm_SecureBootSegment_APPL_B_Mode_Sync: CryptoKeyElementAllowPartialAccess=false, CryptoKeyElementPersist=true, CryptoKeyElementId=3039, CryptoKeyElementSize=1, CryptoKeyElementReadAccess=RA_ALLOWED, CryptoKeyElementWriteAccess=WA_ALLOWED
        Crypto_30_LibCv_vHsm_SecureBootSegment_APPL_B_Address_Sync: CryptoKeyElementAllowPartialAccess=false, CryptoKeyElementPersist=true, CryptoKeyElementId=3024, CryptoKeyElementSize=4, CryptoKeyElementReadAccess=RA_ALLOWED, CryptoKeyElementWriteAccess=WA_ALLOWED
        Crypto_30_LibCv_vHsm_SecureBootSegment_APPL_B_Length_Sync: CryptoKeyElementAllowPartialAccess=false, CryptoKeyElementPersist=true, CryptoKeyElementId=3025, CryptoKeyElementSize=4, CryptoKeyElementReadAccess=RA_ALLOWED, CryptoKeyElementWriteAccess=WA_ALLOWED
        Crypto_30_LibCv_vHsm_SecureBootSegment_APPL_B_CMAC_Sync: CryptoKeyElementAllowPartialAccess=true, CryptoKeyElementPersist=true, CryptoKeyElementId=3026, CryptoKeyElementSize=16, CryptoKeyElementReadAccess=RA_ALLOWED, CryptoKeyElementWriteAccess=WA_ALLOWED
        Crypto_30_LibCv_vHsm_SecureBootSegment_APPL_A_Action_Sync: CryptoKeyElementAllowPartialAccess=false, CryptoKeyElementPersist=true, CryptoKeyElementId=3029, CryptoKeyElementSize=1, CryptoKeyElementReadAccess=RA_ALLOWED, CryptoKeyElementWriteAccess=WA_ALLOWED
        Crypto_30_LibCv_vHsm_SecureBootSegment_APPL_B_Action_Sync: CryptoKeyElementAllowPartialAccess=false, CryptoKeyElementPersist=true, CryptoKeyElementId=3029, CryptoKeyElementSize=1, CryptoKeyElementReadAccess=RA_ALLOWED, CryptoKeyElementWriteAccess=WA_ALLOWED
        Crypto_30_LibCv_vHsm_SecureBoot_Section_Active_Sync: CryptoKeyElementAllowPartialAccess=false, CryptoKeyElementPersist=true, CryptoKeyElementId=2, CryptoKeyElementSize=1, CryptoKeyElementReadAccess=RA_ALLOWED, CryptoKeyElementWriteAccess=WA_ALLOWED
        Crypto_30_LibCv_ACrypto_30_LibCv_SIN_Sync: CryptoKeyElementAllowPartialAccess=false, CryptoKeyElementPersist=true, CryptoKeyElementId=1, CryptoKeyElementSize=16, CryptoKeyElementReadAccess=RA_ALLOWED, CryptoKeyElementWriteAccess=WA_ALLOWED
        Crypto_30_LibCv_AACryptoKeyElementVIN_Sync: CryptoKeyElementAllowPartialAccess=false, CryptoKeyElementPersist=true, CryptoKeyElementId=1, CryptoKeyElementSize=17, CryptoKeyElementReadAccess=RA_ALLOWED, CryptoKeyElementWriteAccess=WA_ALLOWED
    CryptoKeys
      33 x CryptoKey, all with CryptoKeyDeriveIterations=1:
        vHsm_SecureBoot_Segment_BM_0: CryptoKeyId=30, CryptoKeyTypeRef=Crypto_30_LibCv_vHsm_SecureBootSegment_KeyType_BM_0
        vHsm_SecureBoot_Segment_APPL_2: CryptoKeyId=29, CryptoKeyTypeRef=Crypto_30_LibCv_vHsm_SecureBootSegment_KeyType_APPL_2
        vHsm_SecureBoot_Segment_APPL_0: CryptoKeyId=27, CryptoKeyTypeRef=Crypto_30_LibCv_vHsm_SecureBootSegment_KeyType_APPL_A
        vHsm_SecureBoot_Segment_APPL_1: CryptoKeyId=28, CryptoKeyTypeRef=Crypto_30_LibCv_vHsm_SecureBootSegment_KeyType_APPL_B
        vHsm_SecureBoot_Group_BM: CryptoKeyId=25, CryptoKeyTypeRef=Crypto_30_LibCv_vHsm_SecureBootGroup
        vHsm_SecureBoot_Group_FBL: CryptoKeyId=26, CryptoKeyTypeRef=Crypto_30_LibCv_vHsm_SecureBootGroup
        vHsm_SecureBoot_Group_APPL: CryptoKeyId=24, CryptoKeyTypeRef=Crypto_30_LibCv_vHsm_SecureBootGroup
        vHsm_SecureBoot_Segment_FBL_0: CryptoKeyId=31, CryptoKeyTypeRef=Crypto_30_LibCv_vHsm_SecureBootSegment_KeyType_FBL_0
        vHsm_Hardware: CryptoKeyId=20, CryptoKeyTypeRef=vHsm_Hal_Hardware
        vHsm_SecureBoot_Signature: CryptoKeyId=32, CryptoKeyTypeRef=Crypto_30_LibCv_Signature
        SymmetricKey: CryptoKeyId=14, CryptoKeyTypeRef=Crypto_30_LibCv_Cipher
        WriteOnceKey: CryptoKeyId=15, CryptoKeyTypeRef=Crypto_30_LibCv_WriteOnceKey
        SecureBootProtectedKey: CryptoKeyId=8, CryptoKeyTypeRef=Crypto_30_LibCv_SecureBootProtectedKey
        vHsm_Custom: CryptoKeyId=16, CryptoKeyTypeRef=Crypto_30_LibCv_Cipher
        vHsm_FirmwareUpdate_Decrypt: CryptoKeyId=17, CryptoKeyTypeRef=Crypto_30_LibCv_Cipher
        vHsm_FirmwareUpdate_Encrypt: CryptoKeyId=18, CryptoKeyTypeRef=Crypto_30_LibCv_Cipher
        vHsm_FirmwareUpdate_Mac: CryptoKeyId=19, CryptoKeyTypeRef=Crypto_30_LibCv_Mac
        She_Key1: CryptoKeyId=10, CryptoKeyTypeRef=Crypto_30_LibCv_MacShe
        She_Key2: CryptoKeyId=11, CryptoKeyTypeRef=Crypto_30_LibCv_CipherShe
        She_MasterEcuKey: CryptoKeyId=12, CryptoKeyTypeRef=Crypto_30_LibCv_MacShe
        She_SecretKey: CryptoKeyId=13, CryptoKeyTypeRef=Crypto_30_LibCv_MacShe
        She_Info: CryptoKeyId=9, CryptoKeyTypeRef=Crypto_30_LibCv_SheInfoKey
        vHsm_Info: CryptoKeyId=21, CryptoKeyTypeRef=Crypto_30_LibCv_vHsm_Info
        vHsm_Info_SecureBoot: CryptoKeyId=22, CryptoKeyTypeRef=vHsm_Core_vHsmSecureBootGroupInfo_Type
        KeyM_Cert_Intermediate: CryptoKeyId=7, CryptoKeyTypeRef=Crypto_30_LibCv_KeyType_KeyM_CertificateData
        vHsm_RomKey0: CryptoKeyId=23, CryptoKeyTypeRef=vHsm_Hal_RomKeyType
        CryIfKey_SecOC_CMAC: CryptoKeyId=4, CryptoKeyTypeRef=Crypto_30_LibCv_Mac
        CryIfKey_vHsm_Hal_CMAC: CryptoKeyId=6, CryptoKeyTypeRef=vHsm_Hal_CMAC
        CryIfKey_vHsm_Aggregated_hsm_hal_cmac: CryptoKeyId=5, CryptoKeyTypeRef=Crypto_30_LibCv_vHsm_SecOC_Cmac
        CryIfKey_Aes128: CryptoKeyId=2, CryptoKeyTypeRef=Crypto_30_LibCv_CryptoKeyType_Aes128
        CryIfKey_Random: CryptoKeyId=3, CryptoKeyTypeRef=vHsm_Hal_Random
        CryIfKey_ASIN: CryptoKeyId=1, CryptoKeyTypeRef=Crypto_30_LibCv_ACryptoKeyType_SIN
        CryIfKey_AACryptoKeyVIN: CryptoKeyId=0, CryptoKeyTypeRef=Crypto_30_LibCv_AACryptoKeyTypeVIN
    CryptoKeyTypes
      31 x CryptoKeyType:
        Crypto_30_LibCv_vHsm_SecureBootSegment_KeyType_BM_0: CryptoKeyElementRef=Crypto_30_LibCv_vHsm_SecureBootSegment_BM_0_Sanction_Sync, CryptoKeyElementRef=Crypto_30_LibCv_vHsm_SecureBootSegment_BM_0_Mode_Sync, CryptoKeyElementRef=Crypto_30_LibCv_vHsm_SecureBootSegment_BM_0_Address_Sync, CryptoKeyElementRef=Crypto_30_LibCv_vHsm_SecureBootSegment_BM_0_Length_Sync, CryptoKeyElementRef=Crypto_30_LibCv_vHsm_SecureBootSegment_BM_0_CMAC_Sync
        Crypto_30_LibCv_vHsm_SecureBootSegment_KeyType_APPL_2: CryptoKeyElementRef=Crypto_30_LibCv_vHsm_SecureBootSegment_APPL_2_Sanction_Sync, CryptoKeyElementRef=Crypto_30_LibCv_vHsm_SecureBootSegment_APPL_2_Mode_Sync, CryptoKeyElementRef=Crypto_30_LibCv_vHsm_SecureBootSegment_APPL_2_Address_Sync, CryptoKeyElementRef=Crypto_30_LibCv_vHsm_SecureBootSegment_APPL_2_Length_Sync, CryptoKeyElementRef=Crypto_30_LibCv_vHsm_SecureBootSegment_APPL_2_CMAC_Sync
        Crypto_30_LibCv_vHsm_SecureBootSegment_KeyType_APPL_0: CryptoKeyElementRef=Crypto_30_LibCv_vHsm_SecureBootSegment_APPL_0_Sanction_Sync, CryptoKeyElementRef=Crypto_30_LibCv_vHsm_SecureBootSegment_APPL_0_Mode_Sync, CryptoKeyElementRef=Crypto_30_LibCv_vHsm_SecureBootSegment_APPL_0_Address_Sync, CryptoKeyElementRef=Crypto_30_LibCv_vHsm_SecureBootSegment_APPL_0_Length_Sync, CryptoKeyElementRef=Crypto_30_LibCv_vHsm_SecureBootSegment_APPL_0_CMAC_Sync
        Crypto_30_LibCv_vHsm_SecureBootSegment_KeyType_APPL_1: CryptoKeyElementRef=Crypto_30_LibCv_vHsm_SecureBootSegment_APPL_1_Sanction_Sync, CryptoKeyElementRef=Crypto_30_LibCv_vHsm_SecureBootSegment_APPL_1_Mode_Sync, CryptoKeyElementRef=Crypto_30_LibCv_vHsm_SecureBootSegment_APPL_1_Address_Sync, CryptoKeyElementRef=Crypto_30_LibCv_vHsm_SecureBootSegment_APPL_1_Length_Sync, CryptoKeyElementRef=Crypto_30_LibCv_vHsm_SecureBootSegment_APPL_1_CMAC_Sync
        Crypto_30_LibCv_vHsm_SecureBootGroup: CryptoKeyElementRef=Crypto_30_LibCv_vHsm_SecureBoot_Key_Sync, CryptoKeyElementRef=Crypto_30_LibCv_vHsm_SecureBoot_Section_Active_Sync
        Crypto_30_LibCv_vHsm_SecureBootSegment_KeyType_FBL_0: CryptoKeyElementRef=Crypto_30_LibCv_vHsm_SecureBootSegment_FBL_0_Sanction_Sync, CryptoKeyElementRef=Crypto_30_LibCv_vHsm_SecureBootSegment_FBL_0_Mode_Sync, CryptoKeyElementRef=Crypto_30_LibCv_vHsm_SecureBootSegment_FBL_0_Address_Sync, CryptoKeyElementRef=Crypto_30_LibCv_vHsm_SecureBootSegment_FBL_0_Length_Sync, CryptoKeyElementRef=Crypto_30_LibCv_vHsm_SecureBootSegment_FBL_0_CMAC_Sync
        vHsm_Hal_Hardware: CryptoKeyElementRef=vHsm_Hal_FlashOperation_Sync
        Crypto_30_LibCv_Signature: CryptoKeyElementRef=Crypto_30_LibCv_Signature_Key_Sync
        Crypto_30_LibCv_Cipher: CryptoKeyElementRef=Crypto_30_LibCv_Cipher_Key_Sync, CryptoKeyElementRef=Crypto_30_LibCv_Cipher_IV_Sync, CryptoKeyElementRef=Crypto_30_LibCv_Cipher_Proof_Sync
        Crypto_30_LibCv_WriteOnceKey: CryptoKeyElementRef=Crypto_30_LibCv_Cipher_Key_Sync
        Crypto_30_LibCv_SecureBootProtectedKey: CryptoKeyElementRef=Crypto_30_LibCv_Cipher_IV_Sync, CryptoKeyElementRef=Crypto_30_LibCv_Cipher_Key_Sync
        Crypto_30_LibCv_Random_Nist_800_90A_DRBG_AES_NoDF: CryptoKeyElementRef=Crypto_30_LibCv_Random_Algorithm_Nist_800_90A_DRBG_AES128_Sync, CryptoKeyElementRef=Crypto_30_LibCv_Random_PrivateString_Sync, CryptoKeyElementRef=Crypto_30_LibCv_Random_Reseed_Counter_Sync, CryptoKeyElementRef=Crypto_30_LibCv_Random_Seed_Nist_800_90A_DRBG_AES128_Sync, CryptoKeyElementRef=Crypto_30_LibCv_Random_AdditionalInput_Sync
        Crypto_30_LibCv_LazyPersistKey: CryptoKeyElementRef=Crypto_30_LibCv_vHsm_LazyPersistKey_Sync
        Crypto_30_LibCv_Mac: CryptoKeyElementRef=Crypto_30_LibCv_Mac_Key_Sync, CryptoKeyElementRef=Crypto_30_LibCv_Mac_Proof_Sync, CryptoKeyElementRef=Crypto_30_LibCv_Cipher_IV_Sync
        Crypto_30_LibCv_MacShe: CryptoKeyElementRef=Crypto_30_LibCv_Mac_Proof_Sync, CryptoKeyElementRef=Crypto_30_LibCv_Mac_Key_She_Sync, CryptoKeyElementRef=Crypto_30_LibCv_She_Counter_Sync
        Crypto_30_LibCv_CipherShe: CryptoKeyElementRef=Crypto_30_LibCv_Cipher_IV_Sync, CryptoKeyElementRef=Crypto_30_LibCv_Cipher_Proof_Sync, CryptoKeyElementRef=Crypto_30_LibCv_Cipher_Key_She_Sync, CryptoKeyElementRef=Crypto_30_LibCv_She_Counter_Sync
        Crypto_30_LibCv_SheInfoKey: CryptoKeyElementRef=Crypto_30_LibCv_She_UId_Sync, CryptoKeyElementRef=Crypto_30_LibCv_She_BootProtection_Sync, CryptoKeyElementRef=Crypto_30_LibCv_She_DebuggerProtection_Sync
        vHsm_Core_vHsmInfo_Type: CryptoKeyElementRef=vHsm_Core_vHsmInfo_Version_Sync, CryptoKeyElementRef=vHsm_Core_vHsmInfo_PerformPersist_Sync, CryptoKeyElementRef=vHsm_Core_vHsmInfo_PerformRepersist_Sync, CryptoKeyElementRef=vHsm_Core_vHsmInfo_StartFirmwareUpdater_Sync, CryptoKeyElementRef=vHsm_Core_vHsmInfo_SecureBootEnd_Sync, CryptoKeyElementRef=vHsm_Core_vHsmInfo_SecureBootResult_Sync
        vHsm_Core_vHsmSecureBootGroupInfo_Type: CryptoKeyElementRef=vHsm_Core_vHsmSecureBootInfo_GroupState_Sync
        Crypto_30_LibCv_KeyType_KeyM_CertificateData: CryptoKeyElementRef=Crypto_30_LibCv_KeyM_CertificateData_Sync
        vHsm_Hal_RomKeyType: CryptoKeyElementRef=vHsm_Hal_RomKey_Sync
        vHsmDummyKeyType: CryptoKeyElementRef=vHsmDummyKeyElement
        Crypto_30_LibCv_vHsm_Info: CryptoKeyElementRef=Crypto_30_LibCv_vHsm_Info_Uid_Sync, CryptoKeyElementRef=Crypto_30_LibCv_vHsm_Info_ErrorLog_Sync, CryptoKeyElementRef=Crypto_30_LibCv_vHsm_Info_TestCounterPersisted_Sync, CryptoKeyElementRef=Crypto_30_LibCv_vHsm_Info_TestCounterVolatile_Sync
        vHsm_Hal_CMAC: CryptoKeyElementRef=vHsm_Hal_CMAC_Sync, CryptoKeyElementRef=vHsm_Hal_FlashOperation_Sync
        Crypto_30_LibCv_vHsm_SecOC_Cmac: CryptoKeyElementRef=Crypto_30_LibCv_SecOC_CMAC_Sync, CryptoKeyElementRef=Crypto_30_LibCv_CryptoKey_GetKeyState_Sync
        Crypto_30_LibCv_CryptoKeyType_Aes128: CryptoKeyElementRef=Crypto_30_LibCv_CryptoKeyElement_Aes128_Sync, CryptoKeyElementRef=Crypto_30_LibCv_CryptoKeyElement_Aes128_IV_Sync
        vHsm_Hal_Random: CryptoKeyElementRef=vHsm_Hal_CryptoKey_Random_Sync
        Crypto_30_LibCv_vHsm_SecureBootSegment_KeyType_APPL_A: CryptoKeyElementRef=Crypto_30_LibCv_vHsm_SecureBootSegment_APPL_A_Sanction_Sync, CryptoKeyElementRef=Crypto_30_LibCv_vHsm_SecureBootSegment_APPL_A_Mode_Sync, CryptoKeyElementRef=Crypto_30_LibCv_vHsm_SecureBootSegment_APPL_A_Address_Sync, CryptoKeyElementRef=Crypto_30_LibCv_vHsm_SecureBootSegment_APPL_A_Length_Sync, CryptoKeyElementRef=Crypto_30_LibCv_vHsm_SecureBootSegment_APPL_A_CMAC_Sync, CryptoKeyElementRef=Crypto_30_LibCv_vHsm_SecureBootSegment_APPL_A_Action_Sync
        Crypto_30_LibCv_vHsm_SecureBootSegment_KeyType_APPL_B: CryptoKeyElementRef=Crypto_30_LibCv_vHsm_SecureBootSegment_APPL_B_Sanction_Sync, CryptoKeyElementRef=Crypto_30_LibCv_vHsm_SecureBootSegment_APPL_B_Mode_Sync, CryptoKeyElementRef=Crypto_30_LibCv_vHsm_SecureBootSegment_APPL_B_Address_Sync, CryptoKeyElementRef=Crypto_30_LibCv_vHsm_SecureBootSegment_APPL_B_Length_Sync, CryptoKeyElementRef=Crypto_30_LibCv_vHsm_SecureBootSegment_APPL_B_CMAC_Sync, CryptoKeyElementRef=Crypto_30_LibCv_vHsm_SecureBootSegment_APPL_B_Action_Sync
        Crypto_30_LibCv_ACryptoKeyType_SIN: CryptoKeyElementRef=Crypto_30_LibCv_ACrypto_30_LibCv_SIN_Sync
        Crypto_30_LibCv_AACryptoKeyTypeVIN: CryptoKeyElementRef=Crypto_30_LibCv_AACryptoKeyElementVIN_Sync
    CryptoDriverObjects
      8 x CryptoDriverObject, all with CryptoDriverObjectQueueSize=1:
        Crypto_30_vHsm_Core: CryptoDriverObjectId=0, CryptoBufferSize=128, CryptoPrimitiveRef=vHsm_Core_vHsmSecureBoot, CryptoPrimitiveRef=vHsm_Core_vHsmFirmwareUpdate, CryptoPrimitiveRef=vHsm_Core_vHsmSecureBootUpdate, CryptoPrimitiveRef=vHsm_Core_vHsmSecureSoftwareDownload
        Crypto_30_vHsm_Hal: CryptoDriverObjectId=1, CryptoBufferSize=128, CryptoPrimitiveRef=vHsm_Hal_Trng, CryptoPrimitiveRef=vHsm_Hal_AesDecrypt, CryptoPrimitiveRef=vHsm_Hal_AesEncrypt, CryptoPrimitiveRef=vHsm_Hal_AesCmacVerify, CryptoPrimitiveRef=vHsm_Hal_AesCmacGenerate, CryptoPrimitiveRef=vHsm_Hal_RSA
        Crypto_30_vHsm_LibCv: CryptoDriverObjectId=6, CryptoBufferSize=128, CryptoPrimitiveRef=Crypto_30_LibCv_SHA256, CryptoPrimitiveRef=Crypto_30_LibCv_AesDecrypt, CryptoPrimitiveRef=Crypto_30_LibCv_AesEncrypt, CryptoPrimitiveRef=Crypto_30_LibCv_AesCmacGenerate, CryptoPrimitiveRef=Crypto_30_LibCv_AesCmacVerify, CryptoPrimitiveRef=Crypto_30_LibCv_RngDrbgAes128
        Crypto_30_vHsm_KeyManagement: CryptoDriverObjectId=5, CryptoBufferSize=128, CryptoPrimitiveRef=vHsmUsageForbidden
        Crypto_30_vHsm_LibCv_HighPrio: CryptoDriverObjectId=7, CryptoBufferSize=128, CryptoPrimitiveRef=Crypto_30_LibCv_SHA256, CryptoPrimitiveRef=Crypto_30_LibCv_AesDecrypt, CryptoPrimitiveRef=Crypto_30_LibCv_AesEncrypt, CryptoPrimitiveRef=Crypto_30_LibCv_AesCmacGenerate, CryptoPrimitiveRef=Crypto_30_LibCv_AesCmacVerify, CryptoPrimitiveRef=Crypto_30_LibCv_RngDrbgAes128
        Crypto_30_vHsm_KeyM: CryptoDriverObjectId=4, CryptoBufferSize=128, CryptoPrimitiveRef=Crypto_30_LibCv_EccNistP256R1VerifySha256, CryptoPrimitiveRef=Crypto_30_LibCv_KeySetValid
        Crypto_30_Hsm_Hal_AesCmacGenerate: CryptoDriverObjectId=2, CryptoBufferSize=512, CryptoPrimitiveRef=vHsm_Hal_AesCmacGenerate
        Crypto_30_Hsm_Hal_AesCmacVerify: CryptoDriverObjectId=3, CryptoBufferSize=512, CryptoPrimitiveRef=vHsm_Hal_AesCmacVerify
    CryptoPrimitives
      19 x CryptoPrimitive:
        vHsm_Core_vHsmSecureBoot: CryptoPrimitiveService=CRYPTO_MAC_VERIFY, CryptoPrimitiveAlgorithmFamily=CRYPTO_ALGOFAM_CUSTOM_VHSM_SECURE_BOOT, CryptoPrimitiveAlgorithmMode=CRYPTO_ALGOMODE_CMAC, CryptoPrimitiveAlgorithmMode=CRYPTO_ALGOMODE_NOT_SET, CryptoPrimitiveAlgorithmMode=CRYPTO_ALGOMODE_CUSTOM, CryptoPrimitiveAlgorithmSecondaryFamily=CRYPTO_ALGOFAM_NOT_SET
        vHsm_Core_vHsmFirmwareUpdate: CryptoPrimitiveService=CRYPTO_AEADENCRYPT, CryptoPrimitiveAlgorithmFamily=CRYPTO_ALGOFAM_CUSTOM_VHSM_FIRMWARE_UPDATE, CryptoPrimitiveAlgorithmMode=CRYPTO_ALGOMODE_GCM, CryptoPrimitiveAlgorithmMode=CRYPTO_ALGOMODE_NOT_SET, CryptoPrimitiveAlgorithmSecondaryFamily=CRYPTO_ALGOFAM_NOT_SET
        vHsm_Core_vHsmSecureBootUpdate: CryptoPrimitiveService=CRYPTO_SIGNATURE_VERIFY, CryptoPrimitiveAlgorithmFamily=CRYPTO_ALGOFAM_CUSTOM, CryptoPrimitiveAlgorithmMode=CRYPTO_ALGOMODE_NOT_SET, CryptoPrimitiveAlgorithmSecondaryFamily=CRYPTO_ALGOFAM_NOT_SET
        vHsm_Core_vHsmSecureSoftwareDownload: CryptoPrimitiveService=CRYPTO_SIGNATURE_VERIFY, CryptoPrimitiveAlgorithmFamily=CRYPTO_ALGOFAM_CUSTOM_VHSM_SOFTWARE_DOWNLOAD, CryptoPrimitiveAlgorithmMode=CRYPTO_ALGOMODE_NOT_SET, CryptoPrimitiveAlgorithmSecondaryFamily=CRYPTO_ALGOFAM_NOT_SET
        vHsm_Hal_Trng: CryptoPrimitiveService=CRYPTO_RANDOM, CryptoPrimitiveAlgorithmFamily=CRYPTO_ALGOFAM_RNG, CryptoPrimitiveAlgorithmMode=CRYPTO_ALGOMODE_NOT_SET, CryptoPrimitiveAlgorithmSecondaryFamily=CRYPTO_ALGOFAM_NOT_SET
        vHsm_Hal_AesDecrypt: CryptoPrimitiveService=CRYPTO_DECRYPT, CryptoPrimitiveAlgorithmFamily=CRYPTO_ALGOFAM_AES, CryptoPrimitiveAlgorithmMode=CRYPTO_ALGOMODE_ECB, CryptoPrimitiveAlgorithmMode=CRYPTO_ALGOMODE_CBC, CryptoPrimitiveAlgorithmMode=CRYPTO_ALGOMODE_CTR, CryptoPrimitiveAlgorithmSecondaryFamily=CRYPTO_ALGOFAM_NOT_SET, CryptoPrimitiveAlgorithmSecondaryFamily=CRYPTO_ALGOFAM_CUSTOM_PADDING_PKCS7
        vHsm_Hal_AesEncrypt: CryptoPrimitiveService=CRYPTO_ENCRYPT, CryptoPrimitiveAlgorithmFamily=CRYPTO_ALGOFAM_AES, CryptoPrimitiveAlgorithmMode=CRYPTO_ALGOMODE_ECB, CryptoPrimitiveAlgorithmMode=CRYPTO_ALGOMODE_CBC, CryptoPrimitiveAlgorithmMode=CRYPTO_ALGOMODE_CTR, CryptoPrimitiveAlgorithmSecondaryFamily=CRYPTO_ALGOFAM_NOT_SET, CryptoPrimitiveAlgorithmSecondaryFamily=CRYPTO_ALGOFAM_CUSTOM_PADDING_PKCS7
        vHsm_Hal_AesCmacVerify: CryptoPrimitiveService=CRYPTO_MAC_VERIFY, CryptoPrimitiveAlgorithmFamily=CRYPTO_ALGOFAM_AES, CryptoPrimitiveAlgorithmMode=CRYPTO_ALGOMODE_CMAC, CryptoPrimitiveAlgorithmSecondaryFamily=CRYPTO_ALGOFAM_NOT_SET
        vHsm_Hal_AesCmacGenerate: CryptoPrimitiveService=CRYPTO_MAC_GENERATE, CryptoPrimitiveAlgorithmFamily=CRYPTO_ALGOFAM_AES, CryptoPrimitiveAlgorithmMode=CRYPTO_ALGOMODE_CMAC, CryptoPrimitiveAlgorithmSecondaryFamily=CRYPTO_ALGOFAM_NOT_SET
        vHsm_Hal_RSA: CryptoPrimitiveService=CRYPTO_DECRYPT, CryptoPrimitiveAlgorithmFamily=CRYPTO_ALGOFAM_RSA, CryptoPrimitiveAlgorithmMode=CRYPTO_ALGOMODE_NOT_SET, CryptoPrimitiveAlgorithmSecondaryFamily=CRYPTO_ALGOFAM_RSA
        Crypto_30_LibCv_SHA256: CryptoPrimitiveService=CRYPTO_HASH, CryptoPrimitiveAlgorithmFamily=CRYPTO_ALGOFAM_SHA2_256, CryptoPrimitiveAlgorithmMode=CRYPTO_ALGOMODE_NOT_SET, CryptoPrimitiveAlgorithmSecondaryFamily=CRYPTO_ALGOFAM_NOT_SET
        Crypto_30_LibCv_AesDecrypt: CryptoPrimitiveService=CRYPTO_DECRYPT, CryptoPrimitiveAlgorithmFamily=CRYPTO_ALGOFAM_AES, CryptoPrimitiveAlgorithmMode=CRYPTO_ALGOMODE_ECB, CryptoPrimitiveAlgorithmMode=CRYPTO_ALGOMODE_CBC, CryptoPrimitiveAlgorithmSecondaryFamily=CRYPTO_ALGOFAM_NOT_SET, CryptoPrimitiveAlgorithmSecondaryFamily=CRYPTO_ALGOFAM_CUSTOM_PADDING_PKCS7, CryptoPrimitiveAlgorithmSecondaryFamily=CRYPTO_ALGOFAM_CUSTOM
        Crypto_30_LibCv_AesEncrypt: CryptoPrimitiveService=CRYPTO_ENCRYPT, CryptoPrimitiveAlgorithmFamily=CRYPTO_ALGOFAM_AES, CryptoPrimitiveAlgorithmMode=CRYPTO_ALGOMODE_ECB, CryptoPrimitiveAlgorithmMode=CRYPTO_ALGOMODE_CBC, CryptoPrimitiveAlgorithmSecondaryFamily=CRYPTO_ALGOFAM_NOT_SET, CryptoPrimitiveAlgorithmSecondaryFamily=CRYPTO_ALGOFAM_CUSTOM_PADDING_PKCS7, CryptoPrimitiveAlgorithmSecondaryFamily=CRYPTO_ALGOFAM_CUSTOM
        Crypto_30_LibCv_AesCmacGenerate: CryptoPrimitiveService=CRYPTO_MAC_GENERATE, CryptoPrimitiveAlgorithmFamily=CRYPTO_ALGOFAM_AES, CryptoPrimitiveAlgorithmMode=CRYPTO_ALGOMODE_CMAC, CryptoPrimitiveAlgorithmSecondaryFamily=CRYPTO_ALGOFAM_NOT_SET
        Crypto_30_LibCv_AesCmacVerify: CryptoPrimitiveService=CRYPTO_MAC_VERIFY, CryptoPrimitiveAlgorithmFamily=CRYPTO_ALGOFAM_AES, CryptoPrimitiveAlgorithmMode=CRYPTO_ALGOMODE_CMAC, CryptoPrimitiveAlgorithmSecondaryFamily=CRYPTO_ALGOFAM_NOT_SET
        Crypto_30_LibCv_RngDrbgAes128: CryptoPrimitiveService=CRYPTO_RANDOM, CryptoPrimitiveAlgorithmFamily=CRYPTO_ALGOFAM_CUSTOM_DRBG, CryptoPrimitiveAlgorithmMode=CRYPTO_ALGOMODE_NOT_SET, CryptoPrimitiveAlgorithmSecondaryFamily=CRYPTO_ALGOFAM_AES
        Crypto_30_LibCv_EccNistP256R1VerifySha256: CryptoPrimitiveService=CRYPTO_SIGNATURE_VERIFY, CryptoPrimitiveAlgorithmFamily=CRYPTO_ALGOFAM_ECCNIST, CryptoPrimitiveAlgorithmMode=CRYPTO_ALGOMODE_CUSTOM_P256R1, CryptoPrimitiveAlgorithmSecondaryFamily=CRYPTO_ALGOFAM_SHA2_256
        Crypto_30_LibCv_KeySetValid: CryptoPrimitiveService=CRYPTO_KEY_SET_VALID, CryptoPrimitiveAlgorithmFamily=CRYPTO_ALGOFAM_NOT_SET, CryptoPrimitiveAlgorithmMode=CRYPTO_ALGOMODE_NOT_SET, CryptoPrimitiveAlgorithmSecondaryFamily=CRYPTO_ALGOFAM_NOT_SET
        vHsmUsageForbidden: CryptoPrimitiveService=CRYPTO_RANDOM, CryptoPrimitiveAlgorithmFamily=CRYPTO_ALGOFAM_NOT_SET, CryptoPrimitiveAlgorithmMode=CRYPTO_ALGOMODE_NOT_SET, CryptoPrimitiveAlgorithmSecondaryFamily=CRYPTO_ALGOFAM_NOT_SET
    CryptovHsm:
      CryptoIpcChannels = 2
      CryptoIpcProtocolVersion = 2
      CryptoKeyElementDeleteSupport = true
      CryptoInterruptMode = true
      CryptoRedirection = false
      CryptoIpcMacJobOptimization = true
      CryptoDetInstanceMask = 0
      CryptoKeyDeriveJobSupport = true
      CryptoHost2HsmAddress = 4280221716
      CryptoHsm2HostAddress = 4280221712
      CryptoIpcInstanceId = 0
      CryptoIpcInitialization = true
      CryptoManagementDriverObject = Crypto_30_vHsm_KeyManagement
      CryptoJobRequestInterrupt: CryptoJobRequestInterruptFlagSetAddress=4280221764, CryptoJobRequestInterruptFlagSetMask=1, CryptoJobRequestInterruptFlagSetting=false
      CryptoJobResponseInterrupt:
        CryptoJobResponseInterruptFlagClearAddress = 4280221784
        CryptoJobResponseInterruptFlagClearMask = 1
        CryptoJobResponseInterruptFlagClearValue = 1
        CryptoJobResponseInterruptFlagClearing = true
      3 x CryptoMemoryArea, all with CryptoAreaPriority=0, CryptoAreaEnabled=true:
        RH850_GlobalRamB: CryptoAreaStart=4278091776, CryptoAreaStop=4278190079, CryptoAreaType=CRYPTO_AREA_HSM_READ_ACCESS
        RH850_GlobalRamA: CryptoAreaStart=4277043200, CryptoAreaStop=4277141503, CryptoAreaType=CRYPTO_AREA_HSM_READWRITE_ACCESS
        RH850_CodeFlash: CryptoAreaStart=0, CryptoAreaStop=4194303, CryptoAreaType=CRYPTO_AREA_HSM_READ_ACCESS
