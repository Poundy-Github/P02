AUTOSAR XML (schema 00046)
package /ActiveEcuC
  module config Adc: implementation-config-variant=VARIANT-POST-BUILD, module-description=Adc_Impl
    AdcPublished0 (AdcPublishedInformation): AdcChannelValueSigned=false, AdcGroupFirstChannelFixed=false, AdcMaxChannelResolution=12, AdcDmaTypeUsed=ADC_DMA_TYPE_TWO
    AdcDemEventParameterRefs0 (AdcDemEventParameterRefs)
    AdcGeneral:
      AdcVersionCheckExternalModules = false
      AdcDeInitApi = true
      AdcDevErrorDetect = false
      AdcDemErrorDetect = false
      AdcEnableLimitCheck = false
      AdcEnableTrackHold = true
      AdcEnableQueuing = false
      AdcEnableStartStopGroupApi = true
      AdcGrpNotifCapability = true
      AdcHwTriggerApi = true
      AdcPriorityImplementation = ADC_PRIORITY_NONE
      AdcReadGroupApi = true
      AdcGetStreamLastPointerApi = false
      AdcDmaMode = false
      AdcCriticalSectionProtection = true
      AdcResultAlignment = ADC_ALIGN_RIGHT
      AdcDeviceName = R7F701651
      AdcVersionInfoApi = false
      AdcSoftStop = false
      AdcPwmDiagnosticSupport = false
      AdcPwmDiagDoubleBuff = false
      AdcExternalMuxSupport = false
      AdcEnableDisableChSupport = false
      AdcAlreadyInitDetCheck = false
      AdcEnableBufferAllocation = false
      AdcHwUnitVirtualChannel = ADC_50_36
      AdcEnableStreaming = false
      AdcFunctionalityMode = ADC_POLLING_INTERRUPT_MODE
      AdcFlexibleThreshold = false
      AdcPwsaQueFullIrqCallback = Adc_FullIrqCallback
      AdcEnableSelfDiag = false
      AdcWakeUpFactorClearIsr = false
      AdcAdcaWriteVerify = WV_DISABLE
      AdcPwmDiagWriteVerify = WV_DISABLE
      AdcDmacWriteVerify = WV_DISABLE
      AdcWufWriteVerify = WV_DISABLE
      AdcAdcaRAMMirror = DISABLE
      AdcPwmDiagRAMMirror = DISABLE
      AdcDmacRAMMirror = DISABLE
      AdcUseWriteVerifyErrorInterface = false
      AdcWriteVerifyErrorInterface = 
      AdcLoopTimeOut = 65535
      AdcEnableClkImmediateValue = false
      AdcSelfDiagDelayClkSrc = McuClockSettingConfig
    AdcConfigSet0 (AdcConfigSet)
      AdcHwUnit0 (AdcHwUnit):
        AdcClockSource = NOT_USED
        AdcHwUnitId = ADC_HWUNIT_0
        AdcPrescale = 0
        AdcHwUnitResolution = ADC_12_BIT
        AdcSamplingTime = ADC_SAMPLING_12H
        AdcSuspendMode = ADC_SYNCHRONOUS_SUSPEND
        AdcMaxNoOfDiagRunTime = 1
        AdcPwmDiagProtLength = 0
        AdcEnableOverWriteInterrupt = false
        AdcEnableLimitCheckInterrupt = false
        AdcErrorNotification = NULL
        AdcHwScanGroup0 (AdcHwScanGroup): AdcSgQueueSize=1, AdcSgProcessingMode=ADC_INTERRUPT_MODE, AdcSgId=1, AdcSgDmaChannel=DMA04, AdcSgDmaChannel2=DMA05
        AdcGroup0 (AdcGroup):
          AdcGroupAccessMode = ADC_ACCESS_MODE_SINGLE
          AdcGroupConversionMode = ADC_CONV_MODE_ONESHOT
          AdcGroupId = 0
          AdcScanGroup = 1
          AdcGroupPriority = 13
          AdcGroupReplacement = ADC_GROUP_REPL_ABORT_RESTART
          AdcGroupTriggSrc = ADC_TRIGG_SRC_SW
          AdcHwTrigSignal = ADC_HW_TRIG_BOTH_EDGES
          AdcHwTrigTimer = 0
          AdcNotification = IoHwAb_Adc_Notification_Group0
          AdcStreamingBufferMode = ADC_STREAM_BUFFER_CIRCULAR
          AdcStreamingNumSamples = 1
          AdcResultAccessMode = ADC_ISR_ACCESS
          AdcPwmDiagnosticGroup = false
          AdcSelfDiagMode = ADC_SELF_DIAG_OFF
          AdcSelfDiagVolLevSel = SEL0
          AdcGroupDefinition = AdcChannel00_VBATT_VIP_DET_ADC
          AdcGroupDefinition = AdcChannel01_VIP_A1VREF_IAN
          AdcGroupDefinition = AdcChannel02_VIP_VREF_Fuel_IAN
          AdcGroupDefinition = AdcChannel03_VIP_Fuellevel1_IAN
          AdcGroupDefinition = AdcChannel04_VIP_Fuellevel2_IAN
          AdcGroupDefinition = AdcChannel05_VIP_Version_MON1_IAN
          AdcGroupDefinition = AdcChannel06_VIP_Version_MON2_IAN
          AdcGroupDefinition = AdcChannel07_VIP_BC_IAN
          AdcGroupDefinition = AdcChannel08_VIP_ANT1_P_Diag
          AdcGroupDefinition = AdcChannel09_VIP_ANT2_P_Diag
          AdcGroupDefinition = AdcChannel10_GPSANTpwer_VIP_Adsense
          AdcGroupDefinition = AdcChannel11_VIP_TPS7B7701_IAN
          AdcGroupDefinition = AdcChannel12_VIP_NTC_MON2_IAN
          AdcGroupDefinition = AdcChannel13_VIP_NTC_MON3_IAN
          AdcGroupDefinition = AdcChannel14_MICpwr_VIP_Adsense
          AdcGroupDefinition = AdcChannel15_VIP_NTC_MON1_IAN
        16 x AdcChannel, all with AdcChannelConvTime=0, AdcChannelHighLimit=4095, AdcChannelLimitCheck=false, AdcChannelLowLimit=0, AdcChannelRangeSelect=ADC_RANGE_ALWAYS, AdcChannelRefVoltsrcHigh=NOT_USED, AdcChannelRefVoltsrcLow=NOT_USED, AdcChannelResolution=12, AdcChannelSampTime=0, AdcChannelTrackHold=ADC_TH_DISABLED, AdcEnablePullDown=false, AdcExtMuxDelayCounter=0, AdcSelectDiagCh=false, AdcSelfDiagChSel=false:
          AdcChannel00_VBATT_VIP_DET_ADC: AdcChannelId=0
          AdcChannel01_VIP_A1VREF_IAN: AdcChannelId=1
          AdcChannel02_VIP_VREF_Fuel_IAN: AdcChannelId=2
          AdcChannel03_VIP_Fuellevel1_IAN: AdcChannelId=3
          AdcChannel04_VIP_Fuellevel2_IAN: AdcChannelId=4
          AdcChannel05_VIP_Version_MON1_IAN: AdcChannelId=5
          AdcChannel06_VIP_Version_MON2_IAN: AdcChannelId=6
          AdcChannel07_VIP_BC_IAN: AdcChannelId=7
          AdcChannel08_VIP_ANT1_P_Diag: AdcChannelId=8
          AdcChannel09_VIP_ANT2_P_Diag: AdcChannelId=9
          AdcChannel10_GPSANTpwer_VIP_Adsense: AdcChannelId=10
          AdcChannel11_VIP_TPS7B7701_IAN: AdcChannelId=11
          AdcChannel12_VIP_NTC_MON2_IAN: AdcChannelId=12
          AdcChannel13_VIP_NTC_MON3_IAN: AdcChannelId=13
          AdcChannel14_MICpwr_VIP_Adsense: AdcChannelId=14
          AdcChannel15_VIP_NTC_MON1_IAN: AdcChannelId=15
      AdcHwUnit1 (AdcHwUnit):
        AdcHwUnitId = ADC_HWUNIT_1
        AdcHwUnitResolution = ADC_12_BIT
        AdcSamplingTime = ADC_SAMPLING_12H
        AdcClockSource = NOT_USED
        AdcEnableLimitCheckInterrupt = false
        AdcEnableOverWriteInterrupt = false
        AdcErrorNotification = NULL
        AdcMaxNoOfDiagRunTime = 1
        AdcPrescale = 0
        AdcPwmDiagProtLength = 0
        AdcSuspendMode = ADC_SYNCHRONOUS_SUSPEND
        AdcGroup1 (AdcGroup):
          AdcGroupAccessMode = ADC_ACCESS_MODE_SINGLE
          AdcGroupConversionMode = ADC_CONV_MODE_ONESHOT
          AdcGroupId = 1
          AdcGroupTriggSrc = ADC_TRIGG_SRC_SW
          AdcStreamingBufferMode = ADC_STREAM_BUFFER_CIRCULAR
          AdcStreamingNumSamples = 1
          AdcResultAccessMode = ADC_ISR_ACCESS
          AdcScanGroup = 1
          AdcGroupPriority = 13
          AdcGroupReplacement = ADC_GROUP_REPL_ABORT_RESTART
          AdcHwTrigSignal = ADC_HW_TRIG_BOTH_EDGES
          AdcHwTrigTimer = 0
          AdcPwmDiagnosticGroup = false
          AdcSelfDiagMode = ADC_SELF_DIAG_OFF
          AdcSelfDiagVolLevSel = SEL0
          AdcNotification = IoHwAb_Adc_Notification_Group1
          AdcGroupDefinition = AdcChannel00_MIC_VIP_SENS1
          AdcGroupDefinition = AdcChannel01_MIC_VIP_SENS2
          AdcGroupDefinition = AdcChannel02_MIC_VIP_SENS1_N
          AdcGroupDefinition = AdcChannel03_MIC_VIP_SENS2_N
        AdcHwScanGroup1 (AdcHwScanGroup): AdcSgId=1, AdcSgProcessingMode=ADC_INTERRUPT_MODE, AdcSgDmaChannel=DMA00, AdcSgDmaChannel2=DMA00, AdcSgQueueSize=1
        4 x AdcChannel, all with AdcChannelConvTime=0, AdcChannelHighLimit=4095, AdcChannelLimitCheck=false, AdcEnablePullDown=false, AdcSelectDiagCh=false, AdcSelfDiagChSel=false, AdcChannelLowLimit=0, AdcChannelRangeSelect=ADC_RANGE_ALWAYS, AdcChannelRefVoltsrcHigh=NOT_USED, AdcChannelRefVoltsrcLow=NOT_USED, AdcChannelResolution=12, AdcChannelSampTime=0, AdcChannelTrackHold=ADC_TH_DISABLED, AdcExtMuxDelayCounter=0:
          AdcChannel00_MIC_VIP_SENS1: AdcChannelId=0
          AdcChannel01_MIC_VIP_SENS2: AdcChannelId=1
          AdcChannel02_MIC_VIP_SENS1_N: AdcChannelId=2
          AdcChannel03_MIC_VIP_SENS2_N: AdcChannelId=3
