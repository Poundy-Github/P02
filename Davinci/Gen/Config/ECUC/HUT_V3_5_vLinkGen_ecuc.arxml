AUTOSAR XML (schema 00046)
package /ActiveEcuC
  module config vLinkGen: implementation-config-variant=VARIANT-PRE-COMPILE, module-description=vLinkGen_Impl
    vLinkGenMemLayout
      CODE_FLASH (vLinkGenMemoryRegion): vLinkGenMemoryRegionAddrOffset=0, vLinkGenMemoryRegionSize=4194304, vLinkGenMemoryRegionAddress=0, vLinkGenMemoryRegionHwRegion=CodeFlash
        3 x vLinkGenMemoryRegionBlock, all with vLinkGenMemoryRegionBlockInitStage=NONE:
          BCODE0: vLinkGenMemoryRegionBlockSize=128, vLinkGenMemoryRegionBlockPosition=0, vLinkGenMemoryRegionBlockAddress=0, vLinkGenMemoryRegionBlockBoundary=LOWER
          CODE_FLASH_0: vLinkGenMemoryRegionBlockPosition=1, vLinkGenMemoryRegionBlockSize=3866496, vLinkGenMemoryRegionBlockAddress=128, vLinkGenMemoryRegionBlockBoundary=LOWER
          SECURE_ICU_CODE_FLASH_0: vLinkGenMemoryRegionBlockPosition=0, vLinkGenMemoryRegionBlockSize=327680, vLinkGenMemoryRegionBlockBoundary=UPPER, vLinkGenMemoryRegionBlockAddress=3866624
      LOCAL_RAM (vLinkGenMemoryRegion): vLinkGenMemoryRegionAddrOffset=0, vLinkGenMemoryRegionSize=262144, vLinkGenMemoryRegionAddress=4273733632, vLinkGenMemoryRegionHwRegion=LocalRAM
        LOCAL_RAM_0 (vLinkGenMemoryRegionBlock):
          vLinkGenMemoryRegionBlockInitCore = 0
          vLinkGenMemoryRegionBlockInitStage = HARD_RESET_ONLY
          vLinkGenMemoryRegionBlockPosition = 0
          vLinkGenMemoryRegionBlockSize = 262144
          vLinkGenMemoryRegionBlockAddress = 4273733632
          vLinkGenMemoryRegionBlockBoundary = LOWER
      Startup_Stakk_c0 (vLinkGenLogicalSymbolGroup): vLinkGenSymbolGroupPosition=0
        Startup_Stack_c0 (vLinkGenLinkerSymbol): vLinkGenLinkerSymbolName=__section_stack_c0_end, vLinkGenLinkerSymbolValue=_STACK_C0_LIMIT, vLinkGenLinkerSymbolPosition=0
      Startup_Labels (vLinkGenLogicalSymbolGroup): vLinkGenSymbolGroupPosition=0
        Startup_Labels1 (vLinkGenLinkerSymbol): vLinkGenLinkerSymbolName=_RESET, vLinkGenLinkerSymbolValue=brsStartupEntry, vLinkGenLinkerSymbolPosition=0
        Startup_Labels2 (vLinkGenLinkerSymbol): vLinkGenLinkerSymbolName=_RESET_CORE0, vLinkGenLinkerSymbolValue=brsStartupEntry, vLinkGenLinkerSymbolPosition=0
      vLinkGenLinkerSections
        brsStartup (vLinkGenLinkerCodeSection): vLinkGenLinkerCodeSectionName=brsStartup, vLinkGenLinkerCodeSectionFast=true
        bcode0 (vLinkGenLinkerCodeSection): vLinkGenLinkerCodeSectionName=bcode0, vLinkGenLinkerCodeSectionFast=true
        28 x vLinkGenLinkerSpecSection, all with vLinkGenLinkerSpecSectionPad=0:
          text: vLinkGenLinkerSpecSectionValue=.text
          vletext: vLinkGenLinkerSpecSectionValue=.vletext
          secinfo: vLinkGenLinkerSpecSectionValue=.secinfo
          syscall: vLinkGenLinkerSpecSectionValue=.syscall
          fixaddr: vLinkGenLinkerSpecSectionValue=.fixaddr
          fixtype: vLinkGenLinkerSpecSectionValue=.fixtype
          picbase: vLinkGenLinkerSpecSectionValue=.picbase
          pidbase: vLinkGenLinkerSpecSectionValue=.pidbase
          rodata: vLinkGenLinkerSpecSectionValue=.rodata
          rosdata: vLinkGenLinkerSpecSectionValue=.rosdata
          ldata: vLinkGenLinkerSpecSectionValue=.ldata
          sdata2: vLinkGenLinkerSpecSectionValue=.sdata2
          rozdata: vLinkGenLinkerSpecSectionValue=.rozdata
          zrodata: vLinkGenLinkerSpecSectionValue=.zrodata
          data: vLinkGenLinkerSpecSectionValue=.data
          sdabase: vLinkGenLinkerSpecSectionValue=.sdabase
          sdata: vLinkGenLinkerSpecSectionValue=.sdata
          tdata: vLinkGenLinkerSpecSectionValue=.tdata
          zdata: vLinkGenLinkerSpecSectionValue=.zdata
          PPC_EMB_SDATA0: vLinkGenLinkerSpecSectionValue=.PPC.EMB.sdata0
          bss: vLinkGenLinkerSpecSectionValue=.bss
          COMMON: vLinkGenLinkerSpecSectionValue=COMMON
          sbss: vLinkGenLinkerSpecSectionValue=.sbss
          SMALLCOMMON: vLinkGenLinkerSpecSectionValue=SMALLCOMMON
          zbss: vLinkGenLinkerSpecSectionValue=.zbss
          PPC_EMB_SBSS0: vLinkGenLinkerSpecSectionValue=.PPC.EMB.sbss0
          ZEROCOMMON: vLinkGenLinkerSpecSectionValue=ZEROCOMMON
          stack: vLinkGenLinkerSpecSectionValue=.stack
        6 x vLinkGenLinkerCodeSection, all with vLinkGenLinkerCodeSectionFast=false, vLinkGenLinkerCodeSectionModule=Os:
          OS_CODE: vLinkGenLinkerCodeSectionName=OS_CODE
          OS_OS_COREINITHOOK_CODE: vLinkGenLinkerCodeSectionName=OS_OS_COREINITHOOK_CODE
          OS_INTVEC_CODE: vLinkGenLinkerCodeSectionName=OS_INTVEC_CODE, vLinkGenLinkerCodeSectionAlignment=512
          OS_EXCVEC_CORE0_CODE: vLinkGenLinkerCodeSectionName=OS_EXCVEC_CORE0_CODE, vLinkGenLinkerCodeSectionAlignment=512
          OS_INTVEC_CORE0_CODE: vLinkGenLinkerCodeSectionName=OS_INTVEC_CORE0_CODE, vLinkGenLinkerCodeSectionAlignment=512
          OS_ERRORHOOK_CODE: vLinkGenLinkerCodeSectionName=OS_ERRORHOOK_CODE
        13 x vLinkGenLinkerConstSection, all with vLinkGenLinkerConstSectionModule=Os:
          OS_CONST: vLinkGenLinkerConstSectionName=OS_CONST, vLinkGenLinkerConstSectionFast=false
          OS_CONST_FAST: vLinkGenLinkerConstSectionName=OS_CONST_FAST, vLinkGenLinkerConstSectionFast=true
          OS_INTVEC_CONST: vLinkGenLinkerConstSectionName=OS_INTVEC_CONST, vLinkGenLinkerConstSectionFast=false
          OS_GLOBALSHARED_CONST: vLinkGenLinkerConstSectionName=OS_GLOBALSHARED_CONST, vLinkGenLinkerConstSectionFast=false
          OS_GLOBALSHARED_CONST_FAST: vLinkGenLinkerConstSectionName=OS_GLOBALSHARED_CONST_FAST, vLinkGenLinkerConstSectionFast=true
          OS_CORE0_CONST: vLinkGenLinkerConstSectionName=OS_CORE0_CONST, vLinkGenLinkerConstSectionFast=false
          OS_CORE0_CONST_FAST: vLinkGenLinkerConstSectionName=OS_CORE0_CONST_FAST, vLinkGenLinkerConstSectionFast=true
          OS_EXCVEC_CORE0_CONST: vLinkGenLinkerConstSectionName=OS_EXCVEC_CORE0_CONST, vLinkGenLinkerConstSectionFast=false, vLinkGenLinkerConstSectionAlignment=512
          OS_INTVEC_CORE0_CONST: vLinkGenLinkerConstSectionName=OS_INTVEC_CORE0_CONST, vLinkGenLinkerConstSectionFast=false, vLinkGenLinkerConstSectionAlignment=512
          OS_SystemApplication_OsCore0_CONST: vLinkGenLinkerConstSectionName=OS_SystemApplication_OsCore0_CONST, vLinkGenLinkerConstSectionFast=false
          OS_SystemApplication_OsCore0_CONST_FAST: vLinkGenLinkerConstSectionName=OS_SystemApplication_OsCore0_CONST_FAST, vLinkGenLinkerConstSectionFast=true
          OS_OsApplication_NonTrust_OsCore0_CONST: vLinkGenLinkerConstSectionName=OS_OsApplication_NonTrust_OsCore0_CONST, vLinkGenLinkerConstSectionFast=false
          OS_OsApplication_NonTrust_OsCore0_CONST_FAST: vLinkGenLinkerConstSectionName=OS_OsApplication_NonTrust_OsCore0_CONST_FAST, vLinkGenLinkerConstSectionFast=true
        5 x vLinkGenLinkerStackSection, all with vLinkGenLinkerStackSectionAlignment=4, vLinkGenLinkerStackSectionModule=Os:
          OS_STACK_OSCORE0_ERROR_VAR_NOINIT: vLinkGenLinkerStackSectionName=OS_STACK_OSCORE0_ERROR_VAR_NOINIT
          OS_STACK_OSCORE0_INIT_VAR_NOINIT: vLinkGenLinkerStackSectionName=OS_STACK_OSCORE0_INIT_VAR_NOINIT
          OS_STACK_OSCORE0_KERNEL_VAR_NOINIT: vLinkGenLinkerStackSectionName=OS_STACK_OSCORE0_KERNEL_VAR_NOINIT
          OS_STACK_OSCORE0_TASK_PRIO4294967295_VAR_NOINIT: vLinkGenLinkerStackSectionName=OS_STACK_OSCORE0_TASK_PRIO4294967295_VAR_NOINIT
          OS_STACK_OSCORE0_ISR_CORE_VAR_NOINIT: vLinkGenLinkerStackSectionName=OS_STACK_OSCORE0_ISR_CORE_VAR_NOINIT
        54 x vLinkGenLinkerVarSection, all with vLinkGenLinkerVarSectionModule=Os:
          OS_VAR_NOCACHE: vLinkGenLinkerVarSectionName=OS_VAR_NOCACHE, vLinkGenLinkerVarSectionFast=false
          OS_VAR_NOCACHE_NOINIT: vLinkGenLinkerVarSectionName=OS_VAR_NOCACHE_NOINIT, vLinkGenLinkerVarSectionFast=false
          OS_VAR_FAST_NOCACHE: vLinkGenLinkerVarSectionName=OS_VAR_FAST_NOCACHE, vLinkGenLinkerVarSectionFast=true
          OS_VAR_FAST_NOCACHE_NOINIT: vLinkGenLinkerVarSectionName=OS_VAR_FAST_NOCACHE_NOINIT, vLinkGenLinkerVarSectionFast=true
          OS_GLOBALSHARED_VAR_NOINIT: vLinkGenLinkerVarSectionName=OS_GLOBALSHARED_VAR_NOINIT, vLinkGenLinkerVarSectionFast=false
          OS_GLOBALSHARED_VAR: vLinkGenLinkerVarSectionName=OS_GLOBALSHARED_VAR, vLinkGenLinkerVarSectionFast=false
          OS_GLOBALSHARED_VAR_ZERO_INIT: vLinkGenLinkerVarSectionName=OS_GLOBALSHARED_VAR_ZERO_INIT, vLinkGenLinkerVarSectionFast=false
          OS_GLOBALSHARED_VAR_NOCACHE_NOINIT: vLinkGenLinkerVarSectionName=OS_GLOBALSHARED_VAR_NOCACHE_NOINIT, vLinkGenLinkerVarSectionFast=false
          OS_GLOBALSHARED_VAR_NOCACHE: vLinkGenLinkerVarSectionName=OS_GLOBALSHARED_VAR_NOCACHE, vLinkGenLinkerVarSectionFast=false
          OS_GLOBALSHARED_VAR_NOCACHE_ZERO_INIT: vLinkGenLinkerVarSectionName=OS_GLOBALSHARED_VAR_NOCACHE_ZERO_INIT, vLinkGenLinkerVarSectionFast=false
          OS_GLOBALSHARED_VAR_FAST_NOINIT: vLinkGenLinkerVarSectionName=OS_GLOBALSHARED_VAR_FAST_NOINIT, vLinkGenLinkerVarSectionFast=true
          OS_GLOBALSHARED_VAR_FAST: vLinkGenLinkerVarSectionName=OS_GLOBALSHARED_VAR_FAST, vLinkGenLinkerVarSectionFast=true
          OS_GLOBALSHARED_VAR_FAST_ZERO_INIT: vLinkGenLinkerVarSectionName=OS_GLOBALSHARED_VAR_FAST_ZERO_INIT, vLinkGenLinkerVarSectionFast=true
          OS_GLOBALSHARED_VAR_FAST_NOCACHE_NOINIT: vLinkGenLinkerVarSectionName=OS_GLOBALSHARED_VAR_FAST_NOCACHE_NOINIT, vLinkGenLinkerVarSectionFast=true
          OS_GLOBALSHARED_VAR_FAST_NOCACHE: vLinkGenLinkerVarSectionName=OS_GLOBALSHARED_VAR_FAST_NOCACHE, vLinkGenLinkerVarSectionFast=true
          OS_GLOBALSHARED_VAR_FAST_NOCACHE_ZERO_INIT: vLinkGenLinkerVarSectionName=OS_GLOBALSHARED_VAR_FAST_NOCACHE_ZERO_INIT, vLinkGenLinkerVarSectionFast=true
          OS_CORESTATUS_CORE0_VAR_NOCACHE_NOINIT: vLinkGenLinkerVarSectionName=OS_CORESTATUS_CORE0_VAR_NOCACHE_NOINIT, vLinkGenLinkerVarSectionFast=false
          OS_CORESTATUS_CORE0_VAR_FAST_NOCACHE_NOINIT: vLinkGenLinkerVarSectionName=OS_CORESTATUS_CORE0_VAR_FAST_NOCACHE_NOINIT, vLinkGenLinkerVarSectionFast=true
          OS_CORE0_VAR: vLinkGenLinkerVarSectionName=OS_CORE0_VAR, vLinkGenLinkerVarSectionFast=false
          OS_CORE0_VAR_FAST: vLinkGenLinkerVarSectionName=OS_CORE0_VAR_FAST, vLinkGenLinkerVarSectionFast=true
          OS_CORE0_VAR_NOCACHE: vLinkGenLinkerVarSectionName=OS_CORE0_VAR_NOCACHE, vLinkGenLinkerVarSectionFast=false
          OS_CORE0_VAR_FAST_NOCACHE: vLinkGenLinkerVarSectionName=OS_CORE0_VAR_FAST_NOCACHE, vLinkGenLinkerVarSectionFast=true
          OS_CORE0_VAR_NOINIT: vLinkGenLinkerVarSectionName=OS_CORE0_VAR_NOINIT, vLinkGenLinkerVarSectionFast=false
          OS_CORE0_VAR_FAST_NOINIT: vLinkGenLinkerVarSectionName=OS_CORE0_VAR_FAST_NOINIT, vLinkGenLinkerVarSectionFast=true
          OS_CORE0_VAR_NOCACHE_NOINIT: vLinkGenLinkerVarSectionName=OS_CORE0_VAR_NOCACHE_NOINIT, vLinkGenLinkerVarSectionFast=false
          OS_CORE0_VAR_FAST_NOCACHE_NOINIT: vLinkGenLinkerVarSectionName=OS_CORE0_VAR_FAST_NOCACHE_NOINIT, vLinkGenLinkerVarSectionFast=true
          OS_PUBLIC_CORE0_VAR_NOINIT: vLinkGenLinkerVarSectionName=OS_PUBLIC_CORE0_VAR_NOINIT, vLinkGenLinkerVarSectionFast=false
          OS_PUBLIC_CORE0_VAR_FAST_NOINIT: vLinkGenLinkerVarSectionName=OS_PUBLIC_CORE0_VAR_FAST_NOINIT, vLinkGenLinkerVarSectionFast=true
          OS_BARRIER_CORE0_VAR_NOCACHE_NOINIT: vLinkGenLinkerVarSectionName=OS_BARRIER_CORE0_VAR_NOCACHE_NOINIT, vLinkGenLinkerVarSectionFast=false
          OS_BARRIER_CORE0_VAR_FAST_NOCACHE_NOINIT: vLinkGenLinkerVarSectionName=OS_BARRIER_CORE0_VAR_FAST_NOCACHE_NOINIT, vLinkGenLinkerVarSectionFast=true
          OS_SystemApplication_OsCore0_VAR_NOINIT: vLinkGenLinkerVarSectionName=OS_SystemApplication_OsCore0_VAR_NOINIT, vLinkGenLinkerVarSectionFast=false
          OS_SystemApplication_OsCore0_VAR: vLinkGenLinkerVarSectionName=OS_SystemApplication_OsCore0_VAR, vLinkGenLinkerVarSectionFast=false
          OS_SystemApplication_OsCore0_VAR_ZERO_INIT: vLinkGenLinkerVarSectionName=OS_SystemApplication_OsCore0_VAR_ZERO_INIT, vLinkGenLinkerVarSectionFast=false
          OS_SystemApplication_OsCore0_VAR_NOCACHE_NOINIT: vLinkGenLinkerVarSectionName=OS_SystemApplication_OsCore0_VAR_NOCACHE_NOINIT, vLinkGenLinkerVarSectionFast=false
          OS_SystemApplication_OsCore0_VAR_NOCACHE: vLinkGenLinkerVarSectionName=OS_SystemApplication_OsCore0_VAR_NOCACHE, vLinkGenLinkerVarSectionFast=false
          OS_SystemApplication_OsCore0_VAR_NOCACHE_ZERO_INIT: vLinkGenLinkerVarSectionName=OS_SystemApplication_OsCore0_VAR_NOCACHE_ZERO_INIT, vLinkGenLinkerVarSectionFast=false
          OS_SystemApplication_OsCore0_VAR_FAST_NOINIT: vLinkGenLinkerVarSectionName=OS_SystemApplication_OsCore0_VAR_FAST_NOINIT, vLinkGenLinkerVarSectionFast=true
          OS_SystemApplication_OsCore0_VAR_FAST: vLinkGenLinkerVarSectionName=OS_SystemApplication_OsCore0_VAR_FAST, vLinkGenLinkerVarSectionFast=true
          OS_SystemApplication_OsCore0_VAR_FAST_ZERO_INIT: vLinkGenLinkerVarSectionName=OS_SystemApplication_OsCore0_VAR_FAST_ZERO_INIT, vLinkGenLinkerVarSectionFast=true
          OS_SystemApplication_OsCore0_VAR_FAST_NOCACHE_NOINIT: vLinkGenLinkerVarSectionName=OS_SystemApplication_OsCore0_VAR_FAST_NOCACHE_NOINIT, vLinkGenLinkerVarSectionFast=true
          OS_SystemApplication_OsCore0_VAR_FAST_NOCACHE: vLinkGenLinkerVarSectionName=OS_SystemApplication_OsCore0_VAR_FAST_NOCACHE, vLinkGenLinkerVarSectionFast=true
          OS_SystemApplication_OsCore0_VAR_FAST_NOCACHE_ZERO_INIT: vLinkGenLinkerVarSectionName=OS_SystemApplication_OsCore0_VAR_FAST_NOCACHE_ZERO_INIT, vLinkGenLinkerVarSectionFast=true
          OS_OsApplication_NonTrust_OsCore0_VAR_NOINIT: vLinkGenLinkerVarSectionName=OS_OsApplication_NonTrust_OsCore0_VAR_NOINIT, vLinkGenLinkerVarSectionFast=false
          OS_OsApplication_NonTrust_OsCore0_VAR: vLinkGenLinkerVarSectionName=OS_OsApplication_NonTrust_OsCore0_VAR, vLinkGenLinkerVarSectionFast=false
          OS_OsApplication_NonTrust_OsCore0_VAR_ZERO_INIT: vLinkGenLinkerVarSectionName=OS_OsApplication_NonTrust_OsCore0_VAR_ZERO_INIT, vLinkGenLinkerVarSectionFast=false
          OS_OsApplication_NonTrust_OsCore0_VAR_NOCACHE_NOINIT: vLinkGenLinkerVarSectionName=OS_OsApplication_NonTrust_OsCore0_VAR_NOCACHE_NOINIT, vLinkGenLinkerVarSectionFast=false
          OS_OsApplication_NonTrust_OsCore0_VAR_NOCACHE: vLinkGenLinkerVarSectionName=OS_OsApplication_NonTrust_OsCore0_VAR_NOCACHE, vLinkGenLinkerVarSectionFast=false
          OS_OsApplication_NonTrust_OsCore0_VAR_NOCACHE_ZERO_INIT: vLinkGenLinkerVarSectionName=OS_OsApplication_NonTrust_OsCore0_VAR_NOCACHE_ZERO_INIT, vLinkGenLinkerVarSectionFast=false
          OS_OsApplication_NonTrust_OsCore0_VAR_FAST_NOINIT: vLinkGenLinkerVarSectionName=OS_OsApplication_NonTrust_OsCore0_VAR_FAST_NOINIT, vLinkGenLinkerVarSectionFast=true
          OS_OsApplication_NonTrust_OsCore0_VAR_FAST: vLinkGenLinkerVarSectionName=OS_OsApplication_NonTrust_OsCore0_VAR_FAST, vLinkGenLinkerVarSectionFast=true
          OS_OsApplication_NonTrust_OsCore0_VAR_FAST_ZERO_INIT: vLinkGenLinkerVarSectionName=OS_OsApplication_NonTrust_OsCore0_VAR_FAST_ZERO_INIT, vLinkGenLinkerVarSectionFast=true
          OS_OsApplication_NonTrust_OsCore0_VAR_FAST_NOCACHE_NOINIT: vLinkGenLinkerVarSectionName=OS_OsApplication_NonTrust_OsCore0_VAR_FAST_NOCACHE_NOINIT, vLinkGenLinkerVarSectionFast=true
          OS_OsApplication_NonTrust_OsCore0_VAR_FAST_NOCACHE: vLinkGenLinkerVarSectionName=OS_OsApplication_NonTrust_OsCore0_VAR_FAST_NOCACHE, vLinkGenLinkerVarSectionFast=true
          OS_OsApplication_NonTrust_OsCore0_VAR_FAST_NOCACHE_ZERO_INIT: vLinkGenLinkerVarSectionName=OS_OsApplication_NonTrust_OsCore0_VAR_FAST_NOCACHE_ZERO_INIT, vLinkGenLinkerVarSectionFast=true
        4 x vLinkGenLinkerCodeSection, all with vLinkGenLinkerCodeSectionFast=false, vLinkGenLinkerCodeSectionModule=Os:
          OS_LinIsr_30_Rh850Rlin_31_0_CODE: vLinkGenLinkerCodeSectionName=OS_LinIsr_30_Rh850Rlin_31_0_CODE
          OS_CanIsrGlobalStatus_CODE: vLinkGenLinkerCodeSectionName=OS_CanIsrGlobalStatus_CODE
          OS_BSW_DIAGNOSE_CODE: vLinkGenLinkerCodeSectionName=OS_BSW_DIAGNOSE_CODE
          OS_BSW_COMM_CODE: vLinkGenLinkerCodeSectionName=OS_BSW_COMM_CODE
        OS_STACK_BSW_COMM_VAR_NOINIT (vLinkGenLinkerStackSection): vLinkGenLinkerStackSectionName=OS_STACK_BSW_COMM_VAR_NOINIT, vLinkGenLinkerStackSectionAlignment=4, vLinkGenLinkerStackSectionModule=Os
        5 x vLinkGenLinkerCodeSection, all with vLinkGenLinkerCodeSectionFast=false, vLinkGenLinkerCodeSectionModule=Os:
          OS_DRIVERS_SAFE_CODE: vLinkGenLinkerCodeSectionName=OS_DRIVERS_SAFE_CODE
          OS_SYS_CODE: vLinkGenLinkerCodeSectionName=OS_SYS_CODE
          OS_IPC_CODE: vLinkGenLinkerCodeSectionName=OS_IPC_CODE
          OS_TT_GEAR_CODE: vLinkGenLinkerCodeSectionName=OS_TT_GEAR_CODE
          OS_Default_Init_Task_CODE: vLinkGenLinkerCodeSectionName=OS_Default_Init_Task_CODE
        OS_STACK_OSCORE0_TASK_PRIO50_VAR_NOINIT (vLinkGenLinkerStackSection):
          vLinkGenLinkerStackSectionName = OS_STACK_OSCORE0_TASK_PRIO50_VAR_NOINIT
          vLinkGenLinkerStackSectionAlignment = 4
          vLinkGenLinkerStackSectionModule = Os
        OS_Default_Init_Task_Trusted_CODE (vLinkGenLinkerCodeSection): vLinkGenLinkerCodeSectionName=OS_Default_Init_Task_Trusted_CODE, vLinkGenLinkerCodeSectionFast=false, vLinkGenLinkerCodeSectionModule=Os
        OS_STACK_OSCORE0_TASK_PRIO49_VAR_NOINIT (vLinkGenLinkerStackSection):
          vLinkGenLinkerStackSectionName = OS_STACK_OSCORE0_TASK_PRIO49_VAR_NOINIT
          vLinkGenLinkerStackSectionAlignment = 4
          vLinkGenLinkerStackSectionModule = Os
        OS_FUEL_TC_ODO_CODE (vLinkGenLinkerCodeSection): vLinkGenLinkerCodeSectionName=OS_FUEL_TC_ODO_CODE, vLinkGenLinkerCodeSectionFast=false, vLinkGenLinkerCodeSectionModule=Os
        OS_Default_BSW_CODE (vLinkGenLinkerCodeSection): vLinkGenLinkerCodeSectionName=OS_Default_BSW_CODE, vLinkGenLinkerCodeSectionFast=false, vLinkGenLinkerCodeSectionModule=Os
        OS_STACK_FUEL_TC_ODO_VAR_NOINIT (vLinkGenLinkerStackSection): vLinkGenLinkerStackSectionName=OS_STACK_FUEL_TC_ODO_VAR_NOINIT, vLinkGenLinkerStackSectionAlignment=4, vLinkGenLinkerStackSectionModule=Os
        OS_PROTECTIONHOOK_CODE (vLinkGenLinkerCodeSection): vLinkGenLinkerCodeSectionName=OS_PROTECTIONHOOK_CODE, vLinkGenLinkerCodeSectionFast=false, vLinkGenLinkerCodeSectionModule=Os
        OS_STACK_OSCORE0_PROTECTION_VAR_NOINIT (vLinkGenLinkerStackSection):
          vLinkGenLinkerStackSectionName = OS_STACK_OSCORE0_PROTECTION_VAR_NOINIT
          vLinkGenLinkerStackSectionAlignment = 4
          vLinkGenLinkerStackSectionModule = Os
        OS_SHUTDOWNHOOK_CODE (vLinkGenLinkerCodeSection): vLinkGenLinkerCodeSectionName=OS_SHUTDOWNHOOK_CODE, vLinkGenLinkerCodeSectionFast=false, vLinkGenLinkerCodeSectionModule=Os
        OS_STACK_OSCORE0_SHUTDOWN_VAR_NOINIT (vLinkGenLinkerStackSection): vLinkGenLinkerStackSectionName=OS_STACK_OSCORE0_SHUTDOWN_VAR_NOINIT, vLinkGenLinkerStackSectionAlignment=4, vLinkGenLinkerStackSectionModule=Os
        OS_PRETASKHOOK_CODE (vLinkGenLinkerCodeSection): vLinkGenLinkerCodeSectionName=OS_PRETASKHOOK_CODE, vLinkGenLinkerCodeSectionFast=false, vLinkGenLinkerCodeSectionModule=Os
        OS_POSTTASKHOOK_CODE (vLinkGenLinkerCodeSection): vLinkGenLinkerCodeSectionName=OS_POSTTASKHOOK_CODE, vLinkGenLinkerCodeSectionFast=false, vLinkGenLinkerCodeSectionModule=Os
        6 x vLinkGenLinkerStackSection, all with vLinkGenLinkerStackSectionAlignment=4, vLinkGenLinkerStackSectionModule=Os:
          OS_STACK_DEFAULT_BSW_VAR_NOINIT: vLinkGenLinkerStackSectionName=OS_STACK_DEFAULT_BSW_VAR_NOINIT
          OS_STACK_IPC_VAR_NOINIT: vLinkGenLinkerStackSectionName=OS_STACK_IPC_VAR_NOINIT
          OS_STACK_TT_GEAR_VAR_NOINIT: vLinkGenLinkerStackSectionName=OS_STACK_TT_GEAR_VAR_NOINIT
          OS_STACK_SYS_VAR_NOINIT: vLinkGenLinkerStackSectionName=OS_STACK_SYS_VAR_NOINIT
          OS_STACK_BSW_DIAGNOSE_VAR_NOINIT: vLinkGenLinkerStackSectionName=OS_STACK_BSW_DIAGNOSE_VAR_NOINIT
          OS_STACK_DRIVERS_SAFE_VAR_NOINIT: vLinkGenLinkerStackSectionName=OS_STACK_DRIVERS_SAFE_VAR_NOINIT
        34 x vLinkGenLinkerCodeSection, all with vLinkGenLinkerCodeSectionFast=false, vLinkGenLinkerCodeSectionModule=Os:
          OS_PANICHOOK_CODE: vLinkGenLinkerCodeSectionName=OS_PANICHOOK_CODE
          OS_EXT_INTP_CH21_CAT2_ISR_CODE: vLinkGenLinkerCodeSectionName=OS_EXT_INTP_CH21_CAT2_ISR_CODE
          OS_CanIsrStatus_3_CODE: vLinkGenLinkerCodeSectionName=OS_CanIsrStatus_3_CODE
          OS_ADC0_SG1_CAT2_ISR_CODE: vLinkGenLinkerCodeSectionName=OS_ADC0_SG1_CAT2_ISR_CODE
          OS_ADC1_SG1_CAT2_ISR_CODE: vLinkGenLinkerCodeSectionName=OS_ADC1_SG1_CAT2_ISR_CODE
          OS_EXT_INTP_CH00_CAT2_ISR_CODE: vLinkGenLinkerCodeSectionName=OS_EXT_INTP_CH00_CAT2_ISR_CODE
          OS_EXT_INTP_CH01_CAT2_ISR_CODE: vLinkGenLinkerCodeSectionName=OS_EXT_INTP_CH01_CAT2_ISR_CODE
          OS_EXT_INTP_CH{03..05}_CAT2_ISR_CODE: vLinkGenLinkerCodeSectionName=OS_EXT_INTP_CH{03..05}_CAT2_ISR_CODE
          OS_EXT_INTP_CH{11..13}_CAT2_ISR_CODE: vLinkGenLinkerCodeSectionName=OS_EXT_INTP_CH{11..13}_CAT2_ISR_CODE
          OS_EXT_INTP_CH18_CAT2_ISR_CODE: vLinkGenLinkerCodeSectionName=OS_EXT_INTP_CH18_CAT2_ISR_CODE
          OS_EXT_INTP_CH19_CAT2_ISR_CODE: vLinkGenLinkerCodeSectionName=OS_EXT_INTP_CH19_CAT2_ISR_CODE
          OS_TAUD0_CH13_CAT2_ISR_CODE: vLinkGenLinkerCodeSectionName=OS_TAUD0_CH13_CAT2_ISR_CODE
          OS_TAUD0_CH15_CAT2_ISR_CODE: vLinkGenLinkerCodeSectionName=OS_TAUD0_CH15_CAT2_ISR_CODE
          OS_SPI_CSIH3_TIR_CAT2_ISR_CODE: vLinkGenLinkerCodeSectionName=OS_SPI_CSIH3_TIR_CAT2_ISR_CODE
          OS_INTRIIC0TI_interrupt_CODE: vLinkGenLinkerCodeSectionName=OS_INTRIIC0TI_interrupt_CODE
          OS_INTRIIC0EE_interrupt_CODE: vLinkGenLinkerCodeSectionName=OS_INTRIIC0EE_interrupt_CODE
          OS_INTRIIC0RI_interrupt_CODE: vLinkGenLinkerCodeSectionName=OS_INTRIIC0RI_interrupt_CODE
          OS_INTRIIC0TEI_interrupt_CODE: vLinkGenLinkerCodeSectionName=OS_INTRIIC0TEI_interrupt_CODE
          OS_Uart_IntTx4_CODE: vLinkGenLinkerCodeSectionName=OS_Uart_IntTx4_CODE
          OS_Uart_IntRx4_CODE: vLinkGenLinkerCodeSectionName=OS_Uart_IntRx4_CODE
          OS_Uart_IntErr4_CODE: vLinkGenLinkerCodeSectionName=OS_Uart_IntErr4_CODE
          OS_Uart_IntTx5_CODE: vLinkGenLinkerCodeSectionName=OS_Uart_IntTx5_CODE
          OS_Uart_IntRx5_CODE: vLinkGenLinkerCodeSectionName=OS_Uart_IntRx5_CODE
          OS_Uart_IntErr5_CODE: vLinkGenLinkerCodeSectionName=OS_Uart_IntErr5_CODE
          OS_INTRIIC1TI_interrupt_CODE: vLinkGenLinkerCodeSectionName=OS_INTRIIC1TI_interrupt_CODE
          OS_INTRIIC1EE_interrupt_CODE: vLinkGenLinkerCodeSectionName=OS_INTRIIC1EE_interrupt_CODE
          OS_INTRIIC1RI_interrupt_CODE: vLinkGenLinkerCodeSectionName=OS_INTRIIC1RI_interrupt_CODE
          OS_INTRIIC1TEI_interrupt_CODE: vLinkGenLinkerCodeSectionName=OS_INTRIIC1TEI_interrupt_CODE
          OS_CanIsrWakeup_3_CODE: vLinkGenLinkerCodeSectionName=OS_CanIsrWakeup_3_CODE
          OS_GateWay_CODE: vLinkGenLinkerCodeSectionName=OS_GateWay_CODE
        OS_STACK_GATEWAY_VAR_NOINIT (vLinkGenLinkerStackSection): vLinkGenLinkerStackSectionName=OS_STACK_GATEWAY_VAR_NOINIT, vLinkGenLinkerStackSectionAlignment=4, vLinkGenLinkerStackSectionModule=Os
        7 x vLinkGenLinkerCodeSection, all with vLinkGenLinkerCodeSectionFast=false, vLinkGenLinkerCodeSectionModule=Os:
          OS_CanIsrWakeup_0_CODE: vLinkGenLinkerCodeSectionName=OS_CanIsrWakeup_0_CODE
          OS_CanIsrStatus_0_CODE: vLinkGenLinkerCodeSectionName=OS_CanIsrStatus_0_CODE
          OS_CanIsrStatus_1_CODE: vLinkGenLinkerCodeSectionName=OS_CanIsrStatus_1_CODE
          OS_CanIsrWakeup_1_CODE: vLinkGenLinkerCodeSectionName=OS_CanIsrWakeup_1_CODE
          OS_LinIsr_30_Rh850Rlin_32_0_CODE: vLinkGenLinkerCodeSectionName=OS_LinIsr_30_Rh850Rlin_32_0_CODE
          OS_INTFICUIF0DFRQPE_CODE: vLinkGenLinkerCodeSectionName=OS_INTFICUIF0DFRQPE_CODE
          OS_SWC_LOW_CODE: vLinkGenLinkerCodeSectionName=OS_SWC_LOW_CODE
        OS_STACK_SWC_LOW_VAR_NOINIT (vLinkGenLinkerStackSection): vLinkGenLinkerStackSectionName=OS_STACK_SWC_LOW_VAR_NOINIT, vLinkGenLinkerStackSectionAlignment=4, vLinkGenLinkerStackSectionModule=Os
        OS_OsApplication_Trust_OsCore0_CONST (vLinkGenLinkerConstSection): vLinkGenLinkerConstSectionName=OS_OsApplication_Trust_OsCore0_CONST, vLinkGenLinkerConstSectionFast=false, vLinkGenLinkerConstSectionModule=Os
        OS_OsApplication_Trust_OsCore0_CONST_FAST (vLinkGenLinkerConstSection):
          vLinkGenLinkerConstSectionName = OS_OsApplication_Trust_OsCore0_CONST_FAST
          vLinkGenLinkerConstSectionFast = true
          vLinkGenLinkerConstSectionModule = Os
        12 x vLinkGenLinkerVarSection, all with vLinkGenLinkerVarSectionModule=Os:
          OS_OsApplication_Trust_OsCore0_VAR_NOINIT: vLinkGenLinkerVarSectionName=OS_OsApplication_Trust_OsCore0_VAR_NOINIT, vLinkGenLinkerVarSectionFast=false
          OS_OsApplication_Trust_OsCore0_VAR: vLinkGenLinkerVarSectionName=OS_OsApplication_Trust_OsCore0_VAR, vLinkGenLinkerVarSectionFast=false
          OS_OsApplication_Trust_OsCore0_VAR_ZERO_INIT: vLinkGenLinkerVarSectionName=OS_OsApplication_Trust_OsCore0_VAR_ZERO_INIT, vLinkGenLinkerVarSectionFast=false
          OS_OsApplication_Trust_OsCore0_VAR_NOCACHE_NOINIT: vLinkGenLinkerVarSectionName=OS_OsApplication_Trust_OsCore0_VAR_NOCACHE_NOINIT, vLinkGenLinkerVarSectionFast=false
          OS_OsApplication_Trust_OsCore0_VAR_NOCACHE: vLinkGenLinkerVarSectionName=OS_OsApplication_Trust_OsCore0_VAR_NOCACHE, vLinkGenLinkerVarSectionFast=false
          OS_OsApplication_Trust_OsCore0_VAR_NOCACHE_ZERO_INIT: vLinkGenLinkerVarSectionName=OS_OsApplication_Trust_OsCore0_VAR_NOCACHE_ZERO_INIT, vLinkGenLinkerVarSectionFast=false
          OS_OsApplication_Trust_OsCore0_VAR_FAST_NOINIT: vLinkGenLinkerVarSectionName=OS_OsApplication_Trust_OsCore0_VAR_FAST_NOINIT, vLinkGenLinkerVarSectionFast=true
          OS_OsApplication_Trust_OsCore0_VAR_FAST: vLinkGenLinkerVarSectionName=OS_OsApplication_Trust_OsCore0_VAR_FAST, vLinkGenLinkerVarSectionFast=true
          OS_OsApplication_Trust_OsCore0_VAR_FAST_ZERO_INIT: vLinkGenLinkerVarSectionName=OS_OsApplication_Trust_OsCore0_VAR_FAST_ZERO_INIT, vLinkGenLinkerVarSectionFast=true
          OS_OsApplication_Trust_OsCore0_VAR_FAST_NOCACHE_NOINIT: vLinkGenLinkerVarSectionName=OS_OsApplication_Trust_OsCore0_VAR_FAST_NOCACHE_NOINIT, vLinkGenLinkerVarSectionFast=true
          OS_OsApplication_Trust_OsCore0_VAR_FAST_NOCACHE: vLinkGenLinkerVarSectionName=OS_OsApplication_Trust_OsCore0_VAR_FAST_NOCACHE, vLinkGenLinkerVarSectionFast=true
          OS_OsApplication_Trust_OsCore0_VAR_FAST_NOCACHE_ZERO_INIT: vLinkGenLinkerVarSectionName=OS_OsApplication_Trust_OsCore0_VAR_FAST_NOCACHE_ZERO_INIT, vLinkGenLinkerVarSectionFast=true
        3 x vLinkGenLinkerCodeSection, all with vLinkGenLinkerCodeSectionFast=false, vLinkGenLinkerCodeSectionModule=Os:
          OS_EXT_INTP_CH09_CAT2_ISR_CODE: vLinkGenLinkerCodeSectionName=OS_EXT_INTP_CH09_CAT2_ISR_CODE
          OS_EXT_INTP_CH20_CAT2_ISR_CODE: vLinkGenLinkerCodeSectionName=OS_EXT_INTP_CH20_CAT2_ISR_CODE
          OS_vHsmResponseIsr_CODE: vLinkGenLinkerCodeSectionName=OS_vHsmResponseIsr_CODE
        vLinkGenLinkerStackSection: vLinkGenLinkerStackSectionName=stack111
      14 x vLinkGenLogicalConstGroup:
        OS_CODE: vLinkGenConstGroupPosition=900, vLinkGenConstGroupRegion=CODE_FLASH_0, vLinkGenConstGroupModule=Os
          OS_CODE (vLinkGenConstSectionGroup):
            vLinkGenConstSectionGroupPosition = 0
            vLinkGenConstSectionGroupInit = NONE
            vLinkGenConstSectionGroupInitStage = ONE
            vLinkGenConstSectionGroupRef = vLinkGenLinkerSections/OS_CODE
            vLinkGenConstSectionGroupRef = OS_OS_COREINITHOOK_CODE
        OS_CONST: vLinkGenConstGroupPosition=910, vLinkGenConstGroupRegion=CODE_FLASH_0, vLinkGenConstGroupModule=Os
          OS_CONST (vLinkGenConstSectionGroup):
            vLinkGenConstSectionGroupPosition = 0
            vLinkGenConstSectionGroupInit = NONE
            vLinkGenConstSectionGroupInitStage = ONE
            vLinkGenConstSectionGroupRef = vLinkGenLinkerSections/OS_CONST
            vLinkGenConstSectionGroupRef = OS_CONST_FAST
            vLinkGenConstSectionGroupRef = OS_CORE0_CONST
            vLinkGenConstSectionGroupRef = OS_CORE0_CONST_FAST
            vLinkGenConstSectionGroupRef = OS_SystemApplication_OsCore0_CONST
            vLinkGenConstSectionGroupRef = OS_SystemApplication_OsCore0_CONST_FAST
        OS_EXCVEC_CORE0_CODE: vLinkGenConstGroupPosition=0, vLinkGenConstGroupRegion=CODE_FLASH_0, vLinkGenConstGroupModule=Os
          OS_EXCVEC_CORE0_CODE (vLinkGenConstSectionGroup):
            vLinkGenConstSectionGroupPosition = 0
            vLinkGenConstSectionGroupInit = NONE
            vLinkGenConstSectionGroupInitStage = ONE
            vLinkGenConstSectionGroupAlignment = 512
            vLinkGenConstSectionGroupEndAlignment = 4
            vLinkGenConstSectionGroupRef = vLinkGenLinkerSections/OS_EXCVEC_CORE0_CODE
        OS_EXCVEC_CORE0_CONST: vLinkGenConstGroupPosition=0, vLinkGenConstGroupRegion=CODE_FLASH_0, vLinkGenConstGroupModule=Os
          OS_EXCVEC_CORE0_CONST (vLinkGenConstSectionGroup):
            vLinkGenConstSectionGroupPosition = 0
            vLinkGenConstSectionGroupInit = NONE
            vLinkGenConstSectionGroupInitStage = ONE
            vLinkGenConstSectionGroupAlignment = 512
            vLinkGenConstSectionGroupEndAlignment = 4
            vLinkGenConstSectionGroupRef = vLinkGenLinkerSections/OS_EXCVEC_CORE0_CONST
        OS_INTVEC_CORE0_CODE: vLinkGenConstGroupPosition=0, vLinkGenConstGroupRegion=CODE_FLASH_0, vLinkGenConstGroupModule=Os
          OS_INTVEC_CORE0_CODE (vLinkGenConstSectionGroup):
            vLinkGenConstSectionGroupPosition = 0
            vLinkGenConstSectionGroupInit = NONE
            vLinkGenConstSectionGroupInitStage = ONE
            vLinkGenConstSectionGroupAlignment = 512
            vLinkGenConstSectionGroupEndAlignment = 4
            vLinkGenConstSectionGroupRef = vLinkGenLinkerSections/OS_INTVEC_CORE0_CODE
        OS_INTVEC_CORE0_CONST: vLinkGenConstGroupPosition=0, vLinkGenConstGroupRegion=CODE_FLASH_0, vLinkGenConstGroupModule=Os
          OS_INTVEC_CORE0_CONST (vLinkGenConstSectionGroup):
            vLinkGenConstSectionGroupPosition = 0
            vLinkGenConstSectionGroupInit = NONE
            vLinkGenConstSectionGroupInitStage = ONE
            vLinkGenConstSectionGroupAlignment = 512
            vLinkGenConstSectionGroupEndAlignment = 4
            vLinkGenConstSectionGroupRef = vLinkGenLinkerSections/OS_INTVEC_CORE0_CONST
        OS_INTVEC_CODE: vLinkGenConstGroupPosition=0, vLinkGenConstGroupRegion=CODE_FLASH_0, vLinkGenConstGroupModule=Os
          OS_INTVEC_CODE (vLinkGenConstSectionGroup):
            vLinkGenConstSectionGroupPosition = 0
            vLinkGenConstSectionGroupInit = NONE
            vLinkGenConstSectionGroupInitStage = ONE
            vLinkGenConstSectionGroupAlignment = 512
            vLinkGenConstSectionGroupEndAlignment = 4
            vLinkGenConstSectionGroupRef = vLinkGenLinkerSections/OS_INTVEC_CODE
        OS_INTVEC_CONST: vLinkGenConstGroupPosition=0, vLinkGenConstGroupRegion=CODE_FLASH_0, vLinkGenConstGroupModule=Os
          OS_INTVEC_CONST (vLinkGenConstSectionGroup):
            vLinkGenConstSectionGroupPosition = 0
            vLinkGenConstSectionGroupInit = NONE
            vLinkGenConstSectionGroupInitStage = ONE
            vLinkGenConstSectionGroupAlignment = 512
            vLinkGenConstSectionGroupEndAlignment = 4
            vLinkGenConstSectionGroupRef = vLinkGenLinkerSections/OS_INTVEC_CONST
        OS_GLOBALSHARED_CONST: vLinkGenConstGroupPosition=5, vLinkGenConstGroupRegion=CODE_FLASH_0, vLinkGenConstGroupModule=Os
          OS_GLOBALSHARED_CONST (vLinkGenConstSectionGroup):
            vLinkGenConstSectionGroupPosition = 0
            vLinkGenConstSectionGroupInit = NONE
            vLinkGenConstSectionGroupInitStage = ONE
            vLinkGenConstSectionGroupRef = vLinkGenLinkerSections/OS_GLOBALSHARED_CONST
            vLinkGenConstSectionGroupRef = OS_GLOBALSHARED_CONST_FAST
        OS_USER_CODE: vLinkGenConstGroupPosition=5, vLinkGenConstGroupRegion=CODE_FLASH_0, vLinkGenConstGroupModule=Os
          OS_USER_CODE (vLinkGenConstSectionGroup):
            vLinkGenConstSectionGroupPosition = 0
            vLinkGenConstSectionGroupInit = NONE
            vLinkGenConstSectionGroupInitStage = ONE
            vLinkGenConstSectionGroupRef = OS_ERRORHOOK_CODE
            vLinkGenConstSectionGroupRef = OS_LinIsr_30_Rh850Rlin_31_0_CODE
            vLinkGenConstSectionGroupRef = OS_CanIsrGlobalStatus_CODE
            vLinkGenConstSectionGroupRef = OS_BSW_DIAGNOSE_CODE
            vLinkGenConstSectionGroupRef = OS_BSW_COMM_CODE
            vLinkGenConstSectionGroupRef = OS_DRIVERS_SAFE_CODE
            vLinkGenConstSectionGroupRef = OS_SYS_CODE
            vLinkGenConstSectionGroupRef = OS_IPC_CODE
            vLinkGenConstSectionGroupRef = OS_TT_GEAR_CODE
            vLinkGenConstSectionGroupRef = OS_Default_Init_Task_CODE
            vLinkGenConstSectionGroupRef = OS_Default_Init_Task_Trusted_CODE
            vLinkGenConstSectionGroupRef = OS_FUEL_TC_ODO_CODE
            vLinkGenConstSectionGroupRef = OS_Default_BSW_CODE
            vLinkGenConstSectionGroupRef = OS_PROTECTIONHOOK_CODE
            vLinkGenConstSectionGroupRef = OS_SHUTDOWNHOOK_CODE
            vLinkGenConstSectionGroupRef = OS_PRETASKHOOK_CODE
            vLinkGenConstSectionGroupRef = OS_POSTTASKHOOK_CODE
            vLinkGenConstSectionGroupRef = OS_PANICHOOK_CODE
            vLinkGenConstSectionGroupRef = OS_EXT_INTP_CH21_CAT2_ISR_CODE
            vLinkGenConstSectionGroupRef = OS_CanIsrStatus_3_CODE
            vLinkGenConstSectionGroupRef = OS_ADC0_SG1_CAT2_ISR_CODE
            vLinkGenConstSectionGroupRef = OS_ADC1_SG1_CAT2_ISR_CODE
            vLinkGenConstSectionGroupRef = OS_EXT_INTP_CH00_CAT2_ISR_CODE
            vLinkGenConstSectionGroupRef = OS_EXT_INTP_CH01_CAT2_ISR_CODE
            vLinkGenConstSectionGroupRef = OS_EXT_INTP_CH{03..05}_CAT2_ISR_CODE
            vLinkGenConstSectionGroupRef = OS_EXT_INTP_CH{11..13}_CAT2_ISR_CODE
            vLinkGenConstSectionGroupRef = OS_EXT_INTP_CH18_CAT2_ISR_CODE
            vLinkGenConstSectionGroupRef = OS_EXT_INTP_CH19_CAT2_ISR_CODE
            vLinkGenConstSectionGroupRef = OS_TAUD0_CH13_CAT2_ISR_CODE
            vLinkGenConstSectionGroupRef = OS_TAUD0_CH15_CAT2_ISR_CODE
            vLinkGenConstSectionGroupRef = OS_SPI_CSIH3_TIR_CAT2_ISR_CODE
            vLinkGenConstSectionGroupRef = OS_INTRIIC0TI_interrupt_CODE
            vLinkGenConstSectionGroupRef = OS_INTRIIC0EE_interrupt_CODE
            vLinkGenConstSectionGroupRef = OS_INTRIIC0RI_interrupt_CODE
            vLinkGenConstSectionGroupRef = OS_INTRIIC0TEI_interrupt_CODE
            vLinkGenConstSectionGroupRef = OS_Uart_IntTx4_CODE
            vLinkGenConstSectionGroupRef = OS_Uart_IntRx4_CODE
            vLinkGenConstSectionGroupRef = OS_Uart_IntErr4_CODE
            vLinkGenConstSectionGroupRef = OS_Uart_IntTx5_CODE
            vLinkGenConstSectionGroupRef = OS_Uart_IntRx5_CODE
            vLinkGenConstSectionGroupRef = OS_Uart_IntErr5_CODE
            vLinkGenConstSectionGroupRef = OS_INTRIIC1TI_interrupt_CODE
            vLinkGenConstSectionGroupRef = OS_INTRIIC1EE_interrupt_CODE
            vLinkGenConstSectionGroupRef = OS_INTRIIC1RI_interrupt_CODE
            vLinkGenConstSectionGroupRef = OS_INTRIIC1TEI_interrupt_CODE
            vLinkGenConstSectionGroupRef = OS_CanIsrWakeup_3_CODE
            vLinkGenConstSectionGroupRef = OS_GateWay_CODE
            vLinkGenConstSectionGroupRef = OS_CanIsrWakeup_0_CODE
            vLinkGenConstSectionGroupRef = OS_CanIsrStatus_0_CODE
            vLinkGenConstSectionGroupRef = OS_CanIsrStatus_1_CODE
            vLinkGenConstSectionGroupRef = OS_CanIsrWakeup_1_CODE
            vLinkGenConstSectionGroupRef = OS_LinIsr_30_Rh850Rlin_32_0_CODE
            vLinkGenConstSectionGroupRef = OS_INTFICUIF0DFRQPE_CODE
            vLinkGenConstSectionGroupRef = OS_SWC_LOW_CODE
            vLinkGenConstSectionGroupRef = OS_EXT_INTP_CH09_CAT2_ISR_CODE
            vLinkGenConstSectionGroupRef = OS_EXT_INTP_CH20_CAT2_ISR_CODE
            vLinkGenConstSectionGroupRef = OS_vHsmResponseIsr_CODE
        OS_USER_CONST: vLinkGenConstGroupPosition=5, vLinkGenConstGroupRegion=CODE_FLASH_0, vLinkGenConstGroupModule=Os
          OS_USER_CONST (vLinkGenConstSectionGroup):
            vLinkGenConstSectionGroupPosition = 0
            vLinkGenConstSectionGroupInit = NONE
            vLinkGenConstSectionGroupInitStage = ONE
            vLinkGenConstSectionGroupRef = OS_OsApplication_NonTrust_OsCore0_CONST
            vLinkGenConstSectionGroupRef = OS_OsApplication_NonTrust_OsCore0_CONST_FAST
            vLinkGenConstSectionGroupRef = OS_OsApplication_Trust_OsCore0_CONST
            vLinkGenConstSectionGroupRef = OS_OsApplication_Trust_OsCore0_CONST_FAST
        Const_Default: vLinkGenConstGroupPosition=1000, vLinkGenConstGroupRegion=CODE_FLASH_0
          7 x vLinkGenConstSectionGroup, all with vLinkGenConstSectionGroupPosition=0, vLinkGenConstSectionGroupInit=NONE, vLinkGenConstSectionGroupInitStage=ONE:
            text: vLinkGenConstSectionGroupRef=vLinkGenLinkerSections/text, vLinkGenConstSectionGroupRef=vletext, vLinkGenConstSectionGroupRef=syscall, vLinkGenConstSectionGroupRef=fixaddr, vLinkGenConstSectionGroupRef=fixtype, vLinkGenConstSectionGroupRef=picbase, vLinkGenConstSectionGroupRef=pidbase
            secinfo: vLinkGenConstSectionGroupRef=vLinkGenLinkerSections/secinfo
            rodata: vLinkGenConstSectionGroupRef=vLinkGenLinkerSections/rodata
            rosdata: vLinkGenConstSectionGroupRef=vLinkGenLinkerSections/rosdata, vLinkGenConstSectionGroupRef=ldata
            rozdata: vLinkGenConstSectionGroupRef=vLinkGenLinkerSections/rozdata, vLinkGenConstSectionGroupRef=zrodata
            sdata2: vLinkGenConstSectionGroupRef=vLinkGenLinkerSections/sdata2
            tdata: vLinkGenConstSectionGroupRef=vLinkGenLinkerSections/tdata
        Startup_Code: vLinkGenConstGroupPosition=0, vLinkGenConstGroupRegion=CODE_FLASH_0
          Startup_Code (vLinkGenConstSectionGroup):
            vLinkGenConstSectionGroupPosition = 0
            vLinkGenConstSectionGroupInit = NONE
            vLinkGenConstSectionGroupInitStage = ONE
            vLinkGenConstSectionGroupRef = brsStartup
        Startup_Code_Core0: vLinkGenConstGroupPosition=0, vLinkGenConstGroupRegion=BCODE0
          Startup_Code_Core0 (vLinkGenConstSectionGroup):
            vLinkGenConstSectionGroupPosition = 0
            vLinkGenConstSectionGroupInit = NONE
            vLinkGenConstSectionGroupInitStage = ONE
            vLinkGenConstSectionGroupRef = bcode0
      9 x vLinkGenLogicalVarGroup, all with vLinkGenVarGroupRegion=LOCAL_RAM_0:
        OS_DATA_CORE0_VAR: vLinkGenVarGroupInitCore=0, vLinkGenVarGroupPosition=5, vLinkGenVarGroupRomRegion=CODE_FLASH_0, vLinkGenVarGroupModule=Os
          3 x vLinkGenVarSectionGroup, all with vLinkGenVarSectionGroupPosition=0, vLinkGenVarSectionGroupInitStage=ONE:
            OS_DATA_CORE0_VAR_NOINIT: vLinkGenVarSectionGroupInit=NONE, vLinkGenVarSectionGroupRef=OS_CORE0_VAR_NOINIT, vLinkGenVarSectionGroupRef=OS_CORE0_VAR_FAST_NOINIT, vLinkGenVarSectionGroupRef=OS_CORE0_VAR_NOCACHE_NOINIT, vLinkGenVarSectionGroupRef=OS_CORE0_VAR_FAST_NOCACHE_NOINIT, vLinkGenVarSectionGroupRef=OS_SystemApplication_OsCore0_VAR_NOINIT, vLinkGenVarSectionGroupRef=OS_SystemApplication_OsCore0_VAR_NOCACHE_NOINIT, vLinkGenVarSectionGroupRef=OS_SystemApplication_OsCore0_VAR_FAST_NOINIT, vLinkGenVarSectionGroupRef=OS_SystemApplication_OsCore0_VAR_FAST_NOCACHE_NOINIT
            OS_DATA_CORE0_VAR_INIT: vLinkGenVarSectionGroupInit=INIT, vLinkGenVarSectionGroupRef=OS_CORE0_VAR, vLinkGenVarSectionGroupRef=OS_CORE0_VAR_FAST, vLinkGenVarSectionGroupRef=OS_CORE0_VAR_NOCACHE, vLinkGenVarSectionGroupRef=OS_CORE0_VAR_FAST_NOCACHE, vLinkGenVarSectionGroupRef=OS_SystemApplication_OsCore0_VAR, vLinkGenVarSectionGroupRef=OS_SystemApplication_OsCore0_VAR_NOCACHE, vLinkGenVarSectionGroupRef=OS_SystemApplication_OsCore0_VAR_FAST, vLinkGenVarSectionGroupRef=OS_SystemApplication_OsCore0_VAR_FAST_NOCACHE
            OS_DATA_CORE0_VAR_ZERO_INIT: vLinkGenVarSectionGroupInit=ZERO_INIT, vLinkGenVarSectionGroupRef=OS_SystemApplication_OsCore0_VAR_ZERO_INIT, vLinkGenVarSectionGroupRef=OS_SystemApplication_OsCore0_VAR_NOCACHE_ZERO_INIT, vLinkGenVarSectionGroupRef=OS_SystemApplication_OsCore0_VAR_FAST_ZERO_INIT, vLinkGenVarSectionGroupRef=OS_SystemApplication_OsCore0_VAR_FAST_NOCACHE_ZERO_INIT
        OS_STACKS_CORE0_VAR: vLinkGenVarGroupPosition=5, vLinkGenVarGroupModule=Os
          OS_STACKS_CORE0_VAR_NOINIT (vLinkGenVarSectionGroup):
            vLinkGenVarSectionGroupPosition = 0
            vLinkGenVarSectionGroupInit = NONE
            vLinkGenVarSectionGroupInitStage = ONE
            vLinkGenVarSectionGroupRef = OS_STACK_OSCORE0_ERROR_VAR_NOINIT
            vLinkGenVarSectionGroupRef = OS_STACK_OSCORE0_INIT_VAR_NOINIT
            vLinkGenVarSectionGroupRef = OS_STACK_OSCORE0_KERNEL_VAR_NOINIT
            vLinkGenVarSectionGroupRef = OS_STACK_OSCORE0_TASK_PRIO4294967295_VAR_NOINIT
            vLinkGenVarSectionGroupRef = OS_STACK_OSCORE0_ISR_CORE_VAR_NOINIT
            vLinkGenVarSectionGroupRef = OS_STACK_BSW_COMM_VAR_NOINIT
            vLinkGenVarSectionGroupRef = OS_STACK_OSCORE0_TASK_PRIO50_VAR_NOINIT
            vLinkGenVarSectionGroupRef = OS_STACK_OSCORE0_TASK_PRIO49_VAR_NOINIT
            vLinkGenVarSectionGroupRef = OS_STACK_FUEL_TC_ODO_VAR_NOINIT
            vLinkGenVarSectionGroupRef = OS_STACK_OSCORE0_PROTECTION_VAR_NOINIT
            vLinkGenVarSectionGroupRef = OS_STACK_OSCORE0_SHUTDOWN_VAR_NOINIT
            vLinkGenVarSectionGroupRef = OS_STACK_DEFAULT_BSW_VAR_NOINIT
            vLinkGenVarSectionGroupRef = OS_STACK_IPC_VAR_NOINIT
            vLinkGenVarSectionGroupRef = OS_STACK_TT_GEAR_VAR_NOINIT
            vLinkGenVarSectionGroupRef = OS_STACK_SYS_VAR_NOINIT
            vLinkGenVarSectionGroupRef = OS_STACK_BSW_DIAGNOSE_VAR_NOINIT
            vLinkGenVarSectionGroupRef = OS_STACK_DRIVERS_SAFE_VAR_NOINIT
            vLinkGenVarSectionGroupRef = OS_STACK_GATEWAY_VAR_NOINIT
            vLinkGenVarSectionGroupRef = OS_STACK_SWC_LOW_VAR_NOINIT
        OS_DATA_SHARED_VAR: vLinkGenVarGroupInitCore=0, vLinkGenVarGroupPosition=5, vLinkGenVarGroupRomRegion=CODE_FLASH_0, vLinkGenVarGroupModule=Os
          OS_DATA_SHARED_VAR_NOINIT (vLinkGenVarSectionGroup):
            vLinkGenVarSectionGroupPosition = 0
            vLinkGenVarSectionGroupInit = NONE
            vLinkGenVarSectionGroupInitStage = ONE
            vLinkGenVarSectionGroupRef = OS_VAR_NOCACHE_NOINIT
            vLinkGenVarSectionGroupRef = OS_VAR_FAST_NOCACHE_NOINIT
            vLinkGenVarSectionGroupRef = OS_CORESTATUS_CORE0_VAR_NOCACHE_NOINIT
            vLinkGenVarSectionGroupRef = OS_CORESTATUS_CORE0_VAR_FAST_NOCACHE_NOINIT
            vLinkGenVarSectionGroupRef = OS_PUBLIC_CORE0_VAR_NOINIT
            vLinkGenVarSectionGroupRef = OS_PUBLIC_CORE0_VAR_FAST_NOINIT
            vLinkGenVarSectionGroupRef = OS_BARRIER_CORE0_VAR_NOCACHE_NOINIT
            vLinkGenVarSectionGroupRef = OS_BARRIER_CORE0_VAR_FAST_NOCACHE_NOINIT
          OS_DATA_SHARED_VAR_INIT (vLinkGenVarSectionGroup):
            vLinkGenVarSectionGroupPosition = 0
            vLinkGenVarSectionGroupInit = INIT
            vLinkGenVarSectionGroupInitStage = ONE
            vLinkGenVarSectionGroupRef = OS_VAR_NOCACHE
            vLinkGenVarSectionGroupRef = OS_VAR_FAST_NOCACHE
        OS_GLOBALSHARED_VAR: vLinkGenVarGroupInitCore=0, vLinkGenVarGroupPosition=5, vLinkGenVarGroupRomRegion=CODE_FLASH_0, vLinkGenVarGroupModule=Os
          3 x vLinkGenVarSectionGroup, all with vLinkGenVarSectionGroupPosition=0, vLinkGenVarSectionGroupInitStage=ONE:
            OS_GLOBALSHARED_VAR_NOINIT: vLinkGenVarSectionGroupInit=NONE, vLinkGenVarSectionGroupRef=vLinkGenLinkerSections/OS_GLOBALSHARED_VAR_NOINIT, vLinkGenVarSectionGroupRef=OS_GLOBALSHARED_VAR_NOCACHE_NOINIT, vLinkGenVarSectionGroupRef=OS_GLOBALSHARED_VAR_FAST_NOINIT, vLinkGenVarSectionGroupRef=OS_GLOBALSHARED_VAR_FAST_NOCACHE_NOINIT
            OS_GLOBALSHARED_VAR_INIT: vLinkGenVarSectionGroupInit=INIT, vLinkGenVarSectionGroupRef=vLinkGenLinkerSections/OS_GLOBALSHARED_VAR, vLinkGenVarSectionGroupRef=OS_GLOBALSHARED_VAR_NOCACHE, vLinkGenVarSectionGroupRef=OS_GLOBALSHARED_VAR_FAST, vLinkGenVarSectionGroupRef=OS_GLOBALSHARED_VAR_FAST_NOCACHE
            OS_GLOBALSHARED_VAR_ZERO_INIT: vLinkGenVarSectionGroupInit=ZERO_INIT, vLinkGenVarSectionGroupRef=vLinkGenLinkerSections/OS_GLOBALSHARED_VAR_ZERO_INIT, vLinkGenVarSectionGroupRef=OS_GLOBALSHARED_VAR_NOCACHE_ZERO_INIT, vLinkGenVarSectionGroupRef=OS_GLOBALSHARED_VAR_FAST_ZERO_INIT, vLinkGenVarSectionGroupRef=OS_GLOBALSHARED_VAR_FAST_NOCACHE_ZERO_INIT
        Data_Default: vLinkGenVarGroupInitCore=0, vLinkGenVarGroupPosition=1000, vLinkGenVarGroupRomRegion=CODE_FLASH_0
          9 x vLinkGenVarSectionGroup, all with vLinkGenVarSectionGroupPosition=0, vLinkGenVarSectionGroupInitStage=ONE:
            data: vLinkGenVarSectionGroupInit=INIT, vLinkGenVarSectionGroupAlignment=4, vLinkGenVarSectionGroupEndAlignment=4, vLinkGenVarSectionGroupRef=vLinkGenLinkerSections/data
            sdabase: vLinkGenVarSectionGroupInit=NONE, vLinkGenVarSectionGroupRef=vLinkGenLinkerSections/sdabase
            sdata: vLinkGenVarSectionGroupInit=INIT, vLinkGenVarSectionGroupAlignment=4, vLinkGenVarSectionGroupEndAlignment=4, vLinkGenVarSectionGroupRef=vLinkGenLinkerSections/sdata
            zdata: vLinkGenVarSectionGroupInit=INIT, vLinkGenVarSectionGroupAlignment=4, vLinkGenVarSectionGroupEndAlignment=4, vLinkGenVarSectionGroupRef=vLinkGenLinkerSections/zdata, vLinkGenVarSectionGroupRef=PPC_EMB_SDATA0
            bss: vLinkGenVarSectionGroupInit=ZERO_INIT, vLinkGenVarSectionGroupAlignment=4, vLinkGenVarSectionGroupEndAlignment=4, vLinkGenVarSectionGroupRef=vLinkGenLinkerSections/bss, vLinkGenVarSectionGroupRef=COMMON, vLinkGenVarSectionGroupFlag=vLinkGenVarGroupFlags/CLEAR
            sbss: vLinkGenVarSectionGroupInit=ZERO_INIT, vLinkGenVarSectionGroupAlignment=4, vLinkGenVarSectionGroupEndAlignment=4, vLinkGenVarSectionGroupRef=vLinkGenLinkerSections/sbss, vLinkGenVarSectionGroupRef=SMALLCOMMON, vLinkGenVarSectionGroupFlag=vLinkGenVarGroupFlags/CLEAR
            zbss: vLinkGenVarSectionGroupInit=ZERO_INIT, vLinkGenVarSectionGroupAlignment=4, vLinkGenVarSectionGroupEndAlignment=4, vLinkGenVarSectionGroupRef=vLinkGenLinkerSections/zbss, vLinkGenVarSectionGroupRef=PPC_EMB_SBSS0, vLinkGenVarSectionGroupRef=ZEROCOMMON, vLinkGenVarSectionGroupFlag=vLinkGenVarGroupFlags/CLEAR
            stack: vLinkGenVarSectionGroupInit=NONE, vLinkGenVarSectionGroupRef=vLinkGenLinkerSections/stack
            heap: vLinkGenVarSectionGroupAlignment=16, vLinkGenVarSectionGroupSize=1024, vLinkGenVarSectionGroupInit=NONE, vLinkGenVarSectionGroupFlag=vLinkGenVarGroupFlags/NOCLEAR
        STACK_C0: vLinkGenVarGroupInitCore=0, vLinkGenVarGroupPosition=0
          STACK_C0 (vLinkGenVarSectionGroup):
            vLinkGenVarSectionGroupAlignment = 4
            vLinkGenVarSectionGroupEndAlignment = 4
            vLinkGenVarSectionGroupSize = 1024
            vLinkGenVarSectionGroupInit = ZERO_INIT
            vLinkGenVarSectionGroupInitStage = EARLY
            vLinkGenVarSectionGroupPosition = 0
        OS_OsApplication_NonTrust_OsCore0_VAR: vLinkGenVarGroupPosition=0, vLinkGenVarGroupInitCore=0, vLinkGenVarGroupModule=Os, vLinkGenVarGroupRomRegion=CODE_FLASH_0
          3 x vLinkGenVarSectionGroup, all with vLinkGenVarSectionGroupPosition=0, vLinkGenVarSectionGroupInitStage=ONE:
            OS_OsApplication_NonTrust_OsCore0_VAR_NOINIT: vLinkGenVarSectionGroupInit=NONE, vLinkGenVarSectionGroupRef=vLinkGenLinkerSections/OS_OsApplication_NonTrust_OsCore0_VAR_NOINIT, vLinkGenVarSectionGroupRef=OS_OsApplication_NonTrust_OsCore0_VAR_NOCACHE_NOINIT, vLinkGenVarSectionGroupRef=OS_OsApplication_NonTrust_OsCore0_VAR_FAST_NOINIT, vLinkGenVarSectionGroupRef=OS_OsApplication_NonTrust_OsCore0_VAR_FAST_NOCACHE_NOINIT
            OS_OsApplication_NonTrust_OsCore0_VAR_INIT: vLinkGenVarSectionGroupInit=INIT, vLinkGenVarSectionGroupRef=vLinkGenLinkerSections/OS_OsApplication_NonTrust_OsCore0_VAR, vLinkGenVarSectionGroupRef=OS_OsApplication_NonTrust_OsCore0_VAR_NOCACHE, vLinkGenVarSectionGroupRef=OS_OsApplication_NonTrust_OsCore0_VAR_FAST, vLinkGenVarSectionGroupRef=OS_OsApplication_NonTrust_OsCore0_VAR_FAST_NOCACHE
            OS_OsApplication_NonTrust_OsCore0_VAR_ZERO_INIT: vLinkGenVarSectionGroupInit=ZERO_INIT, vLinkGenVarSectionGroupRef=vLinkGenLinkerSections/OS_OsApplication_NonTrust_OsCore0_VAR_ZERO_INIT, vLinkGenVarSectionGroupRef=OS_OsApplication_NonTrust_OsCore0_VAR_NOCACHE_ZERO_INIT, vLinkGenVarSectionGroupRef=OS_OsApplication_NonTrust_OsCore0_VAR_FAST_ZERO_INIT, vLinkGenVarSectionGroupRef=OS_OsApplication_NonTrust_OsCore0_VAR_FAST_NOCACHE_ZERO_INIT
        OS_OsApplication_VAR: vLinkGenVarGroupPosition=0, vLinkGenVarGroupInitCore=0, vLinkGenVarGroupModule=Os, vLinkGenVarGroupRomRegion=LOCAL_RAM_0
          3 x vLinkGenVarSectionGroup, all with vLinkGenVarSectionGroupPosition=0, vLinkGenVarSectionGroupInitStage=ONE:
            OS_OsApplication_VAR_NOINIT: vLinkGenVarSectionGroupInit=NONE
            OS_OsApplication_VAR_INIT: vLinkGenVarSectionGroupInit=INIT
            OS_OsApplication_VAR_ZERO_INIT: vLinkGenVarSectionGroupInit=ZERO_INIT
        OS_OsApplication_Trust_OsCore0_VAR: vLinkGenVarGroupPosition=0, vLinkGenVarGroupInitCore=0, vLinkGenVarGroupModule=Os, vLinkGenVarGroupRomRegion=LOCAL_RAM_0
          3 x vLinkGenVarSectionGroup, all with vLinkGenVarSectionGroupPosition=0, vLinkGenVarSectionGroupInitStage=ONE:
            OS_OsApplication_Trust_OsCore0_VAR_NOINIT: vLinkGenVarSectionGroupInit=NONE, vLinkGenVarSectionGroupRef=vLinkGenLinkerSections/OS_OsApplication_Trust_OsCore0_VAR_NOINIT, vLinkGenVarSectionGroupRef=OS_OsApplication_Trust_OsCore0_VAR_NOCACHE_NOINIT, vLinkGenVarSectionGroupRef=OS_OsApplication_Trust_OsCore0_VAR_FAST_NOINIT, vLinkGenVarSectionGroupRef=OS_OsApplication_Trust_OsCore0_VAR_FAST_NOCACHE_NOINIT
            OS_OsApplication_Trust_OsCore0_VAR_INIT: vLinkGenVarSectionGroupInit=INIT, vLinkGenVarSectionGroupRef=vLinkGenLinkerSections/OS_OsApplication_Trust_OsCore0_VAR, vLinkGenVarSectionGroupRef=OS_OsApplication_Trust_OsCore0_VAR_NOCACHE, vLinkGenVarSectionGroupRef=OS_OsApplication_Trust_OsCore0_VAR_FAST, vLinkGenVarSectionGroupRef=OS_OsApplication_Trust_OsCore0_VAR_FAST_NOCACHE
            OS_OsApplication_Trust_OsCore0_VAR_ZERO_INIT: vLinkGenVarSectionGroupInit=ZERO_INIT, vLinkGenVarSectionGroupRef=vLinkGenLinkerSections/OS_OsApplication_Trust_OsCore0_VAR_ZERO_INIT, vLinkGenVarSectionGroupRef=OS_OsApplication_Trust_OsCore0_VAR_NOCACHE_ZERO_INIT, vLinkGenVarSectionGroupRef=OS_OsApplication_Trust_OsCore0_VAR_FAST_ZERO_INIT, vLinkGenVarSectionGroupRef=OS_OsApplication_Trust_OsCore0_VAR_FAST_NOCACHE_ZERO_INIT
    vLinkGenPublishedInformation: vLinkGenDuplicatedLabels=true, vLinkGenGeneration=2
      vLinkGenConstGroupFlags
        4 x vLinkGenConstGroupFlag:
          ABS
          CLEAR
          NOCLEAR
          NOLOAD
      vLinkGenVarGroupFlags
        4 x vLinkGenVarGroupFlag:
          ABS
          CLEAR
          NOCLEAR
          NOLOAD
    vLinkGenGeneral: vLinkGenFileGeneration=STANDARD
