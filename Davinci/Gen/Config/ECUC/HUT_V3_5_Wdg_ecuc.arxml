AUTOSAR XML (schema 00046)
package /ActiveEcuC
  module config Wdg: implementation-config-variant=VARIANT-POST-BUILD, module-description=Wdg_Impl
    WdgGeneral:
      WdgDevErrorDetect = false
      WdgDisableAllowed = false
      WdgIndex = 0
      WdgInitialTimeout = 5
      WdgMaxTimeout = 5
      WdgRunArea = ROM
      WdgTriggerLocation = NULL
      WdgVersionInfoApi = false
      WdgCriticalSectionProtection = true
      WdgEnableClkImmediateValue = true
      WdgDeviceName = R7F701651
      WdgErrorModeSetting = WDG_RESET_MODE
      WdgWindowSizeSelection = SIZE_100_PERCENT
      WdgRamMirror = DISABLE
      WdgUseWriteVerifyErrorInterface = false
      WdgVaryingActivationCodeMode = DISABLE
      WdgVersionCheckExternalModules = false
      WdgWakeUpFactorClearIsr = false
      WdgWriteVerify = WV_DISABLE
      WdgClockRefImmediateValue = 1875
      WdgClockRef = McuAwoWdta
    WdgPublishedInformation: WdgTriggerMode=WDG_WINDOW
    WdgSettingsConfig: WdgDefaultMode=WDGIF_FAST_MODE
      WdgSettingsFast: WdgClkSettingsFast=WDGCLK_DIVBY_2POWOF_10
      WdgSettingsOff
      WdgSettingsSlow: WdgClkSettingsSlow=WDGCLK_DIVBY_2POWOF_16
