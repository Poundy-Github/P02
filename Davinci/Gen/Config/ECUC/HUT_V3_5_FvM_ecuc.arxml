AUTOSAR XML (schema 00046)
package /ActiveEcuC
  module config FvM: implementation-config-variant=VARIANT-PRE-COMPILE, module-description=FvM_Impl
    FvMGeneral: FvMDevErrorDetect=true, FvMVersionInfoApi=false, FvMSafeBswChecks=false, FvMStartUpAcceptanceTime=0.1, FvMMainFunctionPeriod=0.1
    FvMGeneration:
      FvMOutOfBoundsWriteProtectionStrategy = NONE
      FvMOutOfBoundsWriteSanitizer = false
      FvMOutOfBoundsReadSanitizer = false
      FvMShortSymbols = false
      FvMInterfacesForDeactivatedData = false
      FvMReferringKeysInComments = false
    FvMJasparGeneral:
      FvMTripCounterBitSize = 24
      FvMResetCounterBitSize = 16
      FvMClearAcceptanceWindow = 3
      FvMTxUseDefaultFreshnessValueDuringStartUp = true
      FvMEnableDevelopmentMode = true
      FvMUseDefaultValuesIfOutOfSyncAfterStartUpTime = true
      FvMReturnValueForSameTripResetCounterSyncMessage = E_OK
      FvMTripCounterNvMBlockDescriptor = NvMBlockDescriptor_Fvm_TripCount
    FreshnessValueProcessing_HUT_FD1_Sc_oB30_for_SC_CAN_V3_2_e0e5cc6a_Tx (FvMFreshnessValueTxProcessing): FvMProcessingRef=HUT_FD1_Sc_oB30_for_SC_CAN_V3_2_e0e5cc6a_Tx
      FvMFreshnessValueUseCase
        FvMJasparAttributes: FvMMessageCounterBitSize=22, FvMResetFlagBitSize=2
    FreshnessValueProcessing_HUT15_Sc_oB30_for_SC_CAN_V3_2_d2d608b6_Tx (FvMFreshnessValueTxProcessing): FvMProcessingRef=HUT15_Sc_oB30_for_SC_CAN_V3_2_d2d608b6_Tx
      FvMFreshnessValueUseCase
        FvMJasparAttributes: FvMMessageCounterBitSize=22, FvMResetFlagBitSize=2
    11 x FvMFreshnessValueRxProcessing:
      FreshnessValueProcessing_TPMS2_Sc_oB30_for_SC_CAN_V3_2_c8a12d62_Rx: FvMProcessingRef=TPMS2_Sc_oB30_for_SC_CAN_V3_2_c8a12d62_Rx
        FvMFreshnessValueUseCase
          FvMJasparAttributes: FvMMessageCounterBitSize=22, FvMResetFlagBitSize=2
      FreshnessValueProcessing_TPMS1_Sc_oB30_for_SC_CAN_V3_2_fd4c9b31_Rx: FvMProcessingRef=TPMS1_Sc_oB30_for_SC_CAN_V3_2_fd4c9b31_Rx
        FvMFreshnessValueUseCase
          FvMJasparAttributes: FvMMessageCounterBitSize=22, FvMResetFlagBitSize=2
      FreshnessValueProcessing_R_PBox1_Sc_oB30_for_SC_CAN_V3_2_28fd970b_Rx: FvMProcessingRef=R_PBOX1_Sc_oB30_for_SC_CAN_V3_2_1bc17110_Rx
        FvMFreshnessValueUseCase
          FvMJasparAttributes: FvMMessageCounterBitSize=22, FvMResetFlagBitSize=2
      FreshnessValueProcessing_IFC_FD2_Sc_oB30_for_SC_CAN_V3_2_9b0c0f4a_Rx: FvMProcessingRef=IFC_FD2_Sc_oB30_for_SC_CAN_V3_2_9b0c0f4a_Rx
        FvMFreshnessValueUseCase
          FvMJasparAttributes: FvMMessageCounterBitSize=22, FvMResetFlagBitSize=2
      FreshnessValueProcessing_GW_Sync_Req_Sc_oB30_for_SC_CAN_V3_2_922ee695_Rx: FvMProcessingRef=GW_Sync_Req_Sc_oB30_for_SC_CAN_V3_2_922ee695_Rx
        FvMFreshnessValueUseCase
          FvMSyncMessage
      FreshnessValueProcessing_BCM3_Sc_oB30_for_SC_CAN_V3_2_5f72e2fa_Rx: FvMProcessingRef=BCM3_Sc_oB30_for_SC_CAN_V3_2_5f72e2fa_Rx
        FvMFreshnessValueUseCase
          FvMJasparAttributes: FvMMessageCounterBitSize=22, FvMResetFlagBitSize=2
      FreshnessValueProcessing_BCM1_Sc_oB30_for_SC_CAN_V3_2_cf14c4a7_Rx: FvMProcessingRef=BCM1_Sc_oB30_for_SC_CAN_V3_2_cf14c4a7_Rx
        FvMFreshnessValueUseCase
          FvMJasparAttributes: FvMMessageCounterBitSize=22, FvMResetFlagBitSize=2
      FreshnessValueProcessing_AMP2_Sc_oB30_for_SC_CAN_V3_2_b40eb813_Rx: FvMProcessingRef=AMP2_Sc_oB30_for_SC_CAN_V3_2_b40eb813_Rx
        FvMFreshnessValueUseCase
          FvMJasparAttributes: FvMMessageCounterBitSize=22, FvMResetFlagBitSize=2
      FreshnessValueProcessing_AEB_FD2_Sc_oB30_for_SC_CAN_V3_2_cb95b5fe_Rx: FvMProcessingRef=AEB_FD2_Sc_oB30_for_SC_CAN_V3_2_cb95b5fe_Rx
        FvMFreshnessValueUseCase
          FvMJasparAttributes: FvMMessageCounterBitSize=22, FvMResetFlagBitSize=2
      FreshnessValueProcessing_ACC_FD2_Sc_oB30_for_SC_CAN_V3_2_21d026ea_Rx: FvMProcessingRef=ACC_FD2_Sc_oB30_for_SC_CAN_V3_2_21d026ea_Rx
        FvMFreshnessValueUseCase
          FvMJasparAttributes: FvMMessageCounterBitSize=22, FvMResetFlagBitSize=2
      FreshnessValueProcessing_ABM1_Sc_oB30_for_SC_CAN_V3_2_a346d8c1_Rx: FvMProcessingRef=ABM1_Sc_oB30_for_SC_CAN_V3_2_a346d8c1_Rx
        FvMFreshnessValueUseCase
          FvMJasparAttributes: FvMMessageCounterBitSize=22, FvMResetFlagBitSize=2
    FreshnessValueProcessing_IP2_Sc_oB30_for_SC_CAN_V3_2_bf1dcb66_Tx (FvMFreshnessValueTxProcessing): FvMProcessingRef=IP2_Sc_oB30_for_SC_CAN_V3_2_bf1dcb66_Tx
      FvMFreshnessValueUseCase
        FvMJasparAttributes: FvMMessageCounterBitSize=22, FvMResetFlagBitSize=2
    3 x FvMFreshnessValueRxProcessing:
      FreshnessValueProcessing_ESP_FD2_Sc_oB30_for_SC_CAN_V3_2_49635fc5_Rx: FvMProcessingRef=ESP_FD2_Sc_oB30_for_SC_CAN_V3_2_49635fc5_Rx
        FvMFreshnessValueUseCase
          FvMJasparAttributes: FvMMessageCounterBitSize=22, FvMResetFlagBitSize=2
      FreshnessValueProcessing_T_BOX_FD1_Sc_oB30_for_SC_CAN_V3_2_c35f86d3_Rx: FvMProcessingRef=T_BOX_FD1_Sc_oB30_for_SC_CAN_V3_2_c35f86d3_Rx
        FvMFreshnessValueUseCase
          FvMJasparAttributes: FvMMessageCounterBitSize=22, FvMResetFlagBitSize=2
      FreshnessValueProcessing_T_BOX_FD3_Sc_oB30_for_SC_CAN_V3_2_5339a08e_Rx: FvMProcessingRef=T_BOX_FD3_Sc_oB30_for_SC_CAN_V3_2_5339a08e_Rx
        FvMFreshnessValueUseCase
          FvMJasparAttributes: FvMMessageCounterBitSize=22, FvMResetFlagBitSize=2
