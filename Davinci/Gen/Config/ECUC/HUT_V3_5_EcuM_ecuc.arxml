AUTOSAR XML (schema 00046)
package /ActiveEcuC
  module config EcuM: implementation-config-variant=VARIANT-PRE-COMPILE, module-description=EcuM_Impl
    EcuMConfiguration
      EcuMFlexConfiguration: EcuMFlexModuleConfigurationRef=CanConfigSet, EcuMFlexModuleConfigurationRef=LinGlobalConfig, EcuMNormalMcuModeRef=McuModeSettingConf_normal
        ECUM_CAUSE_UNKNOWN (EcuMShutdownCause): EcuMShutdownCauseId=0
        ECUM_RESET_IO (EcuMResetMode): EcuMResetModeId=2
        ECUM_RESET_MCU (EcuMResetMode): EcuMResetModeId=0
        ECUM_CAUSE_DCM (EcuMShutdownCause): EcuMShutdownCauseId=3
        ECUM_RESET_WAKEUP (EcuMResetMode): EcuMResetModeId=3
        ECUM_CAUSE_ECU_STATE (EcuMShutdownCause): EcuMShutdownCauseId=1
        ECUM_RESET_WDG (EcuMResetMode): EcuMResetModeId=1
        ECUM_CAUSE_WDGM (EcuMShutdownCause): EcuMShutdownCauseId=2
      EcuMCommonConfiguration: EcuMConfigConsistencyHash=6035708958675038996, EcuMDefaultAppMode=OSDEFAULTAPPMODE, EcuMOSResource=OsResource
        ECUM_WKSOURCE_POWER (EcuMWakeupSource): EcuMWakeupSourceId=0, EcuMValidationTimeout=0, EcuMCheckWakeupTimeout=0, EcuMWakeupSourcePolling=false, EcuMResetReasonRef=McuResetReasonConfPOR
        EcuMDriverInitListOne
          10 x EcuMDriverInitItem:
            Port_Init: index=0, EcuMModuleID=Port, EcuMModuleService=Port_Init, EcuMModuleHeader=Port.h
            PduR_PreInit: index=1, EcuMModuleID=PduR, EcuMModuleService=PduR_PreInit, EcuMModuleHeader=PduR.h
            BswM_PreInit: index=2, EcuMModuleID=BswM, EcuMModuleService=BswM_PreInit, EcuMModuleHeader=BswM.h
            Mcu_Init: index=3, EcuMModuleID=Mcu, EcuMModuleService=Mcu_Init, EcuMModuleHeader=Mcu.h
            Mcu_Init_AdditionalCode: index=4, EcuMModuleID=Code, EcuMAdditionalInitCode=Mcu_InitClock(0);while (MCU_PLL_LOCKED != Mcu_GetPllStatus());Mcu_DistributePllClock();, EcuMModuleHeader=Mcu.h
            Icu_Init: index=5, EcuMModuleID=Icu, EcuMModuleService=Icu_Init, EcuMModuleHeader=Icu.h
            Gpt_Init: EcuMModuleID=Gpt, EcuMModuleHeader=Gpt.h, EcuMModuleService=Gpt_Init
            Pwm_Init: EcuMModuleID=Pwm, EcuMModuleService=Pwm_Init, EcuMModuleHeader=Pwm.h
            Spi_Init: EcuMModuleID=Code, EcuMModuleService=, EcuMModuleHeader=Spi.h, EcuMAdditionalInitCode=Spi_Init(SpiConf0_SpiDriver_SpiDriver0);
            ADC_Init: EcuMModuleID=Adc, EcuMModuleService=Adc_Init, EcuMModuleHeader=Adc.h
        4 x EcuMWakeupSource, all with EcuMCheckWakeupTimeout=0:
          ECUM_WKSOURCE_INTERNAL_WDG: EcuMWakeupSourceId=3, EcuMValidationTimeout=0, EcuMWakeupSourcePolling=false, EcuMResetReasonRef=McuResetReasonConfWdta0
          ECUM_WKSOURCE_INTERNAL_RESET: EcuMWakeupSourceId=2, EcuMValidationTimeout=0, EcuMWakeupSourcePolling=false, EcuMResetReasonRef=McuResetReasonConfSwRst
          CN_B30_for_SC_CAN_V3_2_c0d6c67b: EcuMWakeupSourceId=5, EcuMWakeupSourcePolling=true, EcuMValidationTimeout=5, EcuMComMChannelRef=CN_B30_for_SC_CAN_V3_2_c0d6c67b
          ECUM_WKSOURCE_RESET: EcuMWakeupSourceId=1, EcuMValidationTimeout=0, EcuMWakeupSourcePolling=false
        EcuMDefaultShutdownTarget: EcuMDefaultState=EcuMStateSleep, EcuMDefaultSleepModeRef=EcuMSleepMode_NormalSleep
        ECUM_WKSOURCE_EXTERNAL_WDG (EcuMWakeupSource): EcuMWakeupSourceId=4, EcuMValidationTimeout=0, EcuMCheckWakeupTimeout=0, EcuMWakeupSourcePolling=false
        EcuMDriverInitListZero
          18 x EcuMDriverInitItem:
            Lin_InitMemory: index=0, EcuMModuleID=Lin, EcuMModuleService=Lin_InitMemory, EcuMModuleHeader=Lin.h
            CanNm_InitMemory: index=2, EcuMModuleID=CanNm, EcuMModuleService=CanNm_InitMemory, EcuMModuleHeader=CanNm.h
            BswM_InitMemory: index=5, EcuMModuleID=BswM, EcuMModuleService=BswM_InitMemory, EcuMModuleHeader=BswM.h
            Det_InitMemory: index=8, EcuMModuleID=Det, EcuMModuleService=Det_InitMemory, EcuMModuleHeader=Det.h
            Nm_InitMemory: index=9, EcuMModuleID=Nm, EcuMModuleService=Nm_InitMemory, EcuMModuleHeader=Nm.h
            CanTp_InitMemory: index=10, EcuMModuleID=CanTp, EcuMModuleService=CanTp_InitMemory, EcuMModuleHeader=CanTp.h
            Dem_InitMemory: index=11, EcuMModuleID=Dem, EcuMModuleService=Dem_InitMemory, EcuMModuleHeader=Dem.h
            CanIf_InitMemory: index=13, EcuMModuleID=CanIf, EcuMModuleService=CanIf_InitMemory, EcuMModuleHeader=CanIf.h
            Can_InitMemory: index=14, EcuMModuleID=Can, EcuMModuleService=Can_InitMemory, EcuMModuleHeader=Can.h
            CanSM_InitMemory: index=15, EcuMModuleID=CanSM, EcuMModuleService=CanSM_InitMemory, EcuMModuleHeader=CanSM_EcuM.h
            PduR_InitMemory: index=16, EcuMModuleID=PduR, EcuMModuleService=PduR_InitMemory, EcuMModuleHeader=PduR.h
            Det_Init: index=17, EcuMModuleID=Det, EcuMModuleService=Det_Init, EcuMModuleHeader=Det.h
            ComM_InitMemory: index=18, EcuMModuleID=ComM, EcuMModuleService=ComM_InitMemory, EcuMModuleHeader=ComM.h
            LinTrcv_30_Tle7259_InitMemory: index=19, EcuMModuleID=LinTrcv, EcuMModuleService=LinTrcv_30_Tle7259_InitMemory, EcuMModuleHeader=LinTrcv_30_Tle7259.h
            Rte_InitMemory: index=20, EcuMModuleID=Rte, EcuMModuleService=Rte_InitMemory, EcuMModuleHeader=Rte_Main.h
            Com_InitMemory: index=21, EcuMModuleID=Com, EcuMModuleService=Com_InitMemory, EcuMModuleHeader=Com.h
            Dem_PreInit: index=4, EcuMModuleID=Dem, EcuMModuleService=Dem_PreInit, EcuMModuleHeader=Dem.h
            Dcm_InitMemory: index=22, EcuMModuleID=Dcm, EcuMModuleService=Dcm_InitMemory, EcuMModuleHeader=Dcm.h
        EcuMSleepMode_NormalSleep (EcuMSleepMode): EcuMSleepModeId=0, EcuMSleepModeMcuModeRef=McuModeSettingConf_normal, EcuMWakeupSourceMask=CN_B30_for_SC_CAN_V3_2_c0d6c67b
        EcuMSleepMode_LviSleep (EcuMSleepMode): EcuMSleepModeId=1, EcuMSleepModeMcuModeRef=McuModeSettingConf_lvi, EcuMWakeupSourceMask=ECUM_WKSOURCE_LVI
        ECUM_WKSOURCE_LVI (EcuMWakeupSource): EcuMWakeupSourceId=6, EcuMWakeupSourcePolling=false
        ECUM_WKSOURCE_COMMON_WAKEUP (EcuMWakeupSource): EcuMWakeupSourceId=7, EcuMWakeupSourcePolling=false, EcuMResetReasonRef=McuResetReasonConfWakeup
    EcuMGeneral:
      EcuMDevErrorDetect = true
      EcuMIncludeDem = true
      EcuMIncludeDet = true
      EcuMMainFunctionPeriod = 0.01
      EcuMVersionInfoApi = false
      EcuMDeferredBswMNotification = false
      EcuMSlaveCoreHandling = true
      EcuMEnableFixBehavior = false
      EcuMNonChannelWakeupInRun = false
      EcuMGeneration: EcuMOutOfBoundsWriteSanitizer=false, EcuMOutOfBoundsReadSanitizer=false, EcuMInterfacesForDeactivatedData=false
    EcuMFlexGeneral: EcuMAlarmClockPresent=false, EcuMResetLoopDetection=false, EcuMEnableDefBehaviour=false
