AUTOSAR XML (schema 00046)
package /ActiveEcuC
  module config Port: implementation-config-variant=VARIANT-POST-BUILD, module-description=Port_Impl
    PortGeneral0 (PortGeneral):
      PortDevErrorDetect = false
      PortSetPinDirectionApi = true
      PortSetPinDefaultDirectionApi = false
      PortSetPinModeApi = false
      PortSetPinDefaultModeApi = false
      PortVersionInfoApi = false
      PortVersionCheckExternalModules = false
      PortDeviceName = R7F701651
      PortCriticalSectionProtection = true
      PortPinStatusBackUp = false
      PortSetToDioAltModeApi = true
      PortMaxMode = 7
      PortWriteVerify = WV_DISABLE
      PortUseWriteVerifyErrorInterface = false
      PortWriteVerifyErrorInterface = NULL
      PortRAMMirror = DISABLE
      PortUnlockSequenceCount = 20
    PortDemEventParameterRefs0 (PortDemEventParameterRefs): PORT_E_WRITE_TIMEOUT_FAILURE=AutoCreatedDemEvent_PortDemEventParameterRefs_PORT_E_WRITE_TIMEOUT_FAILURE
    PortConfig_Normal (PortConfigSet)
      PortContainer: PortNumberOfPortPins=1
        PortPin:
          PortPinDirection = PORT_PIN_IN
          PortPinDirectionChangeable = false
          PortPinId = 1
          PortPinInitialMode = PORT_PIN_MODE_ADC
          PortPinLevelValue = PORT_PIN_LEVEL_HIGH
          PortPinMode = PORT_PIN_MODE_ADC
          PortPinModeChangeable = false
      PortFilterGroupConfig
      PortGroup08 (PortGroup8)
        SOC_VIP_CSIH1_REQ2 (PortPin0):
          PortBiDirectionControl = false
          PortInputBufferControl = false
          PortInputSelection = TYPE_2_SUPP_PIS
          PortOpenDrainControl = false
          PortPinDioAltModeChangeable = false
          PortPinDirection = PORT_PIN_IN
          PortPinDirectionChangeable = false
          PortPinInitialMode = INTP4_AT3IN
          PortPinLevelValue = PORT_PIN_LEVEL_LOW
          PortPinModeChangeable = false
          PortPullDownOption = false
          PortPullUpOption = false
        SOC_VIP_CSIH2_REQ2 (PortPin1):
          PortBiDirectionControl = false
          PortInputBufferControl = false
          PortInputSelection = TYPE_2_SUPP_PIS
          PortOpenDrainControl = false
          PortPinDioAltModeChangeable = false
          PortPinDirection = PORT_PIN_IN
          PortPinDirectionChangeable = false
          PortPinInitialMode = INTP5_AT3IN
          PortPinLevelValue = PORT_PIN_LEVEL_LOW
          PortPinModeChangeable = false
          PortPullDownOption = false
          PortPullUpOption = false
        VBATT_VIP_DET_EN_3V3 (PortPin2):
          PortBiDirectionControl = false
          PortInputBufferControl = false
          PortInputSelection = TYPE_2_SUPP_PIS
          PortOpenDrainControl = false
          PortPinDioAltModeChangeable = false
          PortPinDirection = PORT_PIN_OUT
          PortPinDirectionChangeable = false
          PortPinInitialMode = DIO_PFC_PFCE_PMCSR
          PortPinLevelValue = PORT_PIN_LEVEL_HIGH
          PortPinModeChangeable = false
          PortPullDownOption = false
          PortPullUpOption = false
        VIP_SOC_EDL_3V3 (PortPin3):
          PortBiDirectionControl = false
          PortInputBufferControl = false
          PortInputSelection = TYPE_2_SUPP_PIS
          PortOpenDrainControl = false
          PortPinDioAltModeChangeable = false
          PortPinDirection = PORT_PIN_OUT
          PortPinDirectionChangeable = false
          PortPinInitialMode = DIO_PFC_PFCE_PMCSR
          PortPinLevelValue = PORT_PIN_LEVEL_LOW
          PortPinModeChangeable = false
          PortPullDownOption = false
          PortPullUpOption = false
        PMIC_VIP_PSHOLD (PortPin4):
          PortBiDirectionControl = false
          PortInputBufferControl = true
          PortInputSelection = TYPE_2_SUPP_PIS
          PortOpenDrainControl = false
          PortPinDioAltModeChangeable = false
          PortPinDirection = PORT_PIN_IN
          PortPinDirectionChangeable = false
          PortPinInitialMode = DIO
          PortPinLevelValue = PORT_PIN_LEVEL_LOW
          PortPinModeChangeable = false
          PortPullDownOption = false
          PortPullUpOption = false
        VIP_8532_DIAG3 (PortPin5):
          PortBiDirectionControl = false
          PortInputBufferControl = true
          PortInputSelection = TYPE_2_SUPP_PIS
          PortOpenDrainControl = false
          PortPinDioAltModeChangeable = false
          PortPinDirection = PORT_PIN_IN
          PortPinDirectionChangeable = false
          PortPinInitialMode = INTP9_AT3IN_PFC_PFCE_PMCSR
          PortPinLevelValue = PORT_PIN_LEVEL_LOW
          PortPinModeChangeable = false
          PortPullDownOption = false
          PortPullUpOption = false
        VIP_WD_enable (PortPin7):
          PortBiDirectionControl = false
          PortInputBufferControl = false
          PortInputSelection = TYPE_2_SUPP_PIS
          PortOpenDrainControl = false
          PortPinDioAltModeChangeable = false
          PortPinDirection = PORT_PIN_OUT
          PortPinDirectionChangeable = false
          PortPinInitialMode = DIO_PFC_PFCE_PMCSR
          PortPinLevelValue = PORT_PIN_LEVEL_LOW
          PortPinModeChangeable = false
          PortPullDownOption = false
          PortPullUpOption = false
        VIP_CAN0_STB (PortPin6):
          PortBiDirectionControl = false
          PortInputBufferControl = false
          PortInputSelection = TYPE_2_SUPP_PIS
          PortOpenDrainControl = false
          PortPinDioAltModeChangeable = false
          PortPinDirection = PORT_PIN_OUT
          PortPinDirectionChangeable = false
          PortPinInitialMode = DIO_PFC_PFCE_PMCSR
          PortPinLevelValue = PORT_PIN_LEVEL_HIGH
          PortPinModeChangeable = false
          PortPullDownOption = false
          PortPullUpOption = false
        VIP_GPS_RXD (PortPin8):
          PortBiDirectionControl = false
          PortInputBufferControl = false
          PortInputSelection = TYPE_2_SUPP_PIS
          PortOpenDrainControl = false
          PortPinDioAltModeChangeable = false
          PortPinDirection = PORT_PIN_IN
          PortPinDirectionChangeable = false
          PortPinInitialMode = RLIN34RX_AT4IN
          PortPinLevelValue = PORT_PIN_LEVEL_LOW
          PortPinModeChangeable = false
          PortPullDownOption = false
          PortPullUpOption = false
        VIP_GPS_TXD (PortPin9):
          PortBiDirectionControl = false
          PortInputBufferControl = false
          PortInputSelection = TYPE_2_SUPP_PIS
          PortOpenDrainControl = false
          PortPinDioAltModeChangeable = true
          PortPinDirection = PORT_PIN_OUT
          PortPinDirectionChangeable = false
          PortPinInitialMode = RLIN34TX_AT4OUT_PFC_PFCE_PMCSR
          PortPinLevelValue = PORT_PIN_LEVEL_LOW
          PortPinModeChangeable = false
          PortPullDownOption = false
          PortPullUpOption = false
        VIP_Gyro_INT2 (PortPin10):
          PortBiDirectionControl = false
          PortInputBufferControl = true
          PortInputSelection = TYPE_2_SUPP_PIS
          PortOpenDrainControl = false
          PortPinDioAltModeChangeable = false
          PortPinDirection = PORT_PIN_IN
          PortPinDirectionChangeable = false
          PortPinInitialMode = DIO
          PortPinLevelValue = PORT_PIN_LEVEL_LOW
          PortPinModeChangeable = false
          PortPullDownOption = false
          PortPullUpOption = false
        VIP_WATCHDOG_WDI (PortPin11):
          PortBiDirectionControl = false
          PortInputBufferControl = true
          PortInputSelection = TYPE_2_SUPP_PIS
          PortOpenDrainControl = false
          PortPinDioAltModeChangeable = false
          PortPinDirection = PORT_PIN_IN
          PortPinDirectionChangeable = true
          PortPinInitialMode = DIO_PFC_PFCE_PMCSR
          PortPinLevelValue = PORT_PIN_LEVEL_LOW
          PortPinModeChangeable = false
          PortPullDownOption = false
          PortPullUpOption = false
        VIP_ON_IDH (PortPin12):
          PortBiDirectionControl = false
          PortInputBufferControl = true
          PortInputSelection = TYPE_2_SUPP_PIS
          PortOpenDrainControl = false
          PortPinDioAltModeChangeable = false
          PortPinDirection = PORT_PIN_IN
          PortPinDirectionChangeable = false
          PortPinInitialMode = DIO_PFC_PFCE_PMCSR
          PortPinLevelValue = PORT_PIN_LEVEL_LOW
          PortPinModeChangeable = false
          PortPullDownOption = false
          PortPullUpOption = false
      PortGroup10
        SOC_VIP_CSIH1_SI (PortPin0):
          PortBiDirectionControl = false
          PortDriveStrengthControl = false
          PortInputBufferControl = false
          PortInputSelection = TYPE_2_SUPP_PIS
          PortIpControl = false
          PortOpenDrainControl = false
          PortPinDioAltModeChangeable = false
          PortPinDirection = PORT_PIN_IN
          PortPinDirectionChangeable = false
          PortPinInitialMode = CSIH1SI_AT5IN
          PortPinLevelValue = PORT_PIN_LEVEL_LOW
          PortPinModeChangeable = false
          PortPullDownOption = false
          PortPullUpOption = false
        SOC_VIP_CSIH1_SC (PortPin1):
          PortBiDirectionControl = false
          PortDriveStrengthControl = false
          PortInputBufferControl = false
          PortInputSelection = TYPE_2_SUPP_PIS
          PortIpControl = true
          PortOpenDrainControl = false
          PortPinDioAltModeChangeable = false
          PortPinDirection = PORT_PIN_IN
          PortPinDirectionChangeable = false
          PortPinInitialMode = CSIH1SC_AT5IN
          PortPinLevelValue = PORT_PIN_LEVEL_LOW
          PortPinModeChangeable = false
          PortPullDownOption = false
          PortPullUpOption = false
        SOC_VIP_CSIH1_SO (PortPin2):
          PortBiDirectionControl = false
          PortDriveStrengthControl = false
          PortInputBufferControl = false
          PortInputSelection = TYPE_2_SUPP_PIS
          PortIpControl = true
          PortOpenDrainControl = false
          PortPinDioAltModeChangeable = false
          PortPinDirection = PORT_PIN_IN
          PortPinDirectionChangeable = false
          PortPinInitialMode = CSIH1SO_AT5OUT
          PortPinLevelValue = PORT_PIN_LEVEL_LOW
          PortPinModeChangeable = false
          PortPullDownOption = false
          PortPullUpOption = false
        VIP_SOC_UPDATA (PortPin3):
          PortBiDirectionControl = false
          PortDriveStrengthControl = false
          PortInputBufferControl = false
          PortInputSelection = TYPE_2_SUPP_PIS
          PortIpControl = false
          PortOpenDrainControl = false
          PortPinDioAltModeChangeable = false
          PortPinDirection = PORT_PIN_OUT
          PortPinDirectionChangeable = false
          PortPinInitialMode = DIO
          PortPinLevelValue = PORT_PIN_LEVEL_LOW
          PortPinModeChangeable = false
          PortPullDownOption = false
          PortPullUpOption = false
        VIP_SOC_SHUTDOWN (PortPin4):
          PortBiDirectionControl = false
          PortDriveStrengthControl = false
          PortInputBufferControl = false
          PortInputSelection = TYPE_2_SUPP_PIS
          PortIpControl = false
          PortOpenDrainControl = false
          PortPinDioAltModeChangeable = false
          PortPinDirection = PORT_PIN_OUT
          PortPinDirectionChangeable = false
          PortPinInitialMode = DIO
          PortPinLevelValue = PORT_PIN_LEVEL_LOW
          PortPinModeChangeable = false
          PortPullDownOption = false
          PortPullUpOption = false
        SOC_VIP_CSIH1_CS (PortPin6):
          PortBiDirectionControl = false
          PortDriveStrengthControl = false
          PortInputBufferControl = false
          PortInputSelection = TYPE_2_SUPP_PIS
          PortIpControl = false
          PortOpenDrainControl = false
          PortPinDioAltModeChangeable = false
          PortPinDirection = PORT_PIN_IN
          PortPinDirectionChangeable = false
          PortPinInitialMode = TAUD0I13_AT1IN
          PortPinLevelValue = PORT_PIN_LEVEL_LOW
          PortPinModeChangeable = false
          PortPullDownOption = false
          PortPullUpOption = false
        SOC_VIP_CSIH2_CS (PortPin7):
          PortBiDirectionControl = false
          PortDriveStrengthControl = false
          PortInputBufferControl = false
          PortInputSelection = TYPE_2_SUPP_PIS
          PortIpControl = false
          PortOpenDrainControl = false
          PortPinDioAltModeChangeable = false
          PortPinDirection = PORT_PIN_IN
          PortPinDirectionChangeable = false
          PortPinInitialMode = TAUD0I15_AT1IN
          PortPinLevelValue = PORT_PIN_LEVEL_LOW
          PortPinModeChangeable = false
          PortPullDownOption = false
          PortPullUpOption = false
        SI479XX_VIP_INT_3V3 (PortPin9):
          PortBiDirectionControl = false
          PortDriveStrengthControl = false
          PortInputBufferControl = true
          PortInputSelection = TYPE_2_SUPP_PIS
          PortIpControl = false
          PortOpenDrainControl = false
          PortPinDioAltModeChangeable = false
          PortPinDirection = PORT_PIN_IN
          PortPinDirectionChangeable = false
          PortPinInitialMode = DIO
          PortPinLevelValue = PORT_PIN_LEVEL_LOW
          PortPinModeChangeable = false
          PortPullDownOption = false
          PortPullUpOption = false
        VIP_SOC_CSIH1_REQ1 (PortPin10):
          PortBiDirectionControl = false
          PortDriveStrengthControl = false
          PortInputBufferControl = false
          PortInputSelection = TYPE_2_SUPP_PIS
          PortIpControl = false
          PortOpenDrainControl = false
          PortPinDioAltModeChangeable = false
          PortPinDirection = PORT_PIN_OUT
          PortPinDirectionChangeable = false
          PortPinInitialMode = DIO
          PortPinLevelValue = PORT_PIN_LEVEL_LOW
          PortPinModeChangeable = false
          PortPullDownOption = false
          PortPullUpOption = false
        VIP_VD3V3_SYNC (PortPin11):
          PortBiDirectionControl = false
          PortDriveStrengthControl = false
          PortInputBufferControl = false
          PortInputSelection = TYPE_2_SUPP_PIS
          PortIpControl = false
          PortOpenDrainControl = false
          PortPinDioAltModeChangeable = false
          PortPinDirection = PORT_PIN_OUT
          PortPinDirectionChangeable = false
          PortPinInitialMode = TAUB0O1_AT4OUT
          PortPinLevelValue = PORT_PIN_LEVEL_LOW
          PortPinModeChangeable = false
          PortPullDownOption = false
          PortPullUpOption = false
        VIP_20098_EN (PortPin12):
          PortBiDirectionControl = false
          PortDriveStrengthControl = false
          PortInputBufferControl = false
          PortInputSelection = TYPE_2_SUPP_PIS
          PortIpControl = false
          PortOpenDrainControl = false
          PortPinDioAltModeChangeable = false
          PortPinDirection = PORT_PIN_OUT
          PortPinDirectionChangeable = false
          PortPinInitialMode = DIO
          PortPinLevelValue = PORT_PIN_LEVEL_LOW
          PortPinModeChangeable = false
          PortPullDownOption = false
          PortPullUpOption = false
        VIP_20098_PG (PortPin13):
          PortBiDirectionControl = false
          PortDriveStrengthControl = false
          PortInputBufferControl = true
          PortInputSelection = TYPE_2_SUPP_PIS
          PortIpControl = false
          PortOpenDrainControl = false
          PortPinDioAltModeChangeable = false
          PortPinDirection = PORT_PIN_IN
          PortPinDirectionChangeable = false
          PortPinInitialMode = DIO
          PortPinLevelValue = PORT_PIN_LEVEL_LOW
          PortPinModeChangeable = false
          PortPullDownOption = false
          PortPullUpOption = false
        VIP_SOC_CSIH2_REQ1 (PortPin14):
          PortBiDirectionControl = false
          PortDriveStrengthControl = false
          PortInputBufferControl = false
          PortInputSelection = TYPE_2_SUPP_PIS
          PortIpControl = false
          PortOpenDrainControl = false
          PortPinDioAltModeChangeable = false
          PortPinDirection = PORT_PIN_OUT
          PortPinDirectionChangeable = false
          PortPinInitialMode = DIO
          PortPinLevelValue = PORT_PIN_LEVEL_LOW
          PortPinModeChangeable = false
          PortPullDownOption = false
          PortPullUpOption = false
        VIP_OPL_IDL (PortPin15):
          PortBiDirectionControl = false
          PortDriveStrengthControl = false
          PortInputBufferControl = true
          PortInputSelection = TYPE_2_SUPP_PIS
          PortOpenDrainControl = false
          PortPinDioAltModeChangeable = false
          PortPinDirection = PORT_PIN_IN
          PortPinDirectionChangeable = false
          PortPinInitialMode = DIO
          PortPinLevelValue = PORT_PIN_LEVEL_LOW
          PortPinModeChangeable = false
          PortPullDownOption = false
          PortPullUpOption = false
        VIP_MIC_res_key (PortPin5):
          PortBiDirectionControl = false
          PortDriveStrengthControl = false
          PortInputBufferControl = false
          PortInputSelection = TYPE_2_SUPP_PIS
          PortIpControl = false
          PortOpenDrainControl = false
          PortPinDioAltModeChangeable = false
          PortPinDirection = PORT_PIN_OUT
          PortPinDirectionChangeable = false
          PortPinInitialMode = DIO
          PortPinLevelValue = PORT_PIN_LEVEL_LOW
          PortPinModeChangeable = false
          PortPullDownOption = false
          PortPullUpOption = false
      PortGroup00 (PortGroup0)
        VIP_I2C0_SDA (PortPin11):
          PortBiDirectionControl = true
          PortDriveStrengthControl = false
          PortInputBufferControl = true
          PortInputSelection = TYPE_2_SUPP_PIS
          PortOpenDrainControl = true
          PortPinDioAltModeChangeable = false
          PortPinDirection = PORT_PIN_IN
          PortPinDirectionChangeable = true
          PortPinInitialMode = RIIC0SDA_AT1IN_PFC_PFCE_PMCSR
          PortPinLevelValue = PORT_PIN_LEVEL_LOW
          PortPinModeChangeable = false
          PortPullDownOption = false
          PortPullUpOption = false
        VIP_I2C0_SCL (PortPin12):
          PortBiDirectionControl = true
          PortDriveStrengthControl = false
          PortInputBufferControl = false
          PortInputSelection = TYPE_2_SUPP_PIS
          PortOpenDrainControl = true
          PortPinDioAltModeChangeable = false
          PortPinDirection = PORT_PIN_OUT
          PortPinDirectionChangeable = true
          PortPinInitialMode = RIIC0SCL_AT1OUT_PFC_PFCE_PMCSR
          PortPinLevelValue = PORT_PIN_LEVEL_LOW
          PortPinModeChangeable = false
          PortPullDownOption = false
          PortPullUpOption = false
        VIP_CAN0_TXD (PortPin0):
          PortBiDirectionControl = false
          PortDriveStrengthControl = false
          PortInputBufferControl = false
          PortInputSelection = TYPE_2_SUPP_PIS
          PortOpenDrainControl = false
          PortPinDioAltModeChangeable = false
          PortPinDirection = PORT_PIN_OUT
          PortPinDirectionChangeable = false
          PortPinInitialMode = CAN0TX_AT2OUT
          PortPinLevelValue = PORT_PIN_LEVEL_LOW
          PortPinModeChangeable = false
          PortPullDownOption = false
          PortPullUpOption = false
        VIP_CAN0_RXD (PortPin1):
          PortBiDirectionControl = false
          PortDriveStrengthControl = false
          PortInputBufferControl = false
          PortInputSelection = TYPE_2_SUPP_PIS
          PortOpenDrainControl = false
          PortPinDioAltModeChangeable = false
          PortPinDirection = PORT_PIN_IN
          PortPinDirectionChangeable = false
          PortPinInitialMode = CAN0RX_AT2IN
          PortPinLevelValue = PORT_PIN_LEVEL_LOW
          PortPinModeChangeable = false
          PortPullDownOption = false
          PortPullUpOption = false
        VIP_CAN1_RXD (PortPin2):
          PortBiDirectionControl = false
          PortDriveStrengthControl = false
          PortInputBufferControl = false
          PortInputSelection = TYPE_2_SUPP_PIS
          PortIpControl = false
          PortOpenDrainControl = false
          PortPinDioAltModeChangeable = false
          PortPinDirection = PORT_PIN_IN
          PortPinDirectionChangeable = false
          PortPinInitialMode = CAN1RX_AT2IN
          PortPinLevelValue = PORT_PIN_LEVEL_LOW
          PortPinModeChangeable = false
          PortPullDownOption = false
          PortPullUpOption = false
        VIP_CAN1_TXD (PortPin3):
          PortBiDirectionControl = false
          PortDriveStrengthControl = false
          PortInputBufferControl = false
          PortInputSelection = TYPE_2_SUPP_PIS
          PortIpControl = false
          PortOpenDrainControl = false
          PortPinDioAltModeChangeable = false
          PortPinDirection = PORT_PIN_OUT
          PortPinDirectionChangeable = false
          PortPinInitialMode = CAN1TX_AT2OUT
          PortPinLevelValue = PORT_PIN_LEVEL_LOW
          PortPinModeChangeable = false
          PortPullDownOption = false
          PortPullUpOption = false
        VIP_RLIN31_RXD (PortPin4):
          PortBiDirectionControl = false
          PortDriveStrengthControl = false
          PortInputBufferControl = false
          PortInputSelection = TYPE_2_SUPP_PIS
          PortOpenDrainControl = false
          PortPinDioAltModeChangeable = false
          PortPinDirection = PORT_PIN_IN
          PortPinDirectionChangeable = false
          PortPinInitialMode = RLIN31RX_AT1IN
          PortPinLevelValue = PORT_PIN_LEVEL_LOW
          PortPinModeChangeable = false
          PortPullDownOption = false
          PortPullUpOption = false
        VIP_RLIN31_TXD (PortPin5):
          PortBiDirectionControl = false
          PortDriveStrengthControl = false
          PortInputBufferControl = false
          PortInputSelection = TYPE_2_SUPP_PIS
          PortIpControl = false
          PortOpenDrainControl = false
          PortPinDioAltModeChangeable = false
          PortPinDirection = PORT_PIN_OUT
          PortPinDirectionChangeable = false
          PortPinInitialMode = RLIN31TX_AT1OUT
          PortPinLevelValue = PORT_PIN_LEVEL_LOW
          PortPinModeChangeable = false
          PortPullDownOption = false
          PortPullUpOption = false
        VIP_Gyro_INT1 (PortPin6):
          PortBiDirectionControl = false
          PortDriveStrengthControl = false
          PortInputBufferControl = true
          PortInputSelection = TYPE_2_SUPP_PIS
          PortIpControl = false
          PortOpenDrainControl = false
          PortPinDioAltModeChangeable = false
          PortPinDirection = PORT_PIN_IN
          PortPinDirectionChangeable = false
          PortPinInitialMode = DIO
          PortPinLevelValue = PORT_PIN_LEVEL_LOW
          PortPinModeChangeable = false
          PortPullDownOption = false
          PortPullUpOption = false
        VIP_CAN3_RXD (PortPin7):
          PortBiDirectionControl = false
          PortDriveStrengthControl = false
          PortInputBufferControl = false
          PortInputSelection = TYPE_2_SUPP_PIS
          PortOpenDrainControl = false
          PortPinDioAltModeChangeable = false
          PortPinDirection = PORT_PIN_IN
          PortPinDirectionChangeable = false
          PortPinInitialMode = CAN3RX_AT5IN
          PortPinLevelValue = PORT_PIN_LEVEL_LOW
          PortPinModeChangeable = false
          PortPullDownOption = false
          PortPullUpOption = false
        VIP_CAN3_TXD (PortPin8):
          PortBiDirectionControl = false
          PortDriveStrengthControl = false
          PortInputBufferControl = false
          PortInputSelection = TYPE_2_SUPP_PIS
          PortOpenDrainControl = false
          PortPinDioAltModeChangeable = false
          PortPinDirection = PORT_PIN_OUT
          PortPinDirectionChangeable = false
          PortPinInitialMode = CAN3TX_AT5OUT
          PortPinLevelValue = PORT_PIN_LEVEL_LOW
          PortPinModeChangeable = false
          PortPullDownOption = false
          PortPullUpOption = false
        VIP_ChargeEN_ODH (PortPin9):
          PortBiDirectionControl = false
          PortDriveStrengthControl = false
          PortInputBufferControl = false
          PortInputSelection = TYPE_2_SUPP_PIS
          PortOpenDrainControl = false
          PortPinDioAltModeChangeable = false
          PortPinDirection = PORT_PIN_OUT
          PortPinDirectionChangeable = false
          PortPinInitialMode = DIO
          PortPinLevelValue = PORT_PIN_LEVEL_LOW
          PortPinModeChangeable = false
          PortPullDownOption = false
          PortPullUpOption = false
        VIP_CAN3_STB (PortPin10):
          PortBiDirectionControl = false
          PortDriveStrengthControl = false
          PortInputBufferControl = false
          PortInputSelection = TYPE_2_SUPP_PIS
          PortOpenDrainControl = false
          PortPinDioAltModeChangeable = false
          PortPinDirection = PORT_PIN_OUT
          PortPinDirectionChangeable = false
          PortPinInitialMode = DIO
          PortPinLevelValue = PORT_PIN_LEVEL_LOW
          PortPinModeChangeable = false
          PortPullDownOption = false
          PortPullUpOption = false
        VIP_RLIN32_RXD (PortPin13):
          PortBiDirectionControl = false
          PortDriveStrengthControl = false
          PortInputBufferControl = false
          PortInputSelection = TYPE_2_SUPP_PIS
          PortIpControl = false
          PortOpenDrainControl = false
          PortPinDioAltModeChangeable = false
          PortPinDirection = PORT_PIN_IN
          PortPinDirectionChangeable = false
          PortPinInitialMode = RLIN32RX_AT1IN
          PortPinLevelValue = PORT_PIN_LEVEL_LOW
          PortPinModeChangeable = false
          PortPullDownOption = false
          PortPullUpOption = false
        VIP_RLIN32_TXD (PortPin14):
          PortBiDirectionControl = false
          PortDriveStrengthControl = false
          PortInputBufferControl = false
          PortInputSelection = TYPE_2_SUPP_PIS
          PortIpControl = false
          PortOpenDrainControl = false
          PortPinDioAltModeChangeable = false
          PortPinDirection = PORT_PIN_OUT
          PortPinDirectionChangeable = false
          PortPinInitialMode = RLIN32TX_AT1OUT
          PortPinLevelValue = PORT_PIN_LEVEL_LOW
          PortPinModeChangeable = false
          PortPullDownOption = false
          PortPullUpOption = false
      PortGroupAnalog1
        MIC_VIP_SENS1 (PortPin0):
          PortBiDirectionControl = false
          PortInputBufferControl = false
          PortPinDirection = PORT_PIN_IN
          PortPinDirectionChangeable = false
          PortPinInitialMode = ALT_NOT_SUPPORTED
          PortPinLevelValue = PORT_PIN_LEVEL_LOW
        MIC_VIP_SENS2 (PortPin1):
          PortBiDirectionControl = false
          PortInputBufferControl = false
          PortPinDirection = PORT_PIN_IN
          PortPinDirectionChangeable = false
          PortPinInitialMode = ALT_NOT_SUPPORTED
          PortPinLevelValue = PORT_PIN_LEVEL_LOW
        MIC_VIP_SENS1_N (PortPin2):
          PortBiDirectionControl = false
          PortInputBufferControl = false
          PortPinDirection = PORT_PIN_IN
          PortPinDirectionChangeable = false
          PortPinInitialMode = ALT_NOT_SUPPORTED
          PortPinLevelValue = PORT_PIN_LEVEL_LOW
        MIC_VIP_SENS2_N (PortPin3):
          PortBiDirectionControl = false
          PortInputBufferControl = false
          PortPinDirection = PORT_PIN_IN
          PortPinDirectionChangeable = false
          PortPinInitialMode = ALT_NOT_SUPPORTED
          PortPinLevelValue = PORT_PIN_LEVEL_LOW
        VIP_ETN_0_9V_EN (PortPin10):
          PortBiDirectionControl = false
          PortInputBufferControl = false
          PortPinDirection = PORT_PIN_OUT
          PortPinDirectionChangeable = false
          PortPinInitialMode = ALT_NOT_SUPPORTED
          PortPinLevelValue = PORT_PIN_LEVEL_LOW
        VIP_ETN_2_5V_EN (PortPin11):
          PortBiDirectionControl = false
          PortInputBufferControl = false
          PortPinDirection = PORT_PIN_OUT
          PortPinDirectionChangeable = false
          PortPinInitialMode = ALT_NOT_SUPPORTED
          PortPinLevelValue = PORT_PIN_LEVEL_LOW
        SXM_VIP_CTI (PortPin12):
          PortBiDirectionControl = false
          PortInputBufferControl = true
          PortPinDirection = PORT_PIN_IN
          PortPinDirectionChangeable = false
          PortPinInitialMode = ALT_NOT_SUPPORTED
          PortPinLevelValue = PORT_PIN_LEVEL_LOW
        SXM_VIP_FACT (PortPin13):
          PortBiDirectionControl = false
          PortInputBufferControl = true
          PortPinDirection = PORT_PIN_IN
          PortPinDirectionChangeable = false
          PortPinInitialMode = ALT_NOT_SUPPORTED
          PortPinLevelValue = PORT_PIN_LEVEL_LOW
        Tuner_VIP_debug1 (PortPin14):
          PortBiDirectionControl = false
          PortInputBufferControl = true
          PortPinDirection = PORT_PIN_IN
          PortPinDirectionChangeable = false
          PortPinInitialMode = ALT_NOT_SUPPORTED
          PortPinLevelValue = PORT_PIN_LEVEL_LOW
        Tuner_VIP_debug2 (PortPin15):
          PortBiDirectionControl = false
          PortInputBufferControl = true
          PortPinDirection = PORT_PIN_IN
          PortPinDirectionChangeable = false
          PortPinInitialMode = ALT_NOT_SUPPORTED
          PortPinLevelValue = PORT_PIN_LEVEL_LOW
      PortGroup11
        VIP_BSF_IDL (PortPin0):
          PortBiDirectionControl = false
          PortDriveStrengthControl = false
          PortInputBufferControl = true
          PortInputSelection = TYPE_2_SUPP_PIS
          PortOpenDrainControl = false
          PortPinDioAltModeChangeable = false
          PortPinDirection = PORT_PIN_IN
          PortPinDirectionChangeable = false
          PortPinInitialMode = DIO
          PortPinLevelValue = PORT_PIN_LEVEL_LOW
          PortPinModeChangeable = false
          PortPullDownOption = false
          PortPullUpOption = false
        VIP_AMP8532_DIAG3 (PortPin1):
          PortBiDirectionControl = false
          PortDriveStrengthControl = false
          PortInputBufferControl = true
          PortInputSelection = TYPE_2_SUPP_PIS
          PortIpControl = false
          PortOpenDrainControl = false
          PortPinDioAltModeChangeable = false
          PortPinDirection = PORT_PIN_IN
          PortPinDirectionChangeable = false
          PortPinInitialMode = INTP20_AT3IN
          PortPinLevelValue = PORT_PIN_LEVEL_LOW
          PortPinModeChangeable = false
          PortPullDownOption = false
          PortPullUpOption = false
        SOC_VIP_CSIH2_SO (PortPin2):
          PortBiDirectionControl = false
          PortDriveStrengthControl = false
          PortInputBufferControl = false
          PortInputSelection = TYPE_2_SUPP_PIS
          PortIpControl = true
          PortOpenDrainControl = false
          PortPinDioAltModeChangeable = false
          PortPinDirection = PORT_PIN_IN
          PortPinDirectionChangeable = false
          PortPinInitialMode = CSIH2SO_AT1OUT
          PortPinLevelValue = PORT_PIN_LEVEL_LOW
          PortPinModeChangeable = false
          PortPullDownOption = false
          PortPullUpOption = false
        SOC_VIP_CSIH2_SC (PortPin3):
          PortBiDirectionControl = false
          PortDriveStrengthControl = false
          PortInputBufferControl = false
          PortInputSelection = TYPE_2_SUPP_PIS
          PortIpControl = true
          PortOpenDrainControl = false
          PortPinDioAltModeChangeable = false
          PortPinDirection = PORT_PIN_IN
          PortPinDirectionChangeable = false
          PortPinInitialMode = CSIH2SC_AT1IN
          PortPinLevelValue = PORT_PIN_LEVEL_LOW
          PortPinModeChangeable = false
          PortPullDownOption = false
          PortPullUpOption = false
        SOC_VIP_CSIH2_SI (PortPin4):
          PortBiDirectionControl = false
          PortDriveStrengthControl = false
          PortInputBufferControl = false
          PortInputSelection = TYPE_2_SUPP_PIS
          PortIpControl = false
          PortOpenDrainControl = false
          PortPinDioAltModeChangeable = false
          PortPinDirection = PORT_PIN_IN
          PortPinDirectionChangeable = false
          PortPinInitialMode = CSIH2SI_AT1IN
          PortPinLevelValue = PORT_PIN_LEVEL_LOW
          PortPinModeChangeable = false
          PortPullDownOption = false
          PortPullUpOption = false
        VIP_47961_RST_3V3 (PortPin8):
          PortBiDirectionControl = false
          PortDriveStrengthControl = false
          PortInputBufferControl = false
          PortInputSelection = TYPE_2_SUPP_PIS
          PortOpenDrainControl = false
          PortPinDioAltModeChangeable = false
          PortPinDirection = PORT_PIN_OUT
          PortPinDirectionChangeable = false
          PortPinInitialMode = DIO_PFC_PFCE_PMCSR
          PortPinLevelValue = PORT_PIN_LEVEL_LOW
          PortPinModeChangeable = false
          PortPullDownOption = false
          PortPullUpOption = false
        SI4624_VIP_INT_3V3 (PortPin9):
          PortBiDirectionControl = false
          PortDriveStrengthControl = false
          PortInputBufferControl = true
          PortInputSelection = TYPE_2_SUPP_PIS
          PortIpControl = false
          PortOpenDrainControl = false
          PortPinDioAltModeChangeable = false
          PortPinDirection = PORT_PIN_IN
          PortPinDirectionChangeable = false
          PortPinInitialMode = DIO
          PortPinLevelValue = PORT_PIN_LEVEL_LOW
          PortPinModeChangeable = false
          PortPullDownOption = false
          PortPullUpOption = false
        VIP_MIC_POWER_EN_3V3 (PortPin10):
          PortBiDirectionControl = false
          PortDriveStrengthControl = false
          PortInputBufferControl = false
          PortInputSelection = TYPE_2_SUPP_PIS
          PortIpControl = false
          PortOpenDrainControl = false
          PortPinDioAltModeChangeable = false
          PortPinDirection = PORT_PIN_OUT
          PortPinDirectionChangeable = false
          PortPinInitialMode = DIO
          PortPinLevelValue = PORT_PIN_LEVEL_LOW
          PortPinModeChangeable = false
          PortPullDownOption = false
          PortPullUpOption = false
        VIP_TUNER_ANT_EN_3V3 (PortPin11):
          PortBiDirectionControl = false
          PortDriveStrengthControl = false
          PortInputBufferControl = false
          PortInputSelection = TYPE_2_SUPP_PIS
          PortOpenDrainControl = false
          PortPinDioAltModeChangeable = false
          PortPinDirection = PORT_PIN_OUT
          PortPinDirectionChangeable = false
          PortPinInitialMode = DIO
          PortPinLevelValue = PORT_PIN_LEVEL_LOW
          PortPinModeChangeable = false
          PortPullDownOption = false
          PortPullUpOption = false
        VIP_ETN_1V_PWR_EN (PortPin12):
          PortBiDirectionControl = false
          PortDriveStrengthControl = false
          PortInputBufferControl = false
          PortInputSelection = TYPE_2_SUPP_PIS
          PortOpenDrainControl = false
          PortPinDioAltModeChangeable = false
          PortPinDirection = PORT_PIN_OUT
          PortPinDirectionChangeable = false
          PortPinInitialMode = DIO
          PortPinLevelValue = PORT_PIN_LEVEL_LOW
          PortPinModeChangeable = false
          PortPullDownOption = false
          PortPullUpOption = false
        VIP_VG1V2_EN (PortPin15):
          PortBiDirectionControl = false
          PortDriveStrengthControl = false
          PortInputBufferControl = false
          PortInputSelection = TYPE_2_SUPP_PIS
          PortOpenDrainControl = false
          PortPinDioAltModeChangeable = false
          PortPinDirection = PORT_PIN_OUT
          PortPinDirectionChangeable = false
          PortPinInitialMode = DIO
          PortPinLevelValue = PORT_PIN_LEVEL_LOW
          PortPinModeChangeable = false
          PortPullDownOption = false
          PortPullUpOption = false
      PortGroup01 (PortGroup1)
        VIP_RLIN32_INH (PortPin3):
          PortBiDirectionControl = false
          PortDriveStrengthControl = false
          PortInputBufferControl = false
          PortInputSelection = TYPE_2_SUPP_PIS
          PortOpenDrainControl = false
          PortPinDioAltModeChangeable = false
          PortPinDirection = PORT_PIN_IN
          PortPinDirectionChangeable = false
          PortPinInitialMode = INTP19_AT1IN_PFC_PFCE_PMCSR
          PortPinLevelValue = PORT_PIN_LEVEL_LOW
          PortPinModeChangeable = false
          PortPullDownOption = false
          PortPullUpOption = false
        VIP_SI_IDH (PortPin0):
          PortBiDirectionControl = false
          PortDriveStrengthControl = false
          PortInputBufferControl = false
          PortInputSelection = TYPE_2_SUPP_PIS
          PortOpenDrainControl = false
          PortPinDioAltModeChangeable = false
          PortPinDirection = PORT_PIN_IN
          PortPinDirectionChangeable = false
          PortPinInitialMode = INTP13_AT2IN
          PortPinLevelValue = PORT_PIN_LEVEL_LOW
          PortPinModeChangeable = false
          PortPullDownOption = false
          PortPullUpOption = false
        VIP_RLIN31_INH (PortPin1):
          PortBiDirectionControl = false
          PortDriveStrengthControl = false
          PortInputBufferControl = false
          PortInputSelection = TYPE_2_SUPP_PIS
          PortOpenDrainControl = false
          PortPinDioAltModeChangeable = false
          PortPinDirection = PORT_PIN_IN
          PortPinDirectionChangeable = false
          PortPinInitialMode = INTP18_AT1IN_PFC_PFCE_PMCSR
          PortPinLevelValue = PORT_PIN_LEVEL_LOW
          PortPinModeChangeable = false
          PortPullDownOption = false
          PortPullUpOption = false
        VIP_UART_RXD (PortPin4):
          PortBiDirectionControl = false
          PortDriveStrengthControl = false
          PortInputBufferControl = false
          PortInputSelection = TYPE_2_SUPP_PIS
          PortOpenDrainControl = false
          PortPinDioAltModeChangeable = false
          PortPinDirection = PORT_PIN_IN
          PortPinDirectionChangeable = false
          PortPinInitialMode = RLIN35RX_AT1IN
          PortPinLevelValue = PORT_PIN_LEVEL_LOW
          PortPinModeChangeable = false
          PortPullDownOption = false
          PortPullUpOption = false
        VIP_UART_TXD (PortPin5):
          PortBiDirectionControl = false
          PortDriveStrengthControl = false
          PortInputBufferControl = false
          PortInputSelection = TYPE_2_SUPP_PIS
          PortOpenDrainControl = false
          PortPinDioAltModeChangeable = false
          PortPinDirection = PORT_PIN_OUT
          PortPinDirectionChangeable = false
          PortPinInitialMode = RLIN35TX_AT1OUT_PFC_PFCE_PMCSR
          PortPinLevelValue = PORT_PIN_LEVEL_LOW
          PortPinModeChangeable = false
          PortPullDownOption = false
          PortPullUpOption = false
        VIP_PWR_VG5V_M_EN (PortPin8):
          PortBiDirectionControl = false
          PortDriveStrengthControl = false
          PortInputBufferControl = false
          PortInputSelection = TYPE_2_SUPP_PIS
          PortOpenDrainControl = false
          PortPinDioAltModeChangeable = false
          PortPinDirection = PORT_PIN_OUT
          PortPinDirectionChangeable = false
          PortPinInitialMode = ALT_NOT_SUPPORTED
          PortPinLevelValue = PORT_PIN_LEVEL_HIGH
          PortPinModeChangeable = false
          PortPullDownOption = false
          PortPullUpOption = false
        VIP_LVI_IDL (PortPin9):
          PortBiDirectionControl = false
          PortDriveStrengthControl = false
          PortInputBufferControl = false
          PortInputSelection = TYPE_2_SUPP_PIS
          PortOpenDrainControl = false
          PortPinDioAltModeChangeable = false
          PortPinDirection = PORT_PIN_IN
          PortPinDirectionChangeable = false
          PortPinInitialMode = INTP21_AT3IN_PFC_PFCE_PMCSR
          PortPinLevelValue = PORT_PIN_LEVEL_LOW
          PortPinModeChangeable = false
          PortPullDownOption = false
          PortPullUpOption = false
        VIP_RTC_INT (PortPin10):
          PortBiDirectionControl = false
          PortDriveStrengthControl = false
          PortInputBufferControl = true
          PortInputSelection = TYPE_2_SUPP_PIS
          PortOpenDrainControl = false
          PortPinDioAltModeChangeable = false
          PortPinDirection = PORT_PIN_IN
          PortPinDirectionChangeable = false
          PortPinInitialMode = DIO_PFC_PFCE_PMCSR
          PortPinLevelValue = PORT_PIN_LEVEL_LOW
          PortPinModeChangeable = false
          PortPullDownOption = false
          PortPullUpOption = false
        VIP_CAN1_STB (PortPin11):
          PortBiDirectionControl = false
          PortDriveStrengthControl = false
          PortInputBufferControl = false
          PortInputSelection = TYPE_2_SUPP_PIS
          PortOpenDrainControl = false
          PortPinDioAltModeChangeable = false
          PortPinDirection = PORT_PIN_OUT
          PortPinDirectionChangeable = false
          PortPinInitialMode = DIO_PFC_PFCE_PMCSR
          PortPinLevelValue = PORT_PIN_LEVEL_LOW
          PortPinModeChangeable = false
          PortPullDownOption = false
          PortPullUpOption = false
        VIP_VG3V3_VIP_EN (PortPin14):
          PortBiDirectionControl = false
          PortDriveStrengthControl = false
          PortInputBufferControl = false
          PortInputSelection = TYPE_2_SUPP_PIS
          PortOpenDrainControl = false
          PortPinDioAltModeChangeable = false
          PortPinDirection = PORT_PIN_OUT
          PortPinDirectionChangeable = false
          PortPinInitialMode = DIO
          PortPinLevelValue = PORT_PIN_LEVEL_HIGH
          PortPinModeChangeable = false
          PortPullDownOption = false
          PortPullUpOption = false
        VIP_PD_EN_ODH (PortPin15):
          PortBiDirectionControl = false
          PortDriveStrengthControl = false
          PortInputBufferControl = false
          PortInputSelection = TYPE_2_SUPP_PIS
          PortOpenDrainControl = false
          PortPinDioAltModeChangeable = false
          PortPinDirection = PORT_PIN_OUT
          PortPinDirectionChangeable = false
          PortPinInitialMode = DIO_PFC_PMCSR
          PortPinLevelValue = PORT_PIN_LEVEL_LOW
          PortPinModeChangeable = false
          PortPullDownOption = false
          PortPullUpOption = false
      PortGroup20
        PMIC_VIP_FAULT (PortPin0):
          PortBiDirectionControl = false
          PortDriveStrengthControl = false
          PortInputBufferControl = true
          PortInputSelection = TYPE_2_SUPP_PIS
          PortOpenDrainControl = false
          PortPinDioAltModeChangeable = false
          PortPinDirection = PORT_PIN_IN
          PortPinDirectionChangeable = false
          PortPinInitialMode = DIO
          PortPinLevelValue = PORT_PIN_LEVEL_LOW
          PortPinModeChangeable = false
          PortPullDownOption = false
          PortPullUpOption = false
        VIP_USB1_CTRL2 (PortPin1):
          PortBiDirectionControl = false
          PortDriveStrengthControl = false
          PortInputBufferControl = false
          PortInputSelection = TYPE_2_SUPP_PIS
          PortIpControl = false
          PortOpenDrainControl = false
          PortPinDioAltModeChangeable = false
          PortPinDirection = PORT_PIN_OUT
          PortPinDirectionChangeable = false
          PortPinInitialMode = DIO_PFC_PFCE_PMCSR
          PortPinLevelValue = PORT_PIN_LEVEL_LOW
          PortPinModeChangeable = false
          PortPullDownOption = false
          PortPullUpOption = false
        VIP_TM_IDL (PortPin2):
          PortBiDirectionControl = false
          PortDriveStrengthControl = false
          PortInputBufferControl = false
          PortInputSelection = TYPE_2_SUPP_PIS
          PortIpControl = false
          PortOpenDrainControl = false
          PortPinDioAltModeChangeable = false
          PortPinDirection = PORT_PIN_OUT
          PortPinDirectionChangeable = false
          PortPinInitialMode = DIO
          PortPinLevelValue = PORT_PIN_LEVEL_LOW
          PortPinModeChangeable = false
          PortPullDownOption = false
          PortPullUpOption = false
        VIP_USB1_FAULT_N (PortPin3):
          PortBiDirectionControl = false
          PortDriveStrengthControl = false
          PortInputBufferControl = false
          PortInputSelection = TYPE_2_SUPP_PIS
          PortOpenDrainControl = false
          PortPinDioAltModeChangeable = false
          PortPinDirection = PORT_PIN_OUT
          PortPinDirectionChangeable = false
          PortPinInitialMode = DIO_PFC_PFCE_PMCSR
          PortPinLevelValue = PORT_PIN_LEVEL_LOW
          PortPinModeChangeable = false
          PortPullDownOption = false
          PortPullUpOption = false
        VIP_USB1_EN (PortPin4):
          PortBiDirectionControl = false
          PortDriveStrengthControl = false
          PortInputBufferControl = false
          PortInputSelection = TYPE_2_SUPP_PIS
          PortOpenDrainControl = false
          PortPinDioAltModeChangeable = false
          PortPinDirection = PORT_PIN_OUT
          PortPinDirectionChangeable = false
          PortPinInitialMode = DIO
          PortPinLevelValue = PORT_PIN_LEVEL_LOW
          PortPinModeChangeable = false
          PortPullDownOption = false
          PortPullUpOption = false
        VIP_USB1_CTRL1 (PortPin5):
          PortBiDirectionControl = false
          PortDriveStrengthControl = false
          PortInputBufferControl = false
          PortInputSelection = TYPE_2_SUPP_PIS
          PortOpenDrainControl = false
          PortPinDioAltModeChangeable = false
          PortPinDirection = PORT_PIN_OUT
          PortPinDirectionChangeable = true
          PortPinInitialMode = DIO_PFC_PFCE_PMCSR
          PortPinLevelValue = PORT_PIN_LEVEL_LOW
          PortPinModeChangeable = false
          PortPullDownOption = false
          PortPullUpOption = false
      PortGroupAnalog0
        VBATT_VIP_DET_ADC (PortPin0):
          PortBiDirectionControl = false
          PortInputBufferControl = false
          PortPinDirection = PORT_PIN_IN
          PortPinDirectionChangeable = false
          PortPinInitialMode = ALT_NOT_SUPPORTED
          PortPinLevelValue = PORT_PIN_LEVEL_LOW
        VIP_A1VREF_IAN (PortPin1):
          PortBiDirectionControl = false
          PortInputBufferControl = false
          PortPinDirection = PORT_PIN_IN
          PortPinDirectionChangeable = false
          PortPinInitialMode = ALT_NOT_SUPPORTED
          PortPinLevelValue = PORT_PIN_LEVEL_LOW
        VIP_VREF_Fuel_IAN (PortPin2):
          PortBiDirectionControl = false
          PortInputBufferControl = false
          PortPinDirection = PORT_PIN_IN
          PortPinDirectionChangeable = false
          PortPinInitialMode = ALT_NOT_SUPPORTED
          PortPinLevelValue = PORT_PIN_LEVEL_LOW
        VIP_Fuellevel1_IAN (PortPin3):
          PortBiDirectionControl = false
          PortInputBufferControl = false
          PortPinDirection = PORT_PIN_IN
          PortPinDirectionChangeable = false
          PortPinInitialMode = ALT_NOT_SUPPORTED
          PortPinLevelValue = PORT_PIN_LEVEL_LOW
        VIP_Fuellevel2_IAN (PortPin4):
          PortBiDirectionControl = false
          PortInputBufferControl = false
          PortPinDirection = PORT_PIN_IN
          PortPinDirectionChangeable = false
          PortPinInitialMode = ALT_NOT_SUPPORTED
          PortPinLevelValue = PORT_PIN_LEVEL_LOW
        VIP_Version_MON1_IAN (PortPin5):
          PortBiDirectionControl = false
          PortInputBufferControl = false
          PortPinDirection = PORT_PIN_IN
          PortPinDirectionChangeable = false
          PortPinInitialMode = ALT_NOT_SUPPORTED
          PortPinLevelValue = PORT_PIN_LEVEL_LOW
        VIP_Version_MON2_IAN (PortPin6):
          PortBiDirectionControl = false
          PortInputBufferControl = false
          PortPinDirection = PORT_PIN_IN
          PortPinDirectionChangeable = false
          PortPinInitialMode = ALT_NOT_SUPPORTED
          PortPinLevelValue = PORT_PIN_LEVEL_LOW
        VIP_BC_IAN (PortPin7):
          PortBiDirectionControl = false
          PortInputBufferControl = false
          PortPinDirection = PORT_PIN_IN
          PortPinDirectionChangeable = false
          PortPinInitialMode = ALT_NOT_SUPPORTED
          PortPinLevelValue = PORT_PIN_LEVEL_LOW
        VIP_ANT1_P_Diag (PortPin8):
          PortBiDirectionControl = false
          PortInputBufferControl = false
          PortPinDirection = PORT_PIN_IN
          PortPinDirectionChangeable = false
          PortPinInitialMode = ALT_NOT_SUPPORTED
          PortPinLevelValue = PORT_PIN_LEVEL_LOW
        VIP_ANT2_P_Diag (PortPin9):
          PortBiDirectionControl = false
          PortInputBufferControl = false
          PortPinDirection = PORT_PIN_IN
          PortPinDirectionChangeable = false
          PortPinInitialMode = ALT_NOT_SUPPORTED
          PortPinLevelValue = PORT_PIN_LEVEL_LOW
        GPSANTpwer_VIP_ADsense (PortPin10):
          PortBiDirectionControl = false
          PortInputBufferControl = false
          PortPinDirection = PORT_PIN_IN
          PortPinDirectionChangeable = false
          PortPinInitialMode = ALT_NOT_SUPPORTED
          PortPinLevelValue = PORT_PIN_LEVEL_LOW
        VIP_TPS7B7701_IAN (PortPin11):
          PortBiDirectionControl = false
          PortInputBufferControl = false
          PortPinDirection = PORT_PIN_IN
          PortPinDirectionChangeable = false
          PortPinInitialMode = ALT_NOT_SUPPORTED
          PortPinLevelValue = PORT_PIN_LEVEL_LOW
        VIP_NTC_MON2_IAN (PortPin12):
          PortBiDirectionControl = false
          PortInputBufferControl = false
          PortPinDirection = PORT_PIN_IN
          PortPinDirectionChangeable = false
          PortPinInitialMode = ALT_NOT_SUPPORTED
          PortPinLevelValue = PORT_PIN_LEVEL_LOW
        VIP_NTC_MON3_IAN (PortPin13):
          PortBiDirectionControl = false
          PortInputBufferControl = false
          PortPinDirection = PORT_PIN_IN
          PortPinDirectionChangeable = false
          PortPinInitialMode = ALT_NOT_SUPPORTED
          PortPinLevelValue = PORT_PIN_LEVEL_LOW
        VIP_PMIC_0752_IAN (PortPin14):
          PortBiDirectionControl = false
          PortInputBufferControl = false
          PortPinDirection = PORT_PIN_IN
          PortPinDirectionChangeable = false
          PortPinInitialMode = ALT_NOT_SUPPORTED
          PortPinLevelValue = PORT_PIN_LEVEL_LOW
        VIP_NTC_MON1_IAN (PortPin15):
          PortBiDirectionControl = false
          PortInputBufferControl = false
          PortPinDirection = PORT_PIN_IN
          PortPinDirectionChangeable = false
          PortPinInitialMode = ALT_NOT_SUPPORTED
          PortPinLevelValue = PORT_PIN_LEVEL_LOW
      PortGroup02 (PortGroup2)
        VIP_PWR_VG10V_EN (PortPin2):
          PortBiDirectionControl = false
          PortDriveStrengthControl = false
          PortInputBufferControl = false
          PortInputSelection = TYPE_2_SUPP_PIS
          PortOpenDrainControl = false
          PortPinDioAltModeChangeable = false
          PortPinDirection = PORT_PIN_OUT
          PortPinDirectionChangeable = false
          PortPinInitialMode = DIO_PMCSR
          PortPinLevelValue = PORT_PIN_LEVEL_HIGH
          PortPinModeChangeable = false
          PortPullDownOption = false
          PortPullUpOption = false
        VIP_VG1V8_M_EN (PortPin3):
          PortBiDirectionControl = false
          PortDriveStrengthControl = false
          PortInputBufferControl = false
          PortInputSelection = TYPE_2_SUPP_PIS
          PortOpenDrainControl = false
          PortPinDioAltModeChangeable = false
          PortPinDirection = PORT_PIN_OUT
          PortPinDirectionChangeable = false
          PortPinInitialMode = DIO_PMCSR
          PortPinLevelValue = PORT_PIN_LEVEL_HIGH
          PortPinModeChangeable = false
          PortPullDownOption = false
          PortPullUpOption = false
        VIP_ID_EN_ODH (PortPin4):
          PortBiDirectionControl = false
          PortDriveStrengthControl = false
          PortInputBufferControl = false
          PortInputSelection = TYPE_2_SUPP_PIS
          PortOpenDrainControl = false
          PortPinDioAltModeChangeable = false
          PortPinDirection = PORT_PIN_OUT
          PortPinDirectionChangeable = false
          PortPinInitialMode = DIO_PFC_PMCSR
          PortPinLevelValue = PORT_PIN_LEVEL_LOW
          PortPinModeChangeable = false
          PortPullDownOption = false
          PortPullUpOption = false
        VIP_HD_EN_ODH (PortPin5):
          PortBiDirectionControl = false
          PortDriveStrengthControl = false
          PortInputBufferControl = false
          PortInputSelection = TYPE_2_SUPP_PIS
          PortOpenDrainControl = false
          PortPinDioAltModeChangeable = false
          PortPinDirection = PORT_PIN_OUT
          PortPinDirectionChangeable = false
          PortPinInitialMode = DIO_PFC_PMCSR
          PortPinLevelValue = PORT_PIN_LEVEL_LOW
          PortPinModeChangeable = false
          PortPullDownOption = false
          PortPullUpOption = false
        VIP_POC_PWREN (PortPin6):
          PortBiDirectionControl = false
          PortDriveStrengthControl = false
          PortInputBufferControl = false
          PortInputSelection = TYPE_2_SUPP_PIS
          PortOpenDrainControl = false
          PortPinDioAltModeChangeable = false
          PortPinDirection = PORT_PIN_OUT
          PortPinDirectionChangeable = false
          PortPinInitialMode = DIO_PMCSR
          PortPinLevelValue = PORT_PIN_LEVEL_LOW
          PortPinModeChangeable = false
          PortPullDownOption = false
          PortPullUpOption = false
        VIP_RVC_PWREN (PortPin7):
          PortBiDirectionControl = false
          PortDriveStrengthControl = false
          PortInputBufferControl = false
          PortInputSelection = TYPE_2_SUPP_PIS
          PortOpenDrainControl = false
          PortPinDioAltModeChangeable = false
          PortPinDirection = PORT_PIN_OUT
          PortPinDirectionChangeable = false
          PortPinInitialMode = DIO_PMCSR
          PortPinLevelValue = PORT_PIN_LEVEL_LOW
          PortPinModeChangeable = false
          PortPullDownOption = false
          PortPullUpOption = false
        VIP_GPSANT_POWER_EN_3V3 (PortPin8):
          PortBiDirectionControl = false
          PortDriveStrengthControl = false
          PortInputBufferControl = false
          PortInputSelection = TYPE_2_SUPP_PIS
          PortOpenDrainControl = false
          PortPinDioAltModeChangeable = false
          PortPinDirection = PORT_PIN_OUT
          PortPinDirectionChangeable = false
          PortPinInitialMode = DIO_PMCSR
          PortPinLevelValue = PORT_PIN_LEVEL_HIGH
          PortPinModeChangeable = false
          PortPullDownOption = false
          PortPullUpOption = false
        VIP_RLIN31_SLP (PortPin9):
          PortBiDirectionControl = false
          PortDriveStrengthControl = false
          PortInputBufferControl = false
          PortInputSelection = TYPE_2_SUPP_PIS
          PortOpenDrainControl = false
          PortPinDioAltModeChangeable = false
          PortPinDirection = PORT_PIN_OUT
          PortPinDirectionChangeable = false
          PortPinInitialMode = DIO_PMCSR
          PortPinLevelValue = PORT_PIN_LEVEL_LOW
          PortPinModeChangeable = false
          PortPullDownOption = false
          PortPullUpOption = false
        VIP_RLIN31_WAKE (PortPin10):
          PortBiDirectionControl = false
          PortDriveStrengthControl = false
          PortInputBufferControl = false
          PortInputSelection = TYPE_2_SUPP_PIS
          PortOpenDrainControl = false
          PortPinDioAltModeChangeable = false
          PortPinDirection = PORT_PIN_OUT
          PortPinDirectionChangeable = false
          PortPinInitialMode = DIO_PMCSR
          PortPinLevelValue = PORT_PIN_LEVEL_LOW
          PortPinModeChangeable = false
          PortPullDownOption = false
          PortPullUpOption = false
        VIP_RLIN32_SLP (PortPin11):
          PortBiDirectionControl = false
          PortDriveStrengthControl = false
          PortInputBufferControl = false
          PortInputSelection = TYPE_2_SUPP_PIS
          PortOpenDrainControl = false
          PortPinDioAltModeChangeable = false
          PortPinDirection = PORT_PIN_OUT
          PortPinDirectionChangeable = false
          PortPinInitialMode = DIO_PMCSR
          PortPinLevelValue = PORT_PIN_LEVEL_LOW
          PortPinModeChangeable = false
          PortPullDownOption = false
          PortPullUpOption = false
        VIP_RLIN32_WAKE (PortPin12):
          PortBiDirectionControl = false
          PortDriveStrengthControl = false
          PortInputBufferControl = false
          PortInputSelection = TYPE_2_SUPP_PIS
          PortOpenDrainControl = false
          PortPinDioAltModeChangeable = false
          PortPinDirection = PORT_PIN_OUT
          PortPinDirectionChangeable = false
          PortPinInitialMode = DIO_PMCSR
          PortPinLevelValue = PORT_PIN_LEVEL_LOW
          PortPinModeChangeable = false
          PortPullDownOption = false
          PortPullUpOption = false
        VIP_GPS_RST (PortPin13):
          PortBiDirectionControl = false
          PortDriveStrengthControl = false
          PortInputBufferControl = false
          PortInputSelection = TYPE_2_SUPP_PIS
          PortOpenDrainControl = false
          PortPinDioAltModeChangeable = false
          PortPinDirection = PORT_PIN_OUT
          PortPinDirectionChangeable = false
          PortPinInitialMode = DIO_PMCSR
          PortPinLevelValue = PORT_PIN_LEVEL_LOW
          PortPinModeChangeable = false
          PortPullDownOption = false
          PortPullUpOption = false
        VIP_PWR_VGBOOST_EN (PortPin14):
          PortBiDirectionControl = false
          PortDriveStrengthControl = false
          PortInputBufferControl = false
          PortInputSelection = TYPE_2_SUPP_PIS
          PortOpenDrainControl = false
          PortPinDioAltModeChangeable = false
          PortPinDirection = PORT_PIN_OUT
          PortPinDirectionChangeable = false
          PortPinInitialMode = DIO_PMCSR
          PortPinLevelValue = PORT_PIN_LEVEL_HIGH
          PortPinModeChangeable = false
          PortPullDownOption = false
          PortPullUpOption = false
        VIP_PWR_VG3V3_M_EN (PortPin15):
          PortBiDirectionControl = false
          PortDriveStrengthControl = false
          PortInputBufferControl = false
          PortInputSelection = TYPE_2_SUPP_PIS
          PortOpenDrainControl = false
          PortPinDioAltModeChangeable = false
          PortPinDirection = PORT_PIN_OUT
          PortPinDirectionChangeable = false
          PortPinInitialMode = DIO_PMCSR
          PortPinLevelValue = PORT_PIN_LEVEL_HIGH
          PortPinModeChangeable = false
          PortPullDownOption = false
          PortPullUpOption = false
      PortGroup03 (PortGroup3)
        VIP_CD_EN_ODH (PortPin0):
          PortBiDirectionControl = false
          PortDriveStrengthControl = false
          PortInputBufferControl = false
          PortInputSelection = TYPE_2_SUPP_PIS
          PortOpenDrainControl = false
          PortPinDioAltModeChangeable = false
          PortPinDirection = PORT_PIN_OUT
          PortPinDirectionChangeable = false
          PortPinInitialMode = DIO_PMCSR
          PortPinLevelValue = PORT_PIN_LEVEL_LOW
          PortPinModeChangeable = false
          PortPullDownOption = false
          PortPullUpOption = false
      PortGroup09 (PortGroup9)
        VIP_I2C1_SDA (PortPin0):
          PortBiDirectionControl = true
          PortInputBufferControl = false
          PortInputSelection = TYPE_2_SUPP_PIS
          PortOpenDrainControl = true
          PortPinDioAltModeChangeable = false
          PortPinDirection = PORT_PIN_OUT
          PortPinDirectionChangeable = true
          PortPinInitialMode = RIIC1SDA_AT7OUT
          PortPinLevelValue = PORT_PIN_LEVEL_LOW
          PortPinModeChangeable = false
          PortPullDownOption = false
          PortPullUpOption = false
        VIP_I2C1_SCL (PortPin1):
          PortBiDirectionControl = true
          PortInputBufferControl = false
          PortInputSelection = TYPE_2_SUPP_PIS
          PortOpenDrainControl = true
          PortPinDioAltModeChangeable = false
          PortPinDirection = PORT_PIN_OUT
          PortPinDirectionChangeable = true
          PortPinInitialMode = RIIC1SCL_AT7OUT
          PortPinLevelValue = PORT_PIN_LEVEL_LOW
          PortPinModeChangeable = false
          PortPullDownOption = false
          PortPullUpOption = false
        SXM_VIP_STBY (PortPin2):
          PortBiDirectionControl = false
          PortInputBufferControl = true
          PortInputSelection = TYPE_2_SUPP_PIS
          PortOpenDrainControl = false
          PortPinDioAltModeChangeable = false
          PortPinDirection = PORT_PIN_IN
          PortPinDirectionChangeable = false
          PortPinInitialMode = DIO_PFC_PMCSR
          PortPinLevelValue = PORT_PIN_LEVEL_LOW
          PortPinModeChangeable = false
          PortPullDownOption = false
          PortPullUpOption = false
        VIP_PWR_VG10V_SYNC (PortPin3):
          PortBiDirectionControl = false
          PortInputBufferControl = false
          PortInputSelection = TYPE_2_SUPP_PIS
          PortOpenDrainControl = false
          PortPinDioAltModeChangeable = false
          PortPinDirection = PORT_PIN_OUT
          PortPinDirectionChangeable = false
          PortPinInitialMode = TAUJ1O1_AT3OUT_PFC_PFCE_PMCSR
          PortPinLevelValue = PORT_PIN_LEVEL_LOW
          PortPinModeChangeable = false
          PortPullDownOption = false
          PortPullUpOption = false
        VIP_SOC3 (PortPin4):
          PortBiDirectionControl = false
          PortInputBufferControl = false
          PortInputSelection = TYPE_2_SUPP_PIS
          PortOpenDrainControl = false
          PortPinDioAltModeChangeable = false
          PortPinDirection = PORT_PIN_OUT
          PortPinDirectionChangeable = false
          PortPinInitialMode = DIO_PFC_PFCE_PMCSR
          PortPinLevelValue = PORT_PIN_LEVEL_LOW
          PortPinModeChangeable = false
          PortPullDownOption = false
          PortPullUpOption = false
      PortGroup12
        VIP_479XX_RST_3V3 (PortPin0):
          PortBiDirectionControl = false
          PortDriveStrengthControl = false
          PortInputBufferControl = false
          PortInputSelection = TYPE_2_SUPP_PIS
          PortOpenDrainControl = false
          PortPinDioAltModeChangeable = false
          PortPinDirection = PORT_PIN_OUT
          PortPinDirectionChangeable = false
          PortPinInitialMode = DIO
          PortPinLevelValue = PORT_PIN_LEVEL_LOW
          PortPinModeChangeable = false
          PortPullDownOption = false
          PortPullUpOption = false
        VIP_4624_RST_3V3 (PortPin1):
          PortBiDirectionControl = false
          PortDriveStrengthControl = false
          PortInputBufferControl = false
          PortInputSelection = TYPE_2_SUPP_PIS
          PortOpenDrainControl = false
          PortPinDioAltModeChangeable = false
          PortPinDirection = PORT_PIN_OUT
          PortPinDirectionChangeable = false
          PortPinInitialMode = DIO
          PortPinLevelValue = PORT_PIN_LEVEL_LOW
          PortPinModeChangeable = false
          PortPullDownOption = false
          PortPullUpOption = false
        VIP_469X_RST_3V3 (PortPin2):
          PortBiDirectionControl = false
          PortDriveStrengthControl = false
          PortInputBufferControl = false
          PortInputSelection = TYPE_2_SUPP_PIS
          PortOpenDrainControl = false
          PortPinDioAltModeChangeable = false
          PortPinDirection = PORT_PIN_OUT
          PortPinDirectionChangeable = false
          PortPinInitialMode = DIO
          PortPinLevelValue = PORT_PIN_LEVEL_LOW
          PortPinModeChangeable = false
          PortPullDownOption = false
          PortPullUpOption = false
      PortGroup13
        VIP_SDARS_SHDN_3V3 (PortPin0):
          PortBiDirectionControl = false
          PortDriveStrengthControl = false
          PortInputBufferControl = false
          PortInputSelection = TYPE_2_SUPP_PIS
          PortOpenDrainControl = false
          PortPinDioAltModeChangeable = false
          PortPinDirection = PORT_PIN_OUT
          PortPinDirectionChangeable = false
          PortPinInitialMode = DIO_PMCSR
          PortPinLevelValue = PORT_PIN_LEVEL_LOW
          PortPinModeChangeable = false
          PortPullDownOption = false
          PortPullUpOption = false
        VIP_SDARS_RST_3V3 (PortPin1):
          PortBiDirectionControl = false
          PortDriveStrengthControl = false
          PortInputBufferControl = false
          PortInputSelection = TYPE_2_SUPP_PIS
          PortOpenDrainControl = false
          PortPinDioAltModeChangeable = false
          PortPinDirection = PORT_PIN_OUT
          PortPinDirectionChangeable = false
          PortPinInitialMode = DIO_PMCSR
          PortPinLevelValue = PORT_PIN_LEVEL_LOW
          PortPinModeChangeable = false
          PortPullDownOption = false
          PortPullUpOption = false
        VIP_A2BPWR_EN (PortPin2):
          PortBiDirectionControl = false
          PortDriveStrengthControl = false
          PortInputBufferControl = false
          PortInputSelection = TYPE_2_SUPP_PIS
          PortOpenDrainControl = false
          PortPinDioAltModeChangeable = false
          PortPinDirection = PORT_PIN_OUT
          PortPinDirectionChangeable = false
          PortPinInitialMode = DIO_PMCSR
          PortPinLevelValue = PORT_PIN_LEVEL_LOW
          PortPinModeChangeable = false
          PortPullDownOption = false
          PortPullUpOption = false
        VIP_SWITCH_SPI_EN (PortPin3):
          PortBiDirectionControl = false
          PortDriveStrengthControl = false
          PortInputBufferControl = false
          PortInputSelection = TYPE_2_SUPP_PIS
          PortOpenDrainControl = false
          PortPinDioAltModeChangeable = false
          PortPinDirection = PORT_PIN_OUT
          PortPinDirectionChangeable = false
          PortPinInitialMode = DIO_PMCSR
          PortPinLevelValue = PORT_PIN_LEVEL_LOW
          PortPinModeChangeable = false
          PortPullDownOption = false
          PortPullUpOption = false
        VIP_PMIC_CBL (PortPin5):
          PortBiDirectionControl = false
          PortDriveStrengthControl = false
          PortInputBufferControl = false
          PortInputSelection = TYPE_2_SUPP_PIS
          PortOpenDrainControl = false
          PortPinDioAltModeChangeable = false
          PortPinDirection = PORT_PIN_OUT
          PortPinDirectionChangeable = false
          PortPinInitialMode = DIO_PFC_PMCSR
          PortPinLevelValue = PORT_PIN_LEVEL_LOW
          PortPinModeChangeable = false
          PortPullDownOption = false
          PortPullUpOption = false
        VIP_PMIC_KPD (PortPin6):
          PortBiDirectionControl = false
          PortDriveStrengthControl = false
          PortInputBufferControl = false
          PortInputSelection = TYPE_2_SUPP_PIS
          PortOpenDrainControl = false
          PortPinDioAltModeChangeable = false
          PortPinDirection = PORT_PIN_OUT
          PortPinDirectionChangeable = false
          PortPinInitialMode = DIO_PFC_PMCSR
          PortPinLevelValue = PORT_PIN_LEVEL_LOW
          PortPinModeChangeable = false
          PortPullDownOption = false
          PortPullUpOption = false
        VIP_PMIC_RST (PortPin7):
          PortBiDirectionControl = false
          PortDriveStrengthControl = false
          PortInputBufferControl = false
          PortInputSelection = TYPE_2_SUPP_PIS
          PortOpenDrainControl = false
          PortPinDioAltModeChangeable = false
          PortPinDirection = PORT_PIN_OUT
          PortPinDirectionChangeable = false
          PortPinInitialMode = DIO_PFC_PMCSR
          PortPinLevelValue = PORT_PIN_LEVEL_LOW
          PortPinModeChangeable = false
          PortPullDownOption = false
          PortPullUpOption = false
      PortGroup18
        SOC_VIP_FAST_BOOT (PortPin0):
          PortBiDirectionControl = false
          PortDriveStrengthControl = false
          PortInputBufferControl = true
          PortInputSelection = TYPE_2_SUPP_PIS
          PortOpenDrainControl = false
          PortPinDioAltModeChangeable = false
          PortPinDirection = PORT_PIN_IN
          PortPinDirectionChangeable = false
          PortPinInitialMode = DIO_PFC_PFCE_PMCSR
          PortPinLevelValue = PORT_PIN_LEVEL_LOW
          PortPinModeChangeable = false
          PortPullDownOption = false
          PortPullUpOption = false
        VIP_USB1_SYNC (PortPin1):
          PortBiDirectionControl = false
          PortDriveStrengthControl = false
          PortInputBufferControl = false
          PortInputSelection = TYPE_2_SUPP_PIS
          PortOpenDrainControl = false
          PortPinDioAltModeChangeable = false
          PortPinDirection = PORT_PIN_OUT
          PortPinDirectionChangeable = false
          PortPinInitialMode = TAUJ3O1_AT4OUT_PFC_PFCE_PMCSR
          PortPinLevelValue = PORT_PIN_LEVEL_LOW
          PortPinModeChangeable = false
          PortPullDownOption = false
          PortPullUpOption = false
        VIP_AMP8531_MUTE (PortPin4):
          PortBiDirectionControl = false
          PortDriveStrengthControl = false
          PortInputBufferControl = false
          PortInputSelection = TYPE_2_SUPP_PIS
          PortOpenDrainControl = false
          PortPinDioAltModeChangeable = false
          PortPinDirection = PORT_PIN_OUT
          PortPinDirectionChangeable = false
          PortPinInitialMode = DIO_PFC_PMCSR
          PortPinLevelValue = PORT_PIN_LEVEL_LOW
          PortPinModeChangeable = false
          PortPullDownOption = false
          PortPullUpOption = false
        VIP_AMP8532_DIAG1 (PortPin5):
          PortBiDirectionControl = false
          PortDriveStrengthControl = false
          PortInputBufferControl = true
          PortInputSelection = TYPE_2_SUPP_PIS
          PortOpenDrainControl = false
          PortPinDioAltModeChangeable = false
          PortPinDirection = PORT_PIN_IN
          PortPinDirectionChangeable = false
          PortPinInitialMode = DIO_PFC_PMCSR
          PortPinLevelValue = PORT_PIN_LEVEL_LOW
          PortPinModeChangeable = false
          PortPullDownOption = false
          PortPullUpOption = false
        VIP_AMP8532_DIAG2 (PortPin6):
          PortBiDirectionControl = false
          PortDriveStrengthControl = false
          PortInputBufferControl = true
          PortInputSelection = TYPE_2_SUPP_PIS
          PortOpenDrainControl = false
          PortPinDioAltModeChangeable = false
          PortPinDirection = PORT_PIN_IN
          PortPinDirectionChangeable = false
          PortPinInitialMode = DIO
          PortPinLevelValue = PORT_PIN_LEVEL_LOW
          PortPinModeChangeable = false
          PortPullDownOption = false
          PortPullUpOption = false
        VIP_AMP8532_EN (PortPin8):
          PortBiDirectionControl = false
          PortDriveStrengthControl = false
          PortInputBufferControl = false
          PortInputSelection = TYPE_2_SUPP_PIS
          PortOpenDrainControl = false
          PortPinDioAltModeChangeable = false
          PortPinDirection = PORT_PIN_OUT
          PortPinDirectionChangeable = false
          PortPinInitialMode = DIO_PMCSR
          PortPinLevelValue = PORT_PIN_LEVEL_LOW
          PortPinModeChangeable = false
          PortPullDownOption = false
          PortPullUpOption = false
        VIP_AMP8532_MUTE (PortPin9):
          PortBiDirectionControl = false
          PortDriveStrengthControl = false
          PortInputBufferControl = false
          PortInputSelection = TYPE_2_SUPP_PIS
          PortOpenDrainControl = false
          PortPinDioAltModeChangeable = false
          PortPinDirection = PORT_PIN_OUT
          PortPinDirectionChangeable = false
          PortPinInitialMode = DIO_PMCSR
          PortPinLevelValue = PORT_PIN_LEVEL_LOW
          PortPinModeChangeable = false
          PortPullDownOption = false
          PortPullUpOption = false
        VIP_AMP8531_DIAG1 (PortPin10):
          PortBiDirectionControl = false
          PortDriveStrengthControl = false
          PortInputBufferControl = true
          PortInputSelection = TYPE_2_SUPP_PIS
          PortOpenDrainControl = false
          PortPinDioAltModeChangeable = false
          PortPinDirection = PORT_PIN_IN
          PortPinDirectionChangeable = false
          PortPinInitialMode = DIO
          PortPinLevelValue = PORT_PIN_LEVEL_LOW
          PortPinModeChangeable = false
          PortPullDownOption = false
          PortPullUpOption = false
        VIP_AMP8531_DIAG2 (PortPin11):
          PortBiDirectionControl = false
          PortDriveStrengthControl = false
          PortInputBufferControl = true
          PortInputSelection = TYPE_2_SUPP_PIS
          PortOpenDrainControl = false
          PortPinDioAltModeChangeable = false
          PortPinDirection = PORT_PIN_IN
          PortPinDirectionChangeable = false
          PortPinInitialMode = DIO
          PortPinLevelValue = PORT_PIN_LEVEL_LOW
          PortPinModeChangeable = false
          PortPullDownOption = false
          PortPullUpOption = false
        VIP_AMP8531_EN (PortPin13):
          PortBiDirectionControl = false
          PortDriveStrengthControl = false
          PortInputBufferControl = false
          PortInputSelection = TYPE_2_SUPP_PIS
          PortOpenDrainControl = false
          PortPinDioAltModeChangeable = false
          PortPinDirection = PORT_PIN_OUT
          PortPinDirectionChangeable = false
          PortPinInitialMode = DIO
          PortPinLevelValue = PORT_PIN_LEVEL_LOW
          PortPinModeChangeable = false
          PortPullDownOption = false
          PortPullUpOption = false
        VIP_DSP_SELE (PortPin14):
          PortBiDirectionControl = false
          PortDriveStrengthControl = false
          PortInputBufferControl = false
          PortInputSelection = TYPE_2_SUPP_PIS
          PortOpenDrainControl = false
          PortPinDioAltModeChangeable = false
          PortPinDirection = PORT_PIN_OUT
          PortPinDirectionChangeable = false
          PortPinInitialMode = DIO
          PortPinLevelValue = PORT_PIN_LEVEL_LOW
          PortPinModeChangeable = false
          PortPullDownOption = false
          PortPullUpOption = false
        VIP_DSP_REST_3V3 (PortPin15):
          PortBiDirectionControl = false
          PortDriveStrengthControl = false
          PortInputBufferControl = false
          PortInputSelection = TYPE_2_SUPP_PIS
          PortOpenDrainControl = false
          PortPinDioAltModeChangeable = false
          PortPinDirection = PORT_PIN_OUT
          PortPinDirectionChangeable = false
          PortPinInitialMode = DIO
          PortPinLevelValue = PORT_PIN_LEVEL_LOW
          PortPinModeChangeable = false
          PortPullDownOption = false
          PortPullUpOption = false
        VIP_ETN_1V_SYNC (PortPin3):
          PortBiDirectionControl = false
          PortDriveStrengthControl = false
          PortInputBufferControl = false
          PortInputSelection = TYPE_2_SUPP_PIS
          PortOpenDrainControl = false
          PortPinDioAltModeChangeable = false
          PortPinDirection = PORT_PIN_OUT
          PortPinDirectionChangeable = false
          PortPinInitialMode = TAUJ3O3_AT4OUT_PFC_PFCE_PMCSR
          PortPinLevelValue = PORT_PIN_LEVEL_LOW
          PortPinModeChangeable = false
          PortPullDownOption = false
          PortPullUpOption = false
      PortGroup19
        VIP_ADC_M_REST (PortPin0):
          PortBiDirectionControl = false
          PortDriveStrengthControl = false
          PortInputBufferControl = false
          PortInputSelection = TYPE_2_SUPP_PIS
          PortOpenDrainControl = false
          PortPinDioAltModeChangeable = false
          PortPinDirection = PORT_PIN_OUT
          PortPinDirectionChangeable = false
          PortPinInitialMode = ALT_NOT_SUPPORTED
          PortPinLevelValue = PORT_PIN_LEVEL_LOW
          PortPinModeChangeable = false
          PortPullDownOption = false
          PortPullUpOption = false
        VIP_RTC_FEN (PortPin1):
          PortBiDirectionControl = false
          PortDriveStrengthControl = false
          PortInputBufferControl = false
          PortInputSelection = TYPE_2_SUPP_PIS
          PortOpenDrainControl = false
          PortPinDioAltModeChangeable = false
          PortPinDirection = PORT_PIN_OUT
          PortPinDirectionChangeable = false
          PortPinInitialMode = ALT_NOT_SUPPORTED
          PortPinLevelValue = PORT_PIN_LEVEL_LOW
          PortPinModeChangeable = false
          PortPullDownOption = false
          PortPullUpOption = false
        A2B_VIP_INT (PortPin2):
          PortBiDirectionControl = false
          PortDriveStrengthControl = false
          PortInputBufferControl = true
          PortInputSelection = TYPE_2_SUPP_PIS
          PortOpenDrainControl = false
          PortPinDioAltModeChangeable = false
          PortPinDirection = PORT_PIN_IN
          PortPinDirectionChangeable = false
          PortPinInitialMode = ALT_NOT_SUPPORTED
          PortPinLevelValue = PORT_PIN_LEVEL_LOW
          PortPinModeChangeable = false
          PortPullDownOption = false
          PortPullUpOption = false
        VIP_REVERSE_IRQ (PortPin3):
          PortBiDirectionControl = false
          PortDriveStrengthControl = false
          PortInputBufferControl = false
          PortInputSelection = TYPE_2_SUPP_PIS
          PortOpenDrainControl = false
          PortPinDioAltModeChangeable = false
          PortPinDirection = PORT_PIN_OUT
          PortPinDirectionChangeable = false
          PortPinInitialMode = ALT_NOT_SUPPORTED
          PortPinLevelValue = PORT_PIN_LEVEL_LOW
          PortPinModeChangeable = false
          PortPullDownOption = false
          PortPullUpOption = false
    PortConfig_Sleep (PortConfigSet)
      PortContainer: PortNumberOfPortPins=1
        PortPin_001 (PortPin):
          PortPinDirection = PORT_PIN_IN
          PortPinDirectionChangeable = false
          PortPinId = 1
          PortPinInitialMode = PORT_PIN_MODE_ADC
          PortPinLevelValue = PORT_PIN_LEVEL_HIGH
          PortPinMode = PORT_PIN_MODE_ADC
          PortPinModeChangeable = false
      PortFilterGroupConfig
      PortGroup08 (PortGroup8)
        SOC_VIP_CSIH1_REQ2 (PortPin0):
          PortBiDirectionControl = false
          PortInputBufferControl = false
          PortInputSelection = TYPE_2_SUPP_PIS
          PortOpenDrainControl = false
          PortPinDioAltModeChangeable = false
          PortPinDirection = PORT_PIN_IN
          PortPinDirectionChangeable = false
          PortPinInitialMode = INTP4_AT3IN
          PortPinLevelValue = PORT_PIN_LEVEL_LOW
          PortPinModeChangeable = false
          PortPullDownOption = false
          PortPullUpOption = false
        SOC_VIP_CSIH2_REQ2 (PortPin1):
          PortBiDirectionControl = false
          PortInputBufferControl = false
          PortInputSelection = TYPE_2_SUPP_PIS
          PortOpenDrainControl = false
          PortPinDioAltModeChangeable = false
          PortPinDirection = PORT_PIN_IN
          PortPinDirectionChangeable = false
          PortPinInitialMode = INTP5_AT3IN
          PortPinLevelValue = PORT_PIN_LEVEL_LOW
          PortPinModeChangeable = false
          PortPullDownOption = false
          PortPullUpOption = false
        VBATT_VIP_DET_EN_3V3 (PortPin2):
          PortBiDirectionControl = false
          PortInputBufferControl = false
          PortInputSelection = TYPE_2_SUPP_PIS
          PortOpenDrainControl = false
          PortPinDioAltModeChangeable = false
          PortPinDirection = PORT_PIN_OUT
          PortPinDirectionChangeable = false
          PortPinInitialMode = DIO_PFC_PFCE_PMCSR
          PortPinLevelValue = PORT_PIN_LEVEL_LOW
          PortPinModeChangeable = false
          PortPullDownOption = false
          PortPullUpOption = false
        VIP_SOC_EDL_3V3 (PortPin3):
          PortBiDirectionControl = false
          PortInputBufferControl = false
          PortInputSelection = TYPE_2_SUPP_PIS
          PortOpenDrainControl = false
          PortPinDioAltModeChangeable = false
          PortPinDirection = PORT_PIN_OUT
          PortPinDirectionChangeable = false
          PortPinInitialMode = DIO_PFC_PFCE_PMCSR
          PortPinLevelValue = PORT_PIN_LEVEL_LOW
          PortPinModeChangeable = false
          PortPullDownOption = false
          PortPullUpOption = false
        PMIC_VIP_PSHOLD (PortPin4):
          PortBiDirectionControl = false
          PortInputBufferControl = false
          PortInputSelection = TYPE_2_SUPP_PIS
          PortOpenDrainControl = false
          PortPinDioAltModeChangeable = false
          PortPinDirection = PORT_PIN_IN
          PortPinDirectionChangeable = false
          PortPinInitialMode = DIO
          PortPinLevelValue = PORT_PIN_LEVEL_LOW
          PortPinModeChangeable = false
          PortPullDownOption = false
          PortPullUpOption = false
        VIP_8532_DIAG3 (PortPin5):
          PortBiDirectionControl = false
          PortInputBufferControl = false
          PortInputSelection = TYPE_2_SUPP_PIS
          PortOpenDrainControl = false
          PortPinDioAltModeChangeable = false
          PortPinDirection = PORT_PIN_IN
          PortPinDirectionChangeable = false
          PortPinInitialMode = DIO_PFC_PFCE_PMCSR
          PortPinLevelValue = PORT_PIN_LEVEL_LOW
          PortPinModeChangeable = false
          PortPullDownOption = false
          PortPullUpOption = false
        VIP_WD_enable (PortPin7):
          PortBiDirectionControl = false
          PortInputBufferControl = false
          PortInputSelection = TYPE_2_SUPP_PIS
          PortOpenDrainControl = false
          PortPinDioAltModeChangeable = false
          PortPinDirection = PORT_PIN_OUT
          PortPinDirectionChangeable = false
          PortPinInitialMode = DIO_PFC_PFCE_PMCSR
          PortPinLevelValue = PORT_PIN_LEVEL_LOW
          PortPinModeChangeable = false
          PortPullDownOption = false
          PortPullUpOption = false
        VIP_CAN0_STB (PortPin6):
          PortBiDirectionControl = false
          PortInputBufferControl = false
          PortInputSelection = TYPE_2_SUPP_PIS
          PortOpenDrainControl = false
          PortPinDioAltModeChangeable = false
          PortPinDirection = PORT_PIN_OUT
          PortPinDirectionChangeable = false
          PortPinInitialMode = DIO_PFC_PFCE_PMCSR
          PortPinLevelValue = PORT_PIN_LEVEL_HIGH
          PortPinModeChangeable = false
          PortPullDownOption = false
          PortPullUpOption = false
        VIP_GPS_RXD (PortPin8):
          PortBiDirectionControl = false
          PortInputBufferControl = false
          PortInputSelection = TYPE_2_SUPP_PIS
          PortOpenDrainControl = false
          PortPinDioAltModeChangeable = false
          PortPinDirection = PORT_PIN_IN
          PortPinDirectionChangeable = false
          PortPinInitialMode = RLIN34RX_AT4IN
          PortPinLevelValue = PORT_PIN_LEVEL_LOW
          PortPinModeChangeable = false
          PortPullDownOption = false
          PortPullUpOption = false
        VIP_GPS_TXD (PortPin9):
          PortBiDirectionControl = false
          PortInputBufferControl = false
          PortInputSelection = TYPE_2_SUPP_PIS
          PortOpenDrainControl = false
          PortPinDioAltModeChangeable = false
          PortPinDirection = PORT_PIN_OUT
          PortPinDirectionChangeable = false
          PortPinInitialMode = DIO_PFC_PFCE_PMCSR
          PortPinLevelValue = PORT_PIN_LEVEL_LOW
          PortPinModeChangeable = false
          PortPullDownOption = false
          PortPullUpOption = false
        VIP_Gyro_INT2 (PortPin10):
          PortBiDirectionControl = false
          PortInputBufferControl = false
          PortInputSelection = TYPE_2_SUPP_PIS
          PortOpenDrainControl = false
          PortPinDioAltModeChangeable = false
          PortPinDirection = PORT_PIN_IN
          PortPinDirectionChangeable = false
          PortPinInitialMode = DIO
          PortPinLevelValue = PORT_PIN_LEVEL_LOW
          PortPinModeChangeable = false
          PortPullDownOption = false
          PortPullUpOption = false
        VIP_WATCHDOG_WDI (PortPin11):
          PortBiDirectionControl = false
          PortInputBufferControl = false
          PortInputSelection = TYPE_2_SUPP_PIS
          PortOpenDrainControl = false
          PortPinDioAltModeChangeable = false
          PortPinDirection = PORT_PIN_IN
          PortPinDirectionChangeable = true
          PortPinInitialMode = DIO_PFC_PFCE_PMCSR
          PortPinLevelValue = PORT_PIN_LEVEL_LOW
          PortPinModeChangeable = false
          PortPullDownOption = false
          PortPullUpOption = false
        VIP_ON_IDH (PortPin12):
          PortBiDirectionControl = false
          PortInputBufferControl = false
          PortInputSelection = TYPE_2_SUPP_PIS
          PortOpenDrainControl = false
          PortPinDioAltModeChangeable = false
          PortPinDirection = PORT_PIN_IN
          PortPinDirectionChangeable = false
          PortPinInitialMode = DIO_PFC_PFCE_PMCSR
          PortPinLevelValue = PORT_PIN_LEVEL_LOW
          PortPinModeChangeable = false
          PortPullDownOption = false
          PortPullUpOption = false
      PortGroup10
        SOC_VIP_CSIH1_SI (PortPin0):
          PortBiDirectionControl = false
          PortDriveStrengthControl = false
          PortInputBufferControl = false
          PortInputSelection = TYPE_2_SUPP_PIS
          PortIpControl = false
          PortOpenDrainControl = false
          PortPinDioAltModeChangeable = false
          PortPinDirection = PORT_PIN_IN
          PortPinDirectionChangeable = false
          PortPinInitialMode = DIO
          PortPinLevelValue = PORT_PIN_LEVEL_LOW
          PortPinModeChangeable = false
          PortPullDownOption = false
          PortPullUpOption = false
        SOC_VIP_CSIH1_SC (PortPin1):
          PortBiDirectionControl = false
          PortDriveStrengthControl = false
          PortInputBufferControl = false
          PortInputSelection = TYPE_2_SUPP_PIS
          PortIpControl = false
          PortOpenDrainControl = false
          PortPinDioAltModeChangeable = false
          PortPinDirection = PORT_PIN_IN
          PortPinDirectionChangeable = false
          PortPinInitialMode = DIO
          PortPinLevelValue = PORT_PIN_LEVEL_LOW
          PortPinModeChangeable = false
          PortPullDownOption = false
          PortPullUpOption = false
        SOC_VIP_CSIH1_SO (PortPin2):
          PortBiDirectionControl = false
          PortDriveStrengthControl = false
          PortInputBufferControl = false
          PortInputSelection = TYPE_2_SUPP_PIS
          PortIpControl = false
          PortOpenDrainControl = false
          PortPinDioAltModeChangeable = false
          PortPinDirection = PORT_PIN_IN
          PortPinDirectionChangeable = false
          PortPinInitialMode = DIO
          PortPinLevelValue = PORT_PIN_LEVEL_LOW
          PortPinModeChangeable = false
          PortPullDownOption = false
          PortPullUpOption = false
        VIP_SOC_UPDATA (PortPin3):
          PortBiDirectionControl = false
          PortDriveStrengthControl = false
          PortInputBufferControl = false
          PortInputSelection = TYPE_2_SUPP_PIS
          PortIpControl = false
          PortOpenDrainControl = false
          PortPinDioAltModeChangeable = false
          PortPinDirection = PORT_PIN_OUT
          PortPinDirectionChangeable = false
          PortPinInitialMode = DIO
          PortPinLevelValue = PORT_PIN_LEVEL_LOW
          PortPinModeChangeable = false
          PortPullDownOption = false
          PortPullUpOption = false
        VIP_SOC_SHUTDOWN (PortPin4):
          PortBiDirectionControl = false
          PortDriveStrengthControl = false
          PortInputBufferControl = false
          PortInputSelection = TYPE_2_SUPP_PIS
          PortIpControl = false
          PortOpenDrainControl = false
          PortPinDioAltModeChangeable = false
          PortPinDirection = PORT_PIN_OUT
          PortPinDirectionChangeable = false
          PortPinInitialMode = DIO
          PortPinLevelValue = PORT_PIN_LEVEL_LOW
          PortPinModeChangeable = false
          PortPullDownOption = false
          PortPullUpOption = false
        SOC_VIP_CSIH1_CS (PortPin6):
          PortBiDirectionControl = false
          PortDriveStrengthControl = false
          PortInputBufferControl = false
          PortInputSelection = TYPE_2_SUPP_PIS
          PortIpControl = false
          PortOpenDrainControl = false
          PortPinDioAltModeChangeable = false
          PortPinDirection = PORT_PIN_IN
          PortPinDirectionChangeable = false
          PortPinInitialMode = DIO
          PortPinLevelValue = PORT_PIN_LEVEL_LOW
          PortPinModeChangeable = false
          PortPullDownOption = false
          PortPullUpOption = false
        SOC_VIP_CSIH2_CS (PortPin7):
          PortBiDirectionControl = false
          PortDriveStrengthControl = false
          PortInputBufferControl = false
          PortInputSelection = TYPE_2_SUPP_PIS
          PortIpControl = false
          PortOpenDrainControl = false
          PortPinDioAltModeChangeable = false
          PortPinDirection = PORT_PIN_IN
          PortPinDirectionChangeable = false
          PortPinInitialMode = DIO
          PortPinLevelValue = PORT_PIN_LEVEL_LOW
          PortPinModeChangeable = false
          PortPullDownOption = false
          PortPullUpOption = false
        SI479XX_VIP_INT_3V3 (PortPin9):
          PortBiDirectionControl = false
          PortDriveStrengthControl = false
          PortInputBufferControl = false
          PortInputSelection = TYPE_2_SUPP_PIS
          PortIpControl = false
          PortOpenDrainControl = false
          PortPinDioAltModeChangeable = false
          PortPinDirection = PORT_PIN_IN
          PortPinDirectionChangeable = false
          PortPinInitialMode = DIO
          PortPinLevelValue = PORT_PIN_LEVEL_LOW
          PortPinModeChangeable = false
          PortPullDownOption = false
          PortPullUpOption = false
        VIP_SOC_CSIH1_REQ1 (PortPin10):
          PortBiDirectionControl = false
          PortDriveStrengthControl = false
          PortInputBufferControl = false
          PortInputSelection = TYPE_2_SUPP_PIS
          PortIpControl = false
          PortOpenDrainControl = false
          PortPinDioAltModeChangeable = false
          PortPinDirection = PORT_PIN_OUT
          PortPinDirectionChangeable = false
          PortPinInitialMode = DIO
          PortPinLevelValue = PORT_PIN_LEVEL_LOW
          PortPinModeChangeable = false
          PortPullDownOption = false
          PortPullUpOption = false
        VIP_VD3V3_SYNC (PortPin11):
          PortBiDirectionControl = false
          PortDriveStrengthControl = false
          PortInputBufferControl = false
          PortInputSelection = TYPE_2_SUPP_PIS
          PortIpControl = false
          PortOpenDrainControl = false
          PortPinDioAltModeChangeable = false
          PortPinDirection = PORT_PIN_IN
          PortPinDirectionChangeable = false
          PortPinInitialMode = DIO
          PortPinLevelValue = PORT_PIN_LEVEL_LOW
          PortPinModeChangeable = false
          PortPullDownOption = false
          PortPullUpOption = false
        VIP_20098_EN (PortPin12):
          PortBiDirectionControl = false
          PortDriveStrengthControl = false
          PortInputBufferControl = false
          PortInputSelection = TYPE_2_SUPP_PIS
          PortIpControl = false
          PortOpenDrainControl = false
          PortPinDioAltModeChangeable = false
          PortPinDirection = PORT_PIN_IN
          PortPinDirectionChangeable = false
          PortPinInitialMode = DIO
          PortPinLevelValue = PORT_PIN_LEVEL_LOW
          PortPinModeChangeable = false
          PortPullDownOption = false
          PortPullUpOption = false
        VIP_20098_PG (PortPin13):
          PortBiDirectionControl = false
          PortDriveStrengthControl = false
          PortInputBufferControl = false
          PortInputSelection = TYPE_2_SUPP_PIS
          PortIpControl = false
          PortOpenDrainControl = false
          PortPinDioAltModeChangeable = false
          PortPinDirection = PORT_PIN_IN
          PortPinDirectionChangeable = false
          PortPinInitialMode = DIO
          PortPinLevelValue = PORT_PIN_LEVEL_LOW
          PortPinModeChangeable = false
          PortPullDownOption = false
          PortPullUpOption = false
        VIP_SOC_CSIH2_REQ1 (PortPin14):
          PortBiDirectionControl = false
          PortDriveStrengthControl = false
          PortInputBufferControl = false
          PortInputSelection = TYPE_2_SUPP_PIS
          PortIpControl = false
          PortOpenDrainControl = false
          PortPinDioAltModeChangeable = false
          PortPinDirection = PORT_PIN_OUT
          PortPinDirectionChangeable = false
          PortPinInitialMode = DIO
          PortPinLevelValue = PORT_PIN_LEVEL_LOW
          PortPinModeChangeable = false
          PortPullDownOption = false
          PortPullUpOption = false
        VIP_OPL_IDL (PortPin15):
          PortBiDirectionControl = false
          PortDriveStrengthControl = false
          PortInputBufferControl = false
          PortInputSelection = TYPE_2_SUPP_PIS
          PortOpenDrainControl = false
          PortPinDioAltModeChangeable = false
          PortPinDirection = PORT_PIN_IN
          PortPinDirectionChangeable = false
          PortPinInitialMode = DIO
          PortPinLevelValue = PORT_PIN_LEVEL_LOW
          PortPinModeChangeable = false
          PortPullDownOption = false
          PortPullUpOption = false
        VIP_MIC_res_key (PortPin5):
          PortBiDirectionControl = false
          PortDriveStrengthControl = false
          PortInputBufferControl = false
          PortInputSelection = TYPE_2_SUPP_PIS
          PortIpControl = false
          PortOpenDrainControl = false
          PortPinDioAltModeChangeable = false
          PortPinDirection = PORT_PIN_OUT
          PortPinDirectionChangeable = false
          PortPinInitialMode = DIO
          PortPinLevelValue = PORT_PIN_LEVEL_LOW
          PortPinModeChangeable = false
          PortPullDownOption = false
          PortPullUpOption = false
      PortGroup00 (PortGroup0)
        VIP_I2C0_SDA (PortPin11):
          PortBiDirectionControl = false
          PortDriveStrengthControl = false
          PortInputBufferControl = false
          PortInputSelection = TYPE_2_SUPP_PIS
          PortOpenDrainControl = false
          PortPinDioAltModeChangeable = false
          PortPinDirection = PORT_PIN_IN
          PortPinDirectionChangeable = false
          PortPinInitialMode = DIO_PFC_PFCE_PMCSR
          PortPinLevelValue = PORT_PIN_LEVEL_LOW
          PortPinModeChangeable = false
          PortPullDownOption = false
          PortPullUpOption = false
        VIP_I2C0_SCL (PortPin12):
          PortBiDirectionControl = false
          PortDriveStrengthControl = false
          PortInputBufferControl = false
          PortInputSelection = TYPE_2_SUPP_PIS
          PortOpenDrainControl = false
          PortPinDioAltModeChangeable = false
          PortPinDirection = PORT_PIN_IN
          PortPinDirectionChangeable = false
          PortPinInitialMode = DIO_PFC_PFCE_PMCSR
          PortPinLevelValue = PORT_PIN_LEVEL_LOW
          PortPinModeChangeable = false
          PortPullDownOption = false
          PortPullUpOption = false
        VIP_CAN0_TXD (PortPin0):
          PortBiDirectionControl = false
          PortDriveStrengthControl = false
          PortInputBufferControl = false
          PortInputSelection = TYPE_2_SUPP_PIS
          PortOpenDrainControl = false
          PortPinDioAltModeChangeable = false
          PortPinDirection = PORT_PIN_OUT
          PortPinDirectionChangeable = false
          PortPinInitialMode = CAN0TX_AT2OUT
          PortPinLevelValue = PORT_PIN_LEVEL_LOW
          PortPinModeChangeable = false
          PortPullDownOption = false
          PortPullUpOption = false
        VIP_CAN0_RXD (PortPin1):
          PortBiDirectionControl = false
          PortDriveStrengthControl = false
          PortInputBufferControl = false
          PortInputSelection = TYPE_2_SUPP_PIS
          PortOpenDrainControl = false
          PortPinDioAltModeChangeable = false
          PortPinDirection = PORT_PIN_IN
          PortPinDirectionChangeable = false
          PortPinInitialMode = CAN0RX_AT2IN
          PortPinLevelValue = PORT_PIN_LEVEL_LOW
          PortPinModeChangeable = false
          PortPullDownOption = false
          PortPullUpOption = false
        VIP_CAN1_RXD (PortPin2):
          PortBiDirectionControl = false
          PortDriveStrengthControl = false
          PortInputBufferControl = false
          PortInputSelection = TYPE_2_SUPP_PIS
          PortIpControl = false
          PortOpenDrainControl = false
          PortPinDioAltModeChangeable = false
          PortPinDirection = PORT_PIN_IN
          PortPinDirectionChangeable = false
          PortPinInitialMode = CAN1RX_AT2IN
          PortPinLevelValue = PORT_PIN_LEVEL_LOW
          PortPinModeChangeable = false
          PortPullDownOption = false
          PortPullUpOption = false
        VIP_CAN1_TXD (PortPin3):
          PortBiDirectionControl = false
          PortDriveStrengthControl = false
          PortInputBufferControl = false
          PortInputSelection = TYPE_2_SUPP_PIS
          PortIpControl = false
          PortOpenDrainControl = false
          PortPinDioAltModeChangeable = false
          PortPinDirection = PORT_PIN_OUT
          PortPinDirectionChangeable = false
          PortPinInitialMode = CAN1TX_AT2OUT
          PortPinLevelValue = PORT_PIN_LEVEL_LOW
          PortPinModeChangeable = false
          PortPullDownOption = false
          PortPullUpOption = false
        VIP_RLIN31_RXD (PortPin4):
          PortBiDirectionControl = false
          PortDriveStrengthControl = false
          PortInputBufferControl = false
          PortInputSelection = TYPE_2_SUPP_PIS
          PortOpenDrainControl = false
          PortPinDioAltModeChangeable = false
          PortPinDirection = PORT_PIN_IN
          PortPinDirectionChangeable = false
          PortPinInitialMode = RLIN31RX_AT1IN
          PortPinLevelValue = PORT_PIN_LEVEL_LOW
          PortPinModeChangeable = false
          PortPullDownOption = false
          PortPullUpOption = false
        VIP_RLIN31_TXD (PortPin5):
          PortBiDirectionControl = false
          PortDriveStrengthControl = false
          PortInputBufferControl = false
          PortInputSelection = TYPE_2_SUPP_PIS
          PortIpControl = false
          PortOpenDrainControl = false
          PortPinDioAltModeChangeable = false
          PortPinDirection = PORT_PIN_OUT
          PortPinDirectionChangeable = false
          PortPinInitialMode = DIO
          PortPinLevelValue = PORT_PIN_LEVEL_LOW
          PortPinModeChangeable = false
          PortPullDownOption = false
          PortPullUpOption = false
        VIP_Gyro_INT1 (PortPin6):
          PortBiDirectionControl = false
          PortDriveStrengthControl = false
          PortInputBufferControl = false
          PortInputSelection = TYPE_2_SUPP_PIS
          PortIpControl = false
          PortOpenDrainControl = false
          PortPinDioAltModeChangeable = false
          PortPinDirection = PORT_PIN_IN
          PortPinDirectionChangeable = false
          PortPinInitialMode = DIO
          PortPinLevelValue = PORT_PIN_LEVEL_LOW
          PortPinModeChangeable = false
          PortPullDownOption = false
          PortPullUpOption = false
        VIP_CAN3_RXD (PortPin7):
          PortBiDirectionControl = false
          PortDriveStrengthControl = false
          PortInputBufferControl = false
          PortInputSelection = TYPE_2_SUPP_PIS
          PortOpenDrainControl = false
          PortPinDioAltModeChangeable = false
          PortPinDirection = PORT_PIN_IN
          PortPinDirectionChangeable = false
          PortPinInitialMode = CAN3RX_AT5IN
          PortPinLevelValue = PORT_PIN_LEVEL_LOW
          PortPinModeChangeable = false
          PortPullDownOption = false
          PortPullUpOption = false
        VIP_CAN3_TXD (PortPin8):
          PortBiDirectionControl = false
          PortDriveStrengthControl = false
          PortInputBufferControl = false
          PortInputSelection = TYPE_2_SUPP_PIS
          PortOpenDrainControl = false
          PortPinDioAltModeChangeable = false
          PortPinDirection = PORT_PIN_OUT
          PortPinDirectionChangeable = false
          PortPinInitialMode = CAN3TX_AT5OUT
          PortPinLevelValue = PORT_PIN_LEVEL_LOW
          PortPinModeChangeable = false
          PortPullDownOption = false
          PortPullUpOption = false
        VIP_ChargeEN_ODH (PortPin9):
          PortBiDirectionControl = false
          PortDriveStrengthControl = false
          PortInputBufferControl = false
          PortInputSelection = TYPE_2_SUPP_PIS
          PortOpenDrainControl = false
          PortPinDioAltModeChangeable = false
          PortPinDirection = PORT_PIN_OUT
          PortPinDirectionChangeable = false
          PortPinInitialMode = DIO
          PortPinLevelValue = PORT_PIN_LEVEL_LOW
          PortPinModeChangeable = false
          PortPullDownOption = false
          PortPullUpOption = false
        VIP_CAN3_STB (PortPin10):
          PortBiDirectionControl = false
          PortDriveStrengthControl = false
          PortInputBufferControl = false
          PortInputSelection = TYPE_2_SUPP_PIS
          PortOpenDrainControl = false
          PortPinDioAltModeChangeable = false
          PortPinDirection = PORT_PIN_OUT
          PortPinDirectionChangeable = false
          PortPinInitialMode = DIO
          PortPinLevelValue = PORT_PIN_LEVEL_HIGH
          PortPinModeChangeable = false
          PortPullDownOption = false
          PortPullUpOption = false
        VIP_RLIN32_RXD (PortPin13):
          PortBiDirectionControl = false
          PortDriveStrengthControl = false
          PortInputBufferControl = false
          PortInputSelection = TYPE_2_SUPP_PIS
          PortIpControl = false
          PortOpenDrainControl = false
          PortPinDioAltModeChangeable = false
          PortPinDirection = PORT_PIN_IN
          PortPinDirectionChangeable = false
          PortPinInitialMode = RLIN32RX_AT1IN
          PortPinLevelValue = PORT_PIN_LEVEL_LOW
          PortPinModeChangeable = false
          PortPullDownOption = false
          PortPullUpOption = false
        VIP_RLIN32_TXD (PortPin14):
          PortBiDirectionControl = false
          PortDriveStrengthControl = false
          PortInputBufferControl = false
          PortInputSelection = TYPE_2_SUPP_PIS
          PortIpControl = false
          PortOpenDrainControl = false
          PortPinDioAltModeChangeable = false
          PortPinDirection = PORT_PIN_OUT
          PortPinDirectionChangeable = false
          PortPinInitialMode = DIO
          PortPinLevelValue = PORT_PIN_LEVEL_LOW
          PortPinModeChangeable = false
          PortPullDownOption = false
          PortPullUpOption = false
      PortGroupAnalog1
        MIC_VIP_SENS1 (PortPin0):
          PortBiDirectionControl = false
          PortInputBufferControl = false
          PortPinDirection = PORT_PIN_IN
          PortPinDirectionChangeable = false
          PortPinInitialMode = ALT_NOT_SUPPORTED
          PortPinLevelValue = PORT_PIN_LEVEL_LOW
        MIC_VIP_SENS2 (PortPin1):
          PortBiDirectionControl = false
          PortInputBufferControl = false
          PortPinDirection = PORT_PIN_IN
          PortPinDirectionChangeable = false
          PortPinInitialMode = ALT_NOT_SUPPORTED
          PortPinLevelValue = PORT_PIN_LEVEL_LOW
        MIC_VIP_SENS1_N (PortPin2):
          PortBiDirectionControl = false
          PortInputBufferControl = false
          PortPinDirection = PORT_PIN_IN
          PortPinDirectionChangeable = false
          PortPinInitialMode = ALT_NOT_SUPPORTED
          PortPinLevelValue = PORT_PIN_LEVEL_LOW
        MIC_VIP_SENS2_N (PortPin3):
          PortBiDirectionControl = false
          PortInputBufferControl = false
          PortPinDirection = PORT_PIN_IN
          PortPinDirectionChangeable = false
          PortPinInitialMode = ALT_NOT_SUPPORTED
          PortPinLevelValue = PORT_PIN_LEVEL_LOW
        VIP_ETN_0_9V_EN (PortPin10):
          PortBiDirectionControl = false
          PortInputBufferControl = false
          PortPinDirection = PORT_PIN_IN
          PortPinDirectionChangeable = false
          PortPinInitialMode = ALT_NOT_SUPPORTED
          PortPinLevelValue = PORT_PIN_LEVEL_LOW
        VIP_ETN_2_5V_EN (PortPin11):
          PortBiDirectionControl = false
          PortInputBufferControl = false
          PortPinDirection = PORT_PIN_IN
          PortPinDirectionChangeable = false
          PortPinInitialMode = ALT_NOT_SUPPORTED
          PortPinLevelValue = PORT_PIN_LEVEL_LOW
        SXM_VIP_CTI (PortPin12):
          PortBiDirectionControl = false
          PortInputBufferControl = false
          PortPinDirection = PORT_PIN_IN
          PortPinDirectionChangeable = false
          PortPinInitialMode = ALT_NOT_SUPPORTED
          PortPinLevelValue = PORT_PIN_LEVEL_LOW
        SXM_VIP_FACT (PortPin13):
          PortBiDirectionControl = false
          PortInputBufferControl = false
          PortPinDirection = PORT_PIN_IN
          PortPinDirectionChangeable = false
          PortPinInitialMode = ALT_NOT_SUPPORTED
          PortPinLevelValue = PORT_PIN_LEVEL_LOW
        Tuner_VIP_debug1 (PortPin14):
          PortBiDirectionControl = false
          PortInputBufferControl = false
          PortPinDirection = PORT_PIN_IN
          PortPinDirectionChangeable = false
          PortPinInitialMode = ALT_NOT_SUPPORTED
          PortPinLevelValue = PORT_PIN_LEVEL_LOW
        Tuner_VIP_debug2 (PortPin15):
          PortBiDirectionControl = false
          PortInputBufferControl = false
          PortPinDirection = PORT_PIN_IN
          PortPinDirectionChangeable = false
          PortPinInitialMode = ALT_NOT_SUPPORTED
          PortPinLevelValue = PORT_PIN_LEVEL_LOW
      PortGroup11
        VIP_BSF_IDL (PortPin0):
          PortBiDirectionControl = false
          PortDriveStrengthControl = false
          PortInputBufferControl = false
          PortInputSelection = TYPE_2_SUPP_PIS
          PortOpenDrainControl = false
          PortPinDioAltModeChangeable = false
          PortPinDirection = PORT_PIN_IN
          PortPinDirectionChangeable = false
          PortPinInitialMode = DIO
          PortPinLevelValue = PORT_PIN_LEVEL_LOW
          PortPinModeChangeable = false
          PortPullDownOption = false
          PortPullUpOption = false
        VIP_AMP8532_DIAG3 (PortPin1):
          PortBiDirectionControl = false
          PortDriveStrengthControl = false
          PortInputBufferControl = false
          PortInputSelection = TYPE_2_SUPP_PIS
          PortIpControl = false
          PortOpenDrainControl = false
          PortPinDioAltModeChangeable = false
          PortPinDirection = PORT_PIN_IN
          PortPinDirectionChangeable = false
          PortPinInitialMode = DIO
          PortPinLevelValue = PORT_PIN_LEVEL_LOW
          PortPinModeChangeable = false
          PortPullDownOption = false
          PortPullUpOption = false
        SOC_VIP_CSIH2_SO (PortPin2):
          PortBiDirectionControl = false
          PortDriveStrengthControl = false
          PortInputBufferControl = false
          PortInputSelection = TYPE_2_SUPP_PIS
          PortIpControl = false
          PortOpenDrainControl = false
          PortPinDioAltModeChangeable = false
          PortPinDirection = PORT_PIN_OUT
          PortPinDirectionChangeable = false
          PortPinInitialMode = DIO
          PortPinLevelValue = PORT_PIN_LEVEL_LOW
          PortPinModeChangeable = false
          PortPullDownOption = false
          PortPullUpOption = false
        SOC_VIP_CSIH2_SC (PortPin3):
          PortBiDirectionControl = false
          PortDriveStrengthControl = false
          PortInputBufferControl = false
          PortInputSelection = TYPE_2_SUPP_PIS
          PortIpControl = false
          PortOpenDrainControl = false
          PortPinDioAltModeChangeable = false
          PortPinDirection = PORT_PIN_OUT
          PortPinDirectionChangeable = false
          PortPinInitialMode = DIO
          PortPinLevelValue = PORT_PIN_LEVEL_LOW
          PortPinModeChangeable = false
          PortPullDownOption = false
          PortPullUpOption = false
        SOC_VIP_CSIH2_SI (PortPin4):
          PortBiDirectionControl = false
          PortDriveStrengthControl = false
          PortInputBufferControl = false
          PortInputSelection = TYPE_2_SUPP_PIS
          PortIpControl = false
          PortOpenDrainControl = false
          PortPinDioAltModeChangeable = false
          PortPinDirection = PORT_PIN_OUT
          PortPinDirectionChangeable = false
          PortPinInitialMode = DIO
          PortPinLevelValue = PORT_PIN_LEVEL_LOW
          PortPinModeChangeable = false
          PortPullDownOption = false
          PortPullUpOption = false
        VIP_47961_RST_3V3 (PortPin8):
          PortBiDirectionControl = false
          PortDriveStrengthControl = false
          PortInputBufferControl = false
          PortInputSelection = TYPE_2_SUPP_PIS
          PortOpenDrainControl = false
          PortPinDioAltModeChangeable = false
          PortPinDirection = PORT_PIN_OUT
          PortPinDirectionChangeable = false
          PortPinInitialMode = DIO_PFC_PFCE_PMCSR
          PortPinLevelValue = PORT_PIN_LEVEL_LOW
          PortPinModeChangeable = false
          PortPullDownOption = false
          PortPullUpOption = false
        SI4624_VIP_INT_3V3 (PortPin9):
          PortBiDirectionControl = false
          PortDriveStrengthControl = false
          PortInputBufferControl = false
          PortInputSelection = TYPE_2_SUPP_PIS
          PortIpControl = false
          PortOpenDrainControl = false
          PortPinDioAltModeChangeable = false
          PortPinDirection = PORT_PIN_IN
          PortPinDirectionChangeable = false
          PortPinInitialMode = DIO
          PortPinLevelValue = PORT_PIN_LEVEL_LOW
          PortPinModeChangeable = false
          PortPullDownOption = false
          PortPullUpOption = false
        VIP_MIC_POWER_EN_3V3 (PortPin10):
          PortBiDirectionControl = false
          PortDriveStrengthControl = false
          PortInputBufferControl = false
          PortInputSelection = TYPE_2_SUPP_PIS
          PortIpControl = false
          PortOpenDrainControl = false
          PortPinDioAltModeChangeable = false
          PortPinDirection = PORT_PIN_OUT
          PortPinDirectionChangeable = false
          PortPinInitialMode = DIO
          PortPinLevelValue = PORT_PIN_LEVEL_LOW
          PortPinModeChangeable = false
          PortPullDownOption = false
          PortPullUpOption = false
        VIP_TUNER_ANT_EN_3V3 (PortPin11):
          PortBiDirectionControl = false
          PortDriveStrengthControl = false
          PortInputBufferControl = false
          PortInputSelection = TYPE_2_SUPP_PIS
          PortOpenDrainControl = false
          PortPinDioAltModeChangeable = false
          PortPinDirection = PORT_PIN_OUT
          PortPinDirectionChangeable = false
          PortPinInitialMode = DIO
          PortPinLevelValue = PORT_PIN_LEVEL_LOW
          PortPinModeChangeable = false
          PortPullDownOption = false
          PortPullUpOption = false
        VIP_ETN_1V_PWR_EN (PortPin12):
          PortBiDirectionControl = false
          PortDriveStrengthControl = false
          PortInputBufferControl = false
          PortInputSelection = TYPE_2_SUPP_PIS
          PortOpenDrainControl = false
          PortPinDioAltModeChangeable = false
          PortPinDirection = PORT_PIN_OUT
          PortPinDirectionChangeable = false
          PortPinInitialMode = DIO
          PortPinLevelValue = PORT_PIN_LEVEL_LOW
          PortPinModeChangeable = false
          PortPullDownOption = false
          PortPullUpOption = false
        VIP_VG1V2_EN (PortPin15):
          PortBiDirectionControl = false
          PortDriveStrengthControl = false
          PortInputBufferControl = false
          PortInputSelection = TYPE_2_SUPP_PIS
          PortOpenDrainControl = false
          PortPinDioAltModeChangeable = false
          PortPinDirection = PORT_PIN_OUT
          PortPinDirectionChangeable = false
          PortPinInitialMode = DIO
          PortPinLevelValue = PORT_PIN_LEVEL_LOW
          PortPinModeChangeable = false
          PortPullDownOption = false
          PortPullUpOption = false
      PortGroup01 (PortGroup1)
        VIP_RLIN32_INH (PortPin3):
          PortBiDirectionControl = false
          PortDriveStrengthControl = false
          PortInputBufferControl = false
          PortInputSelection = TYPE_2_SUPP_PIS
          PortOpenDrainControl = false
          PortPinDioAltModeChangeable = false
          PortPinDirection = PORT_PIN_IN
          PortPinDirectionChangeable = false
          PortPinInitialMode = INTP19_AT1IN_PFC_PFCE_PMCSR
          PortPinLevelValue = PORT_PIN_LEVEL_LOW
          PortPinModeChangeable = false
          PortPullDownOption = false
          PortPullUpOption = false
        VIP_SI_IDH (PortPin0):
          PortBiDirectionControl = false
          PortDriveStrengthControl = false
          PortInputBufferControl = false
          PortInputSelection = TYPE_2_SUPP_PIS
          PortOpenDrainControl = false
          PortPinDioAltModeChangeable = false
          PortPinDirection = PORT_PIN_IN
          PortPinDirectionChangeable = false
          PortPinInitialMode = INTP13_AT2IN
          PortPinLevelValue = PORT_PIN_LEVEL_LOW
          PortPinModeChangeable = false
          PortPullDownOption = false
          PortPullUpOption = false
        VIP_RLIN31_INH (PortPin1):
          PortBiDirectionControl = false
          PortDriveStrengthControl = false
          PortInputBufferControl = false
          PortInputSelection = TYPE_2_SUPP_PIS
          PortOpenDrainControl = false
          PortPinDioAltModeChangeable = false
          PortPinDirection = PORT_PIN_IN
          PortPinDirectionChangeable = false
          PortPinInitialMode = INTP18_AT1IN_PFC_PFCE_PMCSR
          PortPinLevelValue = PORT_PIN_LEVEL_LOW
          PortPinModeChangeable = false
          PortPullDownOption = false
          PortPullUpOption = false
        VIP_UART_RXD (PortPin4):
          PortBiDirectionControl = false
          PortDriveStrengthControl = false
          PortInputBufferControl = false
          PortInputSelection = TYPE_2_SUPP_PIS
          PortOpenDrainControl = false
          PortPinDioAltModeChangeable = false
          PortPinDirection = PORT_PIN_OUT
          PortPinDirectionChangeable = false
          PortPinInitialMode = DIO
          PortPinLevelValue = PORT_PIN_LEVEL_HIGH
          PortPinModeChangeable = false
          PortPullDownOption = false
          PortPullUpOption = false
        VIP_UART_TXD (PortPin5):
          PortBiDirectionControl = false
          PortDriveStrengthControl = false
          PortInputBufferControl = false
          PortInputSelection = TYPE_2_SUPP_PIS
          PortOpenDrainControl = false
          PortPinDioAltModeChangeable = false
          PortPinDirection = PORT_PIN_OUT
          PortPinDirectionChangeable = false
          PortPinInitialMode = DIO_PFC_PFCE_PMCSR
          PortPinLevelValue = PORT_PIN_LEVEL_LOW
          PortPinModeChangeable = false
          PortPullDownOption = false
          PortPullUpOption = false
        VIP_PWR_VG5V_M_EN (PortPin8):
          PortBiDirectionControl = false
          PortDriveStrengthControl = false
          PortInputBufferControl = false
          PortInputSelection = TYPE_2_SUPP_PIS
          PortOpenDrainControl = false
          PortPinDioAltModeChangeable = false
          PortPinDirection = PORT_PIN_OUT
          PortPinDirectionChangeable = false
          PortPinInitialMode = ALT_NOT_SUPPORTED
          PortPinLevelValue = PORT_PIN_LEVEL_LOW
          PortPinModeChangeable = false
          PortPullDownOption = false
          PortPullUpOption = false
        VIP_LVI_IDL (PortPin9):
          PortBiDirectionControl = false
          PortDriveStrengthControl = false
          PortInputBufferControl = false
          PortInputSelection = TYPE_2_SUPP_PIS
          PortOpenDrainControl = false
          PortPinDioAltModeChangeable = false
          PortPinDirection = PORT_PIN_IN
          PortPinDirectionChangeable = false
          PortPinInitialMode = INTP21_AT3IN_PFC_PFCE_PMCSR
          PortPinLevelValue = PORT_PIN_LEVEL_LOW
          PortPinModeChangeable = false
          PortPullDownOption = false
          PortPullUpOption = false
        VIP_RTC_INT (PortPin10):
          PortBiDirectionControl = false
          PortDriveStrengthControl = false
          PortInputBufferControl = false
          PortInputSelection = TYPE_2_SUPP_PIS
          PortOpenDrainControl = false
          PortPinDioAltModeChangeable = false
          PortPinDirection = PORT_PIN_IN
          PortPinDirectionChangeable = false
          PortPinInitialMode = DIO_PFC_PFCE_PMCSR
          PortPinLevelValue = PORT_PIN_LEVEL_LOW
          PortPinModeChangeable = false
          PortPullDownOption = false
          PortPullUpOption = false
        VIP_CAN1_STB (PortPin11):
          PortBiDirectionControl = false
          PortDriveStrengthControl = false
          PortInputBufferControl = false
          PortInputSelection = TYPE_2_SUPP_PIS
          PortOpenDrainControl = false
          PortPinDioAltModeChangeable = false
          PortPinDirection = PORT_PIN_OUT
          PortPinDirectionChangeable = false
          PortPinInitialMode = DIO_PFC_PFCE_PMCSR
          PortPinLevelValue = PORT_PIN_LEVEL_HIGH
          PortPinModeChangeable = false
          PortPullDownOption = false
          PortPullUpOption = false
        VIP_VG3V3_VIP_EN (PortPin14):
          PortBiDirectionControl = false
          PortDriveStrengthControl = false
          PortInputBufferControl = false
          PortInputSelection = TYPE_2_SUPP_PIS
          PortOpenDrainControl = false
          PortPinDioAltModeChangeable = false
          PortPinDirection = PORT_PIN_OUT
          PortPinDirectionChangeable = false
          PortPinInitialMode = DIO
          PortPinLevelValue = PORT_PIN_LEVEL_LOW
          PortPinModeChangeable = false
          PortPullDownOption = false
          PortPullUpOption = false
        VIP_PD_EN_ODH (PortPin15):
          PortBiDirectionControl = false
          PortDriveStrengthControl = false
          PortInputBufferControl = false
          PortInputSelection = TYPE_2_SUPP_PIS
          PortOpenDrainControl = false
          PortPinDioAltModeChangeable = false
          PortPinDirection = PORT_PIN_OUT
          PortPinDirectionChangeable = false
          PortPinInitialMode = DIO_PFC_PMCSR
          PortPinLevelValue = PORT_PIN_LEVEL_LOW
          PortPinModeChangeable = false
          PortPullDownOption = false
          PortPullUpOption = false
      PortGroup20
        PMIC_VIP_FAULT (PortPin0):
          PortBiDirectionControl = false
          PortDriveStrengthControl = false
          PortInputBufferControl = false
          PortInputSelection = TYPE_2_SUPP_PIS
          PortOpenDrainControl = false
          PortPinDioAltModeChangeable = false
          PortPinDirection = PORT_PIN_IN
          PortPinDirectionChangeable = false
          PortPinInitialMode = DIO
          PortPinLevelValue = PORT_PIN_LEVEL_LOW
          PortPinModeChangeable = false
          PortPullDownOption = false
          PortPullUpOption = false
        VIP_USB1_CTRL2 (PortPin1):
          PortBiDirectionControl = false
          PortDriveStrengthControl = false
          PortInputBufferControl = false
          PortInputSelection = TYPE_2_SUPP_PIS
          PortIpControl = false
          PortOpenDrainControl = false
          PortPinDioAltModeChangeable = false
          PortPinDirection = PORT_PIN_OUT
          PortPinDirectionChangeable = false
          PortPinInitialMode = DIO_PFC_PFCE_PMCSR
          PortPinLevelValue = PORT_PIN_LEVEL_LOW
          PortPinModeChangeable = false
          PortPullDownOption = false
          PortPullUpOption = false
        VIP_TM_IDL (PortPin2):
          PortBiDirectionControl = false
          PortDriveStrengthControl = false
          PortInputBufferControl = false
          PortInputSelection = TYPE_2_SUPP_PIS
          PortIpControl = false
          PortOpenDrainControl = false
          PortPinDioAltModeChangeable = false
          PortPinDirection = PORT_PIN_OUT
          PortPinDirectionChangeable = false
          PortPinInitialMode = DIO
          PortPinLevelValue = PORT_PIN_LEVEL_LOW
          PortPinModeChangeable = false
          PortPullDownOption = false
          PortPullUpOption = false
        VIP_USB1_FAULT_N (PortPin3):
          PortBiDirectionControl = false
          PortDriveStrengthControl = false
          PortInputBufferControl = false
          PortInputSelection = TYPE_2_SUPP_PIS
          PortOpenDrainControl = false
          PortPinDioAltModeChangeable = false
          PortPinDirection = PORT_PIN_OUT
          PortPinDirectionChangeable = false
          PortPinInitialMode = DIO_PFC_PFCE_PMCSR
          PortPinLevelValue = PORT_PIN_LEVEL_LOW
          PortPinModeChangeable = false
          PortPullDownOption = false
          PortPullUpOption = false
        VIP_USB1_EN (PortPin4):
          PortBiDirectionControl = false
          PortDriveStrengthControl = false
          PortInputBufferControl = false
          PortInputSelection = TYPE_2_SUPP_PIS
          PortOpenDrainControl = false
          PortPinDioAltModeChangeable = false
          PortPinDirection = PORT_PIN_OUT
          PortPinDirectionChangeable = false
          PortPinInitialMode = DIO
          PortPinLevelValue = PORT_PIN_LEVEL_LOW
          PortPinModeChangeable = false
          PortPullDownOption = false
          PortPullUpOption = false
        VIP_USB1_CTRL1 (PortPin5):
          PortBiDirectionControl = false
          PortDriveStrengthControl = false
          PortInputBufferControl = false
          PortInputSelection = TYPE_2_SUPP_PIS
          PortOpenDrainControl = false
          PortPinDioAltModeChangeable = false
          PortPinDirection = PORT_PIN_OUT
          PortPinDirectionChangeable = true
          PortPinInitialMode = DIO_PFC_PFCE_PMCSR
          PortPinLevelValue = PORT_PIN_LEVEL_LOW
          PortPinModeChangeable = false
          PortPullDownOption = false
          PortPullUpOption = false
      PortGroupAnalog0
        VBATT_VIP_DET_ADC (PortPin0):
          PortBiDirectionControl = false
          PortInputBufferControl = false
          PortPinDirection = PORT_PIN_IN
          PortPinDirectionChangeable = false
          PortPinInitialMode = ALT_NOT_SUPPORTED
          PortPinLevelValue = PORT_PIN_LEVEL_LOW
        VIP_A1VREF_IAN (PortPin1):
          PortBiDirectionControl = false
          PortInputBufferControl = false
          PortPinDirection = PORT_PIN_IN
          PortPinDirectionChangeable = false
          PortPinInitialMode = ALT_NOT_SUPPORTED
          PortPinLevelValue = PORT_PIN_LEVEL_LOW
        VIP_VREF_Fuel_IAN (PortPin2):
          PortBiDirectionControl = false
          PortInputBufferControl = false
          PortPinDirection = PORT_PIN_IN
          PortPinDirectionChangeable = false
          PortPinInitialMode = ALT_NOT_SUPPORTED
          PortPinLevelValue = PORT_PIN_LEVEL_LOW
        VIP_Fuellevel1_IAN (PortPin3):
          PortBiDirectionControl = false
          PortInputBufferControl = false
          PortPinDirection = PORT_PIN_IN
          PortPinDirectionChangeable = false
          PortPinInitialMode = ALT_NOT_SUPPORTED
          PortPinLevelValue = PORT_PIN_LEVEL_LOW
        VIP_Fuellevel2_IAN (PortPin4):
          PortBiDirectionControl = false
          PortInputBufferControl = false
          PortPinDirection = PORT_PIN_IN
          PortPinDirectionChangeable = false
          PortPinInitialMode = ALT_NOT_SUPPORTED
          PortPinLevelValue = PORT_PIN_LEVEL_LOW
        VIP_Version_MON1_IAN (PortPin5):
          PortBiDirectionControl = false
          PortInputBufferControl = false
          PortPinDirection = PORT_PIN_IN
          PortPinDirectionChangeable = false
          PortPinInitialMode = ALT_NOT_SUPPORTED
          PortPinLevelValue = PORT_PIN_LEVEL_LOW
        VIP_Version_MON2_IAN (PortPin6):
          PortBiDirectionControl = false
          PortInputBufferControl = false
          PortPinDirection = PORT_PIN_IN
          PortPinDirectionChangeable = false
          PortPinInitialMode = ALT_NOT_SUPPORTED
          PortPinLevelValue = PORT_PIN_LEVEL_LOW
        VIP_BC_IAN (PortPin7):
          PortBiDirectionControl = false
          PortInputBufferControl = false
          PortPinDirection = PORT_PIN_IN
          PortPinDirectionChangeable = false
          PortPinInitialMode = ALT_NOT_SUPPORTED
          PortPinLevelValue = PORT_PIN_LEVEL_LOW
        VIP_ANT1_P_Diag (PortPin8):
          PortBiDirectionControl = false
          PortInputBufferControl = false
          PortPinDirection = PORT_PIN_IN
          PortPinDirectionChangeable = false
          PortPinInitialMode = ALT_NOT_SUPPORTED
          PortPinLevelValue = PORT_PIN_LEVEL_LOW
        VIP_ANT2_P_Diag (PortPin9):
          PortBiDirectionControl = false
          PortInputBufferControl = false
          PortPinDirection = PORT_PIN_IN
          PortPinDirectionChangeable = false
          PortPinInitialMode = ALT_NOT_SUPPORTED
          PortPinLevelValue = PORT_PIN_LEVEL_LOW
        GPSANTpwer_VIP_ADsense (PortPin10):
          PortBiDirectionControl = false
          PortInputBufferControl = false
          PortPinDirection = PORT_PIN_IN
          PortPinDirectionChangeable = false
          PortPinInitialMode = ALT_NOT_SUPPORTED
          PortPinLevelValue = PORT_PIN_LEVEL_LOW
        VIP_TPS7B7701_IAN (PortPin11):
          PortBiDirectionControl = false
          PortInputBufferControl = false
          PortPinDirection = PORT_PIN_IN
          PortPinDirectionChangeable = false
          PortPinInitialMode = ALT_NOT_SUPPORTED
          PortPinLevelValue = PORT_PIN_LEVEL_LOW
        VIP_NTC_MON2_IAN (PortPin12):
          PortBiDirectionControl = false
          PortInputBufferControl = false
          PortPinDirection = PORT_PIN_IN
          PortPinDirectionChangeable = false
          PortPinInitialMode = ALT_NOT_SUPPORTED
          PortPinLevelValue = PORT_PIN_LEVEL_LOW
        VIP_NTC_MON3_IAN (PortPin13):
          PortBiDirectionControl = false
          PortInputBufferControl = false
          PortPinDirection = PORT_PIN_IN
          PortPinDirectionChangeable = false
          PortPinInitialMode = ALT_NOT_SUPPORTED
          PortPinLevelValue = PORT_PIN_LEVEL_LOW
        VIP_PMIC_0752_IAN (PortPin14):
          PortBiDirectionControl = false
          PortInputBufferControl = false
          PortPinDirection = PORT_PIN_IN
          PortPinDirectionChangeable = false
          PortPinInitialMode = ALT_NOT_SUPPORTED
          PortPinLevelValue = PORT_PIN_LEVEL_LOW
        VIP_NTC_MON1_IAN (PortPin15):
          PortBiDirectionControl = false
          PortInputBufferControl = false
          PortPinDirection = PORT_PIN_IN
          PortPinDirectionChangeable = false
          PortPinInitialMode = ALT_NOT_SUPPORTED
          PortPinLevelValue = PORT_PIN_LEVEL_LOW
      PortGroup02 (PortGroup2)
        VIP_PWR_VG10V_EN (PortPin2):
          PortBiDirectionControl = false
          PortDriveStrengthControl = false
          PortInputBufferControl = false
          PortInputSelection = TYPE_2_SUPP_PIS
          PortOpenDrainControl = false
          PortPinDioAltModeChangeable = false
          PortPinDirection = PORT_PIN_OUT
          PortPinDirectionChangeable = false
          PortPinInitialMode = DIO_PMCSR
          PortPinLevelValue = PORT_PIN_LEVEL_LOW
          PortPinModeChangeable = false
          PortPullDownOption = false
          PortPullUpOption = false
        VIP_VG1V8_M_EN (PortPin3):
          PortBiDirectionControl = false
          PortDriveStrengthControl = false
          PortInputBufferControl = false
          PortInputSelection = TYPE_2_SUPP_PIS
          PortOpenDrainControl = false
          PortPinDioAltModeChangeable = false
          PortPinDirection = PORT_PIN_OUT
          PortPinDirectionChangeable = false
          PortPinInitialMode = DIO_PMCSR
          PortPinLevelValue = PORT_PIN_LEVEL_LOW
          PortPinModeChangeable = false
          PortPullDownOption = false
          PortPullUpOption = false
        VIP_ID_EN_ODH (PortPin4):
          PortBiDirectionControl = false
          PortDriveStrengthControl = false
          PortInputBufferControl = false
          PortInputSelection = TYPE_2_SUPP_PIS
          PortOpenDrainControl = false
          PortPinDioAltModeChangeable = false
          PortPinDirection = PORT_PIN_OUT
          PortPinDirectionChangeable = false
          PortPinInitialMode = DIO_PFC_PMCSR
          PortPinLevelValue = PORT_PIN_LEVEL_LOW
          PortPinModeChangeable = false
          PortPullDownOption = false
          PortPullUpOption = false
        VIP_HD_EN_ODH (PortPin5):
          PortBiDirectionControl = false
          PortDriveStrengthControl = false
          PortInputBufferControl = false
          PortInputSelection = TYPE_2_SUPP_PIS
          PortOpenDrainControl = false
          PortPinDioAltModeChangeable = false
          PortPinDirection = PORT_PIN_OUT
          PortPinDirectionChangeable = false
          PortPinInitialMode = DIO_PFC_PMCSR
          PortPinLevelValue = PORT_PIN_LEVEL_LOW
          PortPinModeChangeable = false
          PortPullDownOption = false
          PortPullUpOption = false
        VIP_POC_PWREN (PortPin6):
          PortBiDirectionControl = false
          PortDriveStrengthControl = false
          PortInputBufferControl = false
          PortInputSelection = TYPE_2_SUPP_PIS
          PortOpenDrainControl = false
          PortPinDioAltModeChangeable = false
          PortPinDirection = PORT_PIN_OUT
          PortPinDirectionChangeable = false
          PortPinInitialMode = DIO_PMCSR
          PortPinLevelValue = PORT_PIN_LEVEL_LOW
          PortPinModeChangeable = false
          PortPullDownOption = false
          PortPullUpOption = false
        VIP_RVC_PWREN (PortPin7):
          PortBiDirectionControl = false
          PortDriveStrengthControl = false
          PortInputBufferControl = false
          PortInputSelection = TYPE_2_SUPP_PIS
          PortOpenDrainControl = false
          PortPinDioAltModeChangeable = false
          PortPinDirection = PORT_PIN_OUT
          PortPinDirectionChangeable = false
          PortPinInitialMode = DIO_PMCSR
          PortPinLevelValue = PORT_PIN_LEVEL_LOW
          PortPinModeChangeable = false
          PortPullDownOption = false
          PortPullUpOption = false
        VIP_GPSANT_POWER_EN_3V3 (PortPin8):
          PortBiDirectionControl = false
          PortDriveStrengthControl = false
          PortInputBufferControl = false
          PortInputSelection = TYPE_2_SUPP_PIS
          PortOpenDrainControl = false
          PortPinDioAltModeChangeable = false
          PortPinDirection = PORT_PIN_OUT
          PortPinDirectionChangeable = false
          PortPinInitialMode = DIO_PMCSR
          PortPinLevelValue = PORT_PIN_LEVEL_LOW
          PortPinModeChangeable = false
          PortPullDownOption = false
          PortPullUpOption = false
        VIP_RLIN31_SLP (PortPin9):
          PortBiDirectionControl = false
          PortDriveStrengthControl = false
          PortInputBufferControl = false
          PortInputSelection = TYPE_2_SUPP_PIS
          PortOpenDrainControl = false
          PortPinDioAltModeChangeable = false
          PortPinDirection = PORT_PIN_OUT
          PortPinDirectionChangeable = false
          PortPinInitialMode = DIO_PMCSR
          PortPinLevelValue = PORT_PIN_LEVEL_LOW
          PortPinModeChangeable = false
          PortPullDownOption = false
          PortPullUpOption = false
        VIP_RLIN31_WAKE (PortPin10):
          PortBiDirectionControl = false
          PortDriveStrengthControl = false
          PortInputBufferControl = false
          PortInputSelection = TYPE_2_SUPP_PIS
          PortOpenDrainControl = false
          PortPinDioAltModeChangeable = false
          PortPinDirection = PORT_PIN_OUT
          PortPinDirectionChangeable = false
          PortPinInitialMode = DIO_PMCSR
          PortPinLevelValue = PORT_PIN_LEVEL_LOW
          PortPinModeChangeable = false
          PortPullDownOption = false
          PortPullUpOption = false
        VIP_RLIN32_SLP (PortPin11):
          PortBiDirectionControl = false
          PortDriveStrengthControl = false
          PortInputBufferControl = false
          PortInputSelection = TYPE_2_SUPP_PIS
          PortOpenDrainControl = false
          PortPinDioAltModeChangeable = false
          PortPinDirection = PORT_PIN_OUT
          PortPinDirectionChangeable = false
          PortPinInitialMode = DIO_PMCSR
          PortPinLevelValue = PORT_PIN_LEVEL_LOW
          PortPinModeChangeable = false
          PortPullDownOption = false
          PortPullUpOption = false
        VIP_RLIN32_WAKE (PortPin12):
          PortBiDirectionControl = false
          PortDriveStrengthControl = false
          PortInputBufferControl = false
          PortInputSelection = TYPE_2_SUPP_PIS
          PortOpenDrainControl = false
          PortPinDioAltModeChangeable = false
          PortPinDirection = PORT_PIN_OUT
          PortPinDirectionChangeable = false
          PortPinInitialMode = DIO_PMCSR
          PortPinLevelValue = PORT_PIN_LEVEL_LOW
          PortPinModeChangeable = false
          PortPullDownOption = false
          PortPullUpOption = false
        VIP_GPS_RST (PortPin13):
          PortBiDirectionControl = false
          PortDriveStrengthControl = false
          PortInputBufferControl = false
          PortInputSelection = TYPE_2_SUPP_PIS
          PortOpenDrainControl = false
          PortPinDioAltModeChangeable = false
          PortPinDirection = PORT_PIN_IN
          PortPinDirectionChangeable = false
          PortPinInitialMode = DIO_PMCSR
          PortPinLevelValue = PORT_PIN_LEVEL_LOW
          PortPinModeChangeable = false
          PortPullDownOption = false
          PortPullUpOption = false
        VIP_PWR_VGBOOST_EN (PortPin14):
          PortBiDirectionControl = false
          PortDriveStrengthControl = false
          PortInputBufferControl = false
          PortInputSelection = TYPE_2_SUPP_PIS
          PortOpenDrainControl = false
          PortPinDioAltModeChangeable = false
          PortPinDirection = PORT_PIN_OUT
          PortPinDirectionChangeable = false
          PortPinInitialMode = DIO_PMCSR
          PortPinLevelValue = PORT_PIN_LEVEL_LOW
          PortPinModeChangeable = false
          PortPullDownOption = false
          PortPullUpOption = false
        VIP_PWR_VG3V3_M_EN (PortPin15):
          PortBiDirectionControl = false
          PortDriveStrengthControl = false
          PortInputBufferControl = false
          PortInputSelection = TYPE_2_SUPP_PIS
          PortOpenDrainControl = false
          PortPinDioAltModeChangeable = false
          PortPinDirection = PORT_PIN_OUT
          PortPinDirectionChangeable = false
          PortPinInitialMode = DIO_PMCSR
          PortPinLevelValue = PORT_PIN_LEVEL_LOW
          PortPinModeChangeable = false
          PortPullDownOption = false
          PortPullUpOption = false
      PortGroup03 (PortGroup3)
        VIP_CD_EN_ODH (PortPin0):
          PortBiDirectionControl = false
          PortDriveStrengthControl = false
          PortInputBufferControl = false
          PortInputSelection = TYPE_2_SUPP_PIS
          PortOpenDrainControl = false
          PortPinDioAltModeChangeable = false
          PortPinDirection = PORT_PIN_OUT
          PortPinDirectionChangeable = false
          PortPinInitialMode = DIO_PMCSR
          PortPinLevelValue = PORT_PIN_LEVEL_LOW
          PortPinModeChangeable = false
          PortPullDownOption = false
          PortPullUpOption = false
      PortGroup09 (PortGroup9)
        VIP_I2C1_SDA (PortPin0):
          PortBiDirectionControl = false
          PortInputBufferControl = false
          PortInputSelection = TYPE_2_SUPP_PIS
          PortOpenDrainControl = false
          PortPinDioAltModeChangeable = false
          PortPinDirection = PORT_PIN_IN
          PortPinDirectionChangeable = false
          PortPinInitialMode = DIO
          PortPinLevelValue = PORT_PIN_LEVEL_LOW
          PortPinModeChangeable = false
          PortPullDownOption = false
          PortPullUpOption = false
        VIP_I2C1_SCL (PortPin1):
          PortBiDirectionControl = false
          PortInputBufferControl = false
          PortInputSelection = TYPE_2_SUPP_PIS
          PortOpenDrainControl = false
          PortPinDioAltModeChangeable = false
          PortPinDirection = PORT_PIN_IN
          PortPinDirectionChangeable = false
          PortPinInitialMode = DIO
          PortPinLevelValue = PORT_PIN_LEVEL_LOW
          PortPinModeChangeable = false
          PortPullDownOption = false
          PortPullUpOption = false
        SXM_VIP_STBY (PortPin2):
          PortBiDirectionControl = false
          PortInputBufferControl = false
          PortInputSelection = TYPE_2_SUPP_PIS
          PortOpenDrainControl = false
          PortPinDioAltModeChangeable = false
          PortPinDirection = PORT_PIN_IN
          PortPinDirectionChangeable = false
          PortPinInitialMode = DIO_PFC_PMCSR
          PortPinLevelValue = PORT_PIN_LEVEL_LOW
          PortPinModeChangeable = false
          PortPullDownOption = false
          PortPullUpOption = false
        VIP_PWR_VG10V_SYNC (PortPin3):
          PortBiDirectionControl = false
          PortInputBufferControl = false
          PortInputSelection = TYPE_2_SUPP_PIS
          PortOpenDrainControl = false
          PortPinDioAltModeChangeable = false
          PortPinDirection = PORT_PIN_IN
          PortPinDirectionChangeable = false
          PortPinInitialMode = DIO_PFC_PFCE_PMCSR
          PortPinLevelValue = PORT_PIN_LEVEL_LOW
          PortPinModeChangeable = false
          PortPullDownOption = false
          PortPullUpOption = false
        VIP_SOC3 (PortPin4):
          PortBiDirectionControl = false
          PortInputBufferControl = false
          PortInputSelection = TYPE_2_SUPP_PIS
          PortOpenDrainControl = false
          PortPinDioAltModeChangeable = false
          PortPinDirection = PORT_PIN_IN
          PortPinDirectionChangeable = false
          PortPinInitialMode = DIO_PFC_PFCE_PMCSR
          PortPinLevelValue = PORT_PIN_LEVEL_LOW
          PortPinModeChangeable = false
          PortPullDownOption = false
          PortPullUpOption = false
      PortGroup12
        VIP_479XX_RST_3V3 (PortPin0):
          PortBiDirectionControl = false
          PortDriveStrengthControl = false
          PortInputBufferControl = false
          PortInputSelection = TYPE_2_SUPP_PIS
          PortOpenDrainControl = false
          PortPinDioAltModeChangeable = false
          PortPinDirection = PORT_PIN_OUT
          PortPinDirectionChangeable = false
          PortPinInitialMode = DIO
          PortPinLevelValue = PORT_PIN_LEVEL_LOW
          PortPinModeChangeable = false
          PortPullDownOption = false
          PortPullUpOption = false
        VIP_4624_RST_3V3 (PortPin1):
          PortBiDirectionControl = false
          PortDriveStrengthControl = false
          PortInputBufferControl = false
          PortInputSelection = TYPE_2_SUPP_PIS
          PortOpenDrainControl = false
          PortPinDioAltModeChangeable = false
          PortPinDirection = PORT_PIN_OUT
          PortPinDirectionChangeable = false
          PortPinInitialMode = DIO
          PortPinLevelValue = PORT_PIN_LEVEL_LOW
          PortPinModeChangeable = false
          PortPullDownOption = false
          PortPullUpOption = false
        VIP_469X_RST_3V3 (PortPin2):
          PortBiDirectionControl = false
          PortDriveStrengthControl = false
          PortInputBufferControl = false
          PortInputSelection = TYPE_2_SUPP_PIS
          PortOpenDrainControl = false
          PortPinDioAltModeChangeable = false
          PortPinDirection = PORT_PIN_OUT
          PortPinDirectionChangeable = false
          PortPinInitialMode = DIO
          PortPinLevelValue = PORT_PIN_LEVEL_LOW
          PortPinModeChangeable = false
          PortPullDownOption = false
          PortPullUpOption = false
      PortGroup13
        VIP_SDARS_SHDN_3V3 (PortPin0):
          PortBiDirectionControl = false
          PortDriveStrengthControl = false
          PortInputBufferControl = false
          PortInputSelection = TYPE_2_SUPP_PIS
          PortOpenDrainControl = false
          PortPinDioAltModeChangeable = false
          PortPinDirection = PORT_PIN_OUT
          PortPinDirectionChangeable = false
          PortPinInitialMode = DIO_PMCSR
          PortPinLevelValue = PORT_PIN_LEVEL_LOW
          PortPinModeChangeable = false
          PortPullDownOption = false
          PortPullUpOption = false
        VIP_SDARS_RST_3V3 (PortPin1):
          PortBiDirectionControl = false
          PortDriveStrengthControl = false
          PortInputBufferControl = false
          PortInputSelection = TYPE_2_SUPP_PIS
          PortOpenDrainControl = false
          PortPinDioAltModeChangeable = false
          PortPinDirection = PORT_PIN_OUT
          PortPinDirectionChangeable = false
          PortPinInitialMode = DIO_PMCSR
          PortPinLevelValue = PORT_PIN_LEVEL_LOW
          PortPinModeChangeable = false
          PortPullDownOption = false
          PortPullUpOption = false
        VIP_A2BPWR_EN (PortPin2):
          PortBiDirectionControl = false
          PortDriveStrengthControl = false
          PortInputBufferControl = false
          PortInputSelection = TYPE_2_SUPP_PIS
          PortOpenDrainControl = false
          PortPinDioAltModeChangeable = false
          PortPinDirection = PORT_PIN_OUT
          PortPinDirectionChangeable = false
          PortPinInitialMode = DIO_PMCSR
          PortPinLevelValue = PORT_PIN_LEVEL_LOW
          PortPinModeChangeable = false
          PortPullDownOption = false
          PortPullUpOption = false
        VIP_SWITCH_SPI_EN (PortPin3):
          PortBiDirectionControl = false
          PortDriveStrengthControl = false
          PortInputBufferControl = false
          PortInputSelection = TYPE_2_SUPP_PIS
          PortOpenDrainControl = false
          PortPinDioAltModeChangeable = false
          PortPinDirection = PORT_PIN_OUT
          PortPinDirectionChangeable = false
          PortPinInitialMode = DIO_PMCSR
          PortPinLevelValue = PORT_PIN_LEVEL_LOW
          PortPinModeChangeable = false
          PortPullDownOption = false
          PortPullUpOption = false
        VIP_PMIC_CBL (PortPin5):
          PortBiDirectionControl = false
          PortDriveStrengthControl = false
          PortInputBufferControl = false
          PortInputSelection = TYPE_2_SUPP_PIS
          PortOpenDrainControl = false
          PortPinDioAltModeChangeable = false
          PortPinDirection = PORT_PIN_OUT
          PortPinDirectionChangeable = false
          PortPinInitialMode = DIO_PFC_PMCSR
          PortPinLevelValue = PORT_PIN_LEVEL_LOW
          PortPinModeChangeable = false
          PortPullDownOption = false
          PortPullUpOption = false
        VIP_PMIC_KPD (PortPin6):
          PortBiDirectionControl = false
          PortDriveStrengthControl = false
          PortInputBufferControl = false
          PortInputSelection = TYPE_2_SUPP_PIS
          PortOpenDrainControl = false
          PortPinDioAltModeChangeable = false
          PortPinDirection = PORT_PIN_OUT
          PortPinDirectionChangeable = false
          PortPinInitialMode = DIO_PFC_PMCSR
          PortPinLevelValue = PORT_PIN_LEVEL_LOW
          PortPinModeChangeable = false
          PortPullDownOption = false
          PortPullUpOption = false
        VIP_PMIC_RST (PortPin7):
          PortBiDirectionControl = false
          PortDriveStrengthControl = false
          PortInputBufferControl = false
          PortInputSelection = TYPE_2_SUPP_PIS
          PortOpenDrainControl = false
          PortPinDioAltModeChangeable = false
          PortPinDirection = PORT_PIN_OUT
          PortPinDirectionChangeable = false
          PortPinInitialMode = DIO_PFC_PMCSR
          PortPinLevelValue = PORT_PIN_LEVEL_LOW
          PortPinModeChangeable = false
          PortPullDownOption = false
          PortPullUpOption = false
      PortGroup18
        SOC_VIP_FAST_BOOT (PortPin0):
          PortBiDirectionControl = false
          PortDriveStrengthControl = false
          PortInputBufferControl = false
          PortInputSelection = TYPE_2_SUPP_PIS
          PortOpenDrainControl = false
          PortPinDioAltModeChangeable = false
          PortPinDirection = PORT_PIN_IN
          PortPinDirectionChangeable = false
          PortPinInitialMode = DIO_PFC_PFCE_PMCSR
          PortPinLevelValue = PORT_PIN_LEVEL_LOW
          PortPinModeChangeable = false
          PortPullDownOption = false
          PortPullUpOption = false
        VIP_USB1_SYNC (PortPin1):
          PortBiDirectionControl = false
          PortDriveStrengthControl = false
          PortInputBufferControl = false
          PortInputSelection = TYPE_2_SUPP_PIS
          PortOpenDrainControl = false
          PortPinDioAltModeChangeable = false
          PortPinDirection = PORT_PIN_OUT
          PortPinDirectionChangeable = false
          PortPinInitialMode = DIO_PFC_PFCE_PMCSR
          PortPinLevelValue = PORT_PIN_LEVEL_LOW
          PortPinModeChangeable = false
          PortPullDownOption = false
          PortPullUpOption = false
        VIP_AMP8531_MUTE (PortPin4):
          PortBiDirectionControl = false
          PortDriveStrengthControl = false
          PortInputBufferControl = false
          PortInputSelection = TYPE_2_SUPP_PIS
          PortOpenDrainControl = false
          PortPinDioAltModeChangeable = false
          PortPinDirection = PORT_PIN_OUT
          PortPinDirectionChangeable = false
          PortPinInitialMode = DIO_PFC_PMCSR
          PortPinLevelValue = PORT_PIN_LEVEL_LOW
          PortPinModeChangeable = false
          PortPullDownOption = false
          PortPullUpOption = false
        VIP_AMP8532_DIAG1 (PortPin5):
          PortBiDirectionControl = false
          PortDriveStrengthControl = false
          PortInputBufferControl = false
          PortInputSelection = TYPE_2_SUPP_PIS
          PortOpenDrainControl = false
          PortPinDioAltModeChangeable = false
          PortPinDirection = PORT_PIN_IN
          PortPinDirectionChangeable = false
          PortPinInitialMode = DIO_PFC_PMCSR
          PortPinLevelValue = PORT_PIN_LEVEL_LOW
          PortPinModeChangeable = false
          PortPullDownOption = false
          PortPullUpOption = false
        VIP_AMP8532_DIAG2 (PortPin6):
          PortBiDirectionControl = false
          PortDriveStrengthControl = false
          PortInputBufferControl = false
          PortInputSelection = TYPE_2_SUPP_PIS
          PortOpenDrainControl = false
          PortPinDioAltModeChangeable = false
          PortPinDirection = PORT_PIN_IN
          PortPinDirectionChangeable = false
          PortPinInitialMode = ALT_NOT_SUPPORTED
          PortPinLevelValue = PORT_PIN_LEVEL_LOW
          PortPinModeChangeable = false
          PortPullDownOption = false
          PortPullUpOption = false
        VIP_AMP8532_EN (PortPin8):
          PortBiDirectionControl = false
          PortDriveStrengthControl = false
          PortInputBufferControl = false
          PortInputSelection = TYPE_2_SUPP_PIS
          PortOpenDrainControl = false
          PortPinDioAltModeChangeable = false
          PortPinDirection = PORT_PIN_OUT
          PortPinDirectionChangeable = false
          PortPinInitialMode = DIO_PMCSR
          PortPinLevelValue = PORT_PIN_LEVEL_LOW
          PortPinModeChangeable = false
          PortPullDownOption = false
          PortPullUpOption = false
        VIP_AMP8532_MUTE (PortPin9):
          PortBiDirectionControl = false
          PortDriveStrengthControl = false
          PortInputBufferControl = false
          PortInputSelection = TYPE_2_SUPP_PIS
          PortOpenDrainControl = false
          PortPinDioAltModeChangeable = false
          PortPinDirection = PORT_PIN_OUT
          PortPinDirectionChangeable = false
          PortPinInitialMode = DIO_PMCSR
          PortPinLevelValue = PORT_PIN_LEVEL_LOW
          PortPinModeChangeable = false
          PortPullDownOption = false
          PortPullUpOption = false
        VIP_AMP8531_DIAG1 (PortPin10):
          PortBiDirectionControl = false
          PortDriveStrengthControl = false
          PortInputBufferControl = false
          PortInputSelection = TYPE_2_SUPP_PIS
          PortOpenDrainControl = false
          PortPinDioAltModeChangeable = false
          PortPinDirection = PORT_PIN_IN
          PortPinDirectionChangeable = false
          PortPinInitialMode = ALT_NOT_SUPPORTED
          PortPinLevelValue = PORT_PIN_LEVEL_LOW
          PortPinModeChangeable = false
          PortPullDownOption = false
          PortPullUpOption = false
        VIP_AMP8531_DIAG2 (PortPin11):
          PortBiDirectionControl = false
          PortDriveStrengthControl = false
          PortInputBufferControl = false
          PortInputSelection = TYPE_2_SUPP_PIS
          PortOpenDrainControl = false
          PortPinDioAltModeChangeable = false
          PortPinDirection = PORT_PIN_IN
          PortPinDirectionChangeable = false
          PortPinInitialMode = ALT_NOT_SUPPORTED
          PortPinLevelValue = PORT_PIN_LEVEL_LOW
          PortPinModeChangeable = false
          PortPullDownOption = false
          PortPullUpOption = false
        VIP_AMP8531_EN (PortPin13):
          PortBiDirectionControl = false
          PortDriveStrengthControl = false
          PortInputBufferControl = false
          PortInputSelection = TYPE_2_SUPP_PIS
          PortOpenDrainControl = false
          PortPinDioAltModeChangeable = false
          PortPinDirection = PORT_PIN_OUT
          PortPinDirectionChangeable = false
          PortPinInitialMode = ALT_NOT_SUPPORTED
          PortPinLevelValue = PORT_PIN_LEVEL_LOW
          PortPinModeChangeable = false
          PortPullDownOption = false
          PortPullUpOption = false
        VIP_DSP_SELE (PortPin14):
          PortBiDirectionControl = false
          PortDriveStrengthControl = false
          PortInputBufferControl = false
          PortInputSelection = TYPE_2_SUPP_PIS
          PortOpenDrainControl = false
          PortPinDioAltModeChangeable = false
          PortPinDirection = PORT_PIN_OUT
          PortPinDirectionChangeable = false
          PortPinInitialMode = ALT_NOT_SUPPORTED
          PortPinLevelValue = PORT_PIN_LEVEL_LOW
          PortPinModeChangeable = false
          PortPullDownOption = false
          PortPullUpOption = false
        VIP_DSP_REST_3V3 (PortPin15):
          PortBiDirectionControl = false
          PortDriveStrengthControl = false
          PortInputBufferControl = false
          PortInputSelection = TYPE_2_SUPP_PIS
          PortOpenDrainControl = false
          PortPinDioAltModeChangeable = false
          PortPinDirection = PORT_PIN_OUT
          PortPinDirectionChangeable = false
          PortPinInitialMode = ALT_NOT_SUPPORTED
          PortPinLevelValue = PORT_PIN_LEVEL_LOW
          PortPinModeChangeable = false
          PortPullDownOption = false
          PortPullUpOption = false
        VIP_ETN_1V_SYNC (PortPin3):
          PortBiDirectionControl = false
          PortDriveStrengthControl = false
          PortInputBufferControl = false
          PortInputSelection = TYPE_2_SUPP_PIS
          PortOpenDrainControl = false
          PortPinDioAltModeChangeable = false
          PortPinDirection = PORT_PIN_OUT
          PortPinDirectionChangeable = false
          PortPinInitialMode = DIO_PFC_PFCE_PMCSR
          PortPinLevelValue = PORT_PIN_LEVEL_LOW
          PortPinModeChangeable = false
          PortPullDownOption = false
          PortPullUpOption = false
      PortGroup19
        VIP_ADC_M_REST (PortPin0):
          PortBiDirectionControl = false
          PortDriveStrengthControl = false
          PortInputBufferControl = false
          PortInputSelection = TYPE_2_SUPP_PIS
          PortOpenDrainControl = false
          PortPinDioAltModeChangeable = false
          PortPinDirection = PORT_PIN_OUT
          PortPinDirectionChangeable = false
          PortPinInitialMode = ALT_NOT_SUPPORTED
          PortPinLevelValue = PORT_PIN_LEVEL_LOW
          PortPinModeChangeable = false
          PortPullDownOption = false
          PortPullUpOption = false
        VIP_RTC_FEN (PortPin1):
          PortBiDirectionControl = false
          PortDriveStrengthControl = false
          PortInputBufferControl = false
          PortInputSelection = TYPE_2_SUPP_PIS
          PortOpenDrainControl = false
          PortPinDioAltModeChangeable = false
          PortPinDirection = PORT_PIN_OUT
          PortPinDirectionChangeable = false
          PortPinInitialMode = ALT_NOT_SUPPORTED
          PortPinLevelValue = PORT_PIN_LEVEL_LOW
          PortPinModeChangeable = false
          PortPullDownOption = false
          PortPullUpOption = false
        A2B_VIP_INT (PortPin2):
          PortBiDirectionControl = false
          PortDriveStrengthControl = false
          PortInputBufferControl = false
          PortInputSelection = TYPE_2_SUPP_PIS
          PortOpenDrainControl = false
          PortPinDioAltModeChangeable = false
          PortPinDirection = PORT_PIN_OUT
          PortPinDirectionChangeable = false
          PortPinInitialMode = ALT_NOT_SUPPORTED
          PortPinLevelValue = PORT_PIN_LEVEL_LOW
          PortPinModeChangeable = false
          PortPullDownOption = false
          PortPullUpOption = false
        VIP_REVERSE_IRQ (PortPin3):
          PortBiDirectionControl = false
          PortDriveStrengthControl = false
          PortInputBufferControl = false
          PortInputSelection = TYPE_2_SUPP_PIS
          PortOpenDrainControl = false
          PortPinDioAltModeChangeable = false
          PortPinDirection = PORT_PIN_OUT
          PortPinDirectionChangeable = false
          PortPinInitialMode = ALT_NOT_SUPPORTED
          PortPinLevelValue = PORT_PIN_LEVEL_LOW
          PortPinModeChangeable = false
          PortPullDownOption = false
          PortPullUpOption = false
