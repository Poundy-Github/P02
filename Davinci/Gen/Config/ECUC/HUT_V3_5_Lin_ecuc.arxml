AUTOSAR XML (schema 00046)
package /ActiveEcuC
  module config Lin: implementation-config-variant=VARIANT-PRE-COMPILE, module-description=Lin_Impl
    LinGeneral:
      LinDevErrorDetect = true
      LinIndex = 0
      LinTimeoutDuration = 100
      LinVersionInfoApi = false
      LinTypeOfInterruptFunction = CATEGORY2
      LinRuntimeMeasurementSupport = false
      LinSafeBswChecks = false
      LinNodeTypeAllowed = Master
    LinGlobalConfig
      CN_LIN00_fd825f00 (LinChannel):  # LIN00
        LinChannelBaudRate = 19200
        LinChannelId = 0
        LinNodeType = MASTER
        LinChannelWakeupSupport = false
        LinUart = 0
        LinUnitName = RLIN3n
        LinSynchBreakLength = 14
        LinBreakDelimiterLength = 2
        LinUnitNumber = 1
        LinClockRef = McuClockReferencePoint_LIN
      CN_LIN00_fd825f00_001 (LinChannel):
        LinChannelBaudRate = 19200
        LinChannelId = 1
        LinNodeType = MASTER
        LinChannelWakeupSupport = false
        LinUart = 0
        LinUnitName = RLIN3n
        LinSynchBreakLength = 14
        LinBreakDelimiterLength = 2
        LinUnitNumber = 2
        LinClockRef = McuClockReferencePoint_LIN
    LinPlatformConfig:
      LinRegisterAddresses = 0xFFCE0000L 0xFFCE0080L 0xFFCE0100L 0xFFCE0180L 0xFFCE2000L 0xFFCE2040L 0xFFCE2080L 0xFFCE20C0L 0xFFCE2100L 0xFFCE2140L 0xFFCE2180L 0xFFCE21C0L
      LinRlin24ChannelName = 20 21 22 23 24 25 26 27 28 29 210 211 212 213 214 215
      LinRlin21ChannelName = -
      LinRlin3ChannelName = 30 31 32 33 34 35 36 37
      LinRlin3Only3Isr = false
