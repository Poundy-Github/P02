AUTOSAR XML (schema 00046)
package /ActiveEcuC
  module config vBaseEnv: implementation-config-variant=VARIANT-PRE-COMPILE, module-description=vBaseEnv_Impl
    vBaseEnvGeneral: vBaseEnvTestedDerivativeRef=RH850_1651
      8 x vBaseEnvDerivativeInformation, all with vBaseEnvAvailableChannels_Flexray=2, vBaseEnvAvailableChannels_Can=8, vBaseEnvCpuCoreAmount=1, vBaseEnvCpuCore=G3KH:
        RH850_1638: vBaseEnvCpuMaxFrequency=160000000, vBaseEnvAvailableChannels_Lin=18, vBaseEnvAvailableChannels_Ethernet=1, vBaseEnvTestedDerivative=RH850_1638, vBaseEnvTestedDerivativeDescription=Renesas RH850 F1KM_S4 Family R7F701638
          vBaseEnvAdditionalParameters: vBaseEnvClockGroup=A2, vBaseEnvDerivativeGroup=F1KM_S4, vBaseEnvPllGroup=A4, vBaseEnvProtectionGroup=A, vBaseEnvPortGroup=A, vBaseEnvResetGroup=A
          8 x vBaseEnvMemLayoutHwRegion:
            CodeFlash: vBaseEnvHwRegionSize=3145728, vBaseEnvHwRegionStartAddress=0
            LocalRAM: vBaseEnvHwRegionSize=163840, vBaseEnvHwRegionStartAddress=4273831936
            GlobalRAM_A: vBaseEnvHwRegionSize=49152, vBaseEnvHwRegionStartAddress=4277092352
            GlobalRAM_B: vBaseEnvHwRegionSize=49152, vBaseEnvHwRegionStartAddress=4278140928
            DataFlash: vBaseEnvHwRegionSize=98304, vBaseEnvHwRegionStartAddress=4280287232
            CodeFlash_Ext: vBaseEnvHwRegionSize=32768, vBaseEnvHwRegionStartAddress=16777216
            RetentionRAM: vBaseEnvHwRegionSize=65536, vBaseEnvHwRegionStartAddress=4277141504
            LocalRAM_Self: vBaseEnvHwRegionSize=163840, vBaseEnvHwRegionStartAddress=4275929088
        RH850_1639: vBaseEnvCpuMaxFrequency=160000000, vBaseEnvAvailableChannels_Lin=18, vBaseEnvAvailableChannels_Ethernet=1, vBaseEnvTestedDerivative=RH850_1639, vBaseEnvTestedDerivativeDescription=Renesas RH850 F1KM_S4 Family R7F701639
          vBaseEnvAdditionalParameters: vBaseEnvClockGroup=A2, vBaseEnvDerivativeGroup=F1KM_S4, vBaseEnvPllGroup=A4, vBaseEnvProtectionGroup=A, vBaseEnvPortGroup=A, vBaseEnvResetGroup=A
          8 x vBaseEnvMemLayoutHwRegion:
            CodeFlash: vBaseEnvHwRegionSize=4194304, vBaseEnvHwRegionStartAddress=0
            LocalRAM: vBaseEnvHwRegionSize=196608, vBaseEnvHwRegionStartAddress=4273799168
            GlobalRAM_A: vBaseEnvHwRegionSize=65536, vBaseEnvHwRegionStartAddress=4277075968
            GlobalRAM_B: vBaseEnvHwRegionSize=65536, vBaseEnvHwRegionStartAddress=4278124544
            DataFlash: vBaseEnvHwRegionSize=131072, vBaseEnvHwRegionStartAddress=4280287232
            CodeFlash_Ext: vBaseEnvHwRegionSize=32768, vBaseEnvHwRegionStartAddress=16777216
            RetentionRAM: vBaseEnvHwRegionSize=65536, vBaseEnvHwRegionStartAddress=4277141504
            LocalRAM_Self: vBaseEnvHwRegionSize=196608, vBaseEnvHwRegionStartAddress=4275896320
        RH850_1644: vBaseEnvCpuMaxFrequency=240000000, vBaseEnvAvailableChannels_Lin=6, vBaseEnvAvailableChannels_Ethernet=0, vBaseEnvTestedDerivative=RH850_1644, vBaseEnvTestedDerivativeDescription=Renesas RH850 F1KM_S4 Family R7F701644
          vBaseEnvAdditionalParameters: vBaseEnvClockGroup=A2, vBaseEnvDerivativeGroup=F1KM_S4, vBaseEnvPllGroup=A4, vBaseEnvProtectionGroup=A, vBaseEnvPortGroup=A, vBaseEnvResetGroup=A
          8 x vBaseEnvMemLayoutHwRegion:
            CodeFlash: vBaseEnvHwRegionSize=3145728, vBaseEnvHwRegionStartAddress=0
            LocalRAM: vBaseEnvHwRegionSize=196608, vBaseEnvHwRegionStartAddress=4273799168
            GlobalRAM_A: vBaseEnvHwRegionSize=65536, vBaseEnvHwRegionStartAddress=4277075968
            GlobalRAM_B: vBaseEnvHwRegionSize=65536, vBaseEnvHwRegionStartAddress=4278124544
            DataFlash: vBaseEnvHwRegionSize=131072, vBaseEnvHwRegionStartAddress=4280287232
            CodeFlash_Ext: vBaseEnvHwRegionSize=32768, vBaseEnvHwRegionStartAddress=16777216
            RetentionRAM: vBaseEnvHwRegionSize=65536, vBaseEnvHwRegionStartAddress=4277141504
            LocalRAM_Self: vBaseEnvHwRegionSize=196608, vBaseEnvHwRegionStartAddress=4275896320
        RH850_1647: vBaseEnvCpuMaxFrequency=240000000, vBaseEnvAvailableChannels_Lin=12, vBaseEnvAvailableChannels_Ethernet=0, vBaseEnvTestedDerivative=RH850_1647, vBaseEnvTestedDerivativeDescription=Renesas RH850 F1KM_S4 Family R7F701647
          vBaseEnvAdditionalParameters: vBaseEnvClockGroup=A2, vBaseEnvDerivativeGroup=F1KM_S4, vBaseEnvPllGroup=A4, vBaseEnvProtectionGroup=A, vBaseEnvPortGroup=A, vBaseEnvResetGroup=A
          8 x vBaseEnvMemLayoutHwRegion:
            CodeFlash: vBaseEnvHwRegionSize=4194304, vBaseEnvHwRegionStartAddress=0
            LocalRAM: vBaseEnvHwRegionSize=262144, vBaseEnvHwRegionStartAddress=4273733632
            GlobalRAM_A: vBaseEnvHwRegionSize=98304, vBaseEnvHwRegionStartAddress=4277043200
            GlobalRAM_B: vBaseEnvHwRegionSize=98304, vBaseEnvHwRegionStartAddress=4278091776
            DataFlash: vBaseEnvHwRegionSize=131072, vBaseEnvHwRegionStartAddress=4280287232
            CodeFlash_Ext: vBaseEnvHwRegionSize=32768, vBaseEnvHwRegionStartAddress=1048576
            RetentionRAM: vBaseEnvHwRegionSize=65536, vBaseEnvHwRegionStartAddress=4277141504
            LocalRAM_Self: vBaseEnvHwRegionSize=262144, vBaseEnvHwRegionStartAddress=4275830784
        RH850_1648: vBaseEnvCpuMaxFrequency=240000000, vBaseEnvAvailableChannels_Lin=18, vBaseEnvAvailableChannels_Ethernet=1, vBaseEnvTestedDerivative=RH850_1648, vBaseEnvTestedDerivativeDescription=Renesas RH850 F1KM_S4 Family R7F701648
          vBaseEnvAdditionalParameters: vBaseEnvClockGroup=A2, vBaseEnvDerivativeGroup=F1KM_S4, vBaseEnvPllGroup=A4, vBaseEnvProtectionGroup=A, vBaseEnvPortGroup=A, vBaseEnvResetGroup=A
          8 x vBaseEnvMemLayoutHwRegion:
            CodeFlash: vBaseEnvHwRegionSize=3145728, vBaseEnvHwRegionStartAddress=0
            LocalRAM: vBaseEnvHwRegionSize=196608, vBaseEnvHwRegionStartAddress=4273733632
            GlobalRAM_A: vBaseEnvHwRegionSize=65536, vBaseEnvHwRegionStartAddress=4277043200
            GlobalRAM_B: vBaseEnvHwRegionSize=65536, vBaseEnvHwRegionStartAddress=4278091776
            DataFlash: vBaseEnvHwRegionSize=131072, vBaseEnvHwRegionStartAddress=4280287232
            CodeFlash_Ext: vBaseEnvHwRegionSize=32768, vBaseEnvHwRegionStartAddress=1048576
            RetentionRAM: vBaseEnvHwRegionSize=65536, vBaseEnvHwRegionStartAddress=4277141504
            LocalRAM_Self: vBaseEnvHwRegionSize=196608, vBaseEnvHwRegionStartAddress=4275830784
        RH850_1649: vBaseEnvCpuMaxFrequency=240000000, vBaseEnvAvailableChannels_Lin=18, vBaseEnvAvailableChannels_Ethernet=1, vBaseEnvTestedDerivative=RH850_1649, vBaseEnvTestedDerivativeDescription=Renesas RH850 F1KM_S4 Family R7F701649
          vBaseEnvAdditionalParameters: vBaseEnvClockGroup=A2, vBaseEnvDerivativeGroup=F1KM_S4, vBaseEnvPllGroup=A4, vBaseEnvProtectionGroup=A, vBaseEnvPortGroup=A, vBaseEnvResetGroup=A
          8 x vBaseEnvMemLayoutHwRegion:
            CodeFlash: vBaseEnvHwRegionSize=4194304, vBaseEnvHwRegionStartAddress=0
            LocalRAM: vBaseEnvHwRegionSize=262144, vBaseEnvHwRegionStartAddress=4273733632
            GlobalRAM_A: vBaseEnvHwRegionSize=98304, vBaseEnvHwRegionStartAddress=4277043200
            GlobalRAM_B: vBaseEnvHwRegionSize=98304, vBaseEnvHwRegionStartAddress=4278091776
            DataFlash: vBaseEnvHwRegionSize=131072, vBaseEnvHwRegionStartAddress=4280287232
            CodeFlash_Ext: vBaseEnvHwRegionSize=32768, vBaseEnvHwRegionStartAddress=16777216
            RetentionRAM: vBaseEnvHwRegionSize=65536, vBaseEnvHwRegionStartAddress=4277141504
            LocalRAM_Self: vBaseEnvHwRegionSize=262144, vBaseEnvHwRegionStartAddress=4275830784
        RH850_1651: vBaseEnvCpuMaxFrequency=240000000, vBaseEnvAvailableChannels_Lin=20, vBaseEnvAvailableChannels_Ethernet=1, vBaseEnvTestedDerivative=RH850_1651, vBaseEnvTestedDerivativeDescription=Renesas RH850 F1KM_S4 Family R7F7016514ABG-C
          vBaseEnvAdditionalParameters: vBaseEnvClockGroup=A2, vBaseEnvDerivativeGroup=F1KM_S4, vBaseEnvPllGroup=A4, vBaseEnvProtectionGroup=A, vBaseEnvPortGroup=A, vBaseEnvResetGroup=A
          8 x vBaseEnvMemLayoutHwRegion:
            CodeFlash: vBaseEnvHwRegionSize=4194304, vBaseEnvHwRegionStartAddress=0
            LocalRAM: vBaseEnvHwRegionSize=262144, vBaseEnvHwRegionStartAddress=4273733632
            GlobalRAM_A: vBaseEnvHwRegionSize=98304, vBaseEnvHwRegionStartAddress=4277043200
            GlobalRAM_B: vBaseEnvHwRegionSize=98304, vBaseEnvHwRegionStartAddress=4278091776
            DataFlash: vBaseEnvHwRegionSize=131072, vBaseEnvHwRegionStartAddress=4280287232
            CodeFlash_Ext: vBaseEnvHwRegionSize=32768, vBaseEnvHwRegionStartAddress=16777216
            RetentionRAM: vBaseEnvHwRegionSize=65536, vBaseEnvHwRegionStartAddress=4277141504
            LocalRAM_Self: vBaseEnvHwRegionSize=262144, vBaseEnvHwRegionStartAddress=4275830784
        RH850_1653: vBaseEnvCpuMaxFrequency=240000000, vBaseEnvAvailableChannels_Lin=20, vBaseEnvAvailableChannels_Ethernet=1, vBaseEnvTestedDerivative=RH850_1653, vBaseEnvTestedDerivativeDescription=Renesas RH850 F1KM_S4 Family R7F7016534ABG-C
          vBaseEnvAdditionalParameters: vBaseEnvClockGroup=A2, vBaseEnvDerivativeGroup=F1KM_S4, vBaseEnvPllGroup=A4, vBaseEnvProtectionGroup=A, vBaseEnvPortGroup=A, vBaseEnvResetGroup=A
          8 x vBaseEnvMemLayoutHwRegion:
            CodeFlash: vBaseEnvHwRegionSize=4194304, vBaseEnvHwRegionStartAddress=0
            LocalRAM: vBaseEnvHwRegionSize=262144, vBaseEnvHwRegionStartAddress=4273733632
            GlobalRAM_A: vBaseEnvHwRegionSize=98304, vBaseEnvHwRegionStartAddress=4277043200
            GlobalRAM_B: vBaseEnvHwRegionSize=98304, vBaseEnvHwRegionStartAddress=4278091776
            DataFlash: vBaseEnvHwRegionSize=131072, vBaseEnvHwRegionStartAddress=4280287232
            CodeFlash_Ext: vBaseEnvHwRegionSize=32768, vBaseEnvHwRegionStartAddress=16777216
            RetentionRAM: vBaseEnvHwRegionSize=65536, vBaseEnvHwRegionStartAddress=4277141504
            LocalRAM_Self: vBaseEnvHwRegionSize=262144, vBaseEnvHwRegionStartAddress=4275830784
      8 x vBaseEnvMemLayoutHwRegion:
        CodeFlash
        LocalRAM
        GlobalRAM_A
        GlobalRAM_B
        DataFlash
        CodeFlash_Ext
        RetentionRAM
        LocalRAM_Self
      vBaseEnvInterruptHandling
        vBaseEnvCan
          28 x vBaseEnvChannel, all with vBaseEnvIsrInterruptPriority=3:
            ICRCANGERR0: vBaseEnvIndex=0, vBaseEnvIsrInterruptSource=22
            ICRCANGRECC0: vBaseEnvIndex=0, vBaseEnvIsrInterruptSource=23
            ICRCAN0ERR: vBaseEnvIndex=0, vBaseEnvIsrInterruptSource=24
            ICRCAN0REC: vBaseEnvIndex=0, vBaseEnvIsrInterruptSource=25
            ICRCAN0TRX: vBaseEnvIndex=0, vBaseEnvIsrInterruptSource=26
            ICRCAN1ERR: vBaseEnvIndex=1, vBaseEnvIsrInterruptSource=113
            ICRCAN1REC: vBaseEnvIndex=1, vBaseEnvIsrInterruptSource=114
            ICRCAN1TRX: vBaseEnvIndex=1, vBaseEnvIsrInterruptSource=115
            ICRCAN2ERR: vBaseEnvIndex=2, vBaseEnvIsrInterruptSource=217
            ICRCAN2REC: vBaseEnvIndex=2, vBaseEnvIsrInterruptSource=218
            ICRCAN2TRX: vBaseEnvIndex=2, vBaseEnvIsrInterruptSource=219
            ICRCAN3ERR: vBaseEnvIndex=3, vBaseEnvIsrInterruptSource=220
            ICRCAN3REC: vBaseEnvIndex=3, vBaseEnvIsrInterruptSource=221
            ICRCAN3TRX: vBaseEnvIndex=3, vBaseEnvIsrInterruptSource=222
            ICRCAN4ERR: vBaseEnvIndex=4, vBaseEnvIsrInterruptSource=272
            ICRCAN4REC: vBaseEnvIndex=4, vBaseEnvIsrInterruptSource=273
            ICRCAN4TRX: vBaseEnvIndex=4, vBaseEnvIsrInterruptSource=274
            ICRCAN5ERR: vBaseEnvIndex=5, vBaseEnvIsrInterruptSource=287
            ICRCAN5REC: vBaseEnvIndex=5, vBaseEnvIsrInterruptSource=288
            ICRCAN5TRX: vBaseEnvIndex=5, vBaseEnvIsrInterruptSource=289
            ICRCANGERR: vBaseEnvIndex=1, vBaseEnvIsrInterruptSource=319
            ICRCANGRECC1: vBaseEnvIndex=1, vBaseEnvIsrInterruptSource=320
            ICRCAN6ERR: vBaseEnvIndex=6, vBaseEnvIsrInterruptSource=321
            ICRCAN6REC: vBaseEnvIndex=6, vBaseEnvIsrInterruptSource=322
            ICRCAN6TRX: vBaseEnvIndex=6, vBaseEnvIsrInterruptSource=323
            ICRCAN7ERR: vBaseEnvIndex=7, vBaseEnvIsrInterruptSource=332
            ICRCAN7REC: vBaseEnvIndex=7, vBaseEnvIsrInterruptSource=333
            ICRCAN7TRX: vBaseEnvIndex=7, vBaseEnvIsrInterruptSource=334
        vBaseEnvLin
          44 x vBaseEnvChannel, all with vBaseEnvIsrInterruptPriority=3:
            ICRLIN30: vBaseEnvIndex=0, vBaseEnvIsrInterruptSource=33
            ICRLIN30UR0: vBaseEnvIndex=0, vBaseEnvIsrInterruptSource=34
            ICRLIN30UR1: vBaseEnvIndex=0, vBaseEnvIsrInterruptSource=35
            ICRLIN30UR2: vBaseEnvIndex=0, vBaseEnvIsrInterruptSource=36
            ICRLIN20: vBaseEnvIndex=20, vBaseEnvIsrInterruptSource=58
            ICRLIN21: vBaseEnvIndex=21, vBaseEnvIsrInterruptSource=59
            ICRLIN31: vBaseEnvIndex=1, vBaseEnvIsrInterruptSource=120
            ICRLIN31UR0: vBaseEnvIndex=1, vBaseEnvIsrInterruptSource=121
            ICRLIN31UR1: vBaseEnvIndex=1, vBaseEnvIsrInterruptSource=122
            ICRLIN31UR2: vBaseEnvIndex=1, vBaseEnvIsrInterruptSource=123
            ICRLIN22: vBaseEnvIndex=22, vBaseEnvIsrInterruptSource=162
            ICRLIN23: vBaseEnvIndex=23, vBaseEnvIsrInterruptSource=163
            ICRLIN32: vBaseEnvIndex=2, vBaseEnvIsrInterruptSource=164
            ICRLIN32UR0: vBaseEnvIndex=2, vBaseEnvIsrInterruptSource=165
            ICRLIN32UR1: vBaseEnvIndex=2, vBaseEnvIsrInterruptSource=166
            ICRLIN32UR2: vBaseEnvIndex=2, vBaseEnvIsrInterruptSource=167
            ICRLIN24: vBaseEnvIndex=24, vBaseEnvIsrInterruptSource=226
            ICRLIN25: vBaseEnvIndex=25, vBaseEnvIsrInterruptSource=227
            ICRLIN33: vBaseEnvIndex=3, vBaseEnvIsrInterruptSource=228
            ICRLIN33UR0: vBaseEnvIndex=3, vBaseEnvIsrInterruptSource=229
            ICRLIN33UR1: vBaseEnvIndex=3, vBaseEnvIsrInterruptSource=230
            ICRLIN33UR2: vBaseEnvIndex=3, vBaseEnvIsrInterruptSource=231
            ICRLIN34: vBaseEnvIndex=4, vBaseEnvIsrInterruptSource=232
            ICRLIN34UR0: vBaseEnvIndex=4, vBaseEnvIsrInterruptSource=233
            ICRLIN34UR1: vBaseEnvIndex=4, vBaseEnvIsrInterruptSource=234
            ICRLIN34UR2: vBaseEnvIndex=4, vBaseEnvIsrInterruptSource=235
            ICRLIN35: vBaseEnvIndex=5, vBaseEnvIsrInterruptSource=236
            ICRLIN35UR0: vBaseEnvIndex=5, vBaseEnvIsrInterruptSource=237
            ICRLIN35UR1: vBaseEnvIndex=5, vBaseEnvIsrInterruptSource=238
            ICRLIN35UR2: vBaseEnvIndex=5, vBaseEnvIsrInterruptSource=239
            ICRLIN26: vBaseEnvIndex=26, vBaseEnvIsrInterruptSource=275
            ICRLIN27: vBaseEnvIndex=27, vBaseEnvIsrInterruptSource=276
            ICRLIN28: vBaseEnvIndex=28, vBaseEnvIsrInterruptSource=285
            ICRLIN29: vBaseEnvIndex=29, vBaseEnvIsrInterruptSource=286
            ICRLIN210: vBaseEnvIndex=30, vBaseEnvIsrInterruptSource=324
            ICRLIN211: vBaseEnvIndex=31, vBaseEnvIsrInterruptSource=325
            ICRLIN36: vBaseEnvIndex=6, vBaseEnvIsrInterruptSource=360
            ICRLIN36UR0: vBaseEnvIndex=6, vBaseEnvIsrInterruptSource=361
            ICRLIN36UR1: vBaseEnvIndex=6, vBaseEnvIsrInterruptSource=362
            ICRLIN36UR2: vBaseEnvIndex=6, vBaseEnvIsrInterruptSource=363
            ICRLIN37: vBaseEnvIndex=7, vBaseEnvIsrInterruptSource=364
            ICRLIN37UR0: vBaseEnvIndex=7, vBaseEnvIsrInterruptSource=365
            ICRLIN37UR1: vBaseEnvIndex=7, vBaseEnvIsrInterruptSource=366
            ICRLIN37UR2: vBaseEnvIndex=7, vBaseEnvIsrInterruptSource=367
        vBaseEnvFlexray
          11 x vBaseEnvChannel, all with vBaseEnvIndex=0, vBaseEnvIsrInterruptPriority=4:
            ICFLXA0FDA: vBaseEnvIsrInterruptSource=173
            ICFLXA0FW: vBaseEnvIsrInterruptSource=174
            ICFLXA0IQE: vBaseEnvIsrInterruptSource=175
            ICFLXA0IQF: vBaseEnvIsrInterruptSource=176
            ICFLXA0OT: vBaseEnvIsrInterruptSource=177
            ICFLXA0OW: vBaseEnvIsrInterruptSource=178
            ICFLXA0LINE0: vBaseEnvIsrInterruptSource=179
            ICFLXA0LINE1: vBaseEnvIsrInterruptSource=180
            ICFLXA0TIM0: vBaseEnvIsrInterruptSource=181
            ICFLXA0TIM1: vBaseEnvIsrInterruptSource=182
            ICFLXA0TIM2: vBaseEnvIsrInterruptSource=183
        vBaseEnvEthernet
          4 x vBaseEnvChannel, all with vBaseEnvIndex=0, vBaseEnvIsrInterruptPriority=1:
            ICETNB0DATA: vBaseEnvIsrInterruptSource=315
            ICETNB0ERR: vBaseEnvIsrInterruptSource=316
            ICETNB0MNG: vBaseEnvIsrInterruptSource=317
            ICETNB0MAC: vBaseEnvIsrInterruptSource=318
