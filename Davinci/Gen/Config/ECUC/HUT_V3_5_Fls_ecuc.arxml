AUTOSAR XML (schema 00046)
package /ActiveEcuC
  module config Fls: implementation-config-variant=VARIANT-PRE-COMPILE, module-description=Fls_Impl
    FlsGeneral:
      FlsVersionCheckExternalModules = false
      FlsAcLoadOnJobStart = false
      FlsBaseAddress = 4280287232
      FlsBlankCheckApi = true
      FlsCancelApi = true
      FlsCompareApi = true
      FlsCriticalSectionProtection = true
      FlsDevErrorDetect = true
      FlsDeviceName = R7F701651
      FlsDriverIndex = 0
      FlsEccNotificationInitCheck = true
      FlsFcuWaitCount = 32
      FlsGetJobResultApi = true
      FlsGetStatusApi = true
      FlsRAMMirror = MIRROR_DISABLE
      FlsSetModeApi = true
      FlsTimeoutMonitoring = false
      FlsTotalSize = 32768
      FlsUseInterrupts = false
      FlsUseWriteVerifyErrorInterface = true
      FlsVersionInfoApi = true
      FlsVirtualBoundaryAddress = 131072
      FlsWriteVerify = WV_DISABLE
      FlsDataFlash:
        FlsBlankCheckApi = true
        FlsDataFlashSize = 131072
        FlsDFBaseAddress = 4280287232
        FlsDFBlockSize = 64
        FlsDFTotalBlocks = 2048
        FlsReadImmediateApi = false
        FlsResumeApi = false
        FlsSuspendApi = false
        FlsCpuFrequency = McuClockSettingConfig
    FlsConfigSet:
      FlsMaxReadFastMode = 4
      FlsMaxReadNormalMode = 4
      FlsAcErase = 0
      FlsAcWrite = 0
      FlsCallCycle = 0.005
      FlsDefaultMode = MEMIF_MODE_SLOW
      FlsMaxEraseNormalMode = 64
      FlsMaxWriteFastMode = 0
      FlsMaxWriteNormalMode = 4
      FlsProtection = 0
      FlsSectorList
        FlsSector: FlsNumberOfSectors=512, FlsPageSize=4, FlsSectorIndex=0, FlsSectorSize=64, FlsSectorStartaddress=0
    FlsPublishedInformation:
      FlsAcLocationErase = 0
      FlsAcLocationWrite = 0
      FlsAcSizeErase = 0
      FlsAcSizeWrite = 0
      FlsBlankCheckTime = 0.000213
      FlsCancelTime = 0.00005
      FlsErasedValue = 4294967295
      FlsEraseTime = 0.01
      FlsExpectedHwId = NULL
      FlsSpecifiedEraseCycles = 125000
      FlsSuspendTime = 0.0003
      FlsWriteTime = 0.0017
