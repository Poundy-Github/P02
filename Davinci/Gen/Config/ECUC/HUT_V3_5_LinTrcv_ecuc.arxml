AUTOSAR XML (schema 00046)
package /ActiveEcuC
  module config LinTrcv: implementation-config-variant=VARIANT-PRE-COMPILE, module-description=LinTrcv_Impl
    LinTrcvGeneral: LinTrcvDevErrorDetect=true, LinTrcvGetVersionInfo=false, LinTrcvIndex=0, LinTrcvWaitCount=0, LinTrcvWakeUpSupport=false, LinTrcvSafeBswChecks=false
    LinTrcvChannel:
      LinTrcvChannelId = 0
      LinTrcvChannelUsed = true
      LinTrcvInitState = LINTRCV_TRCV_MODE_NORMAL
      LinTrcvWakeupByBusUsed = false
      LinTrcvWakeupByPinUsed = false
      LinTrcvSleepInitWorkaround = false
      LinTrcvAccess
        LinTrcvDioAccess
          3 x LinTrcvDioChannelAccess:
            PinEN: LinTrcvHardwareInterfaceName=DioPinEn, LinTrcvDioSymRefName=VIP_RLIN31_SLP
            PinRX: LinTrcvHardwareInterfaceName=DioPinRx, LinTrcvDioSymRefName=VIP_RLIN31_RXD
            PinTX: LinTrcvHardwareInterfaceName=DioPinTx, LinTrcvDioSymRefName=VIP_RLIN31_TXD
      LinTrcvWakeupSourceDetectionDefinition: LinTrcvWakeUpByBusIdentification=TxHighRxLow, LinTrcvWakeUpByPinIdentification=TxLowRxLow
    LinTrcvChannel_001 (LinTrcvChannel):
      LinTrcvChannelId = 1
      LinTrcvChannelUsed = true
      LinTrcvInitState = LINTRCV_TRCV_MODE_NORMAL
      LinTrcvWakeupByBusUsed = false
      LinTrcvWakeupByPinUsed = false
      LinTrcvSleepInitWorkaround = false
      LinTrcvAccess
        LinTrcvDioAccess
          3 x LinTrcvDioChannelAccess:
            PinEN: LinTrcvHardwareInterfaceName=DioPinEn, LinTrcvDioSymRefName=VIP_RLIN32_SLP
            PinRX: LinTrcvHardwareInterfaceName=DioPinRx, LinTrcvDioSymRefName=VIP_RLIN32_RXD
            PinTX: LinTrcvHardwareInterfaceName=DioPinTx, LinTrcvDioSymRefName=VIP_RLIN32_TXD
      LinTrcvWakeupSourceDetectionDefinition: LinTrcvWakeUpByBusIdentification=TxHighRxLow, LinTrcvWakeUpByPinIdentification=TxLowRxLow
