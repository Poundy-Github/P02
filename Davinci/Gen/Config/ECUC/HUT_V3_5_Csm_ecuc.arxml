AUTOSAR XML (schema 00046)
package /ActiveEcuC
  module config Csm: implementation-config-variant=VARIANT-PRE-COMPILE, module-description=Csm_Impl
    CsmGeneral:
      CsmAsymPrivateKeyMaxLength = 32
      CsmAsymPublicKeyMaxLength = 1024
      CsmDevErrorDetect = true
      CsmMainFunctionPeriod = 0.005
      CsmSymKeyMaxLength = 16
      CsmUseDeprecated = false
      CsmVersionInfoApi = false
      CsmCallbackStartNotification = false
      CsmEnforce430JobTypeCompatibility = true
      CsmEnableVarMembersOfJobType = false
      CsmCustomIncludeFiles = Crypto_30_vHsm_Custom.h
    CsmJobs
      27 x CsmJob:
        CsmJob_CMAC_Generate_HUT_IP2: CsmJobId=4, CsmJobPriority=60, CsmJobUsePort=false, CsmProcessingMode=CRYPTO_PROCESSING_ASYNC, CsmJobInterfaceUsePort=CRYPTO_USE_FNC, CsmJobKeyRef=CsmKey, CsmJobPrimitiveRef=Csm/CsmPrimitives_Generate, CsmJobQueueRef=CsmQueue_SecOC_Generate, CsmJobPrimitiveCallbackRef=CsmJob_CMAC_Generate, CsmJobCalloutRef=CSM_SecOc_CsmCallout
        CsmJob_CMAC_Generate_HUT_FD1: CsmJobId=3, CsmJobPriority=60, CsmJobUsePort=false, CsmProcessingMode=CRYPTO_PROCESSING_ASYNC, CsmJobInterfaceUsePort=CRYPTO_USE_FNC, CsmJobKeyRef=CsmKey, CsmJobPrimitiveRef=Csm/CsmPrimitives_Generate, CsmJobQueueRef=CsmQueue_SecOC_Generate, CsmJobPrimitiveCallbackRef=CsmJob_CMAC_Generate, CsmJobCalloutRef=CSM_SecOc_CsmCallout
        CsmJob_CMAC_Generate_HUT15: CsmJobId=2, CsmJobPriority=60, CsmJobUsePort=false, CsmProcessingMode=CRYPTO_PROCESSING_ASYNC, CsmJobInterfaceUsePort=CRYPTO_USE_FNC, CsmJobKeyRef=CsmKey, CsmJobPrimitiveRef=Csm/CsmPrimitives_Generate, CsmJobQueueRef=CsmQueue_SecOC_Generate, CsmJobPrimitiveCallbackRef=CsmJob_CMAC_Generate, CsmJobCalloutRef=CSM_SecOc_CsmCallout
        CsmJob_Aes128_Decrypt: CsmJobId=0, CsmJobPriority=0, CsmJobUsePort=true, CsmProcessingMode=CRYPTO_PROCESSING_ASYNC, CsmJobInterfaceUsePort=CRYPTO_USE_PORT, CsmJobKeyRef=CsmKey_Aes128, CsmJobPrimitiveRef=Csm/CsmPrimitives_AES128_Decrypt, CsmJobQueueRef=CsmQueue_AES128, CsmJobPrimitiveCallbackRef=CsmCallbacks/CsmJob_Aes128_Decrypt, CsmJobCalloutRef=CSM_Aes128_Callout
        CsmJob_Aes128_Encrypt: CsmJobId=1, CsmJobPriority=0, CsmJobUsePort=true, CsmProcessingMode=CRYPTO_PROCESSING_ASYNC, CsmJobInterfaceUsePort=CRYPTO_USE_PORT, CsmJobKeyRef=CsmKey_Aes128, CsmJobPrimitiveRef=Csm/CsmPrimitives_AES128_Encrypt, CsmJobQueueRef=CsmQueue_AES128, CsmJobPrimitiveCallbackRef=CsmCallbacks/CsmJob_Aes128_Encrypt, CsmJobCalloutRef=CSM_Aes128_Callout
        CsmJob_Random: CsmJobId=25, CsmJobPriority=0, CsmJobUsePort=false, CsmProcessingMode=CRYPTO_PROCESSING_SYNC, CsmJobInterfaceUsePort=CRYPTO_USE_FNC, CsmJobKeyRef=CsmKey_RandomSeed, CsmJobPrimitiveRef=Csm/CsmPrimitives_Random, CsmJobQueueRef=CsmQueue
        CsmJob_CMAC_Verify_ABM1: CsmJobId=5, CsmJobPriority=3, CsmJobUsePort=false, CsmProcessingMode=CRYPTO_PROCESSING_ASYNC, CsmJobInterfaceUsePort=CRYPTO_USE_FNC, CsmJobKeyRef=CsmKey, CsmJobPrimitiveRef=Csm/CsmPrimitives_Verify, CsmJobQueueRef=CsmQueue_SecOC_Verify, CsmJobPrimitiveCallbackRef=CsmJob_CMAC_Verify, CsmJobCalloutRef=CSM_SecOc_CsmCallout
        CsmJob_CMAC_Verify_ACC_FD2: CsmJobId=8, CsmJobPriority=4, CsmJobUsePort=false, CsmProcessingMode=CRYPTO_PROCESSING_ASYNC, CsmJobInterfaceUsePort=CRYPTO_USE_FNC, CsmJobKeyRef=CsmKey, CsmJobPrimitiveRef=Csm/CsmPrimitives_Verify, CsmJobQueueRef=CsmQueue_SecOC_Verify, CsmJobPrimitiveCallbackRef=CsmJob_CMAC_Verify, CsmJobCalloutRef=CSM_SecOc_CsmCallout
        CsmJob_CMAC_Verify_AEB_FD2: CsmJobId=9, CsmJobPriority=5, CsmJobUsePort=false, CsmProcessingMode=CRYPTO_PROCESSING_ASYNC, CsmJobInterfaceUsePort=CRYPTO_USE_FNC, CsmJobKeyRef=CsmKey, CsmJobPrimitiveRef=Csm/CsmPrimitives_Verify, CsmJobQueueRef=CsmQueue_SecOC_Verify, CsmJobPrimitiveCallbackRef=CsmJob_CMAC_Verify, CsmJobCalloutRef=CSM_SecOc_CsmCallout
        CsmJob_CMAC_Verify_AMP2: CsmJobId=10, CsmJobPriority=6, CsmJobUsePort=false, CsmProcessingMode=CRYPTO_PROCESSING_ASYNC, CsmJobInterfaceUsePort=CRYPTO_USE_FNC, CsmJobKeyRef=CsmKey, CsmJobPrimitiveRef=Csm/CsmPrimitives_Verify, CsmJobQueueRef=CsmQueue_SecOC_Verify, CsmJobPrimitiveCallbackRef=CsmJob_CMAC_Verify, CsmJobCalloutRef=CSM_SecOc_CsmCallout
        CsmJob_CMAC_Verify_BCM1: CsmJobId=11, CsmJobPriority=7, CsmJobUsePort=false, CsmProcessingMode=CRYPTO_PROCESSING_ASYNC, CsmJobInterfaceUsePort=CRYPTO_USE_FNC, CsmJobKeyRef=CsmKey, CsmJobPrimitiveRef=Csm/CsmPrimitives_Verify, CsmJobQueueRef=CsmQueue_SecOC_Verify, CsmJobPrimitiveCallbackRef=CsmJob_CMAC_Verify, CsmJobCalloutRef=CSM_SecOc_CsmCallout
        CsmJob_CMAC_Verify_BCM3: CsmJobId=12, CsmJobPriority=8, CsmJobUsePort=false, CsmProcessingMode=CRYPTO_PROCESSING_ASYNC, CsmJobInterfaceUsePort=CRYPTO_USE_FNC, CsmJobKeyRef=CsmKey, CsmJobPrimitiveRef=Csm/CsmPrimitives_Verify, CsmJobQueueRef=CsmQueue_SecOC_Verify, CsmJobPrimitiveCallbackRef=CsmJob_CMAC_Verify, CsmJobCalloutRef=CSM_SecOc_CsmCallout
        CsmJob_CMAC_Verify_DCT7: CsmJobId=13, CsmJobPriority=9, CsmJobUsePort=false, CsmProcessingMode=CRYPTO_PROCESSING_ASYNC, CsmJobInterfaceUsePort=CRYPTO_USE_FNC, CsmJobKeyRef=CsmKey, CsmJobPrimitiveRef=Csm/CsmPrimitives_Verify, CsmJobQueueRef=CsmQueue_SecOC_Verify, CsmJobPrimitiveCallbackRef=CsmJob_CMAC_Verify, CsmJobCalloutRef=CSM_SecOc_CsmCallout
        CsmJob_CMAC_Verify_ESP1: CsmJobId=14, CsmJobPriority=10, CsmJobUsePort=false, CsmProcessingMode=CRYPTO_PROCESSING_ASYNC, CsmJobInterfaceUsePort=CRYPTO_USE_FNC, CsmJobKeyRef=CsmKey, CsmJobPrimitiveRef=Csm/CsmPrimitives_Verify, CsmJobQueueRef=CsmQueue_SecOC_Verify, CsmJobPrimitiveCallbackRef=CsmJob_CMAC_Verify, CsmJobCalloutRef=CSM_SecOc_CsmCallout
        CsmJob_CMAC_Verify_ESP2: CsmJobId=15, CsmJobPriority=11, CsmJobUsePort=false, CsmProcessingMode=CRYPTO_PROCESSING_ASYNC, CsmJobInterfaceUsePort=CRYPTO_USE_FNC, CsmJobKeyRef=CsmKey, CsmJobPrimitiveRef=Csm/CsmPrimitives_Verify, CsmJobQueueRef=CsmQueue_SecOC_Verify, CsmJobPrimitiveCallbackRef=CsmJob_CMAC_Verify, CsmJobCalloutRef=CSM_SecOc_CsmCallout
        CsmJob_CMAC_Verify_ESP_FD2: CsmJobId=16, CsmJobPriority=12, CsmJobUsePort=false, CsmProcessingMode=CRYPTO_PROCESSING_ASYNC, CsmJobInterfaceUsePort=CRYPTO_USE_FNC, CsmJobKeyRef=CsmKey, CsmJobPrimitiveRef=Csm/CsmPrimitives_Verify, CsmJobQueueRef=CsmQueue_SecOC_Verify, CsmJobPrimitiveCallbackRef=CsmJob_CMAC_Verify, CsmJobCalloutRef=CSM_SecOc_CsmCallout
        CsmJob_CMAC_Verify_GW_SYNC_REQ: CsmJobId=17, CsmJobPriority=50, CsmJobUsePort=false, CsmProcessingMode=CRYPTO_PROCESSING_ASYNC, CsmJobInterfaceUsePort=CRYPTO_USE_FNC, CsmJobKeyRef=CsmKey, CsmJobPrimitiveRef=Csm/CsmPrimitives_Verify, CsmJobQueueRef=CsmQueue_SecOC_Verify, CsmJobPrimitiveCallbackRef=CsmJob_CMAC_Verify, CsmJobCalloutRef=CSM_SecOcSync_Callout
        CsmJob_CMAC_Verify_IFC_FD2: CsmJobId=18, CsmJobPriority=14, CsmJobUsePort=false, CsmProcessingMode=CRYPTO_PROCESSING_ASYNC, CsmJobInterfaceUsePort=CRYPTO_USE_FNC, CsmJobKeyRef=CsmKey, CsmJobPrimitiveRef=Csm/CsmPrimitives_Verify, CsmJobQueueRef=CsmQueue_SecOC_Verify, CsmJobPrimitiveCallbackRef=CsmJob_CMAC_Verify, CsmJobCalloutRef=CSM_SecOc_CsmCallout
        CsmJob_CMAC_Verify_R_PBox1: CsmJobId=19, CsmJobPriority=15, CsmJobUsePort=false, CsmProcessingMode=CRYPTO_PROCESSING_ASYNC, CsmJobInterfaceUsePort=CRYPTO_USE_FNC, CsmJobKeyRef=CsmKey, CsmJobPrimitiveRef=Csm/CsmPrimitives_Verify, CsmJobQueueRef=CsmQueue_SecOC_Verify, CsmJobPrimitiveCallbackRef=CsmJob_CMAC_Verify, CsmJobCalloutRef=CSM_SecOc_CsmCallout
        CsmJob_CMAC_Verify_TPMS1: CsmJobId=20, CsmJobPriority=18, CsmJobUsePort=false, CsmProcessingMode=CRYPTO_PROCESSING_ASYNC, CsmJobInterfaceUsePort=CRYPTO_USE_FNC, CsmJobKeyRef=CsmKey, CsmJobPrimitiveRef=Csm/CsmPrimitives_Verify, CsmJobQueueRef=CsmQueue_SecOC_Verify, CsmJobPrimitiveCallbackRef=CsmJob_CMAC_Verify, CsmJobCalloutRef=CSM_SecOc_CsmCallout
        CsmJob_CMAC_Verify_TPMS2: CsmJobId=21, CsmJobPriority=19, CsmJobUsePort=false, CsmProcessingMode=CRYPTO_PROCESSING_ASYNC, CsmJobInterfaceUsePort=CRYPTO_USE_FNC, CsmJobKeyRef=CsmKey, CsmJobPrimitiveRef=Csm/CsmPrimitives_Verify, CsmJobQueueRef=CsmQueue_SecOC_Verify, CsmJobPrimitiveCallbackRef=CsmJob_CMAC_Verify, CsmJobCalloutRef=CSM_SecOc_CsmCallout
        CsmJob_CMAC_Verify_T_Box_FD1: CsmJobId=22, CsmJobPriority=16, CsmJobUsePort=false, CsmProcessingMode=CRYPTO_PROCESSING_ASYNC, CsmJobInterfaceUsePort=CRYPTO_USE_FNC, CsmJobKeyRef=CsmKey, CsmJobPrimitiveRef=Csm/CsmPrimitives_Verify, CsmJobQueueRef=CsmQueue_SecOC_Verify, CsmJobPrimitiveCallbackRef=CsmJob_CMAC_Verify, CsmJobCalloutRef=CSM_SecOc_CsmCallout
        CsmJob_CMAC_Verify_T_Box_FD3: CsmJobId=23, CsmJobPriority=17, CsmJobUsePort=false, CsmProcessingMode=CRYPTO_PROCESSING_ASYNC, CsmJobInterfaceUsePort=CRYPTO_USE_FNC, CsmJobKeyRef=CsmKey, CsmJobPrimitiveRef=Csm/CsmPrimitives_Verify, CsmJobQueueRef=CsmQueue_SecOC_Verify, CsmJobPrimitiveCallbackRef=CsmJob_CMAC_Verify, CsmJobCalloutRef=CSM_SecOc_CsmCallout
        CsmJob_KeySetValid: CsmJobId=24, CsmJobPriority=0, CsmJobUsePort=false, CsmProcessingMode=CRYPTO_PROCESSING_ASYNC, CsmJobInterfaceUsePort=CRYPTO_USE_FNC, CsmJobKeyRef=CsmKey_Flash, CsmJobPrimitiveRef=Csm/CsmJobKeySetValidConfig, CsmJobQueueRef=CsmQueue_KeySetValid, CsmJobPrimitiveCallbackRef=CsmCallbacks/CsmJob_KeySetValid, CsmJobCalloutRef=CSM_SetKey_Callout
        CsmJob_SecureBoot_Generate: CsmJobId=26, CsmJobPriority=0, CsmJobUsePort=false, CsmProcessingMode=CRYPTO_PROCESSING_SYNC, CsmJobInterfaceUsePort=CRYPTO_USE_FNC, CsmJobKeyRef=CsmKey_SecureBootAppKey, CsmJobPrimitiveRef=Csm/CsmPrimitives_SecureBoot, CsmJobQueueRef=CsmQueue
        CsmJob_CMAC_Verify_DCT_FD4: CsmJobId=6, CsmJobPriority=3, CsmJobUsePort=false, CsmProcessingMode=CRYPTO_PROCESSING_ASYNC, CsmJobInterfaceUsePort=CRYPTO_USE_FNC, CsmJobKeyRef=CsmKey, CsmJobPrimitiveRef=Csm/CsmPrimitives_Verify, CsmJobQueueRef=CsmQueue_SecOC_Verify, CsmJobPrimitiveCallbackRef=CsmJob_CMAC_Verify, CsmJobCalloutRef=CSM_SecOc_CsmCallout
        CsmJob_CMAC_Verify_ESP_FD1: CsmJobId=7, CsmJobPriority=3, CsmJobUsePort=false, CsmProcessingMode=CRYPTO_PROCESSING_ASYNC, CsmJobInterfaceUsePort=CRYPTO_USE_FNC, CsmJobKeyRef=CsmKey, CsmJobPrimitiveRef=Csm/CsmPrimitives_Verify, CsmJobQueueRef=CsmQueue_SecOC_Verify, CsmJobPrimitiveCallbackRef=CsmJob_CMAC_Verify, CsmJobCalloutRef=CSM_SecOc_CsmCallout
    CsmQueues
      5 x CsmQueue:
        CsmQueue_SecOC_Verify: CsmQueueSize=16, CsmTriggerAsynchJobsInCallback=true, CsmChannelRef=CryIfChannel_SecOC_Verify
        CsmQueue: CsmQueueSize=1, CsmTriggerAsynchJobsInCallback=false, CsmChannelRef=CryIfChannel_CMAC
        CsmQueue_KeySetValid: CsmQueueSize=1, CsmTriggerAsynchJobsInCallback=false, CsmChannelRef=CryIfChannel_KeySetValid
        CsmQueue_SecOC_Generate: CsmQueueSize=3, CsmTriggerAsynchJobsInCallback=true, CsmChannelRef=CryIfChannel_SecOC_Generate
        CsmQueue_AES128: CsmQueueSize=1, CsmTriggerAsynchJobsInCallback=false, CsmChannelRef=CryIfChannel_CMAC
    CsmKeys
      7 x CsmKey:
        CsmKey: CsmKeyId=0, CsmKeyUsePort=true, CsmKeyRef=CryIfKey
        CsmKey_Flash: CsmKeyId=2, CsmKeyUsePort=false, CsmKeyRef=CryIfKey_Flash
        CsmKey_Aes128: CsmKeyId=1, CsmKeyUsePort=false, CsmKeyRef=CryIfKey_Aes128
        CsmKey_RandomSeed: CsmKeyId=3, CsmKeyUsePort=true, CsmKeyRef=CryIfKey_RandomSeed
        CsmKey_SecureBootAPP_A: CsmKeyId=4, CsmKeyUsePort=false, CsmKeyRef=CryIfKey_SecureBootAPP_A
        CsmKey_SecureBootAPP_B: CsmKeyId=5, CsmKeyUsePort=false, CsmKeyRef=CryIfKey_SecureBootAPP_B
        CsmKey_SecureBootAppKey: CsmKeyId=6, CsmKeyUsePort=false, CsmKeyRef=CryIfKey_SecureBootAppKey
    3 x CsmPrimitives:
      CsmPrimitives_Generate
        CsmMacGenerate
          CsmPrimitives_Generate (CsmMacGenerateConfig):
            CsmMacGenerateAlgorithmFamiliy = CRYPTO_ALGOFAM_AES
            CsmMacGenerateAlgorithmFamily = CRYPTO_ALGOFAM_AES
            CsmMacGenerateAlgorithmKeyLength = 16
            CsmMacGenerateAlgorithmMode = CRYPTO_ALGOMODE_CMAC
            CsmMacGenerateAlgorithmSecondaryFamily = CRYPTO_ALGOFAM_NOT_SET
            CsmMacGenerateProcessing = CSM_ASYNCHRONOUS
            CsmMacGenerateResultLength = 16
      CsmPrimitives_Verify
        CsmMacVerify
          CsmPrimitives_Verify (CsmMacVerifyConfig):
            CsmMacVerifyAlgorithmFamiliy = CRYPTO_ALGOFAM_AES
            CsmMacVerifyAlgorithmFamily = CRYPTO_ALGOFAM_AES
            CsmMacVerifyAlgorithmSecondaryFamily = CRYPTO_ALGOFAM_NOT_SET
            CsmMacVerifyCompareLength = 128
            CsmMacVerifyProcessing = CSM_ASYNCHRONOUS
            CsmMacVerifyAlgorithmMode = CRYPTO_ALGOMODE_CMAC
            CsmMacVerifyAlgorithmKeyLength = 16
      CsmPrimitives_RSA
        CsmDecrypt
          CsmPrimitives_RSA (CsmDecryptConfig):
            CsmDecryptAlgorithmFamiliy = CRYPTO_ALGOFAM_RSA
            CsmDecryptAlgorithmFamily = CRYPTO_ALGOFAM_RSA
            CsmDecryptAlgorithmKeyLength = 16
            CsmDecryptAlgorithmMode = CRYPTO_ALGOMODE_CBC
            CsmDecryptAlgorithmSecondaryFamily = CRYPTO_ALGOFAM_NOT_SET
            CsmDecryptProcessing = CSM_SYNCHRONOUS
    CsmCallbacks
      6 x CsmCallback:
        CsmJob_CMAC_Generate: CsmCallbackFunc=CsmJob_CMAC_Generate_Cbk, CsmCallbackId=2
        CsmJob_CMAC_Verify: CsmCallbackFunc=CsmJob_CMAC_Verify_Cbk, CsmCallbackId=3
        CsmJob_KeySetValid: CsmCallbackFunc=CsmJob_KeySetValid_Cbk, CsmCallbackId=4
        CsmJob_SecureBoot_Generate: CsmCallbackFunc=CsmJob_SecureBoot_Generate_Cbk, CsmCallbackId=5
        CsmJob_Aes128_Decrypt: CsmCallbackFunc=CsmJob_Aes128_Decrypt_Cbk, CsmCallbackId=0
        CsmJob_Aes128_Encrypt: CsmCallbackFunc=CsmJob_Aes128_Encrypt_Cbk, CsmCallbackId=1
    7 x CsmPrimitives:
      CsmPrimitives_AES128_Decrypt
        CsmDecrypt
          CsmPrimitives_AES128_Decrypt (CsmDecryptConfig):
            CsmDecryptAlgorithmFamiliy = CRYPTO_ALGOFAM_AES
            CsmDecryptAlgorithmFamily = CRYPTO_ALGOFAM_AES
            CsmDecryptAlgorithmKeyLength = 16
            CsmDecryptAlgorithmMode = CRYPTO_ALGOMODE_CBC
            CsmDecryptAlgorithmSecondaryFamily = CRYPTO_ALGOFAM_NOT_SET
            CsmDecryptProcessing = CSM_ASYNCHRONOUS
            CsmDecryptDataMaxLength = 16
            CsmDecryptResultMaxLength = 16
      CsmPrimitives_AES128_Encrypt
        CsmEncrypt
          CsmPrimitives_AES128_Encrypt (CsmEncryptConfig):
            CsmEncryptAlgorithmFamiliy = CRYPTO_ALGOFAM_AES
            CsmEncryptAlgorithmFamily = CRYPTO_ALGOFAM_AES
            CsmEncryptAlgorithmMode = CRYPTO_ALGOMODE_CBC
            CsmEncryptAlgorithmSecondaryFamily = CRYPTO_ALGOFAM_NOT_SET
            CsmEncryptProcessing = CSM_ASYNCHRONOUS
            CsmEncryptAlgorithmKeyLength = 16
            CsmEncryptDataMaxLength = 16
            CsmEncryptResultMaxLength = 16
      CsmPrimitives_Random
        CsmRandomGenerate
          CsmPrimitives_Random (CsmRandomGenerateConfig):
            CsmRandomGenerateAlgorithmFamiliy = CRYPTO_ALGOFAM_RNG
            CsmRandomGenerateAlgorithmFamily = CRYPTO_ALGOFAM_RNG
            CsmRandomGenerateAlgorithmMode = CRYPTO_ALGOMODE_NOT_SET
            CsmRandomGenerateAlgorithmSecondaryFamily = CRYPTO_ALGOFAM_NOT_SET
            CsmRandomGenerateProcessing = CSM_SYNCHRONOUS
            CsmRandomGenerateResultLength = 16
      CsmJobKeySetValidConfig
        CsmJobKeySetValid
          CsmJobKeySetValidConfig
      CsmPrimitives_SecureBoot
        CsmMacGenerate
          CsmPrimitives_SecureBoot (CsmMacGenerateConfig):
            CsmMacGenerateAlgorithmFamiliy = CRYPTO_ALGOFAM_AES
            CsmMacGenerateAlgorithmFamily = CRYPTO_ALGOFAM_AES
            CsmMacGenerateAlgorithmKeyLength = 16
            CsmMacGenerateAlgorithmMode = CRYPTO_ALGOMODE_CMAC
            CsmMacGenerateAlgorithmSecondaryFamily = CRYPTO_ALGOFAM_NOT_SET
            CsmMacGenerateProcessing = CSM_SYNCHRONOUS
            CsmMacGenerateResultLength = 16
      CsmPrimitives_Verify_SYN
        CsmMacVerify
          CsmPrimitives_Verify_SYN (CsmMacVerifyConfig):
            CsmMacVerifyAlgorithmFamiliy = CRYPTO_ALGOFAM_AES
            CsmMacVerifyAlgorithmFamily = CRYPTO_ALGOFAM_AES
            CsmMacVerifyAlgorithmSecondaryFamily = CRYPTO_ALGOFAM_NOT_SET
            CsmMacVerifyCompareLength = 16
            CsmMacVerifyProcessing = CSM_SYNCHRONOUS
            CsmMacVerifyAlgorithmMode = CRYPTO_ALGOMODE_CMAC
            CsmMacVerifyAlgorithmKeyLength = 16
      CsmPrimitives_Generate_SYN
        CsmMacGenerate
          CsmPrimitives_Generate_SYN (CsmMacGenerateConfig):
            CsmMacGenerateAlgorithmFamiliy = CRYPTO_ALGOFAM_AES
            CsmMacGenerateAlgorithmFamily = CRYPTO_ALGOFAM_AES
            CsmMacGenerateAlgorithmKeyLength = 16
            CsmMacGenerateAlgorithmMode = CRYPTO_ALGOMODE_CMAC
            CsmMacGenerateAlgorithmSecondaryFamily = CRYPTO_ALGOFAM_NOT_SET
            CsmMacGenerateProcessing = CSM_SYNCHRONOUS
            CsmMacGenerateResultLength = 16
    CsmCallouts
      4 x CsmCallout:
        CSM_SecOcSync_Callout: CsmPreJobCalloutFunc=CSM_SecOcSync_Callout_Pre, CsmPostJobCalloutFunc=CSM_SecOcSync_Callout_Post
        CSM_Aes128_Callout: CsmPreJobCalloutFunc=CSM_Aes128_Callout_Pre, CsmPostJobCalloutFunc=CSM_Aes128_Callout_Post
        CSM_SetKey_Callout: CsmPreJobCalloutFunc=CSM_SetKey_Callout_Pre, CsmPostJobCalloutFunc=CSM_SetKey_Callout_Post
        CSM_SecOc_CsmCallout: CsmPreJobCalloutFunc=CSM_SecOc_CsmCallout_Pre, CsmPostJobCalloutFunc=CSM_SecOc_CsmCallout_Post
