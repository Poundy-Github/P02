AUTOSAR XML (schema 00048)
package /Constants
  12 x constant specification:
    ZERO_VALUE: value-spec=0
    NVMBlockODOInit: value-spec=2164195334
    NVMBlockMaintainODO: value-spec=[255, 255, 255, 255, 255, 255, 255, 255, 255, 255, 255, 255, 255, 255, 255, 255, 255, 255, 255, 255, 255, 255, 255, 255, 255, 255, 255, 255, 255, 255, 255, 255, 255, 255, 255, 255, 255, 255, 255, 255, 255, 255, 255, 255, 255, 255, 255, 255, 0, 0, 255, 0, 136, 19, 0, 0, 136, 19, 0, 0, 0, 0, 0, 0, 0, 0, 0, 0, 0, 0, 0, 0, 0, 0, 0, 0, 0, 0, 0, 0]
    NVMBlockTripInit: value-spec=[128, 0, 0, 0, 128, 0, 0, 0, 128, 0, 0, 0, 128, 0, 0, 0, 128, 0, 0, 0]
    NVMBlockTCInit: value-spec=60 x 0
    NVMBlockTCConfigInit: value-spec=60 x 0
    PowerOutInit: value-spec=fields=[ClusterState:0, IVIState:0, HUDState:0, ConsoleState:0, KL15State:0, {short-label=PowerVoltage, fields=[state:0, value:0]}, SpState:0, {short-label=TempVoltage, fields=[state:255, temperature:0]}]
    IPC_Config_Init: value-spec=60 x 0
    NVM_IPC_CAN_Init: value-spec=120 x 0
    SG_ABS3_Init: value-spec=fields=[ABSActv:0, ABSFailSts:0, CheckSum_ABS3:0, EBDActv:0, EBDFailSts:0, RollingCounter_ABS3:0, VehOdoInfo:0, VehOdoInfoSts:0, VehSpd:0, VehSpdVld:0]
    SocRpOdoDataInit: value-spec=fields=[OdoKmValue_u32:0, OdoMileValue_u32:0, TripKmValue_u32:[0, 0, 0], TripMileValue_u32:[0, 0, 0], FsrvKmValue_s32:0, FsrvMileValue_s32:0, OdoTripIsaInvalid:0, OdoInputlValid:0, NvmBlockWriteFlag:0, ClearData_u32:0, FsrvStatus:0, RunCounter_u8:0, VinCheckFlag_u8:0, ClearFlag_u8:0]
    NVMBlockMenuInit: value-spec=[3, 0, 1, 0, 0, 0, 0, 0, 0, 0, 0, 0, 0, 0, 0, 0, 0, 0, 0, 0]
