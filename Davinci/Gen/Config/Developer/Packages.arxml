AUTOSAR XML (schema 00048)
package /DataTypes/DataConstrs
  range AC_FrntWinHeatDislSts: raw 0..1
  range ACC_LeTargrtDection: raw 0..3
  range ACC_LeTgtDx: raw 0..301
  range ACC_LeTgtDy: raw 0..161
  range ACC_LeTgtTyp: raw 0..7
  range ACC_RiTargrtDetn: raw 0..3
  range ACC_RiTgtDx: raw 0..301
  range ACC_RiTgtDy: raw 0..161
  range ACC_RiTgtTyp: raw 0..7
  range Checksum_ACC7: raw 0..255
  range RollingCounter_ACC7: raw 0..15
