AUTOSAR XML (schema 00048)
package /Predefined_DEV/PortInterfaces
  43 x client server interface:
    NvMAdministration: is-service=true
      operation SetBlockProtection: possible-error=NvMAdministration/E_NOT_OK
        arg ProtectionEnabled: type=boolean, direction=IN, server-argument-impl-policy=USE-ARGUMENT-TYPE
      error E_NOT_OK: error-code=1
    NvMNotifyInitBlock: is-service=true
      operation InitBlock
    NvMNotifyJobFinished: is-service=true
      operation JobFinished
        arg ServiceId: type=NvM_ServiceIdType, direction=IN, server-argument-impl-policy=USE-ARGUMENT-TYPE
        arg JobResult: type=NvM_RequestResultType, direction=IN, server-argument-impl-policy=USE-ARGUMENT-TYPE
    NvMService: is-service=true
      operation GetErrorStatus: possible-error=NvMService/E_NOT_OK
        arg ErrorStatus: type=NvM_RequestResultType, direction=OUT, server-argument-impl-policy=USE-ARGUMENT-TYPE
      error E_NOT_OK: error-code=1
    NvMService_AC2: is-service=true
      operation GetErrorStatus: possible-error=NvMService_AC2/E_NOT_OK
        arg ErrorStatus: type=NvM_RequestResultType, direction=OUT, server-argument-impl-policy=USE-ARGUMENT-TYPE
      operation ReadBlock: possible-error=NvMService_AC2/E_NOT_OK
        arg DstPtr: type=dtRef_VOID, direction=IN, server-argument-impl-policy=USE-ARGUMENT-TYPE
      operation WriteBlock: possible-error=NvMService_AC2/E_NOT_OK
        arg SrcPtr: type=dtRef_const_VOID, direction=IN, server-argument-impl-policy=USE-ARGUMENT-TYPE
      error E_NOT_OK: error-code=1
    NvMService_AC2_Defs: is-service=true
      4 x operation, all with possible-error=NvMService_AC2_Defs/E_NOT_OK:
        GetErrorStatus
          arg ErrorStatus: type=NvM_RequestResultType, direction=OUT, server-argument-impl-policy=USE-ARGUMENT-TYPE
        ReadBlock
          arg DstPtr: type=dtRef_VOID, direction=IN, server-argument-impl-policy=USE-ARGUMENT-TYPE
        RestoreBlockDefaults
          arg DstPtr: type=dtRef_VOID, direction=IN, server-argument-impl-policy=USE-ARGUMENT-TYPE
        WriteBlock
          arg SrcPtr: type=dtRef_const_VOID, direction=IN, server-argument-impl-policy=USE-ARGUMENT-TYPE
      error E_NOT_OK: error-code=1
    NvMService_AC2_DS: is-service=true
      5 x operation, all with possible-error=NvMService_AC2_DS/E_NOT_OK:
        GetDataIndex
          arg DataIndex: type=uint8, direction=OUT, server-argument-impl-policy=USE-ARGUMENT-TYPE
        GetErrorStatus
          arg ErrorStatus: type=NvM_RequestResultType, direction=OUT, server-argument-impl-policy=USE-ARGUMENT-TYPE
        ReadBlock
          arg DstPtr: type=dtRef_VOID, direction=IN, server-argument-impl-policy=USE-ARGUMENT-TYPE
        SetDataIndex
          arg DataIndex: type=uint8, direction=IN, server-argument-impl-policy=USE-ARGUMENT-TYPE
        WriteBlock
          arg SrcPtr: type=dtRef_const_VOID, direction=IN, server-argument-impl-policy=USE-ARGUMENT-TYPE
      error E_NOT_OK: error-code=1
    NvMService_AC2_DS_Defs: is-service=true
      6 x operation, all with possible-error=NvMService_AC2_DS_Defs/E_NOT_OK:
        GetDataIndex
          arg DataIndex: type=uint8, direction=OUT, server-argument-impl-policy=USE-ARGUMENT-TYPE
        GetErrorStatus
          arg ErrorStatus: type=NvM_RequestResultType, direction=OUT, server-argument-impl-policy=USE-ARGUMENT-TYPE
        ReadBlock
          arg DstPtr: type=dtRef_VOID, direction=IN, server-argument-impl-policy=USE-ARGUMENT-TYPE
        RestoreBlockDefaults
          arg DstPtr: type=dtRef_VOID, direction=IN, server-argument-impl-policy=USE-ARGUMENT-TYPE
        SetDataIndex
          arg DataIndex: type=uint8, direction=IN, server-argument-impl-policy=USE-ARGUMENT-TYPE
        WriteBlock
          arg SrcPtr: type=dtRef_const_VOID, direction=IN, server-argument-impl-policy=USE-ARGUMENT-TYPE
      error E_NOT_OK: error-code=1
    NvMService_AC2_SRBS: is-service=true
      4 x operation, all with possible-error=NvMService_AC2_SRBS/E_NOT_OK:
        GetErrorStatus
          arg ErrorStatus: type=NvM_RequestResultType, direction=OUT, server-argument-impl-policy=USE-ARGUMENT-TYPE
        ReadBlock
          arg DstPtr: type=dtRef_VOID, direction=IN, server-argument-impl-policy=USE-ARGUMENT-TYPE
        SetRamBlockStatus
          arg RamBlockStatus: type=boolean, direction=IN, server-argument-impl-policy=USE-ARGUMENT-TYPE
        WriteBlock
          arg SrcPtr: type=dtRef_const_VOID, direction=IN, server-argument-impl-policy=USE-ARGUMENT-TYPE
      error E_NOT_OK: error-code=1
    NvMService_AC2_SRBS_Defs: is-service=true
      5 x operation, all with possible-error=NvMService_AC2_SRBS_Defs/E_NOT_OK:
        GetErrorStatus
          arg ErrorStatus: type=NvM_RequestResultType, direction=OUT, server-argument-impl-policy=USE-ARGUMENT-TYPE
        ReadBlock
          arg DstPtr: type=dtRef_VOID, direction=IN, server-argument-impl-policy=USE-ARGUMENT-TYPE
        RestoreBlockDefaults
          arg DstPtr: type=dtRef_VOID, direction=IN, server-argument-impl-policy=USE-ARGUMENT-TYPE
        SetRamBlockStatus
          arg RamBlockStatus: type=boolean, direction=IN, server-argument-impl-policy=USE-ARGUMENT-TYPE
        WriteBlock
          arg SrcPtr: type=dtRef_const_VOID, direction=IN, server-argument-impl-policy=USE-ARGUMENT-TYPE
      error E_NOT_OK: error-code=1
    NvMService_AC2_SRBS_DS: is-service=true
      6 x operation, all with possible-error=NvMService_AC2_SRBS_DS/E_NOT_OK:
        GetDataIndex
          arg DataIndex: type=uint8, direction=OUT, server-argument-impl-policy=USE-ARGUMENT-TYPE
        GetErrorStatus
          arg ErrorStatus: type=NvM_RequestResultType, direction=OUT, server-argument-impl-policy=USE-ARGUMENT-TYPE
        ReadBlock
          arg DstPtr: type=dtRef_VOID, direction=IN, server-argument-impl-policy=USE-ARGUMENT-TYPE
        SetDataIndex
          arg DataIndex: type=uint8, direction=IN, server-argument-impl-policy=USE-ARGUMENT-TYPE
        SetRamBlockStatus
          arg RamBlockStatus: type=boolean, direction=IN, server-argument-impl-policy=USE-ARGUMENT-TYPE
        WriteBlock
          arg SrcPtr: type=dtRef_const_VOID, direction=IN, server-argument-impl-policy=USE-ARGUMENT-TYPE
      error E_NOT_OK: error-code=1
    NvMService_AC2_SRBS_DS_Defs: is-service=true
      7 x operation, all with possible-error=NvMService_AC2_SRBS_DS_Defs/E_NOT_OK:
        GetDataIndex
          arg DataIndex: type=uint8, direction=OUT, server-argument-impl-policy=USE-ARGUMENT-TYPE
        GetErrorStatus
          arg ErrorStatus: type=NvM_RequestResultType, direction=OUT, server-argument-impl-policy=USE-ARGUMENT-TYPE
        ReadBlock
          arg DstPtr: type=dtRef_VOID, direction=IN, server-argument-impl-policy=USE-ARGUMENT-TYPE
        RestoreBlockDefaults
          arg DstPtr: type=dtRef_VOID, direction=IN, server-argument-impl-policy=USE-ARGUMENT-TYPE
        SetDataIndex
          arg DataIndex: type=uint8, direction=IN, server-argument-impl-policy=USE-ARGUMENT-TYPE
        SetRamBlockStatus
          arg RamBlockStatus: type=boolean, direction=IN, server-argument-impl-policy=USE-ARGUMENT-TYPE
        WriteBlock
          arg SrcPtr: type=dtRef_const_VOID, direction=IN, server-argument-impl-policy=USE-ARGUMENT-TYPE
      error E_NOT_OK: error-code=1
    NvMService_AC3: is-service=true
      5 x operation, all with possible-error=NvMService_AC3/E_NOT_OK:
        EraseBlock
        GetErrorStatus
          arg ErrorStatus: type=NvM_RequestResultType, direction=OUT, server-argument-impl-policy=USE-ARGUMENT-TYPE
        InvalidateNvBlock
        ReadBlock
          arg DstPtr: type=dtRef_VOID, direction=IN, server-argument-impl-policy=USE-ARGUMENT-TYPE
        WriteBlock
          arg SrcPtr: type=dtRef_const_VOID, direction=IN, server-argument-impl-policy=USE-ARGUMENT-TYPE
      error E_NOT_OK: error-code=1
    NvMService_AC3_Defs: is-service=true
      6 x operation, all with possible-error=NvMService_AC3_Defs/E_NOT_OK:
        EraseBlock
        GetErrorStatus
          arg ErrorStatus: type=NvM_RequestResultType, direction=OUT, server-argument-impl-policy=USE-ARGUMENT-TYPE
        InvalidateNvBlock
        ReadBlock
          arg DstPtr: type=dtRef_VOID, direction=IN, server-argument-impl-policy=USE-ARGUMENT-TYPE
        RestoreBlockDefaults
          arg DstPtr: type=dtRef_VOID, direction=IN, server-argument-impl-policy=USE-ARGUMENT-TYPE
        WriteBlock
          arg SrcPtr: type=dtRef_const_VOID, direction=IN, server-argument-impl-policy=USE-ARGUMENT-TYPE
      error E_NOT_OK: error-code=1
    NvMService_AC3_DS: is-service=true
      7 x operation, all with possible-error=NvMService_AC3_DS/E_NOT_OK:
        EraseBlock
        GetDataIndex
          arg DataIndex: type=uint8, direction=OUT, server-argument-impl-policy=USE-ARGUMENT-TYPE
        GetErrorStatus
          arg ErrorStatus: type=NvM_RequestResultType, direction=OUT, server-argument-impl-policy=USE-ARGUMENT-TYPE
        InvalidateNvBlock
        ReadBlock
          arg DstPtr: type=dtRef_VOID, direction=IN, server-argument-impl-policy=USE-ARGUMENT-TYPE
        SetDataIndex
          arg DataIndex: type=uint8, direction=IN, server-argument-impl-policy=USE-ARGUMENT-TYPE
        WriteBlock
          arg SrcPtr: type=dtRef_const_VOID, direction=IN, server-argument-impl-policy=USE-ARGUMENT-TYPE
      error E_NOT_OK: error-code=1
    NvMService_AC3_DS_Defs: is-service=true
      8 x operation, all with possible-error=NvMService_AC3_DS_Defs/E_NOT_OK:
        EraseBlock
        GetDataIndex
          arg DataIndex: type=uint8, direction=OUT, server-argument-impl-policy=USE-ARGUMENT-TYPE
        GetErrorStatus
          arg ErrorStatus: type=NvM_RequestResultType, direction=OUT, server-argument-impl-policy=USE-ARGUMENT-TYPE
        InvalidateNvBlock
        ReadBlock
          arg DstPtr: type=dtRef_VOID, direction=IN, server-argument-impl-policy=USE-ARGUMENT-TYPE
        RestoreBlockDefaults
          arg DstPtr: type=dtRef_VOID, direction=IN, server-argument-impl-policy=USE-ARGUMENT-TYPE
        SetDataIndex
          arg DataIndex: type=uint8, direction=IN, server-argument-impl-policy=USE-ARGUMENT-TYPE
        WriteBlock
          arg SrcPtr: type=dtRef_const_VOID, direction=IN, server-argument-impl-policy=USE-ARGUMENT-TYPE
      error E_NOT_OK: error-code=1
    NvMService_AC3_SRBS: is-service=true
      6 x operation, all with possible-error=NvMService_AC3_SRBS/E_NOT_OK:
        EraseBlock
        GetErrorStatus
          arg ErrorStatus: type=NvM_RequestResultType, direction=OUT, server-argument-impl-policy=USE-ARGUMENT-TYPE
        InvalidateNvBlock
        ReadBlock
          arg DstPtr: type=dtRef_VOID, direction=IN, server-argument-impl-policy=USE-ARGUMENT-TYPE
        SetRamBlockStatus
          arg RamBlockStatus: type=boolean, direction=IN, server-argument-impl-policy=USE-ARGUMENT-TYPE
        WriteBlock
          arg SrcPtr: type=dtRef_const_VOID, direction=IN, server-argument-impl-policy=USE-ARGUMENT-TYPE
      error E_NOT_OK: error-code=1
    NvMService_AC3_SRBS_Defs: is-service=true
      7 x operation, all with possible-error=NvMService_AC3_SRBS_Defs/E_NOT_OK:
        EraseBlock
        GetErrorStatus
          arg ErrorStatus: type=NvM_RequestResultType, direction=OUT, server-argument-impl-policy=USE-ARGUMENT-TYPE
        InvalidateNvBlock
        ReadBlock
          arg DstPtr: type=dtRef_VOID, direction=IN, server-argument-impl-policy=USE-ARGUMENT-TYPE
        RestoreBlockDefaults
          arg DstPtr: type=dtRef_VOID, direction=IN, server-argument-impl-policy=USE-ARGUMENT-TYPE
        SetRamBlockStatus
          arg RamBlockStatus: type=boolean, direction=IN, server-argument-impl-policy=USE-ARGUMENT-TYPE
        WriteBlock
          arg SrcPtr: type=dtRef_const_VOID, direction=IN, server-argument-impl-policy=USE-ARGUMENT-TYPE
      error E_NOT_OK: error-code=1
    NvMService_AC3_SRBS_DS: is-service=true
      8 x operation, all with possible-error=NvMService_AC3_SRBS_DS/E_NOT_OK:
        EraseBlock
        GetDataIndex
          arg DataIndex: type=uint8, direction=OUT, server-argument-impl-policy=USE-ARGUMENT-TYPE
        GetErrorStatus
          arg ErrorStatus: type=NvM_RequestResultType, direction=OUT, server-argument-impl-policy=USE-ARGUMENT-TYPE
        InvalidateNvBlock
        ReadBlock
          arg DstPtr: type=dtRef_VOID, direction=IN, server-argument-impl-policy=USE-ARGUMENT-TYPE
        SetDataIndex
          arg DataIndex: type=uint8, direction=IN, server-argument-impl-policy=USE-ARGUMENT-TYPE
        SetRamBlockStatus
          arg RamBlockStatus: type=boolean, direction=IN, server-argument-impl-policy=USE-ARGUMENT-TYPE
        WriteBlock
          arg SrcPtr: type=dtRef_const_VOID, direction=IN, server-argument-impl-policy=USE-ARGUMENT-TYPE
      error E_NOT_OK: error-code=1
    NvMService_AC3_SRBS_DS_Defs: is-service=true
      9 x operation, all with possible-error=NvMService_AC3_SRBS_DS_Defs/E_NOT_OK:
        EraseBlock
        GetDataIndex
          arg DataIndex: type=uint8, direction=OUT, server-argument-impl-policy=USE-ARGUMENT-TYPE
        GetErrorStatus
          arg ErrorStatus: type=NvM_RequestResultType, direction=OUT, server-argument-impl-policy=USE-ARGUMENT-TYPE
        InvalidateNvBlock
        ReadBlock
          arg DstPtr: type=dtRef_VOID, direction=IN, server-argument-impl-policy=USE-ARGUMENT-TYPE
        RestoreBlockDefaults
          arg DstPtr: type=dtRef_VOID, direction=IN, server-argument-impl-policy=USE-ARGUMENT-TYPE
        SetDataIndex
          arg DataIndex: type=uint8, direction=IN, server-argument-impl-policy=USE-ARGUMENT-TYPE
        SetRamBlockStatus
          arg RamBlockStatus: type=boolean, direction=IN, server-argument-impl-policy=USE-ARGUMENT-TYPE
        WriteBlock
          arg SrcPtr: type=dtRef_const_VOID, direction=IN, server-argument-impl-policy=USE-ARGUMENT-TYPE
      error E_NOT_OK: error-code=1
    NvMService_SRBS: is-service=true
      operation GetErrorStatus: possible-error=NvMService_SRBS/E_NOT_OK
        arg ErrorStatus: type=NvM_RequestResultType, direction=OUT, server-argument-impl-policy=USE-ARGUMENT-TYPE
      operation SetRamBlockStatus: possible-error=NvMService_SRBS/E_NOT_OK
        arg RamBlockStatus: type=boolean, direction=IN, server-argument-impl-policy=USE-ARGUMENT-TYPE
      error E_NOT_OK: error-code=1
    CallbackDTCStatusChange: is-service=true, service-kind=DIAGNOSTIC-EVENT-MANAGER
      operation DTCStatusChanged: possible-error=CallbackDTCStatusChange/E_NOT_OK
        arg DTC: type=uint32, direction=IN, server-argument-impl-policy=USE-ARGUMENT-TYPE
        arg DTCStatusOld: type=Dem_UdsStatusByteType, direction=IN, server-argument-impl-policy=USE-ARGUMENT-TYPE
        arg DTCStatusNew: type=Dem_UdsStatusByteType, direction=IN, server-argument-impl-policy=USE-ARGUMENT-TYPE
      error E_NOT_OK: error-code=1
    NvSWC_NvMAdministration
      operation SetBlockProtection: possible-error=NvSWC_NvMAdministration/E_NOT_OK
        arg ProtectionEnabled: type=boolean, direction=IN, server-argument-impl-policy=USE-ARGUMENT-TYPE
      error E_NOT_OK: error-code=1
    NvSWC_NvMNotifyInitBlock
      operation InitBlock
    NvSWC_NvMNotifyJobFinished
      operation JobFinished
        arg ServiceId: type=NvM_ServiceIdType, direction=IN, server-argument-impl-policy=USE-ARGUMENT-TYPE
        arg JobResult: type=NvM_RequestResultType, direction=IN, server-argument-impl-policy=USE-ARGUMENT-TYPE
    NvSWC_NvMService
      operation GetErrorStatus: possible-error=NvSWC_NvMService/E_NOT_OK
        arg ErrorStatus: type=NvM_RequestResultType, direction=OUT, server-argument-impl-policy=USE-ARGUMENT-TYPE
      error E_NOT_OK: error-code=1
    NvSWC_NvMService_AC2
      operation GetErrorStatus: possible-error=NvSWC_NvMService_AC2/E_NOT_OK
        arg ErrorStatus: type=NvM_RequestResultType, direction=OUT, server-argument-impl-policy=USE-ARGUMENT-TYPE
      operation ReadBlock: possible-error=NvSWC_NvMService_AC2/E_NOT_OK
        arg DstPtr: type=dtRef_VOID, direction=IN, server-argument-impl-policy=USE-ARGUMENT-TYPE
      operation WriteBlock: possible-error=NvSWC_NvMService_AC2/E_NOT_OK
        arg SrcPtr: type=dtRef_const_VOID, direction=IN, server-argument-impl-policy=USE-ARGUMENT-TYPE
      error E_NOT_OK: error-code=1
    NvSWC_NvMService_AC2_Defs
      4 x operation, all with possible-error=NvSWC_NvMService_AC2_Defs/E_NOT_OK:
        GetErrorStatus
          arg ErrorStatus: type=NvM_RequestResultType, direction=OUT, server-argument-impl-policy=USE-ARGUMENT-TYPE
        ReadBlock
          arg DstPtr: type=dtRef_VOID, direction=IN, server-argument-impl-policy=USE-ARGUMENT-TYPE
        RestoreBlockDefaults
          arg DstPtr: type=dtRef_VOID, direction=IN, server-argument-impl-policy=USE-ARGUMENT-TYPE
        WriteBlock
          arg SrcPtr: type=dtRef_const_VOID, direction=IN, server-argument-impl-policy=USE-ARGUMENT-TYPE
      error E_NOT_OK: error-code=1
    NvSWC_NvMService_AC2_DS
      5 x operation, all with possible-error=NvSWC_NvMService_AC2_DS/E_NOT_OK:
        GetDataIndex
          arg DataIndex: type=uint8, direction=OUT, server-argument-impl-policy=USE-ARGUMENT-TYPE
        GetErrorStatus
          arg ErrorStatus: type=NvM_RequestResultType, direction=OUT, server-argument-impl-policy=USE-ARGUMENT-TYPE
        ReadBlock
          arg DstPtr: type=dtRef_VOID, direction=IN, server-argument-impl-policy=USE-ARGUMENT-TYPE
        SetDataIndex
          arg DataIndex: type=uint8, direction=IN, server-argument-impl-policy=USE-ARGUMENT-TYPE
        WriteBlock
          arg SrcPtr: type=dtRef_const_VOID, direction=IN, server-argument-impl-policy=USE-ARGUMENT-TYPE
      error E_NOT_OK: error-code=1
    NvSWC_NvMService_AC2_DS_Defs
      6 x operation, all with possible-error=NvSWC_NvMService_AC2_DS_Defs/E_NOT_OK:
        GetDataIndex
          arg DataIndex: type=uint8, direction=OUT, server-argument-impl-policy=USE-ARGUMENT-TYPE
        GetErrorStatus
          arg ErrorStatus: type=NvM_RequestResultType, direction=OUT, server-argument-impl-policy=USE-ARGUMENT-TYPE
        ReadBlock
          arg DstPtr: type=dtRef_VOID, direction=IN, server-argument-impl-policy=USE-ARGUMENT-TYPE
        RestoreBlockDefaults
          arg DstPtr: type=dtRef_VOID, direction=IN, server-argument-impl-policy=USE-ARGUMENT-TYPE
        SetDataIndex
          arg DataIndex: type=uint8, direction=IN, server-argument-impl-policy=USE-ARGUMENT-TYPE
        WriteBlock
          arg SrcPtr: type=dtRef_const_VOID, direction=IN, server-argument-impl-policy=USE-ARGUMENT-TYPE
      error E_NOT_OK: error-code=1
    NvSWC_NvMService_AC2_SRBS
      4 x operation, all with possible-error=NvSWC_NvMService_AC2_SRBS/E_NOT_OK:
        GetErrorStatus
          arg ErrorStatus: type=NvM_RequestResultType, direction=OUT, server-argument-impl-policy=USE-ARGUMENT-TYPE
        ReadBlock
          arg DstPtr: type=dtRef_VOID, direction=IN, server-argument-impl-policy=USE-ARGUMENT-TYPE
        SetRamBlockStatus
          arg RamBlockStatus: type=boolean, direction=IN, server-argument-impl-policy=USE-ARGUMENT-TYPE
        WriteBlock
          arg SrcPtr: type=dtRef_const_VOID, direction=IN, server-argument-impl-policy=USE-ARGUMENT-TYPE
      error E_NOT_OK: error-code=1
    NvSWC_NvMService_AC2_SRBS_Defs
      5 x operation, all with possible-error=NvSWC_NvMService_AC2_SRBS_Defs/E_NOT_OK:
        GetErrorStatus
          arg ErrorStatus: type=NvM_RequestResultType, direction=OUT, server-argument-impl-policy=USE-ARGUMENT-TYPE
        ReadBlock
          arg DstPtr: type=dtRef_VOID, direction=IN, server-argument-impl-policy=USE-ARGUMENT-TYPE
        RestoreBlockDefaults
          arg DstPtr: type=dtRef_VOID, direction=IN, server-argument-impl-policy=USE-ARGUMENT-TYPE
        SetRamBlockStatus
          arg RamBlockStatus: type=boolean, direction=IN, server-argument-impl-policy=USE-ARGUMENT-TYPE
        WriteBlock
          arg SrcPtr: type=dtRef_const_VOID, direction=IN, server-argument-impl-policy=USE-ARGUMENT-TYPE
      error E_NOT_OK: error-code=1
    NvSWC_NvMService_AC2_SRBS_DS
      6 x operation, all with possible-error=NvSWC_NvMService_AC2_SRBS_DS/E_NOT_OK:
        GetDataIndex
          arg DataIndex: type=uint8, direction=OUT, server-argument-impl-policy=USE-ARGUMENT-TYPE
        GetErrorStatus
          arg ErrorStatus: type=NvM_RequestResultType, direction=OUT, server-argument-impl-policy=USE-ARGUMENT-TYPE
        ReadBlock
          arg DstPtr: type=dtRef_VOID, direction=IN, server-argument-impl-policy=USE-ARGUMENT-TYPE
        SetDataIndex
          arg DataIndex: type=uint8, direction=IN, server-argument-impl-policy=USE-ARGUMENT-TYPE
        SetRamBlockStatus
          arg RamBlockStatus: type=boolean, direction=IN, server-argument-impl-policy=USE-ARGUMENT-TYPE
        WriteBlock
          arg SrcPtr: type=dtRef_const_VOID, direction=IN, server-argument-impl-policy=USE-ARGUMENT-TYPE
      error E_NOT_OK: error-code=1
    NvSWC_NvMService_AC2_SRBS_DS_Defs
      7 x operation, all with possible-error=NvSWC_NvMService_AC2_SRBS_DS_Defs/E_NOT_OK:
        GetDataIndex
          arg DataIndex: type=uint8, direction=OUT, server-argument-impl-policy=USE-ARGUMENT-TYPE
        GetErrorStatus
          arg ErrorStatus: type=NvM_RequestResultType, direction=OUT, server-argument-impl-policy=USE-ARGUMENT-TYPE
        ReadBlock
          arg DstPtr: type=dtRef_VOID, direction=IN, server-argument-impl-policy=USE-ARGUMENT-TYPE
        RestoreBlockDefaults
          arg DstPtr: type=dtRef_VOID, direction=IN, server-argument-impl-policy=USE-ARGUMENT-TYPE
        SetDataIndex
          arg DataIndex: type=uint8, direction=IN, server-argument-impl-policy=USE-ARGUMENT-TYPE
        SetRamBlockStatus
          arg RamBlockStatus: type=boolean, direction=IN, server-argument-impl-policy=USE-ARGUMENT-TYPE
        WriteBlock
          arg SrcPtr: type=dtRef_const_VOID, direction=IN, server-argument-impl-policy=USE-ARGUMENT-TYPE
      error E_NOT_OK: error-code=1
    NvSWC_NvMService_AC3
      5 x operation, all with possible-error=NvSWC_NvMService_AC3/E_NOT_OK:
        EraseBlock
        GetErrorStatus
          arg ErrorStatus: type=NvM_RequestResultType, direction=OUT, server-argument-impl-policy=USE-ARGUMENT-TYPE
        InvalidateNvBlock
        ReadBlock
          arg DstPtr: type=dtRef_VOID, direction=IN, server-argument-impl-policy=USE-ARGUMENT-TYPE
        WriteBlock
          arg SrcPtr: type=dtRef_const_VOID, direction=IN, server-argument-impl-policy=USE-ARGUMENT-TYPE
      error E_NOT_OK: error-code=1
    NvSWC_NvMService_AC3_Defs
      6 x operation, all with possible-error=NvSWC_NvMService_AC3_Defs/E_NOT_OK:
        EraseBlock
        GetErrorStatus
          arg ErrorStatus: type=NvM_RequestResultType, direction=OUT, server-argument-impl-policy=USE-ARGUMENT-TYPE
        InvalidateNvBlock
        ReadBlock
          arg DstPtr: type=dtRef_VOID, direction=IN, server-argument-impl-policy=USE-ARGUMENT-TYPE
        RestoreBlockDefaults
          arg DstPtr: type=dtRef_VOID, direction=IN, server-argument-impl-policy=USE-ARGUMENT-TYPE
        WriteBlock
          arg SrcPtr: type=dtRef_const_VOID, direction=IN, server-argument-impl-policy=USE-ARGUMENT-TYPE
      error E_NOT_OK: error-code=1
    NvSWC_NvMService_AC3_DS
      7 x operation, all with possible-error=NvSWC_NvMService_AC3_DS/E_NOT_OK:
        EraseBlock
        GetDataIndex
          arg DataIndex: type=uint8, direction=OUT, server-argument-impl-policy=USE-ARGUMENT-TYPE
        GetErrorStatus
          arg ErrorStatus: type=NvM_RequestResultType, direction=OUT, server-argument-impl-policy=USE-ARGUMENT-TYPE
        InvalidateNvBlock
        ReadBlock
          arg DstPtr: type=dtRef_VOID, direction=IN, server-argument-impl-policy=USE-ARGUMENT-TYPE
        SetDataIndex
          arg DataIndex: type=uint8, direction=IN, server-argument-impl-policy=USE-ARGUMENT-TYPE
        WriteBlock
          arg SrcPtr: type=dtRef_const_VOID, direction=IN, server-argument-impl-policy=USE-ARGUMENT-TYPE
      error E_NOT_OK: error-code=1
    NvSWC_NvMService_AC3_DS_Defs
      8 x operation, all with possible-error=NvSWC_NvMService_AC3_DS_Defs/E_NOT_OK:
        EraseBlock
        GetDataIndex
          arg DataIndex: type=uint8, direction=OUT, server-argument-impl-policy=USE-ARGUMENT-TYPE
        GetErrorStatus
          arg ErrorStatus: type=NvM_RequestResultType, direction=OUT, server-argument-impl-policy=USE-ARGUMENT-TYPE
        InvalidateNvBlock
        ReadBlock
          arg DstPtr: type=dtRef_VOID, direction=IN, server-argument-impl-policy=USE-ARGUMENT-TYPE
        RestoreBlockDefaults
          arg DstPtr: type=dtRef_VOID, direction=IN, server-argument-impl-policy=USE-ARGUMENT-TYPE
        SetDataIndex
          arg DataIndex: type=uint8, direction=IN, server-argument-impl-policy=USE-ARGUMENT-TYPE
        WriteBlock
          arg SrcPtr: type=dtRef_const_VOID, direction=IN, server-argument-impl-policy=USE-ARGUMENT-TYPE
      error E_NOT_OK: error-code=1
    NvSWC_NvMService_AC3_SRBS
      6 x operation, all with possible-error=NvSWC_NvMService_AC3_SRBS/E_NOT_OK:
        EraseBlock
        GetErrorStatus
          arg ErrorStatus: type=NvM_RequestResultType, direction=OUT, server-argument-impl-policy=USE-ARGUMENT-TYPE
        InvalidateNvBlock
        ReadBlock
          arg DstPtr: type=dtRef_VOID, direction=IN, server-argument-impl-policy=USE-ARGUMENT-TYPE
        SetRamBlockStatus
          arg RamBlockStatus: type=boolean, direction=IN, server-argument-impl-policy=USE-ARGUMENT-TYPE
        WriteBlock
          arg SrcPtr: type=dtRef_const_VOID, direction=IN, server-argument-impl-policy=USE-ARGUMENT-TYPE
      error E_NOT_OK: error-code=1
    NvSWC_NvMService_AC3_SRBS_Defs
      7 x operation, all with possible-error=NvSWC_NvMService_AC3_SRBS_Defs/E_NOT_OK:
        EraseBlock
        GetErrorStatus
          arg ErrorStatus: type=NvM_RequestResultType, direction=OUT, server-argument-impl-policy=USE-ARGUMENT-TYPE
        InvalidateNvBlock
        ReadBlock
          arg DstPtr: type=dtRef_VOID, direction=IN, server-argument-impl-policy=USE-ARGUMENT-TYPE
        RestoreBlockDefaults
          arg DstPtr: type=dtRef_VOID, direction=IN, server-argument-impl-policy=USE-ARGUMENT-TYPE
        SetRamBlockStatus
          arg RamBlockStatus: type=boolean, direction=IN, server-argument-impl-policy=USE-ARGUMENT-TYPE
        WriteBlock
          arg SrcPtr: type=dtRef_const_VOID, direction=IN, server-argument-impl-policy=USE-ARGUMENT-TYPE
      error E_NOT_OK: error-code=1
    NvSWC_NvMService_AC3_SRBS_DS
      8 x operation, all with possible-error=NvSWC_NvMService_AC3_SRBS_DS/E_NOT_OK:
        EraseBlock
        GetDataIndex
          arg DataIndex: type=uint8, direction=OUT, server-argument-impl-policy=USE-ARGUMENT-TYPE
        GetErrorStatus
          arg ErrorStatus: type=NvM_RequestResultType, direction=OUT, server-argument-impl-policy=USE-ARGUMENT-TYPE
        InvalidateNvBlock
        ReadBlock
          arg DstPtr: type=dtRef_VOID, direction=IN, server-argument-impl-policy=USE-ARGUMENT-TYPE
        SetDataIndex
          arg DataIndex: type=uint8, direction=IN, server-argument-impl-policy=USE-ARGUMENT-TYPE
        SetRamBlockStatus
          arg RamBlockStatus: type=boolean, direction=IN, server-argument-impl-policy=USE-ARGUMENT-TYPE
        WriteBlock
          arg SrcPtr: type=dtRef_const_VOID, direction=IN, server-argument-impl-policy=USE-ARGUMENT-TYPE
      error E_NOT_OK: error-code=1
    NvSWC_NvMService_AC3_SRBS_DS_Defs
      9 x operation, all with possible-error=NvSWC_NvMService_AC3_SRBS_DS_Defs/E_NOT_OK:
        EraseBlock
        GetDataIndex
          arg DataIndex: type=uint8, direction=OUT, server-argument-impl-policy=USE-ARGUMENT-TYPE
        GetErrorStatus
          arg ErrorStatus: type=NvM_RequestResultType, direction=OUT, server-argument-impl-policy=USE-ARGUMENT-TYPE
        InvalidateNvBlock
        ReadBlock
          arg DstPtr: type=dtRef_VOID, direction=IN, server-argument-impl-policy=USE-ARGUMENT-TYPE
        RestoreBlockDefaults
          arg DstPtr: type=dtRef_VOID, direction=IN, server-argument-impl-policy=USE-ARGUMENT-TYPE
        SetDataIndex
          arg DataIndex: type=uint8, direction=IN, server-argument-impl-policy=USE-ARGUMENT-TYPE
        SetRamBlockStatus
          arg RamBlockStatus: type=boolean, direction=IN, server-argument-impl-policy=USE-ARGUMENT-TYPE
        WriteBlock
          arg SrcPtr: type=dtRef_const_VOID, direction=IN, server-argument-impl-policy=USE-ARGUMENT-TYPE
      error E_NOT_OK: error-code=1
    NvSWC_NvMService_SRBS
      operation GetErrorStatus: possible-error=NvSWC_NvMService_SRBS/E_NOT_OK
        arg ErrorStatus: type=NvM_RequestResultType, direction=OUT, server-argument-impl-policy=USE-ARGUMENT-TYPE
      operation SetRamBlockStatus: possible-error=NvSWC_NvMService_SRBS/E_NOT_OK
        arg RamBlockStatus: type=boolean, direction=IN, server-argument-impl-policy=USE-ARGUMENT-TYPE
      error E_NOT_OK: error-code=1
package /ModeDclrGroups
  mode declaration group BswMSetSystemRunGroup: initial-mode=NO_RUN, on-transition-value=0
    mode RUN: value=1
    mode NO_RUN: value=2
  mode declaration group DcmUserConditionMode: category=ALPHABETIC_ORDER, initial-mode=DCM_USER_CONDITON_NOT_OK, on-transition-value=2
    mode DCM_USER_CONDITION_OK: value=1
    mode DCM_USER_CONDITON_NOT_OK: value=0
package /PortInterfaces
  sender receiver interface AC_FrntWinHeatDislSts
    data AC_FrntWinHeatDislSts: type=AC_FrntWinHeatDislSts
  sender receiver interface IIC_Notify_Message
    data Message: sw-impl-policy=QUEUED, type=uint16
  sender receiver interface AMP_Notify_Message
    data Element: type=uint8
  client server interface IoHwAb_Interface
    6 x operation, all with possible-error=IoHwAb_Interface/E_NOT_OK:
      GetVoltage
        arg Id: type=uint8, direction=IN, server-argument-impl-policy=USE-ARGUMENT-TYPE
        arg Voltage: type=uint32, direction=OUT, server-argument-impl-policy=USE-ARGUMENT-TYPE
      GetPin
        arg Id: type=uint8, direction=IN, server-argument-impl-policy=USE-ARGUMENT-TYPE
        arg Pin: type=boolean, direction=OUT, server-argument-impl-policy=USE-ARGUMENT-TYPE
      SetPin
        arg Id: type=uint8, direction=IN, server-argument-impl-policy=USE-ARGUMENT-TYPE
        arg Digital: type=boolean, direction=IN, server-argument-impl-policy=USE-ARGUMENT-TYPE
      SetDuty
        arg Id: type=uint8, direction=IN, server-argument-impl-policy=USE-ARGUMENT-TYPE
        arg Duty: type=uint16, direction=IN, server-argument-impl-policy=USE-ARGUMENT-TYPE
      SetPeriodAndDuty
        arg Id: type=uint8, direction=IN, server-argument-impl-policy=USE-ARGUMENT-TYPE
        arg Period: type=uint16, direction=IN, server-argument-impl-policy=USE-ARGUMENT-TYPE
        arg Duty: type=uint16, direction=IN, server-argument-impl-policy=USE-ARGUMENT-TYPE
      SetHsLsOutput
        arg Id: type=uint8, direction=IN, server-argument-impl-policy=USE-ARGUMENT-TYPE
        arg Output: type=uint16, direction=IN, server-argument-impl-policy=USE-ARGUMENT-TYPE
    error E_NOT_OK: error-code=1
  mode switch interface Bswm_SetSystemRun
    mode group Mode: type=BswMSetSystemRunGroup
  11 x sender receiver interface:
    Ecum_Set_SystemState_Run
      data Element: type=boolean
    SysPowerMod
      data SysPowerMod: type=SysPowerMod
    SysPowerModVld
      data SysPowerModVld: type=SysPowerModVld
    DrvDoorLockSts
      data DrvDoorLockSts: type=DrvDoorLockSts
    DrvDoorSts
      data DrvDoorSts: type=DrvDoorSts
    CURRENT_GEAR
      data CURRENT_GEAR: type=CURRENT_GEAR
    TranPMode_Sts
      data TranPMode_Sts: type=TranPMode_Sts
    LvPwrSysErr
      data LvPwrSysErr: type=LvPwrSysErr
    Stat_PwrSv_Lvl
      data Stat_PwrSv_Lvl: type=Stat_PwrSv_Lvl
    HUD_SwtSts
      data HUD_SwtSts: type=HUD_SwtSts
    Power_Voltage
      data Element: type=s_PowerOut_t
  client server interface IPC_Gyro_Req
    operation Operation
      4 x arg, all with server-argument-impl-policy=USE-ARGUMENT-TYPE:
        major_msg_id: type=uint8, direction=IN
        sub_msg_id: type=uint8, direction=IN
        param: type=uint8, direction=OUT
        param_len: type=uint16, direction=IN
  73 x sender receiver interface:
    IPC_Gyro_Message
      data Element: sw-impl-policy=QUEUED, type=A_U8_10
    System_Emergency_Sleep_Req
      data Element: type=uint8
    ABS3_0x265
      data ABS3_0x265: type=ABS3_0x265
    BMS19_0x352
      data BMS19_0x352: type=BMS19_0x352
    ECM1_0x111
      data ECM1_0x111: type=ECM1_0x111
    ECM3_0x371
      data ECM3_0x371: type=ECM3_0x371
    ESP2_0x145
      data ESP2_0x145: type=ESP2_0x145
    ESP_FD2_0x137
      data ESP_FD2_0x137: type=ESP_FD2_0x137
    HCU_PT5_0x14A
      data HCU_PT5_0x14A: type=HCU_PT5_0x14A
    Tgtgear_Down
      data Tgtgear_Down: type=Tgtgear_Down
    Tgtgear_Up
      data Tgtgear_Up: type=Tgtgear_Up
    TgtEngSpdIP
      data TgtEngSpdIP: type=TgtEngSpdIP
    TgtEngSpdIPValid
      data TgtEngSpdIPValid: type=TgtEngSpdIPValid
    EngSpd_ForIP
      data EngSpd_ForIP: type=EngSpd_ForIP
    EngSpdVldty
      data EngSpdVldty: type=EngSpdVldty
    EngSpd
      data EngSpd: type=EngSpd
    ECM_VehDstBackup
      data ECM_VehDstBackup: type=ECM_VehDstBackup
    ECM_VIN
      data ECM19_0x3B5: type=ECM_VIN
    SG_ESP1_ESP_FD2
      data SG_ESP1_ESP_FD2: type=SG_ESP1_ESP_FD2
    tiSR_Power_Out
      data SystemStateOut: type=SystemState_RecordType
    Odo_RunCounter
      data RunCounter: type=uint8
    SG_ESP2
      data SG_ESP2: type=SG_ESP2
    SG_ESP2_ESP_FD2
      data SG_ESP2_ESP_FD2: type=SG_ESP2_ESP_FD2
    SG_ABM1
      data SG_ABM1: type=SG_ABM1
    SG_AEB2_AEB_FD2
      data SG_AEB2_AEB_FD2: type=SG_AEB2_AEB_FD2
    SG_AEB3_AEB_FD2
      data SG_AEB3_AEB_FD2: type=SG_AEB3_AEB_FD2
    MILSts
      data MILSts: type=MILSts
    EngSVSSig
      data EngSVSSig: type=EngSVSSig
    EngClntTempWarn
      data EngClntTempWarn: type=EngClntTempWarn
    CruiseCtrlSts
      data CruiseCtrlSts: type=CruiseCtrlSts
    CruiseCtrlSts_PHEV
      data CruiseCtrlSts_PHEV: type=CruiseCtrlSts_PHEV
    Fuel_Status
      data Fuel_Status: type=uint8
    SG_ACC4_ACC_FD2
      data SG_ACC4_ACC_FD2: type=SG_ACC4_ACC_FD2
    SS_Enable_Lamp
      data SS_Enable_Lamp: type=SS_Enable_Lamp
    SS_Fault_Lamp
      data SS_Fault_Lamp: type=SS_Fault_Lamp
    TirePressSysFailrIndcn
      data TirePressSysFailrIndcn: type=TirePressSysFailrIndcn
    FLTirePressIndSts
      data FLTirePressIndSts: type=FLTirePressIndSts
    FRTirePressIndSts
      data FRTirePressIndSts: type=FRTirePressIndSts
    RLTirePressIndSts
      data RLTirePressIndSts: type=RLTirePressIndSts
    RRTirePressIndSts
      data RRTirePressIndSts: type=RRTirePressIndSts
    FLTireTempSts
      data FLTireTempSts: type=FLTireTempSts
    FRTireTempSts
      data FRTireTempSts: type=FRTireTempSts
    RLTireTempSts
      data RLTireTempSts: type=RLTireTempSts
    RRTireTempSts
      data RRTireTempSts: type=RRTireTempSts
    SG_EPS1_FD1
      data SG_EPS1_FD1: type=SG_EPS1_FD1
    SG_IFC4_IFC_FD2
      data SG_IFC4_IFC_FD2: type=SG_IFC4_IFC_FD2
    ESP_HMI_WarningOn
      data ESP_HMI_WarningOn: type=ESP_HMI_WarningOn
    IB_Warn
      data IB_Warn: type=IB_Warn
    FFogLmpSts_F_Pbox
      data FFogLmpSts_F_Pbox: type=FFogLmpSts_F_Pbox
    RFogLmpFailSts_R_Pbox
      data RFogLmpFailSts_R_Pbox: type=RFogLmpFailSts_R_Pbox
    SG_HC1
      data SG_HC1: type=SG_HC1
    LTurnLmpFailSts
      data LTurnLmpFailSts: type=LTurnLmpFailSts
    LTurnLmpSts_R_Pbox
      data LTurnLmpSts_R_Pbox: type=LTurnLmpSts_R_Pbox
    RTurnLmpSts_R_Pbox
      data RTurnLmpSts_R_Pbox: type=RTurnLmpSts_R_Pbox
    PosnLmpOutpSts_R_Pbox
      data PosnLmpOutpSts_R_Pbox: type=PosnLmpOutpSts_R_Pbox
    TrailerSts
      data TrailerSts: type=TrailerSts
    HiLowBeamSts
      data HiLowBeamSts: type=HiLowBeamSts
    HCU_EVLmpSts
      data HCU_EVLmpSts: type=HCU_EVLmpSts
    HCU_ChrgSysLmpSts
      data HCU_ChrgSysLmpSts: type=HCU_ChrgSysLmpSts
    ParkLmpSts_R_Pbox
      data ParkLmpSts_R_Pbox: type=ParkLmpSts_R_Pbox
    TgtRcprtnTrqSts
      data TgtRcprtnTrqSts: type=TgtRcprtnTrqSts
    CCO_Active
      data CCO_Active: type=CCO_Active
    RSDS_CTA_Actv
      data RSDS_CTA_Actv: type=RSDS_CTA_Actv
    RSDS_ErrSts
      data RSDS_ErrSts: type=RSDS_ErrSts
    RemoteModSts
      data RemoteModSts: type=RemoteModSts
    KL30BRelaySts
      data KL30BRelaySts: type=KL30BRelaySts
    BMS_SOCLowWarn
      data BMS_SOCLowWarn: type=BMS_SOCLowWarn
    TSRSts
      data TSRSts: type=TSRSts
    TSRSpdLimSts
      data TSRSpdLimSts: type=TSRSpdLimSts
    TSRSpdLim
      data TSRSpdLim: type=TSRSpdLim
    TSRSpdLimWarn
      data TSRSpdLimWarn: type=TSRSpdLimWarn
    TSRTrfcSignVal
      data TSRTrfcSignVal: type=TSRTrfcSignVal
    ECUlevelNetworkConfigurationDataIdentifier
      data Element: type=Dcm_Data200ByteType
  client server interface VConfig_GetKindConfig
    operation Operation_VConfig_GetKindConfig: possible-error=VConfig_GetKindConfig/Std_ReturnType
      arg kindId: type=uint16, direction=IN, server-argument-impl-policy=USE-ARGUMENT-TYPE
      arg kindConfig: type=uint8, direction=OUT, server-argument-impl-policy=USE-ARGUMENT-TYPE
    error Std_ReturnType: error-code=1
  client server interface VConfig_GetUpdateTick
    operation OperationVConfig_GetUpdateTick: possible-error=[VConfig_GetUpdateTick/Std_ReturnType, VConfig_GetUpdateTick/Std_ReturnType]
      arg updateTick: type=TimeInMicrosecondsType, direction=OUT, server-argument-impl-policy=USE-ARGUMENT-TYPE
    error Std_ReturnType: error-code=1
  73 x sender receiver interface:
    BswM_Warm_Reset
      data Element: type=boolean
    Cluster_Shutdown_Status
      data Element: type=uint8
    AC2_0x385
      data AC2_0x385: type=AC2_0x385
    AC1_0x29D
      data AC1_0x29D: type=AC1_0x29D
    HUT1_0x367
      data HUT1_0x367: type=HUT1_0x367
    ACC_FD2_0x2AB
      data ACC_FD2_0x2AB: type=ACC_FD2_0x2AB
    AEB_FD2_0x227
      data AEB_FD2_0x227: type=AEB_FD2_0x227
    BCM1_0x319
      data BCM1_0x319: type=BCM1_0x319
    BCM3_0x345
      data BCM3_0x345: type=BCM3_0x345
    BCM8_0x29F
      data BCM8_0x29F: type=BCM8_0x29F
    BMS4_0xF1
      data BMS4_0xF1: type=BMS4_0xF1
    BMS30_0x3F1
      data BMS30_0x3F1: type=BMS30_0x3F1
    BMS35_0x2C4
      data BMS35_0x2C4: type=BMS35_0x2C4
    CP1_0x35E
      data CP1_0x35E: type=CP1_0x35E
    CSA1_0x165
      data CSA1_0x165: type=CSA1_0x165
    CSA2_0xA1
      data CSA2_0xA1: type=CSA2_0xA1
    CSA3_0x244
      data CSA3_0x244: type=CSA3_0x244
    DCT5_0x221
      data DCT5_0x221: type=DCT5_0x221
    DCT7_0x235
      data DCT7_0x235: type=DCT7_0x235
    DDCM1_0x2CA
      data DDCM1_0x2CA: type=DDCM1_0x2CA
    DHT_FD1_0xC1
      data DHT_FD1_0xC1: type=DHT_FD1_0xC1
    DMS_FD1_0x24D
      data DMS_FD1_0x24D: type=DMS_FD1_0x24D
    ECM2_0x271
      data ECM2_0x271: type=ECM2_0x271
    ECM_PT7_0x117
      data ECM_PT7_0x117: type=ECM_PT7_0x117
    EEM1_0x2A8
      data EEM1_0x2A8: type=EEM1_0x2A8
    ELD1_0x152
      data ELD1_0x152: type=ELD1_0x152
    EPB1_0x16B
      data EPB1_0x16B: type=EPB1_0x16B
    EPS1_0x168
      data EPS1_0x168: type=EPS1_0x168
    EPS_FD1_0x147
      data EPS_FD1_0x147: type=EPS_FD1_0x147
    ESCL2_0x303
      data ESCL2_0x303: type=ESCL2_0x303
    ESP1_0x149
      data ESP1_0x149: type=ESP1_0x149
    ESP8_0x170
      data ESP8_0x170: type=ESP8_0x170
    ESP10_0xD8
      data ESP10_0xD8: type=ESP10_0xD8
    ESP11_0xC8
      data ESP11_0xC8: type=ESP11_0xC8
    F_PBox1_0x19B
      data F_PBox1_0x19B: type=F_PBox1_0x19B
    FPAS1_0x26D
      data FPAS1_0x26D: type=FPAS1_0x26D
    Haldex1_0x251
      data Haldex1_0x251: type=Haldex1_0x251
    HAP_FD1_0x15B
      data HAP_FD1_0x15B: type=HAP_FD1_0x15B
    HAP_FD2_0x274
      data HAP_FD2_0x274: type=HAP_FD2_0x274
    HAP_FD3_0x298
      data HAP_FD3_0x298: type=HAP_FD3_0x298
    HC1_0x287
      data HC1_0x287: type=HC1_0x287
    HCU_HC6_0x314
      data HCU_HC6_0x314: type=HCU_HC6_0x314
    HCU_HC7_0x3C2
      data HCU_HC7_0x3C2: type=HCU_HC7_0x3C2
    HCU_PT4_0x2FA
      data HCU_PT4_0x2FA: type=HCU_PT4_0x2FA
    HCU_PT7_0x248
      data HCU_PT7_0x248: type=HCU_PT7_0x248
    HCU_PT8_0x1C0
      data HCU_PT8_0x1C0: type=HCU_PT8_0x1C0
    HUD1_0x325
      data HUD1_0x325: type=HUD1_0x325
    HUT2_0x369
      data HUT2_0x369: type=HUT2_0x369
    HUT4_0x36D
      data HUT4_0x36D: type=HUT4_0x36D
    HUT10_0x331
      data HUT10_0x331: type=HUT10_0x331
    HUT17_0x33B
      data HUT17_0x33B: type=HUT17_0x33B
    HUT25_0x339
      data HUT25_0x339: type=HUT25_0x339
    HUT32_0x26F
      data HUT32_0x26F: type=HUT32_0x26F
    HUT33_0x1ED
      data HUT33_0x1ED: type=HUT33_0x1ED
    HUT_IP2_0x27F
      data HUT_IP2_0x27F: type=HUT_IP2_0x27F
    Ibooster_FD2_0x120
      data Ibooster_FD2_0x120: type=Ibooster_FD2_0x120
    IFC_FD3_0x2CF
      data IFC_FD3_0x2CF: type=IFC_FD3_0x2CF
    OBC1_0x316
      data OBC1_0x316: type=OBC1_0x316
    OBC2_0x317
      data OBC2_0x317: type=OBC2_0x317
    PDCM1_0x2CD
      data PDCM1_0x2CD: type=PDCM1_0x2CD
    PEPS2_0x295
      data PEPS2_0x295: type=PEPS2_0x295
    PEPS4_0x302
      data PEPS4_0x302: type=PEPS4_0x302
    R_PBox1_0x19C
      data R_PBox1_0x19C: type=R_PBox1_0x19C
    RPAS1_0x26E
      data RPAS1_0x26E: type=RPAS1_0x26E
    RSDS_FD1_0x16F
      data RSDS_FD1_0x16F: type=RSDS_FD1_0x16F
    SCM1_0x2D1
      data SCM1_0x2D1: type=SCM1_0x2D1
    T_Box_FD1_0x33
      data T_Box_FD1_0x33: type=T_Box_FD1_0x33
    T_Box_FD3_0x3E9
      data T_Box_FD3_0x3E9: type=T_Box_FD3_0x3E9
    TPMS1_0x341
      data TPMS1_0x341: type=TPMS1_0x341
    TPMS2_0x395
      data TPMS2_0x395: type=TPMS2_0x395
    Trailer1_0x273
      data Trailer1_0x273: type=Trailer1_0x273
    VSG1_0x2E1
      data VSG1_0x2E1: type=VSG1_0x2E1
    WPC1_0x2BA
      data WPC1_0x2BA: type=WPC1_0x2BA
  6 x client server interface:
    Gyro_Init_server
      operation Operation
    Rtc_Init_server
      operation Operation
    IPC_Init_Server
      operation Operation
    Common_GW_List
      operation Int
      operation Deinit
    Common_Normal_List
      operation Int
      operation Deinit
    Common_SF_List
      operation Int
      operation Deinit
  132 x sender receiver interface:
    IVI_10MIN_Backup_flag
      data Element: type=uint8
    TgtCrsVehSpd
      data TgtCrsVehSpd: type=uint8
    SS_Screen_tip
      data SS_Screen_tip: type=uint8
    Dyn_PwrSv_Lvl
      data Dyn_PwrSv_Lvl: type=Dyn_PwrSv_Lvl
    PassengerDoorSts
      data PassengerDoorSts: type=PassengerDoorSts
    LRDoorSts
      data LRDoorSts: type=LRDoorSts
    RRDoorSts
      data RRDoorSts: type=RRDoorSts
    TrunkSts
      data TrunkSts: type=TrunkSts
    HoodSts_F_Pbox
      data HoodSts_F_Pbox: type=HoodSts_F_Pbox
    AutoLmpSwtSts
      data AutoLmpSwtSts: type=AutoLmpSwtSts
    LBrkLmpFailSts
      data LBrkLmpFailSts: type=LBrkLmpFailSts
    HiPosnBrkLmpFailSts
      data HiPosnBrkLmpFailSts: type=HiPosnBrkLmpFailSts
    RBrkLmpFailSts
      data RBrkLmpFailSts: type=RBrkLmpFailSts
    LicPlateLmpFailSts
      data LicPlateLmpFailSts: type=LicPlateLmpFailSts
    RvsLmpFailSts
      data RvsLmpFailSts: type=RvsLmpFailSts
    SpeedoInfo
      4 x data:
        VehRunSts: type=uint8
        RealSpeed: type=uint16
        IndicateSpeed: type=uint16
        OverSpdWrnFlg: type=uint8
    TachoInfo
      data EngRunSts: type=uint8
      data EngSpd: type=uint16
    LRPosnLmpFailSts
      data LRPosnLmpFailSts: type=LRPosnLmpFailSts
    RRPosnLmpFailSts
      data RRPosnLmpFailSts: type=RRPosnLmpFailSts
    RLSFailSts
      data RLSFailSts: type=RLSFailSts
    DrowsyDrvDetWarn
      data DrowsyDrvDetWarn: type=DrowsyDrvDetWarn
    WarnKeyInCarWhenExit
      data WarnKeyInCarWhenExit: type=WarnKeyInCarWhenExit
    WarnVldKeyNotFound
      data WarnVldKeyNotFound: type=WarnVldKeyNotFound
    WarnEngStrtNotMeet
      data WarnEngStrtNotMeet: type=WarnEngStrtNotMeet
    PowerRlyFault
      data PowerRlyFault: type=PowerRlyFault
    WarnPowerNotInOffPosn
      data WarnPowerNotInOffPosn: type=WarnPowerNotInOffPosn
    RotSteerWheel
      data RotSteerWheel: type=RotSteerWheel
    DiagLmpReq
      data DiagLmpReq: type=DiagLmpReq
    CouplingThermWarning
      data CouplingThermWarning: type=CouplingThermWarning
    CCO_Warn
      data CCO_Warn: type=CCO_Warn
    HCU_ChrgSysErr_3
      data HCU_ChrgSysErr_3: type=HCU_ChrgSysErr_3
    HCU_ChrgSysErr_4
      data HCU_ChrgSysErr_4: type=HCU_ChrgSysErr_4
    HCU_ChrgSysErr_1
      data HCU_ChrgSysErr_1: type=HCU_ChrgSysErr_1
    HCU_ChrgSysErr_2
      data HCU_ChrgSysErr_2: type=HCU_ChrgSysErr_2
    HCU_ChrgSysErr_5
      data HCU_ChrgSysErr_5: type=HCU_ChrgSysErr_5
    HCU_ChrgSysErr_6
      data HCU_ChrgSysErr_6: type=HCU_ChrgSysErr_6
    HCU_ChrgSysErr_7
      data HCU_ChrgSysErr_7: type=HCU_ChrgSysErr_7
    HCU_ChrgSysErr_8
      data HCU_ChrgSysErr_8: type=HCU_ChrgSysErr_8
    VSG_Sts
      data VSG_Sts: type=VSG_Sts
    HCU_BattLowHeatSts
      data HCU_BattLowHeatSts: type=HCU_BattLowHeatSts
    HCU_BattLowTemWarn
      data HCU_BattLowTemWarn: type=HCU_BattLowTemWarn
    HCU_ChargSts
      data HCU_ChargSts: type=HCU_ChargSts
    HCU_WorkshopMode
      data HCU_WorkshopMode: type=HCU_WorkshopMode
    HCU_IntelBattTempMagSts
      data HCU_IntelBattTempMagSts: type=HCU_IntelBattTempMagSts
    HCU_ACLineDisconnect
      data HCU_ACLineDisconnect: type=HCU_ACLineDisconnect
    HCU_DrvMod
      data HCU_DrvMod: type=HCU_DrvMod
    HCU_ECODrvHabit_Indcn
      data HCU_ECODrvHabit_Indcn: type=HCU_ECODrvHabit_Indcn_adt
    HCU_EgyUsed
      data HCU_EgyUsed: type=HCU_EgyUsed
    HCU_EVContnsDistance
      data HCU_EVContnsDistance: type=HCU_EVContnsDistance
    HCU_EVContnsDistanceVld
      data HCU_EVContnsDistanceVld: type=HCU_EVContnsDistanceVld
    HCU_IntelBattTempMagSts_1
      data HCU_IntelBattTempMagSts: type=HCU_IntelBattTempMagSts
    HCU_RaceLaunchAvail
      data HCU_RaceLaunchAvail: type=HCU_RaceLaunchAvail
    HCU_RaceLaunchSts
      data HCU_RaceLaunchSts: type=HCU_RaceLaunchSts
    HCU_RecupPwr
      data HCU_RecupPwr: type=HCU_RecupPwr
    HCU_TotalScore
      data HCU_TotalScore: type=HCU_TotalScore
    HCU_TotDrvReqPower
      data HCU_TotDrvReqPower: type=HCU_TotDrvReqPower
    HCUImmoAuthRes
      data HCUImmoAuthRes: type=HCUImmoAuthRes
    HeadVertPrkgOutVald
      data HeadVertPrkgOutVald: type=HeadVertPrkgOutVald
    HFASwtSts
      data HFASwtSts: type=HFASwtSts
    HFMVolSetSts
      data HFMVolSetSts: type=HFMVolSetSts
    HiBeamSts_F_Pbox
      data HiBeamSts_F_Pbox: type=HiBeamSts_F_Pbox
    HCU_IntelBattTempMagSts_2
      data HCU_IntelBattTempMagSts: type=HCU_IntelBattTempMagSts
    HCU_IntelBattTempMagSts_3
      data HCU_IntelBattTempMagSts: type=HCU_IntelBattTempMagSts
    HCU_AccelPedalPosn_Diag
      data HCU_AccelPedalPosn_Diag: type=HCU_AccelPedalPosn_Diag
    HCU_AccelPedalPosn_DiagValid
      data HCU_AccelPedalPosn_DiagValid: type=HCU_AccelPedalPosn_DiagValid
    HCU_AvailPower_TM
      data HCU_AvailPower_TM: type=HCU_AvailPower_TM_adt
    BMS_BattHeatRunaway
      data BMS_BattHeatRunaway: type=BMS_BattHeatRunaway
    BMS_BattKeepTempSts
      data BMS_BattKeepTempSts: type=BMS_BattKeepTempSts
    BMS_BattSOC
      data BMS_BattSOC: type=BMS_BattSOC
    BMS_ChrgDurationTime
      data BMS_ChrgDurationTime: type=BMS_ChrgDurationTime
    BMS_IntelEngIdlChrgnSts
      data BMS_IntelEngIdlChrgnSts: type=BMS_IntelEngIdlChrgnSts
    OBC_ConnectSts
      data OBC_ConnectSts: type=OBC_ConnectSts
    OBC_ModSts
      data OBC_ModSts: type=OBC_ModSts
    VSG_HUTSoundResp
      data VSG_HUTSoundResp: type=VSG_HUTSoundResp
    VSGSwtSet
      data VSGSwtSet: type=VSGSwtSet
    CarWashMode_Req
      data CarWashMode_Req: type=CarWashMode_Req
    AccelPedalPosn
      data AccelPedalPosn: type=AccelPedalPosn_adt
    AccelPedalPosnVldty
      data AccelPedalPosnVldty: type=AccelPedalPosnVldty
    AccelPedlPosnDiagc
      data AccelPedlPosnDiagc: type=AccelPedlPosnDiagc
    BrkPedalFeelReq
      data BrkPedalFeelReq: type=BrkPedalFeelReq
    BrkPedalSts
      data BrkPedalSts: type=BrkPedalSts
    BrkPedalSts_BCM
      data BrkPedalSts_BCM: type=BrkPedalSts_BCM
    EMS_AuthenResult
      data EMS_AuthenResult: type=EMS_AuthenResult
    FTIVFault
      data FTIVFault: type=FTIVFault
    GPF_Warning
      data GPF_Warning: type=GPF_Warning
    ACAmbTemp
      data ACAmbTemp: type=ACAmbTemp
    LLasHdLmpDiagSig
      data LLasHdLmpDiagSig: type=LLasHdLmpDiagSig
    RLasHdLmpDiagSig
      data RLasHdLmpDiagSig: type=RLasHdLmpDiagSig
    LaneCalActvtCmd
      data LaneCalActvtCmd: type=LaneCalActvtCmd
    LaneCalFltSts
      data LaneCalFltSts: type=LaneCalFltSts
    LaneCalSts
      data LaneCalSts: type=LaneCalSts
    LasHdLmpSts
      data LasHdLmpSts: type=LasHdLmpSts
    LasHdLmpSts_F_Pbox
      data LasHdLmpSts_F_Pbox: type=LasHdLmpSts_F_Pbox
    LCASwtReq
      data LCASwtReq: type=LCASwtReq
    LCKSwtReq
      data LCKSwtReq: type=LCKSwtReq
    LDWSwtReq
      data LDWSwtReq: type=LDWSwtReq
    LeCamInpFailSts
      data LeCamInpFailSts: type=LeCamInpFailSts
    LHeadLmpFailSts
      data LHeadLmpFailSts: type=LHeadLmpFailSts
    LHiBeamFailSts
      data LHiBeamFailSts: type=LHiBeamFailSts
    LKASwtReq
      data LKASwtReq: type=LKASwtReq
    LLowBeamFailSts
      data LLowBeamFailSts: type=LLowBeamFailSts
    LParaPrkgOutVald
      data LParaPrkgOutVald: type=LParaPrkgOutVald
    RFogLmpSts_R_Pbox
      data RFogLmpSts_R_Pbox: type=RFogLmpSts_R_Pbox
    RHeadLmpFailSts
      data RHeadLmpFailSts: type=RHeadLmpFailSts
    RHiBeamFailSts
      data RHiBeamFailSts: type=RHiBeamFailSts
    RiCamInpFailSts
      data RiCamInpFailSts: type=RiCamInpFailSts
    RLowBeamFailSts
      data RLowBeamFailSts: type=RLowBeamFailSts
    RLTirePress
      data RLTirePress: type=RLTirePress
    RLTireTemp
      data RLTireTemp: type=RLTireTemp
    EspFuncOffSts_mode
      data EspFuncOffSts_mode: type=EspFuncOffSts_mode
    FuelTankCapWarning
      data FuelTankCapWarning: type=FuelTankCapWarning
    RearELDLckSts
      data RearELDLckSts: type=RearELDLckSts
    WPC_FaultSts
      data WPC_FaultSts: type=WPC_FaultSts
    WiprReq_F_Pbox
      data WiprReq_F_Pbox: type=WiprReq_F_Pbox
    WPC_ChrgSts
      data WPC_ChrgSts: type=WPC_ChrgSts
    WPC_PhoneReminder
      data WPC_PhoneReminder: type=WPC_PhoneReminder
    WPC_SwtReq
      data WPC_SwtReq: type=WPC_SwtReq
    WPC_SwtSts
      data WPC_SwtSts: type=WPC_SwtSts
    WshSoftSwt
      data WshSoftSwt: type=WshSoftSwt
    XLvl
      data XLvl: type=XLvl
    YLvl
      data YLvl: type=YLvl
    CCO_TgtVel
      data CCO_TgtVel: type=CCO_TgtVel_adt
    EWP_Err
      data EWP_Err: type=EWP_Err
    DistrctnLvl
      data DistrctnLvl: type=DistrctnLvl
    DrowsnsLvl
      data DrowsnsLvl: type=DrowsnsLvl
    DMSProc
      data DMSProc: type=DMSProc
    DMSProcResult
      data DMSProcResult: type=DMSProcResult
    DMSProcSts
      data DMSProcSts: type=DMSProcSts
    PressReliProgs
      data PressReliProgs: type=PressReliProgs
    RSDS_TrailerSts
      data RSDS_TrailerSts: type=RSDS_TrailerSts
    RSDS_BrkgTrig
      data RSDS_BrkgTrig: type=RSDS_BrkgTrig
    RSDS_RCW_Trigger
      data RSDS_RCW_Trigger: type=RSDS_RCW_Trigger
  5 x client server interface:
    IPC_Send
      operation IPC_Send: possible-error=IPC_Send/Std_ReturnType
        4 x arg, all with server-argument-impl-policy=USE-ARGUMENT-TYPE:
          Id_u8: type=uint8, direction=IN
          data_s: type=uint8, direction=OUT
          len_u16: type=uint16, direction=IN
          Imm_bool: type=boolean, direction=IN
      error Std_ReturnType: error-code=1
    TM_Init
      operation Operation
    TM_Operation
      operation TM_TimerStartStamp
        arg StartStamp: type=uint32, direction=OUT, server-argument-impl-policy=USE-ARGUMENT-TYPE
      operation TM_TimerElapsed
        arg StartStamp: type=uint32, direction=OUT, server-argument-impl-policy=USE-ARGUMENT-TYPE
        arg TimeElapsed: type=uint32, direction=OUT, server-argument-impl-policy=USE-ARGUMENT-TYPE
    DM_API_vGetDrvModWarningStatus
      operation Operation: possible-error=DM_API_vGetDrvModWarningStatus/E_NOT_OK
        arg enDrvModWarningID: type=uint8, direction=IN, server-argument-impl-policy=USE-ARGUMENT-TYPE
        arg status: type=uint8, direction=OUT, server-argument-impl-policy=USE-ARGUMENT-TYPE
      error E_NOT_OK: error-code=1
    DM_API_vGetDrvModTTStatus
      operation Operation: possible-error=DM_API_vGetDrvModTTStatus/E_NOT_OK
        arg enDrvModTTID: type=uint8, direction=IN, server-argument-impl-policy=USE-ARGUMENT-TYPE
        arg status: type=uint8, direction=OUT, server-argument-impl-policy=USE-ARGUMENT-TYPE
      error E_NOT_OK: error-code=1
  sender receiver interface RSDS_LCAResp
    data RSDS_LCAResp: type=RSDS_LCAResp
  sender receiver interface RSDS_BliSts
    data RSDS_BliSts: type=RSDS_BliSts
  sender receiver interface VconfigResponseFlag
    data VconfigResponseFlag: type=uint8
  client server interface Get_ECUVIN_0xF190
    operation Get_ECUVIN_0xF190
      arg arg: type=RW_0xFD00, direction=INOUT, server-argument-impl-policy=USE-ARGUMENT-TYPE
  client server interface tiCS_DM_API_vGetDrvModWarningStatus
    operation Operation: possible-error=tiCS_DM_API_vGetDrvModWarningStatus/E_NOT_OK
      arg enWarningID: type=uint8, direction=IN, server-argument-impl-policy=USE-ARGUMENT-TYPE
      arg status: type=uint8, direction=OUT, server-argument-impl-policy=USE-ARGUMENT-TYPE
    error E_NOT_OK: error-code=1
  client server interface tiCS_DM_API_vGetDrvModTTStatus
    operation Operation: possible-error=tiCS_DM_API_vGetDrvModTTStatus/E_NOT_OK
      arg status: type=uint8, direction=OUT, server-argument-impl-policy=USE-ARGUMENT-TYPE
    error E_NOT_OK: error-code=1
  5 x sender receiver interface:
    tiSR_SpeedoInfo
      data Element: type=s_SpeedoInfo_t
    tiSR_TachoInfo
      data Element: type=s_TachoInfo_t
    tiSR_OdoParament
      data Element: type=s_OdoRteGetParament_t
    tiSR_Fuel_Set_Module_Data
      data Element: type=FUEL_MODULE_OUTPUT_DATA_STRUCT_RTE
    tiSR_TC_Module_Output_Data
      data Element: type=TC_MODULE_OUTPUT_DATA_STRUCT_RTE
  client server interface tiCS_Reset_TC_Module_Data
    operation WriteData: possible-error=tiCS_Reset_TC_Module_Data/E_NOT_OK
      arg tc_reset_index: type=uint8, direction=IN, server-argument-impl-policy=USE-ARGUMENT-TYPE
    error E_NOT_OK: error-code=1
  sender receiver interface tiSR_SocManager
    data SystemState: type=uint8
  client server interface EOL_ReadDID0xFDD8
    operation EOL_GetReadHardInputForCluster
      arg arg: type=EOL_6Bytes, direction=OUT, server-argument-impl-policy=USE-ARGUMENT-TYPE
  client server interface EOL_Get_SpeakerStatus_0xFDD2
    operation EOL_Get_SpeakerStatus_0xFDD2
      arg arg: type=EOL_4Bytes, direction=OUT, server-argument-impl-policy=USE-ARGUMENT-TYPE
  client server interface tiCS_OdoSetParament
    operation Operation: possible-error=tiCS_OdoSetParament/Std_ReturnType
      arg SetId: type=uint8, direction=IN, server-argument-impl-policy=USE-ARGUMENT-TYPE
      arg data: type=uint32, direction=OUT, server-argument-impl-policy=USE-ARGUMENT-TYPE
    error Std_ReturnType: error-code=1
  22 x sender receiver interface:
    SG_IFC5_IFC_FD2
      data SG_IFC5_IFC_FD2: type=SG_IFC5_IFC_FD2
    RSDS_IPSoundReq
      data RSDS_IPSoundReq: type=RSDS_IPSoundReq
    TSRSpdLimCfdc
      data TSRSpdLimCfdc: type=TSRSpdLimCfdc
    PASWorkCmd
      data PASWorkCmd: type=PASWorkCmd
    APS_FLSideSnsrFailSts
      data APS_FLSideSnsrFailSts: type=APS_FLSideSnsrFailSts
    APS_FRSideSnsrFailSts
      data APS_FRSideSnsrFailSts: type=APS_FRSideSnsrFailSts
    APS_RLSideSnsrFailSts
      data APS_RLSideSnsrFailSts: type=APS_RLSideSnsrFailSts
    APS_RRSideSnsrFailSts
      data APS_RRSideSnsrFailSts: type=APS_RRSideSnsrFailSts
    SDW_SoundIndcn
      data SDW_SoundIndcn: type=SDW_SoundIndcn
    SDWActiveSts
      data SDWActiveSts: type=SDWActiveSts
    APS_WorkSts
      data APS_WorkSts: type=APS_WorkSts
    APS_SysSoundIndcn
      data APS_SysSoundIndcn: type=APS_SysSoundIndcn
    RPAS_WorkSts_FD
      data RPAS_WorkSts_FD: type=RPAS_WorkSts_FD
    RPAS_SoundIndcn_FD
      data RPAS_SoundIndcn_FD: type=RPAS_SoundIndcn_FD
    FLTirePress
      data FLTirePress: type=FLTirePress
    FRTirePress
      data FRTirePress: type=FRTirePress
    FRTireTemp
      data FRTireTemp: type=FRTireTemp
    FLTireTemp
      data FLTireTemp: type=FLTireTemp
    RLTireTemp_1
      data RLTireTemp: type=RLTireTemp_adt
    RLTirePress_1
      data RLTirePress: type=RLTirePress_adt
    RRTirePress
      data RRTirePress: type=RRTirePress
    RRTireTemp
      data RRTireTemp: type=RRTireTemp
  8 x client server interface:
    IPCSocReportDtcStatus
      operation IpcSocReportDtcStatus
        arg Data: type=uint8, direction=OUT, server-argument-impl-policy=USE-ARGUMENT-TYPE
        arg Length: type=uint8, direction=IN, server-argument-impl-policy=USE-ARGUMENT-TYPE
    EOL_0xFDD1
      operation EOL_ReadMICStatus
        arg arg: type=EOL_3Bytes, direction=OUT, server-argument-impl-policy=USE-ARGUMENT-TYPE
    EOL_0xFDE0
    EOL_0xFDE1
      operation EOL_ReadWatchDogCnt
        arg arg: type=EOL_4Bytes, direction=OUT, server-argument-impl-policy=USE-ARGUMENT-TYPE
    EOL_0xFDE2
      operation EOL_ReadResetInformation
        arg arg: type=EOL_64Bytes, direction=OUT, server-argument-impl-policy=USE-ARGUMENT-TYPE
    EOL_0xFDE3
    EOL_0xFDD9
      operation EOL_WriteValueForDispalyEnable
        arg arg: type=EOL_2Bytes, direction=OUT, server-argument-impl-policy=USE-ARGUMENT-TYPE
    EOL_0xFD16
      operation EOL_FactoryReset
        arg arg: type=A_1Bytes, direction=OUT, server-argument-impl-policy=USE-ARGUMENT-TYPE
  5 x sender receiver interface:
    IFC_FD2_0x23D
      data IFC_FD2_0x23D: type=IFC_FD2_0x23D
    ABM1_0x351
      data ABM1_0x351: type=ABM1_0x351
    tiSR_AMPDeInitFinished
      data State: type=boolean
    tiSR_GyroDeInitFinished
      data State: type=boolean
    tiSR_RtcDeInitFinished
      data State: type=boolean
  client server interface EOL_0xFD17
    operation EOL_Get_MCUAMP_Temperature_0xFD17
      arg arg: type=EOL_Struct_3Element, direction=OUT, server-argument-impl-policy=USE-ARGUMENT-TYPE
  10 x sender receiver interface:
    BMS_IntelEngIdlChrgnSts_1
      data BMS_IntelEngIdlChrgnSts: type=BMS_IntelEngIdlChrgnSts
    BMS_BattHeatRunaway_1
      data BMS_BattHeatRunaway: type=BMS_BattHeatRunaway
    GentrWarnLmpSts
      data GentrWarnLmpSts: type=GentrWarnLmpSts
    FPAS_SoundIndcn_FD
      data FPAS_SoundIndcn_FD: type=FPAS_SoundIndcn_FD
    FPAS_WorkSts_FD
      data FPAS_WorkSts_FD: type=FPAS_WorkSts_FD
    TGS_LEVER
      data TGS_LEVER: type=TGS_LEVER
    IFC_FD5_0x19F
      data IFC_FD5_0x19F: type=IFC_FD5_0x19F
    IFC_FD6_0x222
      data IFC_FD6_0x222: type=IFC_FD6_0x222
    CR_FD1_0x15E
      data CR_FD1_0x15E: type=CR_FD1_0x15E
    AntitheftSts
      data AntitheftSts: type=AntitheftSts
  client server interface IRTC_Service
    operation UTC2PerpetualCalendar: possible-error=[IRTC_Service/E_NOT_OK, IRTC_Service/E_NOT_OK]
      arg utc: type=sint64, direction=IN, server-argument-impl-policy=USE-ARGUMENT-TYPE
      arg date: type=DateTimeType_t, direction=OUT, server-argument-impl-policy=USE-ARGUMENT-TYPE
    operation GetUTCTimeInMillis: possible-error=IRTC_Service/E_NOT_OK
      arg arg: type=uint64, direction=OUT, server-argument-impl-policy=USE-ARGUMENT-TYPE
    error E_NOT_OK: error-code=1
  41 x sender receiver interface:
    EOL_PartNumber_0xF187
      data PartNumber_0xF187: type=EOL13Bytes
    EOL_RadioAntennaStatus_0xFDD0
      data RadioAntennaStatus_0xFDD0: type=EOL3Bytes
    EOL_ReadHardVersion_0xF193
      data ReadHardVersion_0xF193: type=EOL_15Bytes
    EOL_ReadSerialNumber_ProductData_0xF18C
      data ReadSerialNumber_ProductData_0xF18C: type=A_20Bytes
    EOL_VIPSoftwareVersion_0xFD01
      data VIPSoftwareVersion_0xFD01: type=EOL4Bytes
    if_RTC
      data UtcTime: type=sint64
      data SleepDateTime: type=sint64
    AMP2_0x3E3
      data AMP2_0x3E3: type=AMP2_0x3E3
    AMP3_0x3E5
      data AMP3_0x3E5: type=AMP3_0x3E5
    BCM12_0x238
      data BCM12_0x238: type=BCM12_0x238
    DSM1_0x2C1
      data DSM1_0x2C1: type=DSM1_0x2C1
    GW_FD1_0x2BB
      data GW_FD1_0x2BB: type=GW_FD1_0x2BB
    RPAS2_0x2ED
      data RPAS2_0x2ED: type=RPAS2_0x2ED
    RSDS_FD2_0x30A
      data RSDS_FD2_0x30A: type=RSDS_FD2_0x30A
    TMCU_FD3_0x3C9
      data TMCU_FD3_0x3C9: type=TMCU_FD3_0x3C9
    HUT13_0x31C
      data HUT13_0x31C: type=HUT13_0x31C
    HUT19_0x415
      data HUT19_0x415: type=HUT19_0x415
    HUT20_0x2DE
      data HUT20_0x2DE: type=HUT20_0x2DE
    HUT21_0x2DD
      data HUT21_0x2DD: type=HUT21_0x2DD
    HUT22_0x2DA
      data HUT22_0x2DA: type=HUT22_0x2DA
    HUT23_0x2D8
      data HUT23_0x2D8: type=HUT23_0x2D8
    HUT26_0x2B6
      data HUT26_0x2B6: type=HUT26_0x2B6
    HUT39_0x1EB
      data HUT39_0x1EB: type=HUT39_0x1EB
    HUT6_0x4A
      data HUT6_0x4A: type=HUT6_0x4A
    HUT15_0x1EE
      data HUT15_0x1EE: type=HUT15_0x1EE
    HUT30_0x1E9
      data HUT30_0x1E9: type=HUT30_0x1E9
    HUT_FD1_0x2C3
      data HUT_FD1_0x2C3: type=HUT_FD1_0x2C3
    TMCU_ActSpd_RM
      data TMCU_ActSpd_RM: type=TMCU_ActSpd_RM
    Wakeup_Reason
      data WakeupSource: type=wakeup_type
    ResetReason
      data ResetSource: type=reset_type
    FuelConsumption
      data FuelConsumption: type=FuelConsumption
    FCTA_Warn
      data FCTA_Warn: type=FCTA_Warn
    FCTBTrig
      data FCTBTrig: type=FCTBTrig
    CR_BliSts
      data CR_BliSts: type=CR_BliSts
    FCTA_B_FuncSts
      data FCTA_B_FuncSts: type=FCTA_B_FuncSts
    SG_ACC8_ACC_FD2
      data SG_ACC8_ACC_FD2: type=SG_ACC8_ACC_FD2
    SG_IFC3_IFC_FD2
      data SG_IFC3_IFC_FD2: type=SG_IFC3_IFC_FD2
    tiSR_WakeupReason
      data data: type=wakeup_type
    tiSR_DrvModStatusRecord
      data Element: type=DM_tstDrvModStatusRecord
    tiSR_WarningStsOutput
      data Element: type=WN_WarningStsOutput
    SG_ACC3_ACC_FD2
      data SG_ACC3_ACC_FD2: type=SG_ACC3_ACC_FD2
    tiSR_VIN
      data Element: type=A_17Bytes
  mode switch interface PiDcmUserCondition: is-service=true
    mode group Mode: type=DcmUserConditionMode
  6 x sender receiver interface:
    SafetyCanOutputViaNormal
      27 x data:
        CheckSum_IP2: type=uint8
        dummy_HUT_IP2_0: type=uint8
        IP_ABMWarnLmpFailrSts: type=uint8
        IP_ACCErr: type=uint8
        IP_BattChrgLmpSts: type=uint8
        IP_DrvSeatBeltWarnLmpFailSts: type=uint8
        IP_EngOilPressLowLmpSts: type=uint8
        IP_Err: type=uint8
        IP_FuelLvlLowLmpSts: type=uint8
        IP_FuelLvlInfo: type=uint8
        IP_VehSpdUnit: type=uint8
        IP_PassSeatBeltWarnLmpFailSts: type=uint8
        IP_VehTotDistance: type=uint32
        IP_VehTotDistanceValid: type=uint8
        IP_VINcompr: type=uint8
        RollingCounter_IP2: type=uint8
        IP_LagueSet: type=uint8
        IP_VelSpdDisp_Mile: type=uint8
        IP_FuelAuxTankR: type=uint16
        IP_FuelMainTankR: type=uint16
        IP_VehSpdDisp: type=uint16
        IP_CurrTheme: type=uint8
        IP_InstFuelCons: type=uint16
        IP_AvgFuelCons: type=uint16
        IP_InstFuelConsUnit: type=uint8
        IP_RemainDistance: type=uint16
        IP_EBDFailSts: type=uint8
    EOL_piVehSparePartNumber
      data SparePartNumber: type=EOL_13Bytes
    EOL_KeepDownload
      data keepDownloadRID: type=uint16
    EngCoolantTemp
      data EngCoolantTemp: type=EngCoolantTemp
    EngClntTempVldty
      data EngClntTempVldty: type=EngClntTempVldty
    SocReadyFlag
      data Element: type=uint8
  4 x client server interface:
    ppCS_SWCNormal_ChimeCallback
      operation Operation
        arg arg: type=uint8, direction=OUT, server-argument-impl-policy=USE-ARGUMENT-TYPE
    ppCS_SWCNormal_WrnCallback
      operation Operation
        arg arg: type=uint8, direction=OUT, server-argument-impl-policy=USE-ARGUMENT-TYPE
    ppCS_SWCNormal_TTCallback
      operation Operation
        arg arg: type=uint8, direction=OUT, server-argument-impl-policy=USE-ARGUMENT-TYPE
    CNA_SignalSet
      operation Operation: possible-error=[CNA_SignalSet/Std_ReturnType, CNA_SignalSet/Std_ReturnType]
        arg signalId: type=uint16, direction=IN, server-argument-impl-policy=USE-ARGUMENT-TYPE
        arg value: type=uint32, direction=INOUT, server-argument-impl-policy=USE-ARGUMENT-TYPE
      error Std_ReturnType: error-code=1
  sender receiver interface EOL_ReadGPSSatelliteCount
    data GPSSatelliteCount: type=uint8
  5 x client server interface:
    PpCS_AppClearDTCInfo
      operation AppClearDTCInfo
        arg OpStatus: type=uint8, direction=IN, server-argument-impl-policy=USE-ARGUMENT-TYPE
        arg Result: type=uint8, direction=OUT, server-argument-impl-policy=USE-ARGUMENT-TYPE
    PpCS_AppReadDtcInfomation
      operation AppReadDtcInformation
        arg DtcInfo: type=uint8, direction=OUT, server-argument-impl-policy=USE-ARGUMENT-TYPE
    tiCS_SWCNormal_ChimeCallback
      operation Operation
        arg arg: type=uint8, direction=OUT, server-argument-impl-policy=USE-ARGUMENT-TYPE
    tiCS_SWCNormal_WrnCallback
      operation Operation
        arg arg: type=uint8, direction=OUT, server-argument-impl-policy=USE-ARGUMENT-TYPE
    tiCS_SWCNormal_TTCallback
      operation Operation
        arg arg: type=uint8, direction=OUT, server-argument-impl-policy=USE-ARGUMENT-TYPE
  sender receiver interface tiSR_SWCNormal_ChimeID
    data Element: type=uint8
  client server interface tiCS_HMIResetTC
    operation Callback
      arg data: type=uint8, direction=OUT, server-argument-impl-policy=USE-ARGUMENT-TYPE
  client server interface tiCS_ReceiveMenuSetting
    operation Callback
      arg data: type=uint8, direction=OUT, server-argument-impl-policy=USE-ARGUMENT-TYPE
  sender receiver interface EOL_AMPCalibration
    data AMPCalibration: type=uint16
  sender receiver interface EOL_AMPCalibrationRece
    data EOLReceive: type=A_U8_10
  sender receiver interface SocManager_SocFactoryResetState
    data SocFactoryResetReady: type=boolean
  client server interface PowerTransferCallback
    operation Standby2NomalCallback
    operation Nomal2StandbyCallback
  16 x sender receiver interface:
    IP_LagueSet
      data IP_LagueSet: type=IP_LagueSet
    IP_VelSpdDisp_Mile
      data IP_VelSpdDisp_Mile: type=IP_VelSpdDisp_Mile
    IP_VehSpdDisp
      data IP_VehSpdDisp: type=IP_VehSpdDisp
    IP_FuelAuxTankR
      data IP_FuelAuxTankR: type=IP_FuelAuxTankR
    IP_FuelMainTankR
      data IP_FuelMainTankR: type=IP_FuelMainTankR
    IP_CurrTheme
      data IP_CurrTheme: type=IP_CurrTheme
    IP_InstFuelCons
      data IP_InstFuelCons: type=IP_InstFuelCons
    IP_AvgFuelCons
      data IP_AvgFuelCons: type=IP_AvgFuelCons
    IP_InstFuelConsUnit
      data IP_InstFuelConsUnit: type=IP_InstFuelConsUnit
    IP_RemainDistance
      data IP_RemainDistance: type=IP_RemainDistance
    ACC_FD3_0x2B4
      data ACC_FD3_0x2B4: type=ACC_FD3_0x2B4
    ABS1_0x231
      data ABS1_0x231: type=ABS1_0x231
    ABS2_0x246
      data ABS2_0x246: type=ABS2_0x246
    Cconfig_KindBuffers_400Bytes
      data CconfigKind_400Bytes: type=CconfigKind_400Bytes
    ECUlevelCConfigurationDataIdentifier_300Bytes
      data Element: type=Dcm_Data300ByteType
    BCM6_0x28C
      data BCM6_0x28C: type=BCM6_0x28C
  client server interface CConfig_GetUpdateTick
    operation OperationCConfig_GetUpdateTick: possible-error=[CConfig_GetUpdateTick/Std_ReturnType, CConfig_GetUpdateTick/Std_ReturnType]
      arg updateTick: type=TimeInMicrosecondsType, direction=OUT, server-argument-impl-policy=USE-ARGUMENT-TYPE
    error Std_ReturnType: error-code=1
  4 x sender receiver interface:
    PLG_1_0x2FE
      data PLG_1_0x2FE: type=PLG_1_0x2FE
    HUT16_0x348
      data HUT16_0x348: type=HUT16_0x348
    HUT3_0x36B
      data HUT3_0x36B: type=HUT3_0x36B
    HUT34_0x370
      data HUT34_0x370: type=HUT34_0x370
  client server interface piCS_GetTankResistanceValue
    operation Operation
      arg TankResistanceValue: type=uint8, direction=OUT, server-argument-impl-policy=USE-ARGUMENT-TYPE
  9 x sender receiver interface:
    SG_EPB1
      data SG_EPB1: type=SG_EPB1
    SG_EPS1
      data SG_EPS1: type=SG_EPS1
    SG_DCT7
      data SG_DCT7: type=SG_DCT7
    SG_ABS3
      data SG_ABS3: type=SG_ABS3
    SG_HUT_IP2
      data SG_HUT_IP2: type=SG_HUT_IP2
    SG_ESP1
      data SG_ESP1: type=SG_ESP1
    SG_HUT_IP2_1
      data SG_HUT_IP2: type=SG_HUT_IP2
    SG_ABS3_ESP_FD2
      data SG_ABS3_ESP_FD2: type=SG_ABS3_ESP_FD2
    tiSR_DtcInfoForIPErrorStatus
      data Element: type=uint8
  client server interface tiCS_GetVinNumber
    operation Operation
      arg Data: type=uint8, direction=OUT, server-argument-impl-policy=USE-ARGUMENT-TYPE
  sender receiver interface HUT_IP1_0x293
    data HUT_IP1_0x293: type=HUT_IP1_0x293
  sender receiver interface HUT_IP3_0x34A
    data HUT_IP3_0x34A: type=HUT_IP3_0x34A
  sender receiver interface IP_EBDFailSts
    data IP_EBDFailSts: type=uint8
  client server interface piCS_Diag_ReadDidData
    operation Operation: possible-error=[piCS_Diag_ReadDidData/E_NOT_OK, piCS_Diag_ReadDidData/DCM_E_PENDING, piCS_Diag_ReadDidData/E_NOT_OK, piCS_Diag_ReadDidData/DCM_E_PENDING]
      4 x arg, all with server-argument-impl-policy=USE-ARGUMENT-TYPE:
        dataId: type=uint16, direction=IN
        opStatus: type=uint8, direction=IN
        data: type=uint8, direction=OUT
        length: type=uint16, direction=IN
    error E_NOT_OK: error-code=1
    error DCM_E_PENDING: error-code=10
  client server interface piCS_Diag_WriteDidData
    operation Operation: possible-error=[piCS_Diag_WriteDidData/E_NOT_OK, piCS_Diag_WriteDidData/DCM_E_PENDING, piCS_Diag_WriteDidData/E_NOT_OK, piCS_Diag_WriteDidData/DCM_E_PENDING]
      5 x arg, all with server-argument-impl-policy=USE-ARGUMENT-TYPE:
        dataId: type=uint16, direction=IN
        opStatus: type=uint8, direction=IN
        data: type=uint8, direction=OUT
        length: type=uint16, direction=IN
        errorCode: type=uint8, direction=INOUT
    error E_NOT_OK: error-code=1
    error DCM_E_PENDING: error-code=10
  sender receiver interface SG_ACC7_ACC_FD2
    data SG_ACC7_ACC_FD2: type=SG_ACC7_ACC_FD2
  sender receiver interface SWC_Init_Type
    data Element: type=boolean
  sender receiver interface T_Box_SysErrSts
    data T_Box_SysErrSts: type=T_Box_SysErrSts
  client server interface tiCS_ReceiveSafetyGearCRC
    operation Callback
      arg Data: type=uint8, direction=OUT, server-argument-impl-policy=USE-ARGUMENT-TYPE
  client server interface tiCS_ReceiveSafetyTTCRC
    operation Callback
      arg Data: type=uint8, direction=OUT, server-argument-impl-policy=USE-ARGUMENT-TYPE
  sender receiver interface tiSR_MenuSet_OverSpeedLimit
    data Element: type=uint16
  sender receiver interface tiSR_MenuSet_OverSpeedEnable
    data Element: type=uint8
  sender receiver interface Upgrade_flag
    data Element: type=uint32
  client server interface tiCS_Odo_Api_ParamentGetCsPort
    operation Operation
      arg Id: type=uint8, direction=IN, server-argument-impl-policy=USE-ARGUMENT-TYPE
      arg Data: type=uint8, direction=OUT, server-argument-impl-policy=USE-ARGUMENT-TYPE
  6 x sender receiver interface:
    BSD_LCA_warningReqleft
      data BSD_LCA_warningReqleft: type=BSD_LCA_warningReqleft
    BSD_LCA_warningReqRight
      data BSD_LCA_warningReqRight: type=BSD_LCA_warningReqRight
    RCTA_warningReqLeft
      data RCTA_warningReqLeft: type=RCTA_warningReqLeft
    RCTA_warningReqRight
      data RCTA_warningReqRight: type=RCTA_warningReqRight
    DOW_warningReqleft
      data DOW_warningReqleft: type=DOW_warningReqleft
    DOW_warningReqRight
      data DOW_warningReqRight: type=DOW_warningReqRight
  client server interface tiCS_Fuel_Api_ParamentGetCsPort
    operation Operation
      arg arg: type=Diag_9Bytes, direction=OUT, server-argument-impl-policy=USE-ARGUMENT-TYPE
  client server interface piCS_GetVehicleModeInfo
    operation Data
      arg data: type=uint8, direction=OUT, server-argument-impl-policy=USE-ARGUMENT-TYPE
  client server interface piCS_GetCANMatrixVersionInfo
    operation Data
      arg data: type=uint8, direction=OUT, server-argument-impl-policy=USE-ARGUMENT-TYPE
  sender receiver interface piSR_E2ESwitchChangeTrigger
    data Element: type=uint8
  sender receiver interface piSR_SecOcSwitchChangeInfo
    data Element: type=uint8
  sender receiver interface EOL_ReadAmpCalibrationValue
    data AmpCalibrationValue: type=EOL9Bytes
  client server interface Hsm_Port
    operation TrngGenerate
      arg Trng: type=A_16Bytes, direction=OUT, server-argument-impl-policy=USE-ARGUMENT-TYPE
      arg len: type=uint32, direction=INOUT, server-argument-impl-policy=USE-ARGUMENT-TYPE
  client server interface HsmKeyM
    5 x operation:
      GetAes128Key
        arg IV: type=A_17Bytes, direction=OUT, server-argument-impl-policy=USE-ARGUMENT-TYPE
        arg KEY: type=A_16Bytes, direction=OUT, server-argument-impl-policy=USE-ARGUMENT-TYPE
        arg key_len: type=uint32, direction=INOUT, server-argument-impl-policy=USE-ARGUMENT-TYPE
      GetCmacKey
        arg key: type=IdtHsmKeyArray, direction=OUT, server-argument-impl-policy=USE-ARGUMENT-TYPE
        arg key_len: type=uint32, direction=INOUT, server-argument-impl-policy=USE-ARGUMENT-TYPE
      GetCmacKeyState
        arg state: type=HSM_KeyStateEnum, direction=OUT, server-argument-impl-policy=USE-ARGUMENT-TYPE
      SetAes128Key
        arg IV: type=A_16Bytes, direction=IN, server-argument-impl-policy=USE-ARGUMENT-TYPE
        arg KEY: type=A_16Bytes, direction=IN, server-argument-impl-policy=USE-ARGUMENT-TYPE
        arg key_len: type=uint32, direction=IN, server-argument-impl-policy=USE-ARGUMENT-TYPE
      SetCmacKey
        4 x arg, all with direction=IN, server-argument-impl-policy=USE-ARGUMENT-TYPE:
          vin: type=IdtHsmVinArray
          vin_len: type=uint32
          key: type=IdtHsmKeyArray
          key_len: type=uint32
  sender receiver interface SwToFieldCalRstCmd
    data SwToFieldCalRstCmd: type=SwToFieldCalRstCmd
  sender receiver interface SyncRequestMessageId
    data SyncRequestMessageId: type=SyncRequestMessageId
  sender receiver interface SyncRequstReseverData1
    data SyncRequstReseverData1: type=SyncRequstReseverData1
  client server interface tiCS_IPC_TransmitSignal
    operation Callback
      arg SignalIndex: type=uint32, direction=IN, server-argument-impl-policy=USE-ARGUMENT-TYPE
      arg Data: type=uint8, direction=OUT, server-argument-impl-policy=USE-ARGUMENT-TYPE
  client server interface tiCS_IPC_Tx_E2E_CanMsg_HUT_IP2
    operation Callback
  sender receiver interface DCT3_0xA6
    data DCT3_0xA6: type=DCT3_0xA6
  sender receiver interface ECM11_0x2D3
    data ECM11_0x2D3: type=ECM11_0x2D3
  sender receiver interface tiSR_MenuSetData
    data Element: type=MenuSetData_t
  client server interface tiCS_IPC_API_SetEventTxSignalBuffer
    operation Operation
      arg EventIndex: type=uint32, direction=IN, server-argument-impl-policy=USE-ARGUMENT-TYPE
      arg Data: type=uint8, direction=OUT, server-argument-impl-policy=USE-ARGUMENT-TYPE
  sender receiver interface if_System_Recovery
    data System_Recovery: type=boolean
  client server interface AMP_EOL_Read
    operation Operation: possible-error=N_OK
      arg value: type=A_U8_10, direction=OUT, server-argument-impl-policy=USE-ARGUMENT-TYPE
    error N_OK: error-code=1
  client server interface tiCS_SWCSafety_TTCallback
    operation Operation
      arg arg: type=uint8, direction=OUT, server-argument-impl-policy=USE-ARGUMENT-TYPE
  sender receiver interface tiSR_SWC_TT_SelfCheck
    data Element: type=uint8
  client server interface ADAU_server
    operation StateToInit
    operation StateToDeInit
  sender receiver interface SG_HUT32
    data SG_HUT32: type=SG_HUT32
  client server interface tiCS_IPC_Tx_E2E_CanMsg_HUT32
    operation CallBack
  client server interface tiSR_SafetyMode
    operation Operation
      arg arg: type=uint8, direction=OUT, server-argument-impl-policy=USE-ARGUMENT-TYPE
  sender receiver interface AdjVolUpSwtSts
    data AdjVolUpSwtSts: type=AdjVolUpSwtSts
  sender receiver interface PageUpSwtSts
    data PageUpSwtSts: type=PageUpSwtSts
  sender receiver interface if_Upgrade_System_Recovery
    data System_Recovery: type=boolean
  client server interface IPC_DataSend_If
    operation Operation: possible-error=E_N_OK
      arg p_msg: type=uint8, direction=INOUT, server-argument-impl-policy=USE-ARGUMENT-TYPE
      arg len: type=uint16, direction=IN, server-argument-impl-policy=USE-ARGUMENT-TYPE
      arg priority: type=uint8, direction=IN, server-argument-impl-policy=USE-ARGUMENT-TYPE
    error E_N_OK: error-code=1
  client server interface CanFrameCounter
    operation Can_ABS3_Counter
      arg counter: type=CanFrameCounterType, direction=OUT, server-argument-impl-policy=USE-ARGUMENT-TYPE
    operation Can_ESP_FD2_Counter
      arg counter: type=CanFrameCounterType, direction=OUT, server-argument-impl-policy=USE-ARGUMENT-TYPE
    operation Can_ECM2_Counter
      arg counter: type=CanFrameCounterType, direction=OUT, server-argument-impl-policy=USE-ARGUMENT-TYPE
  client server interface tiCS_E2EAndSecocCommonPort
    operation Operation
      arg Length: type=uint8, direction=IN, server-argument-impl-policy=USE-ARGUMENT-TYPE
      arg Data: type=uint8, direction=INOUT, server-argument-impl-policy=USE-ARGUMENT-TYPE
      arg Status: type=uint8, direction=OUT, server-argument-impl-policy=USE-ARGUMENT-TYPE
  sender receiver interface ACC_FD4_0x2B8
    data ACC_FD4_0x2B8: type=ACC_FD4_0x2B8
  sender receiver interface tiSR_S2M_Information
    data SpeedValue: type=uint16
    data TachoValue: type=uint16
  client server interface tiSR_SensorAorB_Status
    operation Operation: possible-error=tiSR_SensorAorB_Status/E_OK
    error E_OK: error-code=0
  sender receiver interface SG_ACC6_ACC_FD2
    data SG_ACC6_ACC_FD2: type=SG_ACC6_ACC_FD2
  client server interface IPCIviReportDtcStatus
    operation IpcIviReportDtcSts
      arg data: type=uint8, direction=INOUT, server-argument-impl-policy=USE-ARGUMENT-TYPE
      arg length: type=uint8, direction=IN, server-argument-impl-policy=USE-ARGUMENT-TYPE
  sender receiver interface SR_ClusterConfigResponseFlag
    data ClusterConfigResponseFlag: type=uint8
  client server interface USBWriteECUlevelNetworkConfigurationData
    operation USBWriteData: possible-error=[USBWriteECUlevelNetworkConfigurationData/E_OK, USBWriteECUlevelNetworkConfigurationData/E_NOT_OK, E_PENDING, USBWriteECUlevelNetworkConfigurationData/E_OK, USBWriteECUlevelNetworkConfigurationData/E_NOT_OK, E_PENDING]
      arg data: type=uint8, direction=INOUT, server-argument-impl-policy=USE-ARGUMENT-TYPE
      arg length: type=uint16, direction=IN, server-argument-impl-policy=USE-ARGUMENT-TYPE
      arg OpStatus: type=uint8, direction=IN, server-argument-impl-policy=USE-ARGUMENT-TYPE
    error E_OK: error-code=0
    error E_NOT_OK: error-code=1
    error E_PENDING: error-code=10
  19 x sender receiver interface:
    SG_BMS4
      data SG_BMS4: type=SG_BMS4
    SG_HCU_HP5
      data SG_HCU_HP5: type=SG_HCU_HP5
    SG_HCU_PT4
      data SG_HCU_PT4: type=SG_HCU_PT4
    SG_HCU_PT7
      data SG_HCU_PT7: type=SG_HCU_PT7
    SG_DHT_FD1
      data SG_DHT_FD1: type=SG_DHT_FD1
    SG_IFC6_IFC_FD2
      data SG_IFC6_IFC_FD2: type=SG_IFC6_IFC_FD2
    HUT35_0x1E5
      data HUT35_0x1E5: type=HUT35_0x1E5
    HUT_FD4_0x1DA
      data HUT_FD4_0x1DA: type=HUT_FD4_0x1DA
    HAP_FD6_0x289
      data HAP_FD6_0x289: type=HAP_FD6_0x289
    HAP_FD7_0x29B
      data HAP_FD7_0x29B: type=HAP_FD7_0x29B
    HUT40_0x2CE
      data HUT40_0x2CE: type=HUT40_0x2CE
    HCM_L1_0x308
      data HCM_L1_0x308: type=HCM_L1_0x308
    HCM_R1_0x30D
      data HCM_R1_0x30D: type=HCM_R1_0x30D
    BMS22_0x3BF
      data BMS22_0x3BF: type=BMS22_0x3BF
    BMS8_0x285
      data BMS8_0x285: type=BMS8_0x285
    BMS_FD14_0x1E3
      data BMS_FD14_0x1E3: type=BMS_FD14_0x1E3
    HCU_FD1_0x60
      data HCU_FD1_0x60: type=HCU_FD1_0x60
    HCU_HC3_0x268
      data HCU_HC3_0x268: type=HCU_HC3_0x268
    HCU_HC8_0x1E2
      data HCU_HC8_0x1E2: type=HCU_HC8_0x1E2
  client server interface tiCS_TC_EnergyInfo
    operation Operation
      arg Id: type=EnergyInfoDataType, direction=IN, server-argument-impl-policy=USE-ARGUMENT-TYPE
      arg Data: type=uint8, direction=OUT, server-argument-impl-policy=USE-ARGUMENT-TYPE
  client server interface tiCS_TC_EnergyInfoResp
    operation Operation
      arg Id: type=EnergyInfoDataType, direction=IN, server-argument-impl-policy=USE-ARGUMENT-TYPE
      arg Resp: type=boolean, direction=IN, server-argument-impl-policy=USE-ARGUMENT-TYPE
  10 x sender receiver interface:
    HCU_HP5_0x201
      data HCU_HP5_0x201: type=HCU_HP5_0x201
    HCU_HP6_0x11A
      data HCU_HP6_0x11A: type=HCU_HP6_0x11A
    FPAS_WorkSts
      data FPAS_WorkSts: type=FPAS_WorkSts_0x26D
    FPAS_SoundIndcn
      data FPAS_SoundIndcn: type=FPAS_SoundIndcn_0x26D
    RPAS_SoundIndcn
      data RPAS_SoundIndcn: type=RPAS_SoundIndcn_0x26E
    RPAS_WorkSts
      data RPAS_WorkSts: type=RPAS_WorkSts_0x26E
    LADBstatus
      data LADBstatus: type=LADBstatus
    RADBstatus
      data RADBstatus: type=RADBstatus
    LHiBeamSts
      data LHiBeamSts: type=LHiBeamSts
    RHiBeamSts
      data RHiBeamSts: type=RHiBeamSts
  client server interface tiCS_TC_Api_ParamentGetCsPort
    operation Operation
      arg arg: type=uint8, direction=OUT, server-argument-impl-policy=USE-ARGUMENT-TYPE
  5 x sender receiver interface:
    AVASDTCResults
      data AVASDTC: type=AVASDTCRet
    CconfigRequestUpdateFlag
      data CconfigRequestUpdateFlag: type=uint8
    VconfigRequestUpdateFlag
      data VconfigRequestUpdateFlag: type=uint8
    ClearDTC_Service0x14
      data StatusFlag: type=uint8
    piKL15OperationCycleChangeFlag
      data Element: type=uint32
  client server interface ComEx
    operation GetRxE2EStatus: possible-error=[COMEX_ERROR_PARAM, ComEx/E_OK]
      arg GroupId: type=ComEx_SignalGroupIdType, direction=IN, server-argument-impl-policy=USE-ARGUMENT-TYPE
      arg E2eStatus: type=uint32, direction=OUT, server-argument-impl-policy=USE-ARGUMENT-TYPE
    operation ReceiveSignal: possible-error=[COMEX_ERROR_PARAM, COMEX_MAX_AGE_EXCEEDED, COMEX_NEVER_RECEIVED, COMEX_UPDATE_RECEIVED, ComEx/E_OK]
      arg SignalId: type=ComEx_SignalIdType, direction=IN, server-argument-impl-policy=USE-ARGUMENT-TYPE
      arg SignalDataPtr: type=ComEx_SignalDataType, direction=OUT, server-argument-impl-policy=USE-ARGUMENT-TYPE
      arg Length: type=uint8, direction=IN, server-argument-impl-policy=USE-ARGUMENT-TYPE
    operation SendSignal: possible-error=[COMEX_ERROR_PARAM, ComEx/E_OK]
      arg SignalId: type=ComEx_SignalIdType, direction=IN, server-argument-impl-policy=USE-ARGUMENT-TYPE
      arg SignalDataPtr: sw-calibration-access=READ-ONLY, type=ComEx_ConstSignalDataType, direction=IN, server-argument-impl-policy=USE-ARGUMENT-TYPE
      arg Length: type=uint8, direction=IN, server-argument-impl-policy=USE-ARGUMENT-TYPE
    5 x error:
      COMEX_ERROR_PARAM: error-code=1
      COMEX_MAX_AGE_EXCEEDED: error-code=2
      COMEX_NEVER_RECEIVED: error-code=4
      COMEX_UPDATE_RECEIVED: error-code=8
      E_OK: error-code=0
  client server interface tiCS_CNA_Signal
    operation CallBack
      arg signalId: type=uint16, direction=IN, server-argument-impl-policy=USE-ARGUMENT-TYPE
  4 x sender receiver interface:
    tiSR_EnergyInfoId
      data Data: type=EnergyInfoIdDataType
    piDiagMonitorReInitFlag
      data ChangeCounter: type=uint32
    tiSR_DrvGearDisp
      data Element: type=DrvGearDisp
    tiSR_GearMsgMiss
      data Element: type=uint8
  client server interface KeyReturn_Server
    5 x operation:
      disanle
      enable
      register
        arg attribute: type=KeyAttribute_st, direction=IN, server-argument-impl-policy=USE-ARGUMENT-TYPE
        arg KeyId: type=uint8, direction=OUT, server-argument-impl-policy=USE-ARGUMENT-TYPE
      remove
        arg KeyId: type=uint8, direction=IN, server-argument-impl-policy=USE-ARGUMENT-TYPE
      State
        arg KeyId: type=uint8, direction=IN, server-argument-impl-policy=USE-ARGUMENT-TYPE
        arg isPress: type=boolean, direction=OUT, server-argument-impl-policy=USE-ARGUMENT-TYPE
  14 x sender receiver interface:
    AdjVolDwnSwtSts
      data AdjVolDwnSwtSts: type=AdjVolDwnSwtSts
    CustomSwtSts
      data CustomSwtSts: type=CustomSwtSts
    CustomSwtSts_Mmed
      data CustomSwtSts_Mmed: type=CustomSwtSts_Mmed
    EnterSwtSts
      data EnterSwtSts: type=EnterSwtSts
    EnterSwtSts_Mmed
      data EnterSwtSts_Mmed: type=EnterSwtSts_Mmed
    HomeSwtSts
      data HomeSwtSts: type=HomeSwtSts
    MenuReturnSwtSts
      data MenuReturnSwtSts: type=MenuReturnSwtSts
    MuteSwtSts
      data MuteSwtSts: type=MuteSwtSts
    PageDwnSwtSts
      data PageDwnSwtSts: type=PageDwnSwtSts
    PageLSwtSts
      data PageLSwtSts: type=PageLSwtSts
    PageRSwtSts
      data PageRSwtSts: type=PageRSwtSts
    SeekDwnSwtSts
      data SeekDwnSwtSts: type=SeekDwnSwtSts
    SeekUpSwtSts
      data SeekUpSwtSts: type=SeekUpSwtSts
    VRSwtSts
      data VRSwtSts: type=VRSwtSts
  client server interface CNA_SignalSetNoTrigger
    operation Operation: possible-error=[CNA_SignalSetNoTrigger/Std_ReturnType, CNA_SignalSetNoTrigger/Std_ReturnType]
      arg signalId: type=uint16, direction=IN, server-argument-impl-policy=USE-ARGUMENT-TYPE
      arg value: type=uint8, direction=INOUT, server-argument-impl-policy=USE-ARGUMENT-TYPE
    error Std_ReturnType: error-code=1
  client server interface tiCS_OdoTimeSync
    operation CallBack
      arg pre_time: type=sint64, direction=IN, server-argument-impl-policy=USE-ARGUMENT-TYPE
      arg now_time: type=sint64, direction=IN, server-argument-impl-policy=USE-ARGUMENT-TYPE
  client server interface CNA_SignalSet_U8N
    operation Operation: possible-error=[CNA_SignalSet_U8N/Std_ReturnType, CNA_SignalSet_U8N/Std_ReturnType]
      arg signalId: type=uint16, direction=IN, server-argument-impl-policy=USE-ARGUMENT-TYPE
      arg value: type=EventSignalType, direction=INOUT, server-argument-impl-policy=USE-ARGUMENT-TYPE
    error Std_ReturnType: error-code=1
  sender receiver interface SeekDwnAndPageLPress_Timeout
    data Element: type=boolean
  client server interface TtToChime
    operation Callback
      arg data: type=uint8, direction=INOUT, server-argument-impl-policy=USE-ARGUMENT-TYPE
  sender receiver interface AWakeHold
    data DVRRemtCnSts: type=uint8
  sender receiver interface AwakeHlod_Heartbeat
    data counter: type=uint8
  client server interface CNA_SignalGroupSet
    operation Operation: possible-error=CNA_SignalGroupSet/Std_ReturnType
      arg event_signal_info: type=EventSignalInfo_Type, direction=IN, server-argument-impl-policy=USE-ARGUMENT-TYPE
    error Std_ReturnType: error-code=1
  sender receiver interface Vconfig_GetKindBuffers
    data AllKinds: type=VconfigKind_Allbuffers
  client server interface tiCS_ReceiveOffroadInfo
    operation Callback
      arg data: type=uint8, direction=OUT, server-argument-impl-policy=USE-ARGUMENT-TYPE
  sender receiver interface tiSR_CanOutput_IP_ABMWarnLmpFailrSts
    data Element: type=uint8
  client server interface Can_Server_AbnormalWakeupSleepRecord
    operation Get
      arg data: type=A_80Bytes, direction=OUT, server-argument-impl-policy=USE-ARGUMENT-TYPE
  sender receiver interface tiSR_TC_NE_ChargStsOutput
    data Element: type=TC_NE_ChargStsOutput
