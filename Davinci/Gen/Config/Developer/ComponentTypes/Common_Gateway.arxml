AUTOSAR XML (schema 00048)
package /ComponentTypes
  application sw component type Commom_Gateway
    behavior Commom_Gateway_InternalBehavior
      timing event TMT_Common_Gateway_MainFunction: start-on-event=Commom_Gateway_MainFunction_5, period=0.005
      init event Common_Gateway_InitEvent: start-on-event=Commom_Gateway_Init
      timing event TMT_Commom_Gateway_MainFunction_10: start-on-event=Commom_Gateway_MainFunction_10, period=0.01
      timing event TMT_Commom_Gateway_MainFunction_20: start-on-event=Commom_Gateway_MainFunction_20, period=0.02
      4 x runnable:
        Commom_Gateway_MainFunction_5
        Commom_Gateway_Init
        Commom_Gateway_MainFunction_10
        Commom_Gateway_MainFunction_20
  swc implementation Commom_Gateway_Implementation: behavior=Commom_Gateway_InternalBehavior
