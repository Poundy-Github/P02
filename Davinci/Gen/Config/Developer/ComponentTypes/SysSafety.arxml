AUTOSAR XML (schema 00048)
package /ComponentTypes
  application sw component type SysSafety
    behavior SysSafety_InternalBehavior
      exclusive area ExclusiveArea_SysSafety
      init event SysSafety_InitEvent: start-on-event=SysSafety_Init
      timing event TMT_SysSafety_MainFunction: start-on-event=SysSafety_MainFunction, period=0.005
      runnable SysSafety_Init
      runnable SysSafety_MainFunction: can-enter-exclusive-area=ExclusiveArea_SysSafety
      runnable SysSafety_SelfTestStart
  swc implementation SysSafety_Implementation: behavior=SysSafety_InternalBehavior
