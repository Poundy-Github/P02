AUTOSAR XML (schema 00048)
package /ComponentTypes
  swc implementation Log_Implementation: behavior=Log_InternalBehavior
  complex device driver sw component type Log
    behavior Log_InternalBehavior
      exclusive area ExclusiveArea_Log
      init event Log_InitEvent: start-on-event=Logger_Init
      timing event TMT_Log_MainFunction: start-on-event=Logger_MainFunction, period=0.05
      runnable Logger_Init
      runnable Logger_MainFunction: can-enter-exclusive-area=ExclusiveArea_Log
