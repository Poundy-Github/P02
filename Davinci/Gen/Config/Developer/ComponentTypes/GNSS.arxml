AUTOSAR XML (schema 00048)
package /ComponentTypes
  complex device driver sw component type GNSS
    behavior GNSS_InternalBehavior
      init event GNSS_InitEvent: start-on-event=GNSS_Init
      timing event TMT_GNSS_MainFunction: start-on-event=GNSS_MainFunction, period=0.005
      runnable GNSS_Init
      runnable GNSS_MainFunction
  swc implementation GNSS_Implementation: behavior=GNSS_InternalBehavior
