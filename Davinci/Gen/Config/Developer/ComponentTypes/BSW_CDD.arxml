AUTOSAR XML (schema 00048)
package /ComponentTypes
  composition sw component type BSW_CDD
    provide port HsmKeyM: provided-interface=HsmKeyM
      provided-com-specs:
        operation=GetAes128Key, queue-length=1
        operation=GetCmacKey, queue-length=1
        operation=GetCmacKeyState, queue-length=1
        operation=SetAes128Key, queue-length=1
        operation=SetCmacKey, queue-length=1
    15 x component:
      RTC: type=RTC
      IPC: type=IPC
      IIC: type=IIC
      AMP: type=AMP
      Gyro: type=Gyro
      Log: type=Log
      Misc: type=Misc
      IoHwAb: type=IoHwAb
      TM: type=TM
      HSM: type=HSM
      ADAU1978: type=ADAU1978
      SysSafety: type=SysSafety
      ComEx: type=ComEx
      KeyReturn: type=KeyReturn
      GNSS: type=GNSS  # add GNSS component to P03 ,by GW00221986,at 20210421.
    delegate HSM.HsmKeyM <-> outer port HsmKeyM
