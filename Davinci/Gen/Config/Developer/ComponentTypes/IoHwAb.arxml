AUTOSAR XML (schema 00048)
package /ComponentTypes
  ecu abstraction sw component type IoHwAb
    behavior IoHwAb_InternalBehavior
      timing event TMT_IoHwAb_MainFunction: start-on-event=IoHwAb_MainFunction, period=0.005
      init event IoHwAb_InitEvent: start-on-event=IoHwAb_Init
      runnable IoHwAb_MainFunction
      runnable IoHwAb_Init
  swc implementation IoHwAb_Implementation: behavior=IoHwAb_InternalBehavior
