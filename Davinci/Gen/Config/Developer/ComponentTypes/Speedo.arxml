AUTOSAR XML (schema 00048)
package /ComponentTypes
  application sw component type Speedo
    behavior Speedo_InternalBehavior
      init event Speedo_InitEvent: start-on-event=Speedo_Init
      timing event TMT_Speedo_MainFunction: start-on-event=Speedo_MainFunction, period=0.02
      runnable Speedo_Init
      runnable Speedo_MainFunction
  swc implementation Speedo_Implementation: behavior=Speedo_InternalBehavior
