AUTOSAR XML (schema 00048)
package /ComponentTypes
  application sw component type Commom_Normal
    behavior Commom_Normal_InternalBehavior
      timing event TMT_Common_Normal_MainFunction: start-on-event=Commom_Normal_MainFunction_5, period=0.005
      init event Common_Normal_InitEvent: start-on-event=Commom_Normal_Init
      4 x timing event:
        TMT_Commom_Normal_MainFunction_10: start-on-event=Commom_Normal_MainFunction_10, period=0.01
        TMT_Commom_Normal_MainFunction_20: start-on-event=Commom_Normal_MainFunction_20, period=0.02
        TMT_Commom_Normal_MainFunction_50: start-on-event=Commom_Normal_MainFunction_50, period=0.05
        TMT_Commom_Normal_MainFunction_100: start-on-event=Commom_Normal_MainFunction_100, period=0.1
      6 x runnable:
        Commom_Normal_MainFunction_5
        Commom_Normal_Init
        Commom_Normal_MainFunction_10
        Commom_Normal_MainFunction_20
        Commom_Normal_MainFunction_50
        Commom_Normal_MainFunction_100
  swc implementation Commom_Normal_Implementation: behavior=Commom_Normal_InternalBehavior
