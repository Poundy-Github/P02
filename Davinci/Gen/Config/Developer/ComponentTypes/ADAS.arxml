AUTOSAR XML (schema 00048)
package /ComponentTypes
  application sw component type ADAS
    behavior ADAS_InternalBehavior: data-type-mapping=DataTypeMappings_DEV
      init event ADAS_InitEvent: start-on-event=ADAS_Init
      timing event TMT_ADAS_MainFunction: start-on-event=ADAS_MainFunction, period=0.1
      runnable ADAS_Init
      runnable ADAS_MainFunction
  swc implementation ADAS_Implementation: behavior=ADAS_InternalBehavior
