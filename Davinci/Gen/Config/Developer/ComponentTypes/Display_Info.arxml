AUTOSAR XML (schema 00048)
package /ComponentTypes
  application sw component type DisplayInfo
    behavior DisplayInfo_InternalBehavior
      init event Display_Info_InitEvent: start-on-event=DisplayInfo_Init
      timing event TMT_DisplayInfo_MainFunction: start-on-event=DisplayInfo_MainFunction, period=0.05
      runnable DisplayInfo_MainFunction
      runnable DisplayInfo_Init
  swc implementation DisplayInfo_Implementation: behavior=DisplayInfo_InternalBehavior
