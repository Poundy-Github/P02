[part 1 of 3: package /InitialEcuC]
AUTOSAR XML (schema 00046)
package /InitialEcuC
  ecuc value collection InitialEcuC: ecuc-values=[Dcm, Dem]
  module config Dcm: module-description=Dcm_Impl
    DcmConfigSet
      DcmGeneral
      DcmDsd
        DcmDsdServiceTable
          11 x DcmDsdService:
            DiagSessionControl: DcmDsdSidTabServiceId=16, DcmDsdSidTabSubfuncAvail=true
              4 x DcmDsdSubService:
                Default: DcmDsdSubServiceId=1
                Extended: DcmDsdSubServiceId=3, DcmDsdSubServiceSessionLevelRef=DcmDspSession/Default, DcmDsdSubServiceSessionLevelRef=DcmDspSession/Extended
                EOLDiagnosticSession_Start: DcmDsdSubServiceId=96, DcmDsdSubServiceSessionLevelRef=DcmDspSession/Default, DcmDsdSubServiceSessionLevelRef=EOLDiagnosticSession
                UFSKeepProgrammingSession_Start: DcmDsdSubServiceId=111, DcmDsdSubServiceSessionLevelRef=DcmDspSession/Default, DcmDsdSubServiceSessionLevelRef=UFSKeepProgrammingSession
            EcuReset: DcmDsdSidTabServiceId=17, DcmDsdSidTabSubfuncAvail=true, DcmDsdSidTabSessionLevelRef=DcmDspSession/Default, DcmDsdSidTabSessionLevelRef=DcmDspSession/Extended, DcmDsdSidTabSessionLevelRef=EOLDiagnosticSession
              Hard (DcmDsdSubService):
                DcmDsdSubServiceId = 1
                DcmDsdSubServiceSessionLevelRef = DcmDspSession/Default
                DcmDsdSubServiceSessionLevelRef = DcmDspSession/Extended
                DcmDsdSubServiceSessionLevelRef = EOLDiagnosticSession
              Soft (DcmDsdSubService):
                DcmDsdSubServiceId = 3
                DcmDsdSubServiceSessionLevelRef = DcmDspSession/Default
                DcmDsdSubServiceSessionLevelRef = DcmDspSession/Extended
                DcmDsdSubServiceSessionLevelRef = EOLDiagnosticSession
            ClearDiagInfo: DcmDsdSidTabServiceId=20, DcmDsdSidTabSubfuncAvail=false, DcmDsdSidTabSessionLevelRef=DcmDspSession/Default, DcmDsdSidTabSessionLevelRef=DcmDspSession/Extended, DcmDsdSidTabSessionLevelRef=EOLDiagnosticSession
            ReadDtcInfo: DcmDsdSidTabServiceId=25, DcmDsdSidTabSubfuncAvail=true, DcmDsdSidTabSessionLevelRef=DcmDspSession/Default, DcmDsdSidTabSessionLevelRef=DcmDspSession/Extended, DcmDsdSidTabSessionLevelRef=EOLDiagnosticSession
              6 x DcmDsdSubService, all with DcmDsdSubServiceSessionLevelRef=DcmDspSession/Default, DcmDsdSubServiceSessionLevelRef=DcmDspSession/Extended, DcmDsdSubServiceSessionLevelRef=EOLDiagnosticSession:
                RDTCBSM: DcmDsdSubServiceId=2
                RNODTCBSM: DcmDsdSubServiceId=1
                RDTCSSI: DcmDsdSubServiceId=3
                RDTCSSBDTC: DcmDsdSubServiceId=4
                RDTCEDRBDN: DcmDsdSubServiceId=6
                RSUPDTC: DcmDsdSubServiceId=10
            ReadDataById: DcmDsdSidTabServiceId=34, DcmDsdSidTabSubfuncAvail=false, DcmDsdSidTabSessionLevelRef=DcmDspSession/Default, DcmDsdSidTabSessionLevelRef=DcmDspSession/Extended, DcmDsdSidTabSessionLevelRef=EOLDiagnosticSession
            SecurityAccess: DcmDsdSidTabServiceId=39, DcmDsdSidTabSubfuncAvail=true, DcmDsdSidTabSessionLevelRef=DcmDspSession/Extended, DcmDsdSidTabSessionLevelRef=EOLDiagnosticSession
              4 x DcmDsdSubService:
                SeedLevel1_Request: DcmDsdSubServiceId=1, DcmDsdSubServiceSessionLevelRef=DcmDspSession/Extended
                KeyLevel1_Send: DcmDsdSubServiceId=2, DcmDsdSubServiceSessionLevelRef=DcmDspSession/Extended
                EOLrequestSeed_Request: DcmDsdSubServiceId=97, DcmDsdSubServiceSessionLevelRef=EOLDiagnosticSession
                EOLrequestSeed_Key_Send: DcmDsdSubServiceId=98, DcmDsdSubServiceSessionLevelRef=EOLDiagnosticSession
            CommunicationControl: DcmDsdSidTabServiceId=40, DcmDsdSidTabSubfuncAvail=true, DcmDsdSidTabSessionLevelRef=DcmDspSession/Extended
              EnableRxAndTx (DcmDsdSubService): DcmDsdSubServiceId=0, DcmDsdSubServiceSessionLevelRef=DcmDspSession/Extended
              DisableRxAndTx (DcmDsdSubService): DcmDsdSubServiceId=3, DcmDsdSubServiceSessionLevelRef=DcmDspSession/Extended
            WriteDataById: DcmDsdSidTabServiceId=46, DcmDsdSidTabSubfuncAvail=false, DcmDsdSidTabSessionLevelRef=DcmDspSession/Default, DcmDsdSidTabSessionLevelRef=DcmDspSession/Extended, DcmDsdSidTabSessionLevelRef=EOLDiagnosticSession
            RoutineControl: DcmDsdSidTabServiceId=49, DcmDsdSidTabSubfuncAvail=true, DcmDsdSidTabSessionLevelRef=DcmDspSession/Extended, DcmDsdSidTabSessionLevelRef=EOLDiagnosticSession, DcmDsdSidTabSessionLevelRef=UFSKeepProgrammingSession
            TesterPresent: DcmDsdSidTabServiceId=62, DcmDsdSidTabSubfuncAvail=true
              TesterPresent (DcmDsdSubService): DcmDsdSubServiceId=0
            ControlDtcSetting: DcmDsdSidTabServiceId=133, DcmDsdSidTabSubfuncAvail=true, DcmDsdSidTabSessionLevelRef=DcmDspSession/Extended, DcmDsdSidTabSessionLevelRef=UFSKeepProgrammingSession
              Enable (DcmDsdSubService): DcmDsdSubServiceId=1, DcmDsdSubServiceSessionLevelRef=DcmDspSession/Extended, DcmDsdSubServiceSessionLevelRef=UFSKeepProgrammingSession
              Disable (DcmDsdSubService): DcmDsdSubServiceId=2, DcmDsdSubServiceSessionLevelRef=DcmDspSession/Extended, DcmDsdSubServiceSessionLevelRef=UFSKeepProgrammingSession
      DcmDsp: DcmDspMaxDidToRead=5
        MaintenanceOdometer_Maintenance_odometer (DcmDspData): DcmDspDataSize=32, DcmDspDataType=UINT32, DcmDspDataInfoRef=DataInfo_MaintenanceOdometer_Maintenance_odometer
        DataInfo_MaintenanceOdometer_Maintenance_odometer (DcmDspDataInfo): DcmDspDataFixedLength=true
        KL15Status_KL15Status (DcmDspData): DcmDspDataSize=8, DcmDspDataType=UINT8, DcmDspDataInfoRef=DataInfo_KL15Status_KL15Status
        DataInfo_KL15Status_KL15Status (DcmDspDataInfo): DcmDspDataFixedLength=true
        FactoryReset_FactoryReset (DcmDspData): DcmDspDataSize=8, DcmDspDataType=UINT8, DcmDspDataInfoRef=DataInfo_FactoryReset_FactoryReset
        DataInfo_FactoryReset_FactoryReset (DcmDspDataInfo): DcmDspDataFixedLength=true
        ChipsTemperature_ChipsTemperature (DcmDspData): DcmDspDataSize=32, DcmDspDataType=UINT32, DcmDspDataInfoRef=DataInfo_ChipsTemperature_ChipsTemperature
        DataInfo_ChipsTemperature_ChipsTemperature (DcmDspDataInfo): DcmDspDataFixedLength=true
        Battery_Voltage_Battery_Voltage (DcmDspData): DcmDspDataSize=16, DcmDspDataType=UINT16, DcmDspDataInfoRef=DataInfo_Battery_Voltage_Battery_Voltage
        DataInfo_Battery_Voltage_Battery_Voltage (DcmDspDataInfo): DcmDspDataFixedLength=true
        VIPSoftwareVersion_VIPSoftwareVersion (DcmDspData): DcmDspDataSize=32, DcmDspDataType=UINT32, DcmDspDataInfoRef=DataInfo_VIPSoftwareVersion_VIPSoftwareVersion
        DataInfo_VIPSoftwareVersion_VIPSoftwareVersion (DcmDspDataInfo): DcmDspDataFixedLength=true
        AndroidSoftwareVersion_AndroidSoftwareVersion (DcmDspData): DcmDspDataSize=400, DcmDspDataType=UINT8_N, DcmDspDataInfoRef=DataInfo_AndroidSoftwareVersion_AndroidSoftwareVersion
        DataInfo_AndroidSoftwareVersion_AndroidSoftwareVersion (DcmDspDataInfo): DcmDspDataFixedLength=false
        QNXSoftwareVersion_QNXSoftwareVersion (DcmDspData): DcmDspDataSize=400, DcmDspDataType=UINT8_N, DcmDspDataInfoRef=DataInfo_QNXSoftwareVersion_QNXSoftwareVersion
        DataInfo_QNXSoftwareVersion_QNXSoftwareVersion (DcmDspDataInfo): DcmDspDataFixedLength=false
        VIPBootloaderVersion_VIPBootloaderVersion (DcmDspData): DcmDspDataSize=32, DcmDspDataType=UINT32, DcmDspDataInfoRef=DataInfo_VIPBootloaderVersion_VIPBootloaderVersion
        DataInfo_VIPBootloaderVersion_VIPBootloaderVersion (DcmDspDataInfo): DcmDspDataFixedLength=true
        ClearTraceLog_Clear_Log (DcmDspData): DcmDspDataSize=8, DcmDspDataType=UINT8, DcmDspDataInfoRef=DataInfo_ClearTraceLog_Clear_Log
        DataInfo_ClearTraceLog_Clear_Log (DcmDspDataInfo): DcmDspDataFixedLength=true
        WatchDogCounter_MCU_WatchDog_Counter (DcmDspData): DcmDspDataSize=16, DcmDspDataType=UINT16, DcmDspDataInfoRef=DataInfo_WatchDogCounter_MCU_WatchDog_Counter
        DataInfo_WatchDogCounter_MCU_WatchDog_Counter (DcmDspDataInfo): DcmDspDataFixedLength=true
        ResetInformation_ResetInformation (DcmDspData): DcmDspDataSize=488, DcmDspDataType=UINT8_N, DcmDspDataInfoRef=DataInfo_ResetInformation_ResetInformation
        DataInfo_ResetInformation_ResetInformation (DcmDspDataInfo): DcmDspDataFixedLength=true
        DID_0xFD1A_1_1_System_Time (DcmDspData): DcmDspDataSize=56, DcmDspDataType=UINT8_N, DcmDspDataInfoRef=DataInfo_DID_0xFD1A_1_1_System_Time
        DataInfo_DID_0xFD1A_1_1_System_Time (DcmDspDataInfo): DcmDspDataFixedLength=true
        GPSSyncSwitch_Status (DcmDspData): DcmDspDataSize=8, DcmDspDataType=UINT8, DcmDspDataInfoRef=DataInfo_GPSSyncSwitch_Status
        DataInfo_GPSSyncSwitch_Status (DcmDspDataInfo): DcmDspDataFixedLength=true
        BluetoothTestModeSwitch_Test_Mode_ON_OFF (DcmDspData): DcmDspDataSize=8, DcmDspDataType=UINT8, DcmDspDataInfoRef=DataInfo_BluetoothTestModeSwitch_Test_Mode_ON_OFF
        DataInfo_BluetoothTestModeSwitch_Test_Mode_ON_OFF (DcmDspDataInfo): DcmDspDataFixedLength=true
        BluetoothSwitch_BT_ON_OFF (DcmDspData): DcmDspDataSize=8, DcmDspDataType=UINT8, DcmDspDataInfoRef=DataInfo_BluetoothSwitch_BT_ON_OFF
        DataInfo_BluetoothSwitch_BT_ON_OFF (DcmDspDataInfo): DcmDspDataFixedLength=true
        BluetoothECNRSwitch_BT_ECNR_Status (DcmDspData): DcmDspDataSize=8, DcmDspDataType=UINT8, DcmDspDataInfoRef=DataInfo_BluetoothECNRSwitch_BT_ECNR_Status
        DataInfo_BluetoothECNRSwitch_BT_ECNR_Status (DcmDspDataInfo): DcmDspDataFixedLength=true
        BluetoothAddress_BT_Address (DcmDspData): DcmDspDataSize=48, DcmDspDataType=UINT8_N, DcmDspDataInfoRef=DataInfo_BluetoothAddress_BT_Address
        DataInfo_BluetoothAddress_BT_Address (DcmDspDataInfo): DcmDspDataFixedLength=true
        BluetoothFrequencyTrim_Frequency (DcmDspData): DcmDspDataSize=8, DcmDspDataType=UINT8, DcmDspDataInfoRef=DataInfo_BluetoothFrequencyTrim_Frequency
        DataInfo_BluetoothFrequencyTrim_Frequency (DcmDspDataInfo): DcmDspDataFixedLength=true
        BluetoothFriendlyName_BluetoothFriendlyName (DcmDspData): DcmDspDataSize=264, DcmDspDataType=UINT8_N, DcmDspDataInfoRef=DataInfo_BluetoothFriendlyName_BluetoothFriendlyName
        DataInfo_BluetoothFriendlyName_BluetoothFriendlyName (DcmDspDataInfo): DcmDspDataFixedLength=true
        BluetoothModuleScanOn_Status (DcmDspData): DcmDspDataSize=8, DcmDspDataType=UINT8, DcmDspDataInfoRef=DataInfo_BluetoothModuleScanOn_Status
        DataInfo_BluetoothModuleScanOn_Status (DcmDspDataInfo): DcmDspDataFixedLength=true
        BluetoothAudioPlayPause_Status (DcmDspData): DcmDspDataSize=8, DcmDspDataType=UINT8, DcmDspDataInfoRef=DataInfo_BluetoothAudioPlayPause_Status
        DataInfo_BluetoothAudioPlayPause_Status (DcmDspDataInfo): DcmDspDataFixedLength=true
        BluetoothAudioPlayMode_Play_Mode (DcmDspData): DcmDspDataSize=8, DcmDspDataType=UINT8, DcmDspDataInfoRef=DataInfo_BluetoothAudioPlayMode_Play_Mode
        DataInfo_BluetoothAudioPlayMode_Play_Mode (DcmDspDataInfo): DcmDspDataFixedLength=true
        BluetoothAudioForward_Rewind_Forward_Rewind (DcmDspData): DcmDspDataSize=8, DcmDspDataType=UINT8, DcmDspDataInfoRef=DataInfo_BluetoothAudioForward_Rewind_Forward_Rewind
        DataInfo_BluetoothAudioForward_Rewind_Forward_Rewind (DcmDspDataInfo): DcmDspDataFixedLength=true
        BluetoothAudioSkipTrack_Skip (DcmDspData): DcmDspDataSize=8, DcmDspDataType=UINT8, DcmDspDataInfoRef=DataInfo_BluetoothAudioSkipTrack_Skip
        DataInfo_BluetoothAudioSkipTrack_Skip (DcmDspDataInfo): DcmDspDataFixedLength=true
        BluetoothPairListInformation_Clear (DcmDspData): DcmDspDataSize=8, DcmDspDataType=UINT8, DcmDspDataInfoRef=DataInfo_BluetoothPairListInformation_Clear
        DataInfo_BluetoothPairListInformation_Clear (DcmDspDataInfo): DcmDspDataFixedLength=true
        EnterBluetoothMaximumPowerMode_Maximum_Power_Mode (DcmDspData): DcmDspDataSize=8, DcmDspDataType=UINT8, DcmDspDataInfoRef=DataInfo_EnterBluetoothMaximumPowerMode_Maximum_Power_Mode
        DataInfo_EnterBluetoothMaximumPowerMode_Maximum_Power_Mode (DcmDspDataInfo): DcmDspDataFixedLength=true
        BTPairbyBTAddress_BT_Address (DcmDspData): DcmDspDataSize=48, DcmDspDataType=UINT8_N, DcmDspDataInfoRef=DataInfo_BTPairbyBTAddress_BT_Address
        DataInfo_BTPairbyBTAddress_BT_Address (DcmDspDataInfo): DcmDspDataFixedLength=true
        BTPairConfirm_Confirm (DcmDspData): DcmDspDataSize=8, DcmDspDataType=UINT8, DcmDspDataInfoRef=DataInfo_BTPairConfirm_Confirm
        DataInfo_BTPairConfirm_Confirm (DcmDspDataInfo): DcmDspDataFixedLength=true
        ReadBTBER_ReadBTBER (DcmDspData): DcmDspDataSize=32, DcmDspDataType=UINT32, DcmDspDataInfoRef=DataInfo_ReadBTBER_ReadBTBER
        DataInfo_ReadBTBER_ReadBTBER (DcmDspDataInfo): DcmDspDataFixedLength=true
        WiFiTestModeSwitch_Wifi_Test_Mode_ON_OFF (DcmDspData): DcmDspDataSize=48, DcmDspDataType=UINT8_N, DcmDspDataInfoRef=DataInfo_WiFiTestModeSwitch_Wifi_Test_Mode_ON_OFF
        DataInfo_WiFiTestModeSwitch_Wifi_Test_Mode_ON_OFF (DcmDspDataInfo): DcmDspDataFixedLength=true
        WiFiFriendlyName_WiFi_Friendly_Name (DcmDspData): DcmDspDataSize=264, DcmDspDataType=UINT8_N, DcmDspDataInfoRef=DataInfo_WiFiFriendlyName_WiFi_Friendly_Name
        DataInfo_WiFiFriendlyName_WiFi_Friendly_Name (DcmDspDataInfo): DcmDspDataFixedLength=true
        WiFiConnectStatus_Wifi_Station_ON_OFF (DcmDspData): DcmDspDataSize=8, DcmDspDataType=UINT8, DcmDspDataInfoRef=DataInfo_WiFiConnectStatus_Wifi_Station_ON_OFF
        DataInfo_WiFiConnectStatus_Wifi_Station_ON_OFF (DcmDspDataInfo): DcmDspDataFixedLength=true
        WriteWiFiBand_WiFi_Band (DcmDspData): DcmDspDataSize=8, DcmDspDataType=UINT8, DcmDspDataInfoRef=DataInfo_WriteWiFiBand_WiFi_Band
        DataInfo_WriteWiFiBand_WiFi_Band (DcmDspDataInfo): DcmDspDataFixedLength=true
        WiFiChannel_WiFi_Channel (DcmDspData): DcmDspDataSize=8, DcmDspDataType=UINT8, DcmDspDataInfoRef=DataInfo_WiFiChannel_WiFi_Channel
        DataInfo_WiFiChannel_WiFi_Channel (DcmDspDataInfo): DcmDspDataFixedLength=true
        WiFiProtocol_WiFi_Protocol (DcmDspData): DcmDspDataSize=8, DcmDspDataType=UINT8, DcmDspDataInfoRef=DataInfo_WiFiProtocol_WiFi_Protocol
        DataInfo_WiFiProtocol_WiFi_Protocol (DcmDspDataInfo): DcmDspDataFixedLength=true
        WiFiPackageErrorRate_WiFi_PER (DcmDspData): DcmDspDataSize=32, DcmDspDataType=UINT32, DcmDspDataInfoRef=DataInfo_WiFiPackageErrorRate_WiFi_PER
        DataInfo_WiFiPackageErrorRate_WiFi_PER (DcmDspDataInfo): DcmDspDataFixedLength=true
        WiFiMaximumPowerModestatus_WiFi_Maximum_Power_Mode (DcmDspData): DcmDspDataSize=8, DcmDspDataType=UINT8, DcmDspDataInfoRef=DataInfo_WiFiMaximumPowerModestatus_WiFi_Maximum_Power_Mode
        DataInfo_WiFiMaximumPowerModestatus_WiFi_Maximum_Power_Mode (DcmDspDataInfo): DcmDspDataFixedLength=true
        ReadWiFiConnectStatus_0xFD4C (DcmDspData): DcmDspDataSize=8, DcmDspDataType=UINT8, DcmDspDataInfoRef=DataInfo_ReadWiFiConnectStatus_0xFD4C
        DataInfo_ReadWiFiConnectStatus_0xFD4C (DcmDspDataInfo): DcmDspDataFixedLength=true
        WiFiSignalStrength_Signal_Strength (DcmDspData): DcmDspDataSize=8, DcmDspDataType=UINT8, DcmDspDataInfoRef=DataInfo_WiFiSignalStrength_Signal_Strength
        DataInfo_WiFiSignalStrength_Signal_Strength (DcmDspDataInfo): DcmDspDataFixedLength=true
        WiFiConnecttoSpecifiedAP_WiFiConnecttoSpecifiedAP (DcmDspData): DcmDspDataSize=264, DcmDspDataType=UINT8_N, DcmDspDataInfoRef=DataInfo_WiFiConnecttoSpecifiedAP_WiFiConnecttoSpecifiedAP
        DataInfo_WiFiConnecttoSpecifiedAP_WiFiConnecttoSpecifiedAP (DcmDspDataInfo): DcmDspDataFixedLength=false
        WiFiMACAddress_Mac_Address (DcmDspData): DcmDspDataSize=48, DcmDspDataType=UINT8_N, DcmDspDataInfoRef=DataInfo_WiFiMACAddress_Mac_Address
        DataInfo_WiFiMACAddress_Mac_Address (DcmDspDataInfo): DcmDspDataFixedLength=true
        EthernetTestModeSwitch_Status (DcmDspData): DcmDspDataSize=16, DcmDspDataType=UINT16, DcmDspDataInfoRef=DataInfo_EthernetTestModeSwitch_Status
        DataInfo_EthernetTestModeSwitch_Status (DcmDspDataInfo): DcmDspDataFixedLength=true
        EthernetPackageErrorRate_Ethernet_PER (DcmDspData): DcmDspDataSize=64, DcmDspDataType=UINT8_N, DcmDspDataInfoRef=DataInfo_EthernetPackageErrorRate_Ethernet_PER
        DataInfo_EthernetPackageErrorRate_Ethernet_PER (DcmDspDataInfo): DcmDspDataFixedLength=true
        EthernetChannelDiagnosticResult_Ethernet_Channel_Diagnostic_Result (DcmDspData): DcmDspDataSize=64, DcmDspDataType=UINT8_N, DcmDspDataInfoRef=DataInfo_EthernetChannelDiagnosticResult_Ethernet_Channel_Diagnostic_Result
        DataInfo_EthernetChannelDiagnosticResult_Ethernet_Channel_Diagnostic_Result (DcmDspDataInfo): DcmDspDataFixedLength=true
        IPAddress_IP_Address (DcmDspData): DcmDspDataSize=384, DcmDspDataType=UINT8_N, DcmDspDataInfoRef=DataInfo_IPAddress_IP_Address
        DataInfo_IPAddress_IP_Address (DcmDspDataInfo): DcmDspDataFixedLength=true
        AudioSource_Audio_Source (DcmDspData): DcmDspDataSize=8, DcmDspDataType=UINT8, DcmDspDataInfoRef=DataInfo_AudioSource_Audio_Source
        DataInfo_AudioSource_Audio_Source (DcmDspDataInfo): DcmDspDataFixedLength=true
        VolumeLevel_Volume_Level (DcmDspData): DcmDspDataSize=8, DcmDspDataType=UINT8, DcmDspDataInfoRef=DataInfo_VolumeLevel_Volume_Level
        DataInfo_VolumeLevel_Volume_Level (DcmDspDataInfo): DcmDspDataFixedLength=true
        MuteStatus_Mute_status (DcmDspData): DcmDspDataSize=8, DcmDspDataType=UINT8, DcmDspDataInfoRef=DataInfo_MuteStatus_Mute_status
        DataInfo_MuteStatus_Mute_status (DcmDspDataInfo): DcmDspDataFixedLength=true
        BassLevel_Bass_Level (DcmDspData): DcmDspDataSize=8, DcmDspDataType=UINT8, DcmDspDataInfoRef=DataInfo_BassLevel_Bass_Level
        DataInfo_BassLevel_Bass_Level (DcmDspDataInfo): DcmDspDataFixedLength=true
        MiddleLevel_Middle_Level (DcmDspData): DcmDspDataSize=8, DcmDspDataType=UINT8, DcmDspDataInfoRef=DataInfo_MiddleLevel_Middle_Level
        DataInfo_MiddleLevel_Middle_Level (DcmDspDataInfo): DcmDspDataFixedLength=true
        TrebleLevel_Treble_Level (DcmDspData): DcmDspDataSize=8, DcmDspDataType=UINT8, DcmDspDataInfoRef=DataInfo_TrebleLevel_Treble_Level
        DataInfo_TrebleLevel_Treble_Level (DcmDspDataInfo): DcmDspDataFixedLength=true
        BalanceLevel_Balance_Level (DcmDspData): DcmDspDataSize=8, DcmDspDataType=UINT8, DcmDspDataInfoRef=DataInfo_BalanceLevel_Balance_Level
        DataInfo_BalanceLevel_Balance_Level (DcmDspDataInfo): DcmDspDataFixedLength=true
        FaderLevel_Fader_Level (DcmDspData): DcmDspDataSize=8, DcmDspDataType=UINT8, DcmDspDataInfoRef=DataInfo_FaderLevel_Fader_Level
        DataInfo_FaderLevel_Fader_Level (DcmDspDataInfo): DcmDspDataFixedLength=true
        LoudnessStatus_Loudness_Status (DcmDspData): DcmDspDataSize=8, DcmDspDataType=UINT8, DcmDspDataInfoRef=DataInfo_LoudnessStatus_Loudness_Status
        DataInfo_LoudnessStatus_Loudness_Status (DcmDspDataInfo): DcmDspDataFixedLength=true
        SpeedVolumeStatus_Speed_Volume_Status (DcmDspData): DcmDspDataSize=8, DcmDspDataType=UINT8, DcmDspDataInfoRef=DataInfo_SpeedVolumeStatus_Speed_Volume_Status
        DataInfo_SpeedVolumeStatus_Speed_Volume_Status (DcmDspDataInfo): DcmDspDataFixedLength=true
        DTSStatus_DTS_Status (DcmDspData): DcmDspDataSize=8, DcmDspDataType=UINT8, DcmDspDataInfoRef=DataInfo_DTSStatus_DTS_Status
        DataInfo_DTSStatus_DTS_Status (DcmDspDataInfo): DcmDspDataFixedLength=true
        BEXStatus_BEX_Status (DcmDspData): DcmDspDataSize=8, DcmDspDataType=UINT8, DcmDspDataInfoRef=DataInfo_BEXStatus_BEX_Status
        DataInfo_BEXStatus_BEX_Status (DcmDspDataInfo): DcmDspDataFixedLength=true
        BestListeningposition_Best_Listening_Position_Status (DcmDspData): DcmDspDataSize=8, DcmDspDataType=UINT8, DcmDspDataInfoRef=DataInfo_BestListeningposition_Best_Listening_Position_Status
        DataInfo_BestListeningposition_Best_Listening_Position_Status (DcmDspDataInfo): DcmDspDataFixedLength=true
        SetTuningParametersFlat_Flat_ON_OFF (DcmDspData): DcmDspDataSize=8, DcmDspDataType=UINT8, DcmDspDataInfoRef=DataInfo_SetTuningParametersFlat_Flat_ON_OFF
        DataInfo_SetTuningParametersFlat_Flat_ON_OFF (DcmDspDataInfo): DcmDspDataFixedLength=true
        BeepVolume_Beep_Volume_Level (DcmDspData): DcmDspDataSize=8, DcmDspDataType=UINT8, DcmDspDataInfoRef=DataInfo_BeepVolume_Beep_Volume_Level
        DataInfo_BeepVolume_Beep_Volume_Level (DcmDspDataInfo): DcmDspDataFixedLength=true
        NaviVolume_Navi_Volume_Level (DcmDspData): DcmDspDataSize=8, DcmDspDataType=UINT8, DcmDspDataInfoRef=DataInfo_NaviVolume_Navi_Volume_Level
        DataInfo_NaviVolume_Navi_Volume_Level (DcmDspDataInfo): DcmDspDataFixedLength=true
        TTSvolume_TTS_Volume_Level (DcmDspData): DcmDspDataSize=8, DcmDspDataType=UINT8, DcmDspDataInfoRef=DataInfo_TTSvolume_TTS_Volume_Level
        DataInfo_TTSvolume_TTS_Volume_Level (DcmDspDataInfo): DcmDspDataFixedLength=true
        IPwarningVolume_IP_Warning_Volume_Level (DcmDspData): DcmDspDataSize=8, DcmDspDataType=UINT8, DcmDspDataInfoRef=DataInfo_IPwarningVolume_IP_Warning_Volume_Level
        DataInfo_IPwarningVolume_IP_Warning_Volume_Level (DcmDspDataInfo): DcmDspDataFixedLength=true
        BTCallvolume_BT_Call_Volume_Level (DcmDspData): DcmDspDataSize=8, DcmDspDataType=UINT8, DcmDspDataInfoRef=DataInfo_BTCallvolume_BT_Call_Volume_Level
        DataInfo_BTCallvolume_BT_Call_Volume_Level (DcmDspDataInfo): DcmDspDataFixedLength=true
        BTRingvolume_BT_Ring_Volume_Level (DcmDspData): DcmDspDataSize=8, DcmDspDataType=UINT8, DcmDspDataInfoRef=DataInfo_BTRingvolume_BT_Ring_Volume_Level
        DataInfo_BTRingvolume_BT_Ring_Volume_Level (DcmDspDataInfo): DcmDspDataFixedLength=true
        USB_iPodPlayPause_Play_Pause (DcmDspData): DcmDspDataSize=8, DcmDspDataType=UINT8, DcmDspDataInfoRef=DataInfo_USB_iPodPlayPause_Play_Pause
        DataInfo_USB_iPodPlayPause_Play_Pause (DcmDspDataInfo): DcmDspDataFixedLength=true
        USB_iPodPlayMode_Play_Mode (DcmDspData): DcmDspDataSize=8, DcmDspDataType=UINT8, DcmDspDataInfoRef=DataInfo_USB_iPodPlayMode_Play_Mode
        DataInfo_USB_iPodPlayMode_Play_Mode (DcmDspDataInfo): DcmDspDataFixedLength=true
        USB_iPodSkipTrack_Next_Previous (DcmDspData): DcmDspDataSize=8, DcmDspDataType=UINT8, DcmDspDataInfoRef=DataInfo_USB_iPodSkipTrack_Next_Previous
        DataInfo_USB_iPodSkipTrack_Next_Previous (DcmDspDataInfo): DcmDspDataFixedLength=true
        FM_AM_Current_Status_FM_AMCurrentStatus (DcmDspData): DcmDspDataSize=24, DcmDspDataType=UINT8_N, DcmDspDataInfoRef=DataInfo_FM_AM_Current_Status_FM_AMCurrentStatus
        DataInfo_FM_AM_Current_Status_FM_AMCurrentStatus (DcmDspDataInfo): DcmDspDataFixedLength=true
        FM_AMFrequency_Frequency (DcmDspData): DcmDspDataSize=16, DcmDspDataType=UINT16, DcmDspDataInfoRef=DataInfo_FM_AMFrequency_Frequency
        DataInfo_FM_AMFrequency_Frequency (DcmDspDataInfo): DcmDspDataFixedLength=true
        FM_AMSeek_Seek (DcmDspData): DcmDspDataSize=8, DcmDspDataType=UINT8, DcmDspDataInfoRef=DataInfo_FM_AMSeek_Seek
        DataInfo_FM_AMSeek_Seek (DcmDspDataInfo): DcmDspDataFixedLength=true
        TunerUpdateFM_List_Update_FM_List (DcmDspData): DcmDspDataSize=8, DcmDspDataType=UINT8, DcmDspDataInfoRef=DataInfo_TunerUpdateFM_List_Update_FM_List
        DataInfo_TunerUpdateFM_List_Update_FM_List (DcmDspDataInfo): DcmDspDataFixedLength=true
        FM_AMSignalStrength_Signal_Strength (DcmDspData): DcmDspDataSize=8, DcmDspDataType=UINT8, DcmDspDataInfoRef=DataInfo_FM_AMSignalStrength_Signal_Strength
        DataInfo_FM_AMSignalStrength_Signal_Strength (DcmDspDataInfo): DcmDspDataFixedLength=true
        DID_0xFDB0_1_DABCurrentStatus (DcmDspData): DcmDspDataSize=48, DcmDspDataType=UINT8_N, DcmDspDataInfoRef=DataInfo_DID_0xFDB0_1_DABCurrentStatus
        DataInfo_DID_0xFDB0_1_DABCurrentStatus (DcmDspDataInfo): DcmDspDataFixedLength=true
        DABPSName_Curent_DAB_PS_Name (DcmDspData): DcmDspDataSize=64, DcmDspDataType=UINT8_N, DcmDspDataInfoRef=DataInfo_DABPSName_Curent_DAB_PS_Name
        DataInfo_DABPSName_Curent_DAB_PS_Name (DcmDspDataInfo): DcmDspDataFixedLength=true
        DABFrequency_DAB_Frequency_Name (DcmDspData): DcmDspDataSize=32, DcmDspDataType=UINT8_N, DcmDspDataInfoRef=DataInfo_DABFrequency_DAB_Frequency_Name
        DataInfo_DABFrequency_DAB_Frequency_Name (DcmDspDataInfo): DcmDspDataFixedLength=true
        DABBank_DAB_Bank (DcmDspData): DcmDspDataSize=16, DcmDspDataType=UINT16, DcmDspDataInfoRef=DataInfo_DABBank_DAB_Bank
        DataInfo_DABBank_DAB_Bank (DcmDspDataInfo): DcmDspDataFixedLength=true
        DABPreset_Preset_number (DcmDspData): DcmDspDataSize=8, DcmDspDataType=UINT8, DcmDspDataInfoRef=DataInfo_DABPreset_Preset_number
        DataInfo_DABPreset_Preset_number (DcmDspDataInfo): DcmDspDataFixedLength=true
        DABSeek_Seek (DcmDspData): DcmDspDataSize=8, DcmDspDataType=UINT8, DcmDspDataInfoRef=DataInfo_DABSeek_Seek
        DataInfo_DABSeek_Seek (DcmDspDataInfo): DcmDspDataFixedLength=true
        DABEnsembleID_Ensemble_ID (DcmDspData): DcmDspDataSize=8, DcmDspDataType=UINT8, DcmDspDataInfoRef=DataInfo_DABEnsembleID_Ensemble_ID
        DataInfo_DABEnsembleID_Ensemble_ID (DcmDspDataInfo): DcmDspDataFixedLength=true
        DABStationID_DABStationID (DcmDspData): DcmDspDataSize=64, DcmDspDataType=UINT8_N, DcmDspDataInfoRef=DataInfo_DABStationID_DABStationID
        DataInfo_DABStationID_DABStationID (DcmDspDataInfo): DcmDspDataFixedLength=true
        DABBitErrorRatio_Bit_Error_Ratio (DcmDspData): DcmDspDataSize=8, DcmDspDataType=UINT8, DcmDspDataInfoRef=DataInfo_DABBitErrorRatio_Bit_Error_Ratio
        DataInfo_DABBitErrorRatio_Bit_Error_Ratio (DcmDspDataInfo): DcmDspDataFixedLength=true
        DABReceivedSignalStrength_RSS (DcmDspData): DcmDspDataSize=8, DcmDspDataType=UINT8, DcmDspDataInfoRef=DataInfo_DABReceivedSignalStrength_RSS
        DataInfo_DABReceivedSignalStrength_RSS (DcmDspDataInfo): DcmDspDataFixedLength=true
        DABTestTone_Test_tone_type (DcmDspData): DcmDspDataSize=8, DcmDspDataType=UINT8, DcmDspDataInfoRef=DataInfo_DABTestTone_Test_tone_type
        DataInfo_DABTestTone_Test_tone_type (DcmDspDataInfo): DcmDspDataFixedLength=true
        SwitchFunction_SwitchFunction (DcmDspData): DcmDspDataSize=32, DcmDspDataType=UINT32, DcmDspDataInfoRef=DataInfo_SwitchFunction_SwitchFunction
        DataInfo_SwitchFunction_SwitchFunction (DcmDspDataInfo): DcmDspDataFixedLength=true
        Gyro_Status_GyroStatus (DcmDspData): DcmDspDataSize=48, DcmDspDataType=UINT8_N, DcmDspDataInfoRef=DataInfo_Gyro_Status_GyroStatus
        DataInfo_Gyro_Status_GyroStatus (DcmDspDataInfo): DcmDspDataFixedLength=true
        ReadGPSSatelliteCount_ReadGPSSatelliteCount (DcmDspData): DcmDspDataSize=8, DcmDspDataType=UINT8, DcmDspDataInfoRef=DataInfo_ReadGPSSatelliteCount_ReadGPSSatelliteCount
        DataInfo_ReadGPSSatelliteCount_ReadGPSSatelliteCount (DcmDspDataInfo): DcmDspDataFixedLength=true
        IVIDisplayNight_DayMode_Day_Night_Mode (DcmDspData): DcmDspDataSize=8, DcmDspDataType=UINT8, DcmDspDataInfoRef=DataInfo_IVIDisplayNight_DayMode_Day_Night_Mode
        DataInfo_IVIDisplayNight_DayMode_Day_Night_Mode (DcmDspDataInfo): DcmDspDataFixedLength=true
        IVIDisplayBrightness_Brightness (DcmDspData): DcmDspDataSize=8, DcmDspDataType=UINT8, DcmDspDataInfoRef=DataInfo_IVIDisplayBrightness_Brightness
        DataInfo_IVIDisplayBrightness_Brightness (DcmDspDataInfo): DcmDspDataFixedLength=true
        IVI_Display_Voltage_IVI_Display_Voltage (DcmDspData): DcmDspDataSize=8, DcmDspDataType=UINT8, DcmDspDataInfoRef=DataInfo_IVI_Display_Voltage_IVI_Display_Voltage
        DataInfo_IVI_Display_Voltage_IVI_Display_Voltage (DcmDspDataInfo): DcmDspDataFixedLength=true
        IVIDisplayPatternsTest_Manufacture_Date (DcmDspData): DcmDspDataSize=8, DcmDspDataType=UINT8, DcmDspDataInfoRef=DataInfo_IVIDisplayPatternsTest_Manufacture_Date
        DataInfo_IVIDisplayPatternsTest_Manufacture_Date (DcmDspDataInfo): DcmDspDataFixedLength=true
        ClearIVIDisplayDTCInformation_0xFE62 (DcmDspData): DcmDspDataSize=8, DcmDspDataType=UINT8, DcmDspDataInfoRef=DataInfo_ClearIVIDisplayDTCInformation_0xFE62
        DataInfo_ClearIVIDisplayDTCInformation_0xFE62 (DcmDspDataInfo): DcmDspDataFixedLength=true
        IVIDisplayReset_IVIDisplayReset (DcmDspData): DcmDspDataSize=8, DcmDspDataType=UINT8, DcmDspDataInfoRef=DataInfo_IVIDisplayReset_IVIDisplayReset
        DataInfo_IVIDisplayReset_IVIDisplayReset (DcmDspDataInfo): DcmDspDataFixedLength=true
        EnterEOLSession_EnterEOLSession (DcmDspData): DcmDspDataSize=32, DcmDspDataType=UINT32, DcmDspDataInfoRef=DataInfo_EnterEOLSession_EnterEOLSession
        DataInfo_EnterEOLSession_EnterEOLSession (DcmDspDataInfo): DcmDspDataFixedLength=true
        ClusterBrightness_Brightness (DcmDspData): DcmDspDataSize=8, DcmDspDataType=UINT8, DcmDspDataInfoRef=DataInfo_ClusterBrightness_Brightness
        DataInfo_ClusterBrightness_Brightness (DcmDspDataInfo): DcmDspDataFixedLength=true
        DID_0xFE62_1_Cluster_Display_Voltage (DcmDspData): DcmDspDataSize=8, DcmDspDataType=UINT8, DcmDspDataInfoRef=DataInfo_DID_0xFE62_1_Cluster_Display_Voltage
        DataInfo_DID_0xFE62_1_Cluster_Display_Voltage (DcmDspDataInfo): DcmDspDataFixedLength=true
        ClusterDisplayPatternsTest_Manufacture_Date (DcmDspData): DcmDspDataSize=8, DcmDspDataType=UINT8, DcmDspDataInfoRef=DataInfo_ClusterDisplayPatternsTest_Manufacture_Date
        DataInfo_ClusterDisplayPatternsTest_Manufacture_Date (DcmDspDataInfo): DcmDspDataFixedLength=true
        ClusterDisplaySupplierInformation_Supplier_Information (DcmDspData): DcmDspDataSize=8, DcmDspDataType=UINT8, DcmDspDataInfoRef=DataInfo_ClusterDisplaySupplierInformation_Supplier_Information
        DataInfo_ClusterDisplaySupplierInformation_Supplier_Information (DcmDspDataInfo): DcmDspDataFixedLength=true
        ClusterDisplaySizeofScreen_Size (DcmDspData): DcmDspDataSize=8, DcmDspDataType=UINT8, DcmDspDataInfoRef=DataInfo_ClusterDisplaySizeofScreen_Size
        DataInfo_ClusterDisplaySizeofScreen_Size (DcmDspDataInfo): DcmDspDataFixedLength=true
        ClusterDisplayResolution_Resolution (DcmDspData): DcmDspDataSize=8, DcmDspDataType=UINT8, DcmDspDataInfoRef=DataInfo_ClusterDisplayResolution_Resolution
        DataInfo_ClusterDisplayResolution_Resolution (DcmDspDataInfo): DcmDspDataFixedLength=true
        ClusterDisplayType_Display_Type (DcmDspData): DcmDspDataSize=8, DcmDspDataType=UINT8, DcmDspDataInfoRef=DataInfo_ClusterDisplayType_Display_Type
        DataInfo_ClusterDisplayType_Display_Type (DcmDspDataInfo): DcmDspDataFixedLength=true
        ClusterDisplayLVDSsignalstandard_Display_Type (DcmDspData): DcmDspDataSize=8, DcmDspDataType=UINT8, DcmDspDataInfoRef=DataInfo_ClusterDisplayLVDSsignalstandard_Display_Type
        DataInfo_ClusterDisplayLVDSsignalstandard_Display_Type (DcmDspDataInfo): DcmDspDataFixedLength=true
        ClearCluster_DisplayDTCInformation (DcmDspData): DcmDspDataSize=8, DcmDspDataType=UINT8, DcmDspDataInfoRef=DataInfo_ClearCluster_DisplayDTCInformation
        DataInfo_ClearCluster_DisplayDTCInformation (DcmDspDataInfo): DcmDspDataFixedLength=true
        ClusterDisplayReset_ClusterDisplayReset (DcmDspData): DcmDspDataSize=8, DcmDspDataType=UINT8, DcmDspDataInfoRef=DataInfo_ClusterDisplayReset_ClusterDisplayReset
        DataInfo_ClusterDisplayReset_ClusterDisplayReset (DcmDspDataInfo): DcmDspDataFixedLength=true
        ControlDisplayBrightness_Brightness (DcmDspData): DcmDspDataSize=8, DcmDspDataType=UINT8, DcmDspDataInfoRef=DataInfo_ControlDisplayBrightness_Brightness
        DataInfo_ControlDisplayBrightness_Brightness (DcmDspDataInfo): DcmDspDataFixedLength=true
        PassengerDisplayBrightness_Brightness (DcmDspData): DcmDspDataSize=8, DcmDspDataType=UINT8, DcmDspDataInfoRef=DataInfo_PassengerDisplayBrightness_Brightness
        DataInfo_PassengerDisplayBrightness_Brightness (DcmDspDataInfo): DcmDspDataFixedLength=true
        Radio_Antenna_Status_RadioAntennaStatus (DcmDspData): DcmDspDataSize=8, DcmDspDataType=UINT8, DcmDspDataInfoRef=DataInfo_Radio_Antenna_Status_RadioAntennaStatus
        DataInfo_Radio_Antenna_Status_RadioAntennaStatus (DcmDspDataInfo): DcmDspDataFixedLength=true
        MICStatus_MICStatus (DcmDspData): DcmDspDataSize=16, DcmDspDataType=UINT16, DcmDspDataInfoRef=DataInfo_MICStatus_MICStatus
        DataInfo_MICStatus_MICStatus (DcmDspDataInfo): DcmDspDataFixedLength=true
        SpeakerStatus_SpeakerStatus (DcmDspData): DcmDspDataSize=64, DcmDspDataType=UINT8_N, DcmDspDataInfoRef=DataInfo_SpeakerStatus_SpeakerStatus
        DataInfo_SpeakerStatus_SpeakerStatus (DcmDspDataInfo): DcmDspDataFixedLength=true
        ExternalAmpStatus_Amplifier (DcmDspData): DcmDspDataSize=8, DcmDspDataType=UINT8, DcmDspDataInfoRef=DataInfo_ExternalAmpStatus_Amplifier
        DataInfo_ExternalAmpStatus_Amplifier (DcmDspDataInfo): DcmDspDataFixedLength=true
        ReadCamera_LinkStatus (DcmDspData): DcmDspDataSize=48, DcmDspDataType=UINT8_N, DcmDspDataInfoRef=DataInfo_ReadCamera_LinkStatus
        DataInfo_ReadCamera_LinkStatus (DcmDspDataInfo): DcmDspDataFixedLength=true
        ReadDisplayLinkStatus_0xFDF7 (DcmDspData): DcmDspDataSize=40, DcmDspDataType=UINT8_N, DcmDspDataInfoRef=DataInfo_ReadDisplayLinkStatus_0xFDF7
        DataInfo_ReadDisplayLinkStatus_0xFDF7 (DcmDspDataInfo): DcmDspDataFixedLength=true
        CameraSwitch_RVC_AVM_Camera (DcmDspData): DcmDspDataSize=8, DcmDspDataType=UINT8, DcmDspDataInfoRef=DataInfo_CameraSwitch_RVC_AVM_Camera
        DataInfo_CameraSwitch_RVC_AVM_Camera (DcmDspDataInfo): DcmDspDataFixedLength=true
        DMSCameraDisplay0xFDF8_ON_OFF (DcmDspData): DcmDspDataSize=8, DcmDspDataType=UINT8, DcmDspDataInfoRef=DataInfo_DMSCameraDisplay0xFDF8_ON_OFF
        DataInfo_DMSCameraDisplay0xFDF8_ON_OFF (DcmDspDataInfo): DcmDspDataFixedLength=true
        InCarCameraDisplay0xFDF9_ON_OFF (DcmDspData): DcmDspDataSize=8, DcmDspDataType=UINT8, DcmDspDataInfoRef=DataInfo_InCarCameraDisplay0xFDF9_ON_OFF
        DataInfo_InCarCameraDisplay0xFDF9_ON_OFF (DcmDspDataInfo): DcmDspDataFixedLength=true
        DVRCameraDisplaySwitchONOFF_DVRCameraDisplaySwitchONOFF (DcmDspData): DcmDspDataSize=8, DcmDspDataType=UINT8, DcmDspDataInfoRef=DataInfo_DVRCameraDisplaySwitchONOFF_DVRCameraDisplaySwitchONOFF
        DataInfo_DVRCameraDisplaySwitchONOFF_DVRCameraDisplaySwitchONOFF (DcmDspDataInfo): DcmDspDataFixedLength=true
        GestureCameraDisplay_GestureCameraDisplay (DcmDspData): DcmDspDataSize=8, DcmDspDataType=UINT8, DcmDspDataInfoRef=DataInfo_GestureCameraDisplay_GestureCameraDisplay
        DataInfo_GestureCameraDisplay_GestureCameraDisplay (DcmDspDataInfo): DcmDspDataFixedLength=true
        MICTestSwitch_MICTestSwitch (DcmDspData): DcmDspDataSize=16, DcmDspDataType=UINT16, DcmDspDataInfoRef=DataInfo_MICTestSwitch_MICTestSwitch
        DataInfo_MICTestSwitch_MICTestSwitch (DcmDspDataInfo): DcmDspDataFixedLength=true
        AudioOutputbyAmp_A2B_0xFDFA (DcmDspData): DcmDspDataSize=8, DcmDspDataType=UINT8, DcmDspDataInfoRef=DataInfo_AudioOutputbyAmp_A2B_0xFDFA
        DataInfo_AudioOutputbyAmp_A2B_0xFDFA (DcmDspDataInfo): DcmDspDataFixedLength=true
        ClusterHardwareInput_ClusterHardwareInput (DcmDspData): DcmDspDataSize=48, DcmDspDataType=UINT8_N, DcmDspDataInfoRef=DataInfo_ClusterHardwareInput_ClusterHardwareInput
        DataInfo_ClusterHardwareInput_ClusterHardwareInput (DcmDspDataInfo): DcmDspDataFixedLength=true
        Display_enablingValues_Display_enablingValues (DcmDspData): DcmDspDataSize=16, DcmDspDataType=UINT16, DcmDspDataInfoRef=DataInfo_Display_enablingValues_Display_enablingValues
        DataInfo_Display_enablingValues_Display_enablingValues (DcmDspDataInfo): DcmDspDataFixedLength=true
        TBOXMuteValue_Mute_value (DcmDspData): DcmDspDataSize=8, DcmDspDataType=UINT8, DcmDspDataInfoRef=DataInfo_TBOXMuteValue_Mute_value
        DataInfo_TBOXMuteValue_Mute_value (DcmDspDataInfo): DcmDspDataFixedLength=true
        A2BTestSwitch_ON_OFF (DcmDspData): DcmDspDataSize=8, DcmDspDataType=UINT8, DcmDspDataInfoRef=DataInfo_A2BTestSwitch_ON_OFF
        DataInfo_A2BTestSwitch_ON_OFF (DcmDspDataInfo): DcmDspDataFixedLength=true
        AUXTestSwitch_ON_OFF (DcmDspData): DcmDspDataSize=16, DcmDspDataType=UINT16, DcmDspDataInfoRef=DataInfo_AUXTestSwitch_ON_OFF
        DataInfo_AUXTestSwitch_ON_OFF (DcmDspDataInfo): DcmDspDataFixedLength=true
        ReadUSB20PID_0xFE50 (DcmDspData): DcmDspDataSize=32, DcmDspDataType=UINT32, DcmDspDataInfoRef=DataInfo_ReadUSB20PID_0xFE50
        DataInfo_ReadUSB20PID_0xFE50 (DcmDspDataInfo): DcmDspDataFixedLength=true
        ReadUSB30PID_0xFE51 (DcmDspData): DcmDspDataSize=32, DcmDspDataType=UINT32, DcmDspDataInfoRef=DataInfo_ReadUSB30PID_0xFE51
        DataInfo_ReadUSB30PID_0xFE51 (DcmDspDataInfo): DcmDspDataFixedLength=true
        InternalAVMCameraON_OFF_InternalAVMCameraON_OFF (DcmDspData): DcmDspDataSize=8, DcmDspDataType=UINT8, DcmDspDataInfoRef=DataInfo_InternalAVMCameraON_OFF_InternalAVMCameraON_OFF
        DataInfo_InternalAVMCameraON_OFF_InternalAVMCameraON_OFF (DcmDspDataInfo): DcmDspDataFixedLength=true
        AllCameraDisplayToIVI_AllCameraDisplayToIVI (DcmDspData): DcmDspDataSize=8, DcmDspDataType=UINT8, DcmDspDataInfoRef=DataInfo_AllCameraDisplayToIVI_AllCameraDisplayToIVI
        DataInfo_AllCameraDisplayToIVI_AllCameraDisplayToIVI (DcmDspDataInfo): DcmDspDataFixedLength=true
        ReadCameraDisplayStatus_ReadCameraDisplayStatus (DcmDspData): DcmDspDataSize=48, DcmDspDataType=UINT8_N, DcmDspDataInfoRef=DataInfo_ReadCameraDisplayStatus_ReadCameraDisplayStatus
        DataInfo_ReadCameraDisplayStatus_ReadCameraDisplayStatus (DcmDspDataInfo): DcmDspDataFixedLength=true
        VehicleSpeed_Vehicle_Speed (DcmDspData): DcmDspDataSize=16, DcmDspDataType=UINT16, DcmDspDataInfoRef=DataInfo_VehicleSpeed_Vehicle_Speed
        DataInfo_VehicleSpeed_Vehicle_Speed (DcmDspDataInfo): DcmDspDataFixedLength=true
        EngineSpeed_EngineSpeed (DcmDspData): DcmDspDataSize=16, DcmDspDataType=UINT16, DcmDspDataInfoRef=DataInfo_EngineSpeed_EngineSpeed
        DataInfo_EngineSpeed_EngineSpeed (DcmDspDataInfo): DcmDspDataFixedLength=true
        OperatingVoltage_OperatingVoltage (DcmDspData): DcmDspDataSize=8, DcmDspDataType=UINT8, DcmDspDataInfoRef=DataInfo_OperatingVoltage_OperatingVoltage
        DataInfo_OperatingVoltage_OperatingVoltage (DcmDspDataInfo): DcmDspDataFixedLength=true
        Odometer_Odometer (DcmDspData): DcmDspDataSize=24, DcmDspDataType=UINT8_N, DcmDspDataInfoRef=DataInfo_Odometer_Odometer
        DataInfo_Odometer_Odometer (DcmDspDataInfo): DcmDspDataFixedLength=true
        DTCOccurrenceTimer_DTC_Occurrence_Timer (DcmDspData): DcmDspDataSize=32, DcmDspDataType=UINT32, DcmDspDataInfoRef=DataInfo_DTCOccurrenceTimer_DTC_Occurrence_Timer
        DataInfo_DTCOccurrenceTimer_DTC_Occurrence_Timer (DcmDspDataInfo): DcmDspDataFixedLength=true
        ActualRotationSpeed_ActualRotationSpeed (DcmDspData): DcmDspDataSize=16, DcmDspDataType=UINT16, DcmDspDataInfoRef=DataInfo_ActualRotationSpeed_ActualRotationSpeed
        DataInfo_ActualRotationSpeed_ActualRotationSpeed (DcmDspDataInfo): DcmDspDataFixedLength=true
        Check_Ethernet_IP_PING_Function_Routine_Status_Record_Byte_1 (DcmDspData): DcmDspDataSize=8, DcmDspDataType=UINT8, DcmDspDataInfoRef=DataInfo_Check_Ethernet_IP_PING_Function_Routine_Status_Record_Byte_1
        DataInfo_Check_Ethernet_IP_PING_Function_Routine_Status_Record_Byte_1 (DcmDspDataInfo): DcmDspDataFixedLength=true
        IVI_Touch_Test_Routine_Status_Record_Byte_1 (DcmDspData): DcmDspDataSize=8, DcmDspDataType=UINT8, DcmDspDataInfoRef=DataInfo_IVI_Touch_Test_Routine_Status_Record_Byte_1
        DataInfo_IVI_Touch_Test_Routine_Status_Record_Byte_1 (DcmDspDataInfo): DcmDspDataFixedLength=true
        VehicleModel_VehicleModel (DcmDspData): DcmDspDataSize=160, DcmDspDataType=UINT8_N, DcmDspDataInfoRef=DataInfo_VehicleModel_VehicleModel
        DataInfo_VehicleModel_VehicleModel (DcmDspDataInfo): DcmDspDataFixedLength=true
        VehicleManufacturerSparePartNumber_SparePartNumber (DcmDspData): DcmDspDataSize=104, DcmDspDataType=UINT8_N, DcmDspDataInfoRef=DataInfo_VehicleManufacturerSparePartNumber_SparePartNumber
        DataInfo_VehicleManufacturerSparePartNumber_SparePartNumber (DcmDspDataInfo): DcmDspDataFixedLength=true
        SoftwareVersionNumberDataIdentifier_SoftwareVersion (DcmDspData): DcmDspDataSize=120, DcmDspDataType=UINT8_N, DcmDspDataInfoRef=DataInfo_SoftwareVersionNumberDataIdentifier_SoftwareVersion
        DataInfo_SoftwareVersionNumberDataIdentifier_SoftwareVersion (DcmDspDataInfo): DcmDspDataFixedLength=true
        SystemSupplierIdentifier_systemSupplierIdentifier (DcmDspData): DcmDspDataSize=40, DcmDspDataType=UINT8_N, DcmDspDataInfoRef=DataInfo_SystemSupplierIdentifier_systemSupplierIdentifier
        DataInfo_SystemSupplierIdentifier_systemSupplierIdentifier (DcmDspDataInfo): DcmDspDataFixedLength=true
        ECUSerialNumber_ECUSerialNumber (DcmDspData): DcmDspDataSize=160, DcmDspDataType=UINT8_N, DcmDspDataInfoRef=DataInfo_ECUSerialNumber_ECUSerialNumber
        DataInfo_ECUSerialNumber_ECUSerialNumber (DcmDspDataInfo): DcmDspDataFixedLength=true
        VehicleIdentificationNumber_VIN (DcmDspData): DcmDspDataSize=136, DcmDspDataType=UINT8_N, DcmDspDataInfoRef=DataInfo_VehicleIdentificationNumber_VIN
        DataInfo_VehicleIdentificationNumber_VIN (DcmDspDataInfo): DcmDspDataFixedLength=true
        SystemSupplierECUHardwareVersionNumber_ECUHardwareVersionNumber (DcmDspData): DcmDspDataSize=120, DcmDspDataType=UINT8_N, DcmDspDataInfoRef=DataInfo_SystemSupplierECUHardwareVersionNumber_ECUHardwareVersionNumber
        DataInfo_SystemSupplierECUHardwareVersionNumber_ECUHardwareVersionNumber (DcmDspDataInfo): DcmDspDataFixedLength=true
        SystemSupplierECUSoftwareVersionNumber_ECUSoftwareVersionNumber (DcmDspData): DcmDspDataSize=136, DcmDspDataType=UINT8_N, DcmDspDataInfoRef=DataInfo_SystemSupplierECUSoftwareVersionNumber_ECUSoftwareVersionNumber
        DataInfo_SystemSupplierECUSoftwareVersionNumber_ECUSoftwareVersionNumber (DcmDspDataInfo): DcmDspDataFixedLength=true
        CMatrixVersion_CMatrixVersion (DcmDspData): DcmDspDataSize=152, DcmDspDataType=UINT8_N, DcmDspDataInfoRef=DataInfo_CMatrixVersion_CMatrixVersion
        DataInfo_CMatrixVersion_CMatrixVersion (DcmDspDataInfo): DcmDspDataFixedLength=true
        ECUlevelNetworkConfigurationDataIdentifier_NetworkConfigurationDataIdentifier (DcmDspData):
          DcmDspDataSize = 1600
          DcmDspDataType = UINT8_N
          DcmDspDataInfoRef = DataInfo_ECUlevelNetworkConfigurationDataIdentifier_NetworkConfigurationDataIdentifier
        DataInfo_ECUlevelNetworkConfigurationDataIdentifier_NetworkConfigurationDataIdentifier (DcmDspDataInfo): DcmDspDataFixedLength=true
        FOTAIndentifier_New_Data_Object_1 (DcmDspData): DcmDspDataSize=72, DcmDspDataType=UINT8_N, DcmDspDataInfoRef=DataInfo_FOTAIndentifier_New_Data_Object_1
        DataInfo_FOTAIndentifier_New_Data_Object_1 (DcmDspDataInfo): DcmDspDataFixedLength=true
        NodeAddress_NodeAddress (DcmDspData): DcmDspDataSize=72, DcmDspDataType=UINT8_N, DcmDspDataInfoRef=DataInfo_NodeAddress_NodeAddress
        DataInfo_NodeAddress_NodeAddress (DcmDspDataInfo): DcmDspDataFixedLength=true
        CompID1_CompID1 (DcmDspData): DcmDspDataSize=256, DcmDspDataType=UINT8_N, DcmDspDataInfoRef=DataInfo_CompID1_CompID1
        DataInfo_CompID1_CompID1 (DcmDspDataInfo): DcmDspDataFixedLength=true
        FOTAName_FOTAName (DcmDspData): DcmDspDataSize=48, DcmDspDataType=UINT8_N, DcmDspDataInfoRef=DataInfo_FOTAName_FOTAName
        DataInfo_FOTAName_FOTAName (DcmDspDataInfo): DcmDspDataFixedLength=true
        ToolVersion_ToolVersion (DcmDspData): DcmDspDataSize=64, DcmDspDataType=UINT8_N, DcmDspDataInfoRef=DataInfo_ToolVersion_ToolVersion
        DataInfo_ToolVersion_ToolVersion (DcmDspDataInfo): DcmDspDataFixedLength=true
        VehicleManufacturerECUCalibrationSoftwareVersionNumber_ECUCalibrationSoftwareVersionNumber (DcmDspData):
          DcmDspDataSize = 120
          DcmDspDataType = UINT8_N
          DcmDspDataInfoRef = DataInfo_VehicleManufacturerECUCalibrationSoftwareVersionNumber_ECUCalibrationSoftwareVersionNumber
        DataInfo_VehicleManufacturerECUCalibrationSoftwareVersionNumber_ECUCalibrationSoftwareVersionNumber (DcmDspDataInfo): DcmDspDataFixedLength=true
        VehicleManufacturerECUBootSoftwareVersionNumber_ECUBootSoftwareVersionNumber (DcmDspData):
          DcmDspDataSize = 120
          DcmDspDataType = UINT8_N
          DcmDspDataInfoRef = DataInfo_VehicleManufacturerECUBootSoftwareVersionNumber_ECUBootSoftwareVersionNumber
        DataInfo_VehicleManufacturerECUBootSoftwareVersionNumber_ECUBootSoftwareVersionNumber (DcmDspDataInfo): DcmDspDataFixedLength=true
        FactoryMode_FactoryMode (DcmDspData): DcmDspDataSize=8, DcmDspDataType=UINT8, DcmDspDataInfoRef=DataInfo_FactoryMode_FactoryMode
        DataInfo_FactoryMode_FactoryMode (DcmDspDataInfo): DcmDspDataFixedLength=true
        UIN_UIN (DcmDspData): DcmDspDataSize=160, DcmDspDataType=UINT8_N, DcmDspDataInfoRef=DataInfo_UIN_UIN
        DataInfo_UIN_UIN (DcmDspDataInfo): DcmDspDataFixedLength=true
        SecOCKey_SecOCKey (DcmDspData): DcmDspDataSize=128, DcmDspDataType=UINT8_N, DcmDspDataInfoRef=DataInfo_SecOCKey_SecOCKey
        DataInfo_SecOCKey_SecOCKey (DcmDspDataInfo): DcmDspDataFixedLength=true
        SecOCVersionNumber_SecOCVersionNumber (DcmDspData): DcmDspDataSize=24, DcmDspDataType=UINT8_N, DcmDspDataInfoRef=DataInfo_SecOCVersionNumber_SecOCVersionNumber
        DataInfo_SecOCVersionNumber_SecOCVersionNumber (DcmDspDataInfo): DcmDspDataFixedLength=true
        SignalLineSCOCNumber_SignalLineSCOCNumber (DcmDspData): DcmDspDataSize=160, DcmDspDataType=UINT8_N, DcmDspDataInfoRef=DataInfo_SignalLineSCOCNumber_SignalLineSCOCNumber
        DataInfo_SignalLineSCOCNumber_SignalLineSCOCNumber (DcmDspDataInfo): DcmDspDataFixedLength=true
        SignalLineCurrentStatus_SignalLineCurrentStatus (DcmDspData): DcmDspDataSize=64, DcmDspDataType=UINT8_N, DcmDspDataInfoRef=DataInfo_SignalLineCurrentStatus_SignalLineCurrentStatus
        DataInfo_SignalLineCurrentStatus_SignalLineCurrentStatus (DcmDspDataInfo): DcmDspDataFixedLength=true
        SwitchARLTable_SwitchARLTable (DcmDspData): DcmDspDataSize=224, DcmDspDataType=UINT8_N, DcmDspDataInfoRef=DataInfo_SwitchARLTable_SwitchARLTable
        DataInfo_SwitchARLTable_SwitchARLTable (DcmDspDataInfo): DcmDspDataFixedLength=true
        MasterSlaveStatus_MasterSlaveStatus (DcmDspData): DcmDspDataSize=64, DcmDspDataType=UINT8_N, DcmDspDataInfoRef=DataInfo_MasterSlaveStatus_MasterSlaveStatus
        DataInfo_MasterSlaveStatus_MasterSlaveStatus (DcmDspDataInfo): DcmDspDataFixedLength=true
        TestModeStatus_TestModeStatus (DcmDspData): DcmDspDataSize=64, DcmDspDataType=UINT8_N, DcmDspDataInfoRef=DataInfo_TestModeStatus_TestModeStatus
        DataInfo_TestModeStatus_TestModeStatus (DcmDspDataInfo): DcmDspDataFixedLength=true
        LinkStatus_LinkStatus (DcmDspData): DcmDspDataSize=64, DcmDspDataType=UINT8_N, DcmDspDataInfoRef=DataInfo_LinkStatus_LinkStatus
        DataInfo_LinkStatus_LinkStatus (DcmDspDataInfo): DcmDspDataFixedLength=true
        BASE100SQIThreshold_SQIThreshold (DcmDspData): DcmDspDataSize=8, DcmDspDataType=UINT8, DcmDspDataInfoRef=DataInfo_BASE100SQIThreshold_SQIThreshold
        DataInfo_BASE100SQIThreshold_SQIThreshold (DcmDspDataInfo): DcmDspDataFixedLength=true
        BASE1000SQIThreshold_SQIThreshold (DcmDspData): DcmDspDataSize=8, DcmDspDataType=UINT8, DcmDspDataInfoRef=DataInfo_BASE1000SQIThreshold_SQIThreshold
        DataInfo_BASE1000SQIThreshold_SQIThreshold (DcmDspDataInfo): DcmDspDataFixedLength=true
        SQI_SQI (DcmDspData): DcmDspDataSize=64, DcmDspDataType=UINT8_N, DcmDspDataInfoRef=DataInfo_SQI_SQI
        DataInfo_SQI_SQI (DcmDspDataInfo): DcmDspDataFixedLength=true
        SwitchCounter_SwitchCounter (DcmDspData): DcmDspDataSize=32, DcmDspDataType=UINT32, DcmDspDataInfoRef=DataInfo_SwitchCounter_SwitchCounter
        DataInfo_SwitchCounter_SwitchCounter (DcmDspDataInfo): DcmDspDataFixedLength=true
        MACAddress_MACAddress (DcmDspData): DcmDspDataSize=128, DcmDspDataType=UINT8_N, DcmDspDataInfoRef=DataInfo_MACAddress_MACAddress
        DataInfo_MACAddress_MACAddress (DcmDspDataInfo): DcmDspDataFixedLength=true
        TankResistanceValue_TankResistanceValue (DcmDspData): DcmDspDataSize=32, DcmDspDataType=UINT32, DcmDspDataInfoRef=DataInfo_TankResistanceValue_TankResistanceValue
        DataInfo_TankResistanceValue_TankResistanceValue (DcmDspDataInfo): DcmDspDataFixedLength=true
        OemSpeedometer_OemSpeedometer (DcmDspData): DcmDspDataSize=128, DcmDspDataType=UINT8_N, DcmDspDataInfoRef=DataInfo_OemSpeedometer_OemSpeedometer
        DataInfo_OemSpeedometer_OemSpeedometer (DcmDspDataInfo): DcmDspDataFixedLength=true
        OemTachometer_OemTachometer (DcmDspData): DcmDspDataSize=128, DcmDspDataType=UINT8_N, DcmDspDataInfoRef=DataInfo_OemTachometer_OemTachometer
        DataInfo_OemTachometer_OemTachometer (DcmDspDataInfo): DcmDspDataFixedLength=true
        OemCoolant_OemCoolant (DcmDspData): DcmDspDataSize=32, DcmDspDataType=UINT32, DcmDspDataInfoRef=DataInfo_OemCoolant_OemCoolant
        DataInfo_OemCoolant_OemCoolant (DcmDspDataInfo): DcmDspDataFixedLength=true
        OemTank_OemTank (DcmDspData): DcmDspDataSize=80, DcmDspDataType=UINT8_N, DcmDspDataInfoRef=DataInfo_OemTank_OemTank
        DataInfo_OemTank_OemTank (DcmDspDataInfo): DcmDspDataFixedLength=true
        OdometerInfo_OdometerInfo (DcmDspData): DcmDspDataSize=64, DcmDspDataType=UINT8_N, DcmDspDataInfoRef=DataInfo_OdometerInfo_OdometerInfo
        DataInfo_OdometerInfo_OdometerInfo (DcmDspDataInfo): DcmDspDataFixedLength=true
        DID_0xF284_1_TripComputerDistanceToEmpty (DcmDspData): DcmDspDataSize=64, DcmDspDataType=UINT8_N, DcmDspDataInfoRef=DataInfo_DID_0xF284_1_TripComputerDistanceToEmpty
        DataInfo_DID_0xF284_1_TripComputerDistanceToEmpty (DcmDspDataInfo): DcmDspDataFixedLength=true
        TripComputerAvgFuelConsumption_TripComputerAvgFuelConsumption (DcmDspData): DcmDspDataSize=160, DcmDspDataType=UINT8_N, DcmDspDataInfoRef=DataInfo_TripComputerAvgFuelConsumption_TripComputerAvgFuelConsumption
        DataInfo_TripComputerAvgFuelConsumption_TripComputerAvgFuelConsumption (DcmDspDataInfo): DcmDspDataFixedLength=true
        TripComputerInstFuelConsumption_TripComputerInstFuelConsumption (DcmDspData): DcmDspDataSize=120, DcmDspDataType=UINT8_N, DcmDspDataInfoRef=DataInfo_TripComputerInstFuelConsumption_TripComputerInstFuelConsumption
        DataInfo_TripComputerInstFuelConsumption_TripComputerInstFuelConsumption (DcmDspDataInfo): DcmDspDataFixedLength=true
        TripComputerAvgVehicleSpeed_TripComputerAvgVehicleSpeed (DcmDspData): DcmDspDataSize=160, DcmDspDataType=UINT8_N, DcmDspDataInfoRef=DataInfo_TripComputerAvgVehicleSpeed_TripComputerAvgVehicleSpeed
        DataInfo_TripComputerAvgVehicleSpeed_TripComputerAvgVehicleSpeed (DcmDspDataInfo): DcmDspDataFixedLength=true
        TripComputerDrivingTime_TripComputerDrivingTime (DcmDspData): DcmDspDataSize=32, DcmDspDataType=UINT32, DcmDspDataInfoRef=DataInfo_TripComputerDrivingTime_TripComputerDrivingTime
        DataInfo_TripComputerDrivingTime_TripComputerDrivingTime (DcmDspDataInfo): DcmDspDataFixedLength=true
        TripComputerTripDistance_TripComputerTripDistance (DcmDspData): DcmDspDataSize=128, DcmDspDataType=UINT8_N, DcmDspDataInfoRef=DataInfo_TripComputerTripDistance_TripComputerTripDistance
        DataInfo_TripComputerTripDistance_TripComputerTripDistance (DcmDspDataInfo): DcmDspDataFixedLength=true
        ConfigurationInformation_Configuration (DcmDspData): DcmDspDataSize=8, DcmDspDataType=UINT8, DcmDspDataInfoRef=DataInfo_ConfigurationInformation_Configuration
        DataInfo_ConfigurationInformation_Configuration (DcmDspDataInfo): DcmDspDataFixedLength=true
        SOCPBLBootloaderVersion_SOCPBLBootloaderVersion (DcmDspData): DcmDspDataSize=32, DcmDspDataType=UINT32, DcmDspDataInfoRef=DataInfo_SOCPBLBootloaderVersion_SOCPBLBootloaderVersion
        DataInfo_SOCPBLBootloaderVersion_SOCPBLBootloaderVersion (DcmDspDataInfo): DcmDspDataFixedLength=true
        SOCXBLBootloaderVersion_SOCXBLBootloaderVersion (DcmDspData): DcmDspDataSize=32, DcmDspDataType=UINT32, DcmDspDataInfoRef=DataInfo_SOCXBLBootloaderVersion_SOCXBLBootloaderVersion
        DataInfo_SOCXBLBootloaderVersion_SOCXBLBootloaderVersion (DcmDspDataInfo): DcmDspDataFixedLength=true
        SOCABLBootloaderVersion_SOCABLBootloaderVersion (DcmDspData): DcmDspDataSize=32, DcmDspDataType=UINT32, DcmDspDataInfoRef=DataInfo_SOCABLBootloaderVersion_SOCABLBootloaderVersion
        DataInfo_SOCABLBootloaderVersion_SOCABLBootloaderVersion (DcmDspDataInfo): DcmDspDataFixedLength=true
        InternalComponentsVoltage_InternalComponentsVoltage (DcmDspData): DcmDspDataSize=24, DcmDspDataType=UINT8_N, DcmDspDataInfoRef=DataInfo_InternalComponentsVoltage_InternalComponentsVoltage
        DataInfo_InternalComponentsVoltage_InternalComponentsVoltage (DcmDspDataInfo): DcmDspDataFixedLength=true
        SleepMode_Power_State (DcmDspData): DcmDspDataSize=8, DcmDspDataType=UINT8, DcmDspDataInfoRef=DataInfo_SleepMode_Power_State
        DataInfo_SleepMode_Power_State (DcmDspDataInfo): DcmDspDataFixedLength=true
        SkipHighTemperaturewarning_Skip_UserInfo_Input (DcmDspData): DcmDspDataSize=8, DcmDspDataType=UINT8, DcmDspDataInfoRef=DataInfo_SkipHighTemperaturewarning_Skip_UserInfo_Input
        DataInfo_SkipHighTemperaturewarning_Skip_UserInfo_Input (DcmDspDataInfo): DcmDspDataFixedLength=true
        WriteEOLFactoryMode_Factory_Mode (DcmDspData): DcmDspDataSize=8, DcmDspDataType=UINT8, DcmDspDataInfoRef=DataInfo_WriteEOLFactoryMode_Factory_Mode
        DataInfo_WriteEOLFactoryMode_Factory_Mode (DcmDspDataInfo): DcmDspDataFixedLength=true
        FM_RSQ_FM_RSQ (DcmDspData): DcmDspDataSize=8, DcmDspDataType=UINT8, DcmDspDataInfoRef=DataInfo_FM_RSQ_FM_RSQ
        DataInfo_FM_RSQ_FM_RSQ (DcmDspDataInfo): DcmDspDataFixedLength=true
        DID_0xFD1A_1_ECU_error_log (DcmDspData): DcmDspDataSize=456, DcmDspDataType=UINT8_N, DcmDspDataInfoRef=DataInfo_DID_0xFD1A_1_ECU_error_log
        DataInfo_DID_0xFD1A_1_ECU_error_log (DcmDspDataInfo): DcmDspDataFixedLength=true
        DID_0xFD41_1_New_Data_Object (DcmDspData): DcmDspDataSize=8, DcmDspDataType=UINT8, DcmDspDataInfoRef=DataInfo_DID_0xFD41_1_New_Data_Object
        DataInfo_DID_0xFD41_1_New_Data_Object (DcmDspDataInfo): DcmDspDataFixedLength=true
        EthernetLinkStatus_Ethernet_Link_Status (DcmDspData): DcmDspDataSize=64, DcmDspDataType=UINT8_N, DcmDspDataInfoRef=DataInfo_EthernetLinkStatus_Ethernet_Link_Status
        DataInfo_EthernetLinkStatus_Ethernet_Link_Status (DcmDspDataInfo): DcmDspDataFixedLength=true
        EthernetSQL_Ethernet_SQL (DcmDspData): DcmDspDataSize=64, DcmDspDataType=UINT8_N, DcmDspDataInfoRef=DataInfo_EthernetSQL_Ethernet_SQL
        DataInfo_EthernetSQL_Ethernet_SQL (DcmDspDataInfo): DcmDspDataFixedLength=true
        PHYMaster_SlaveMode_Master_Slave (DcmDspData): DcmDspDataSize=8, DcmDspDataType=UINT8, DcmDspDataInfoRef=DataInfo_PHYMaster_SlaveMode_Master_Slave
        DataInfo_PHYMaster_SlaveMode_Master_Slave (DcmDspDataInfo): DcmDspDataFixedLength=true
        EthernetMacAddress_Mac_Address (DcmDspData): DcmDspDataSize=48, DcmDspDataType=UINT8_N, DcmDspDataInfoRef=DataInfo_EthernetMacAddress_Mac_Address
        DataInfo_EthernetMacAddress_Mac_Address (DcmDspDataInfo): DcmDspDataFixedLength=true
        ParkingReducevolumelevel_Parking_Reduce_Volume_Level (DcmDspData): DcmDspDataSize=8, DcmDspDataType=UINT8, DcmDspDataInfoRef=DataInfo_ParkingReducevolumelevel_Parking_Reduce_Volume_Level
        DataInfo_ParkingReducevolumelevel_Parking_Reduce_Volume_Level (DcmDspDataInfo): DcmDspDataFixedLength=true
        NaviReducevolumelevel_Navi_Reduce_Volume_Level (DcmDspData): DcmDspDataSize=8, DcmDspDataType=UINT8, DcmDspDataInfoRef=DataInfo_NaviReducevolumelevel_Navi_Reduce_Volume_Level
        DataInfo_NaviReducevolumelevel_Navi_Reduce_Volume_Level (DcmDspDataInfo): DcmDspDataFixedLength=true
        USB_iPod_Forward_Rewind_Forward_Rewind (DcmDspData): DcmDspDataSize=8, DcmDspDataType=UINT8, DcmDspDataInfoRef=DataInfo_USB_iPod_Forward_Rewind_Forward_Rewind
        DataInfo_USB_iPod_Forward_Rewind_Forward_Rewind (DcmDspDataInfo): DcmDspDataFixedLength=true
        PlayUSBDesiredFile_DesiredTime_PlayUSBDesiredFile_DesiredTime (DcmDspData): DcmDspDataSize=40, DcmDspDataType=UINT8_N, DcmDspDataInfoRef=DataInfo_PlayUSBDesiredFile_DesiredTime_PlayUSBDesiredFile_DesiredTime
        DataInfo_PlayUSBDesiredFile_DesiredTime_PlayUSBDesiredFile_DesiredTime (DcmDspDataInfo): DcmDspDataFixedLength=true
        PlayiPodDesiredFile_Desired_File (DcmDspData): DcmDspDataSize=16, DcmDspDataType=UINT16, DcmDspDataInfoRef=DataInfo_PlayiPodDesiredFile_Desired_File
        DataInfo_PlayiPodDesiredFile_Desired_File (DcmDspDataInfo): DcmDspDataFixedLength=true
        USB_iPodCurrentState_USB_iPodCurrentState (DcmDspData): DcmDspDataSize=40, DcmDspDataType=UINT8_N, DcmDspDataInfoRef=DataInfo_USB_iPodCurrentState_USB_iPodCurrentState
        DataInfo_USB_iPodCurrentState_USB_iPodCurrentState (DcmDspDataInfo): DcmDspDataFixedLength=true
        EjectCDCommand_Eject_CD (DcmDspData): DcmDspDataSize=8, DcmDspDataType=UINT8, DcmDspDataInfoRef=DataInfo_EjectCDCommand_Eject_CD
        DataInfo_EjectCDCommand_Eject_CD (DcmDspDataInfo): DcmDspDataFixedLength=true
        CDPlay_Pause_Play_Pause (DcmDspData): DcmDspDataSize=8, DcmDspDataType=UINT8, DcmDspDataInfoRef=DataInfo_CDPlay_Pause_Play_Pause
        DataInfo_CDPlay_Pause_Play_Pause (DcmDspDataInfo): DcmDspDataFixedLength=true
        CDPlayMode_Play_Mode (DcmDspData): DcmDspDataSize=8, DcmDspDataType=UINT8, DcmDspDataInfoRef=DataInfo_CDPlayMode_Play_Mode
        DataInfo_CDPlayMode_Play_Mode (DcmDspDataInfo): DcmDspDataFixedLength=true
        CDFastForward_Rewind_Forward_Rewind (DcmDspData): DcmDspDataSize=8, DcmDspDataType=UINT8, DcmDspDataInfoRef=DataInfo_CDFastForward_Rewind_Forward_Rewind
        DataInfo_CDFastForward_Rewind_Forward_Rewind (DcmDspDataInfo): DcmDspDataFixedLength=true
        CDSkipTrack_Next_Previous (DcmDspData): DcmDspDataSize=8, DcmDspDataType=UINT8, DcmDspDataInfoRef=DataInfo_CDSkipTrack_Next_Previous
        DataInfo_CDSkipTrack_Next_Previous (DcmDspDataInfo): DcmDspDataFixedLength=true
        CDCurrentStatus_Absolutely_file_number (DcmDspData): DcmDspDataSize=8, DcmDspDataType=UINT8, DcmDspDataInfoRef=DataInfo_CDCurrentStatus_Absolutely_file_number
        DataInfo_CDCurrentStatus_Absolutely_file_number (DcmDspDataInfo): DcmDspDataFixedLength=true
        FMPSName_Curent_Station_PS_Name (DcmDspData): DcmDspDataSize=64, DcmDspDataType=UINT8_N, DcmDspDataInfoRef=DataInfo_FMPSName_Curent_Station_PS_Name
        DataInfo_FMPSName_Curent_Station_PS_Name (DcmDspDataInfo): DcmDspDataFixedLength=true
        FM_AMPreset_Preset_number (DcmDspData): DcmDspDataSize=8, DcmDspDataType=UINT8, DcmDspDataInfoRef=DataInfo_FM_AMPreset_Preset_number
        DataInfo_FM_AMPreset_Preset_number (DcmDspDataInfo): DcmDspDataFixedLength=true
        TunerProperty_Tuner_Property (DcmDspData): DcmDspDataSize=8, DcmDspDataType=UINT8, DcmDspDataInfoRef=DataInfo_TunerProperty_Tuner_Property
        DataInfo_TunerProperty_Tuner_Property (DcmDspDataInfo): DcmDspDataFixedLength=true
        AGCStatus_AGC_Status (DcmDspData): DcmDspDataSize=8, DcmDspDataType=UINT8, DcmDspDataInfoRef=DataInfo_AGCStatus_AGC_Status
        DataInfo_AGCStatus_AGC_Status (DcmDspDataInfo): DcmDspDataFixedLength=true
        FMSERVO_FM_SERVO (DcmDspData): DcmDspDataSize=8, DcmDspDataType=UINT8, DcmDspDataInfoRef=DataInfo_FMSERVO_FM_SERVO
        DataInfo_FMSERVO_FM_SERVO (DcmDspDataInfo): DcmDspDataFixedLength=true
        FMSERVOTransform_FM_SERVO_Transform (DcmDspData): DcmDspDataSize=8, DcmDspDataType=UINT8, DcmDspDataInfoRef=DataInfo_FMSERVOTransform_FM_SERVO_Transform
        DataInfo_FMSERVOTransform_FM_SERVO_Transform (DcmDspDataInfo): DcmDspDataFixedLength=true
        AMSERVO_AM_SERVO (DcmDspData): DcmDspDataSize=8, DcmDspDataType=UINT8, DcmDspDataInfoRef=DataInfo_AMSERVO_AM_SERVO
        DataInfo_AMSERVO_AM_SERVO (DcmDspDataInfo): DcmDspDataFixedLength=true
        AMSERVOTransform_AM_SERVO_Transform (DcmDspData): DcmDspDataSize=8, DcmDspDataType=UINT8, DcmDspDataInfoRef=DataInfo_AMSERVOTransform_AM_SERVO_Transform
        DataInfo_AMSERVOTransform_AM_SERVO_Transform (DcmDspDataInfo): DcmDspDataFixedLength=true
        SetTunerRegister_Tuner_Register (DcmDspData): DcmDspDataSize=8, DcmDspDataType=UINT8, DcmDspDataInfoRef=DataInfo_SetTunerRegister_Tuner_Register
        DataInfo_SetTunerRegister_Tuner_Register (DcmDspDataInfo): DcmDspDataFixedLength=true
        GetFMRSQ_FM_RSQ (DcmDspData): DcmDspDataSize=8, DcmDspDataType=UINT8, DcmDspDataInfoRef=DataInfo_GetFMRSQ_FM_RSQ
        DataInfo_GetFMRSQ_FM_RSQ (DcmDspDataInfo): DcmDspDataFixedLength=true
        GPSInformation_GPSInformation (DcmDspData): DcmDspDataSize=48, DcmDspDataType=UINT8_N, DcmDspDataInfoRef=DataInfo_GPSInformation_GPSInformation
        DataInfo_GPSInformation_GPSInformation (DcmDspDataInfo): DcmDspDataFixedLength=true
        RVC_AVMCameraStatus_RVC_AVM (DcmDspData): DcmDspDataSize=8, DcmDspDataType=UINT8, DcmDspDataInfoRef=DataInfo_RVC_AVMCameraStatus_RVC_AVM
        DataInfo_RVC_AVMCameraStatus_RVC_AVM (DcmDspDataInfo): DcmDspDataFixedLength=true
        DMSCameraStatus_DMS (DcmDspData): DcmDspDataSize=8, DcmDspDataType=UINT8, DcmDspDataInfoRef=DataInfo_DMSCameraStatus_DMS
        DataInfo_DMSCameraStatus_DMS (DcmDspDataInfo): DcmDspDataFixedLength=true
        ExternalAVMCameraStatus_ExternalAVMCameraStatus (DcmDspData): DcmDspDataSize=32, DcmDspDataType=UINT32, DcmDspDataInfoRef=DataInfo_ExternalAVMCameraStatus_ExternalAVMCameraStatus
        DataInfo_ExternalAVMCameraStatus_ExternalAVMCameraStatus (DcmDspDataInfo): DcmDspDataFixedLength=true
        DVRCameraStatus_DMS_camera_status (DcmDspData): DcmDspDataSize=8, DcmDspDataType=UINT8, DcmDspDataInfoRef=DataInfo_DVRCameraStatus_DMS_camera_status
        DataInfo_DVRCameraStatus_DMS_camera_status (DcmDspDataInfo): DcmDspDataFixedLength=true
        In_CarCameraStatus_In_Car_camera_status (DcmDspData): DcmDspDataSize=8, DcmDspDataType=UINT8, DcmDspDataInfoRef=DataInfo_In_CarCameraStatus_In_Car_camera_status
        DataInfo_In_CarCameraStatus_In_Car_camera_status (DcmDspDataInfo): DcmDspDataFixedLength=true
        ADCErrorLog_ADCErrorLog (DcmDspData): DcmDspDataSize=456, DcmDspDataType=UINT8_N, DcmDspDataInfoRef=DataInfo_ADCErrorLog_ADCErrorLog
        DataInfo_ADCErrorLog_ADCErrorLog (DcmDspDataInfo): DcmDspDataFixedLength=true
        EEPROMValue_EEPROMValue (DcmDspData): DcmDspDataSize=32, DcmDspDataType=UINT32, DcmDspDataInfoRef=DataInfo_EEPROMValue_EEPROMValue
        DataInfo_EEPROMValue_EEPROMValue (DcmDspDataInfo): DcmDspDataFixedLength=true
        OverHeatProtectionSwitch_Status (DcmDspData): DcmDspDataSize=8, DcmDspDataType=UINT8, DcmDspDataInfoRef=DataInfo_OverHeatProtectionSwitch_Status
        DataInfo_OverHeatProtectionSwitch_Status (DcmDspDataInfo): DcmDspDataFixedLength=true
        HighTempWarningTemperatureSet_Temperature (DcmDspData): DcmDspDataSize=8, DcmDspDataType=UINT8, DcmDspDataInfoRef=DataInfo_HighTempWarningTemperatureSet_Temperature
        DataInfo_HighTempWarningTemperatureSet_Temperature (DcmDspDataInfo): DcmDspDataFixedLength=true
        IVIDisplayManufactureDate_IVIDisplayManufactureDate (DcmDspData): DcmDspDataSize=8, DcmDspDataType=UINT8, DcmDspDataInfoRef=DataInfo_IVIDisplayManufactureDate_IVIDisplayManufactureDate
        DataInfo_IVIDisplayManufactureDate_IVIDisplayManufactureDate (DcmDspDataInfo): DcmDspDataFixedLength=true
        SparePartnumber_SparePartnumber (DcmDspData): DcmDspDataSize=8, DcmDspDataType=UINT8, DcmDspDataInfoRef=DataInfo_SparePartnumber_SparePartnumber
        DataInfo_SparePartnumber_SparePartnumber (DcmDspDataInfo): DcmDspDataFixedLength=true
        SoftwareVersion_SoftwareVersion (DcmDspData): DcmDspDataSize=8, DcmDspDataType=UINT8, DcmDspDataInfoRef=DataInfo_SoftwareVersion_SoftwareVersion
        DataInfo_SoftwareVersion_SoftwareVersion (DcmDspDataInfo): DcmDspDataFixedLength=true
        DID_0xFDF9_HardwareVersion (DcmDspData): DcmDspDataSize=8, DcmDspDataType=UINT8, DcmDspDataInfoRef=DataInfo_DID_0xFDF9_HardwareVersion
        DataInfo_DID_0xFDF9_HardwareVersion (DcmDspDataInfo): DcmDspDataFixedLength=true
        IVIDisplayThemes_Themes (DcmDspData): DcmDspDataSize=8, DcmDspDataType=UINT8, DcmDspDataInfoRef=DataInfo_IVIDisplayThemes_Themes
        DataInfo_IVIDisplayThemes_Themes (DcmDspDataInfo): DcmDspDataFixedLength=true
        IVIDisplayLinkStatus_LVDS_Link_Status (DcmDspData): DcmDspDataSize=8, DcmDspDataType=UINT8, DcmDspDataInfoRef=DataInfo_IVIDisplayLinkStatus_LVDS_Link_Status
        DataInfo_IVIDisplayLinkStatus_LVDS_Link_Status (DcmDspDataInfo): DcmDspDataFixedLength=true
        ClusterThemes_Themes (DcmDspData): DcmDspDataSize=8, DcmDspDataType=UINT8, DcmDspDataInfoRef=DataInfo_ClusterThemes_Themes
        DataInfo_ClusterThemes_Themes (DcmDspDataInfo): DcmDspDataFixedLength=true
        ClusterStartupAnimationSwitch_Animation_ON_OFF (DcmDspData): DcmDspDataSize=8, DcmDspDataType=UINT8, DcmDspDataInfoRef=DataInfo_ClusterStartupAnimationSwitch_Animation_ON_OFF
        DataInfo_ClusterStartupAnimationSwitch_Animation_ON_OFF (DcmDspDataInfo): DcmDspDataFixedLength=true
        TelltaleTest_TellTale_Value (DcmDspData): DcmDspDataSize=8, DcmDspDataType=UINT8, DcmDspDataInfoRef=DataInfo_TelltaleTest_TellTale_Value
        DataInfo_TelltaleTest_TellTale_Value (DcmDspDataInfo): DcmDspDataFixedLength=true
        ClusterDisplayLinkStatus_LVDS_Link_Status (DcmDspData): DcmDspDataSize=8, DcmDspDataType=UINT8, DcmDspDataInfoRef=DataInfo_ClusterDisplayLinkStatus_LVDS_Link_Status
        DataInfo_ClusterDisplayLinkStatus_LVDS_Link_Status (DcmDspDataInfo): DcmDspDataFixedLength=true
        ControlDisplayThemes_Themes (DcmDspData): DcmDspDataSize=8, DcmDspDataType=UINT8, DcmDspDataInfoRef=DataInfo_ControlDisplayThemes_Themes
        DataInfo_ControlDisplayThemes_Themes (DcmDspDataInfo): DcmDspDataFixedLength=true
        ControlDisplayLinkStatus_LVDS_Link_Status (DcmDspData): DcmDspDataSize=8, DcmDspDataType=UINT8, DcmDspDataInfoRef=DataInfo_ControlDisplayLinkStatus_LVDS_Link_Status
        DataInfo_ControlDisplayLinkStatus_LVDS_Link_Status (DcmDspDataInfo): DcmDspDataFixedLength=true
        HUDSwitch_HUD_ON_OFF (DcmDspData): DcmDspDataSize=8, DcmDspDataType=UINT8, DcmDspDataInfoRef=DataInfo_HUDSwitch_HUD_ON_OFF
        DataInfo_HUDSwitch_HUD_ON_OFF (DcmDspDataInfo): DcmDspDataFixedLength=true
        HUDHeight_HUD_Height (DcmDspData): DcmDspDataSize=8, DcmDspDataType=UINT8, DcmDspDataInfoRef=DataInfo_HUDHeight_HUD_Height
        DataInfo_HUDHeight_HUD_Height (DcmDspDataInfo): DcmDspDataFixedLength=true
        HUDBrightness_Brightness (DcmDspData): DcmDspDataSize=8, DcmDspDataType=UINT8, DcmDspDataInfoRef=DataInfo_HUDBrightness_Brightness
        DataInfo_HUDBrightness_Brightness (DcmDspDataInfo): DcmDspDataFixedLength=true
        HUDRotationSet_Rotation_Direction (DcmDspData): DcmDspDataSize=16, DcmDspDataType=UINT16, DcmDspDataInfoRef=DataInfo_HUDRotationSet_Rotation_Direction
        DataInfo_HUDRotationSet_Rotation_Direction (DcmDspDataInfo): DcmDspDataFixedLength=true
        HUDDisplayMode_Display_Mode (DcmDspData): DcmDspDataSize=8, DcmDspDataType=UINT8, DcmDspDataInfoRef=DataInfo_HUDDisplayMode_Display_Mode
        DataInfo_HUDDisplayMode_Display_Mode (DcmDspDataInfo): DcmDspDataFixedLength=true
        HUDDisplayContent_HUDDisplayContent (DcmDspData): DcmDspDataSize=16, DcmDspDataType=UINT16, DcmDspDataInfoRef=DataInfo_HUDDisplayContent_HUDDisplayContent
        DataInfo_HUDDisplayContent_HUDDisplayContent (DcmDspDataInfo): DcmDspDataFixedLength=true
        HUDDisplayLinkStatus_LVDS_Link_Status (DcmDspData): DcmDspDataSize=8, DcmDspDataType=UINT8, DcmDspDataInfoRef=DataInfo_HUDDisplayLinkStatus_LVDS_Link_Status
        DataInfo_HUDDisplayLinkStatus_LVDS_Link_Status (DcmDspDataInfo): DcmDspDataFixedLength=true
        PassengerDisplayLinkStatus_LVDS_Link_Status (DcmDspData): DcmDspDataSize=8, DcmDspDataType=UINT8, DcmDspDataInfoRef=DataInfo_PassengerDisplayLinkStatus_LVDS_Link_Status
        DataInfo_PassengerDisplayLinkStatus_LVDS_Link_Status (DcmDspDataInfo): DcmDspDataFixedLength=true
        IVI_Touch_Information_Touch_information (DcmDspData): DcmDspDataSize=520, DcmDspDataType=UINT8_N, DcmDspDataInfoRef=DataInfo_IVI_Touch_Information_Touch_information
        DataInfo_IVI_Touch_Information_Touch_information (DcmDspDataInfo): DcmDspDataFixedLength=true
        ControlTouchInformation_Touch_information (DcmDspData): DcmDspDataSize=520, DcmDspDataType=UINT8_N, DcmDspDataInfoRef=DataInfo_ControlTouchInformation_Touch_information
        DataInfo_ControlTouchInformation_Touch_information (DcmDspDataInfo): DcmDspDataFixedLength=true
        PassengerTouchInformation_IVI_Gesture_information (DcmDspData): DcmDspDataSize=8, DcmDspDataType=UINT8, DcmDspDataInfoRef=DataInfo_PassengerTouchInformation_IVI_Gesture_information
        DataInfo_PassengerTouchInformation_IVI_Gesture_information (DcmDspDataInfo): DcmDspDataFixedLength=true
        IVIGestureInformation_Touch_information (DcmDspData): DcmDspDataSize=520, DcmDspDataType=UINT8_N, DcmDspDataInfoRef=DataInfo_IVIGestureInformation_Touch_information
        DataInfo_IVIGestureInformation_Touch_information (DcmDspDataInfo): DcmDspDataFixedLength=true
        PassengerGestureInformation_Passenger_Gesture_information (DcmDspData): DcmDspDataSize=8, DcmDspDataType=UINT8, DcmDspDataInfoRef=DataInfo_PassengerGestureInformation_Passenger_Gesture_information
        DataInfo_PassengerGestureInformation_Passenger_Gesture_information (DcmDspDataInfo): DcmDspDataFixedLength=true
        HUTDisplaySignalStandard_HUTDisplaySignalStandard (DcmDspData): DcmDspDataSize=8, DcmDspDataType=UINT8, DcmDspDataInfoRef=DataInfo_HUTDisplaySignalStandard_HUTDisplaySignalStandard
        DataInfo_HUTDisplaySignalStandard_HUTDisplaySignalStandard (DcmDspDataInfo): DcmDspDataFixedLength=true
        HUTDisplayScreenType_HUTDisplayScreenType (DcmDspData): DcmDspDataSize=8, DcmDspDataType=UINT8, DcmDspDataInfoRef=DataInfo_HUTDisplayScreenType_HUTDisplayScreenType
        DataInfo_HUTDisplayScreenType_HUTDisplayScreenType (DcmDspDataInfo): DcmDspDataFixedLength=true
        HUTDisplayResolution_HUTDisplayResolution (DcmDspData): DcmDspDataSize=8, DcmDspDataType=UINT8, DcmDspDataInfoRef=DataInfo_HUTDisplayResolution_HUTDisplayResolution
        DataInfo_HUTDisplayResolution_HUTDisplayResolution (DcmDspDataInfo): DcmDspDataFixedLength=true
        HUTDisplayScreenSize_HUTDisplayScreenSize (DcmDspData): DcmDspDataSize=8, DcmDspDataType=UINT8, DcmDspDataInfoRef=DataInfo_HUTDisplayScreenSize_HUTDisplayScreenSize
        DataInfo_HUTDisplayScreenSize_HUTDisplayScreenSize (DcmDspDataInfo): DcmDspDataFixedLength=true
        HUTDisplaySupplierInformation_HUT_Display_Supplier_Information (DcmDspData): DcmDspDataSize=8, DcmDspDataType=UINT8, DcmDspDataInfoRef=DataInfo_HUTDisplaySupplierInformation_HUT_Display_Supplier_Information
        DataInfo_HUTDisplaySupplierInformation_HUT_Display_Supplier_Information (DcmDspDataInfo): DcmDspDataFixedLength=true
        HUTDisplayTPVersionNumber_HUTDisplayTPVersionNumber (DcmDspData): DcmDspDataSize=24, DcmDspDataType=UINT8_N, DcmDspDataInfoRef=DataInfo_HUTDisplayTPVersionNumber_HUTDisplayTPVersionNumber
        DataInfo_HUTDisplayTPVersionNumber_HUTDisplayTPVersionNumber (DcmDspDataInfo): DcmDspDataFixedLength=true
        HUTDisplayTemperature_HUT_Display_LCD_Temperature (DcmDspData): DcmDspDataSize=16, DcmDspDataType=UINT16, DcmDspDataInfoRef=DataInfo_HUTDisplayTemperature_HUT_Display_LCD_Temperature
        DataInfo_HUTDisplayTemperature_HUT_Display_LCD_Temperature (DcmDspDataInfo): DcmDspDataFixedLength=true
        HUTDisplayManufacturingDate_HUTDisplayManufacturingDate (DcmDspData): DcmDspDataSize=32, DcmDspDataType=UINT32, DcmDspDataInfoRef=DataInfo_HUTDisplayManufacturingDate_HUTDisplayManufacturingDate
        DataInfo_HUTDisplayManufacturingDate_HUTDisplayManufacturingDate (DcmDspDataInfo): DcmDspDataFixedLength=true
        HUTDisplaySparePartNumber_HUTDisplaySparePartNumber (DcmDspData): DcmDspDataSize=104, DcmDspDataType=UINT8_N, DcmDspDataInfoRef=DataInfo_HUTDisplaySparePartNumber_HUTDisplaySparePartNumber
        DataInfo_HUTDisplaySparePartNumber_HUTDisplaySparePartNumber (DcmDspDataInfo): DcmDspDataFixedLength=true
        HUTDisplaySoftwareVersionNumber_HUTDisplaySoftwareVersionNumber (DcmDspData): DcmDspDataSize=16, DcmDspDataType=UINT8_N, DcmDspDataInfoRef=DataInfo_HUTDisplaySoftwareVersionNumber_HUTDisplaySoftwareVersionNumber
        DataInfo_HUTDisplaySoftwareVersionNumber_HUTDisplaySoftwareVersionNumber (DcmDspDataInfo): DcmDspDataFixedLength=true
        HUTDisplayHardwareVersionNumber_HUTDisplayHardwareVersionNumber (DcmDspData): DcmDspDataSize=16, DcmDspDataType=UINT8_N, DcmDspDataInfoRef=DataInfo_HUTDisplayHardwareVersionNumber_HUTDisplayHardwareVersionNumber
        DataInfo_HUTDisplayHardwareVersionNumber_HUTDisplayHardwareVersionNumber (DcmDspDataInfo): DcmDspDataFixedLength=true
        IPDisplaySession_IPDisplaySession (DcmDspData): DcmDspDataSize=8, DcmDspDataType=UINT8, DcmDspDataInfoRef=DataInfo_IPDisplaySession_IPDisplaySession
        DataInfo_IPDisplaySession_IPDisplaySession (DcmDspDataInfo): DcmDspDataFixedLength=true
        IPDisplayTemperature_IPDisplayTemperature (DcmDspData): DcmDspDataSize=16, DcmDspDataType=UINT16, DcmDspDataInfoRef=DataInfo_IPDisplayTemperature_IPDisplayTemperature
        DataInfo_IPDisplayTemperature_IPDisplayTemperature (DcmDspDataInfo): DcmDspDataFixedLength=true
        IPDisplayManufacturingDate_IPDisplayManufacturingDate (DcmDspData): DcmDspDataSize=32, DcmDspDataType=UINT32, DcmDspDataInfoRef=DataInfo_IPDisplayManufacturingDate_IPDisplayManufacturingDate
        DataInfo_IPDisplayManufacturingDate_IPDisplayManufacturingDate (DcmDspDataInfo): DcmDspDataFixedLength=true
        IPDisplaySparePartNumber_IPDisplaSparePartNumber (DcmDspData): DcmDspDataSize=104, DcmDspDataType=UINT8_N, DcmDspDataInfoRef=DataInfo_IPDisplaySparePartNumber_IPDisplaSparePartNumber
        DataInfo_IPDisplaySparePartNumber_IPDisplaSparePartNumber (DcmDspDataInfo): DcmDspDataFixedLength=true
        IPDisplaySoftwareVersionNumber_IPDisplaySupplierECUSoftwareVersionNumber (DcmDspData): DcmDspDataSize=88, DcmDspDataType=UINT8_N, DcmDspDataInfoRef=DataInfo_IPDisplaySoftwareVersionNumber_IPDisplaySupplierECUSoftwareVersionNumber
        DataInfo_IPDisplaySoftwareVersionNumber_IPDisplaySupplierECUSoftwareVersionNumber (DcmDspDataInfo): DcmDspDataFixedLength=true
        IPDisplayHardwareVersionNumber_IPDisplayHardwareVersionNumber (DcmDspData): DcmDspDataSize=40, DcmDspDataType=UINT8_N, DcmDspDataInfoRef=DataInfo_IPDisplayHardwareVersionNumber_IPDisplayHardwareVersionNumber
        DataInfo_IPDisplayHardwareVersionNumber_IPDisplayHardwareVersionNumber (DcmDspDataInfo): DcmDspDataFixedLength=true
        271 x DcmDspDid:
          MaintenanceOdometer: DcmDspDidIdentifier=517, DcmDspDidInfoRef=DidInfo_MaintenanceOdometer
            Maintenance_odometer (DcmDspDidSignal): DcmDspDidDataPos=0, DcmDspDidDataRef=MaintenanceOdometer_Maintenance_odometer
          KL15Status: DcmDspDidIdentifier=48640, DcmDspDidInfoRef=DidInfo_KL15Status
            KL15Status (DcmDspDidSignal): DcmDspDidDataPos=0, DcmDspDidDataRef=KL15Status_KL15Status
          FactoryReset: DcmDspDidIdentifier=48641, DcmDspDidInfoRef=DidInfo_FactoryReset
            FactoryReset (DcmDspDidSignal): DcmDspDidDataPos=0, DcmDspDidDataRef=FactoryReset_FactoryReset
          ChipsTemperature: DcmDspDidIdentifier=48642, DcmDspDidInfoRef=DidInfo_ChipsTemperature
            ChipsTemperature (DcmDspDidSignal): DcmDspDidDataPos=0, DcmDspDidDataRef=ChipsTemperature_ChipsTemperature
          Battery_Voltage: DcmDspDidIdentifier=48656, DcmDspDidInfoRef=DidInfo_Battery_Voltage
            Battery_Voltage (DcmDspDidSignal): DcmDspDidDataPos=0, DcmDspDidDataRef=Battery_Voltage_Battery_Voltage
          VIPSoftwareVersion: DcmDspDidIdentifier=48672, DcmDspDidInfoRef=DidInfo_VIPSoftwareVersion
            VIPSoftwareVersion (DcmDspDidSignal): DcmDspDidDataPos=0, DcmDspDidDataRef=VIPSoftwareVersion_VIPSoftwareVersion
          AndroidSoftwareVersion: DcmDspDidIdentifier=48673, DcmDspDidInfoRef=DidInfo_AndroidSoftwareVersion
            AndroidSoftwareVersion (DcmDspDidSignal): DcmDspDidDataPos=0, DcmDspDidDataRef=AndroidSoftwareVersion_AndroidSoftwareVersion
          QNXSoftwareVersion: DcmDspDidIdentifier=48674, DcmDspDidInfoRef=DidInfo_QNXSoftwareVersion
            QNXSoftwareVersion (DcmDspDidSignal): DcmDspDidDataPos=0, DcmDspDidDataRef=QNXSoftwareVersion_QNXSoftwareVersion
          VIPBootloaderVersion: DcmDspDidIdentifier=48675, DcmDspDidInfoRef=DidInfo_VIPBootloaderVersion
            VIPBootloaderVersion (DcmDspDidSignal): DcmDspDidDataPos=0, DcmDspDidDataRef=VIPBootloaderVersion_VIPBootloaderVersion
          ClearTraceLog: DcmDspDidIdentifier=48686, DcmDspDidInfoRef=DidInfo_ClearTraceLog
            Clear_Log (DcmDspDidSignal): DcmDspDidDataPos=0, DcmDspDidDataRef=ClearTraceLog_Clear_Log
          WatchDogCounter: DcmDspDidIdentifier=48689, DcmDspDidInfoRef=DidInfo_WatchDogCounter
            MCU_WatchDog_Counter (DcmDspDidSignal): DcmDspDidDataPos=0, DcmDspDidDataRef=WatchDogCounter_MCU_WatchDog_Counter
          ResetInformation: DcmDspDidIdentifier=48690, DcmDspDidInfoRef=DidInfo_ResetInformation
            ResetInformation (DcmDspDidSignal): DcmDspDidDataPos=0, DcmDspDidDataRef=ResetInformation_ResetInformation
          DID_0xFD1A_1_1: DcmDspDidIdentifier=48695, DcmDspDidInfoRef=DidInfo_DID_0xFD1A_1_1
            System_Time (DcmDspDidSignal): DcmDspDidDataPos=0, DcmDspDidDataRef=DID_0xFD1A_1_1_System_Time
          GPSSyncSwitch: DcmDspDidIdentifier=48696, DcmDspDidInfoRef=DidInfo_GPSSyncSwitch
            Status (DcmDspDidSignal): DcmDspDidDataPos=0, DcmDspDidDataRef=GPSSyncSwitch_Status
          BluetoothTestModeSwitch: DcmDspDidIdentifier=48704, DcmDspDidInfoRef=DidInfo_BluetoothTestModeSwitch
            Test_Mode_ON_OFF (DcmDspDidSignal): DcmDspDidDataPos=0, DcmDspDidDataRef=BluetoothTestModeSwitch_Test_Mode_ON_OFF
          BluetoothSwitch: DcmDspDidIdentifier=48705, DcmDspDidInfoRef=DidInfo_BluetoothSwitch
            BT_ON_OFF (DcmDspDidSignal): DcmDspDidDataPos=0, DcmDspDidDataRef=BluetoothSwitch_BT_ON_OFF
          BluetoothECNRSwitch: DcmDspDidIdentifier=48706, DcmDspDidInfoRef=DidInfo_BluetoothECNRSwitch
            BT_ECNR_Status (DcmDspDidSignal): DcmDspDidDataPos=0, DcmDspDidDataRef=BluetoothECNRSwitch_BT_ECNR_Status
          BluetoothAddress: DcmDspDidIdentifier=48707, DcmDspDidInfoRef=DidInfo_BluetoothAddress
            BT_Address (DcmDspDidSignal): DcmDspDidDataPos=0, DcmDspDidDataRef=BluetoothAddress_BT_Address
          BluetoothFrequencyTrim: DcmDspDidIdentifier=48708, DcmDspDidInfoRef=DidInfo_BluetoothFrequencyTrim
            Frequency (DcmDspDidSignal): DcmDspDidDataPos=0, DcmDspDidDataRef=BluetoothFrequencyTrim_Frequency
          BluetoothFriendlyName: DcmDspDidIdentifier=48709, DcmDspDidInfoRef=DidInfo_BluetoothFriendlyName
            BluetoothFriendlyName (DcmDspDidSignal): DcmDspDidDataPos=0, DcmDspDidDataRef=BluetoothFriendlyName_BluetoothFriendlyName
          BluetoothModuleScanOn: DcmDspDidIdentifier=48710, DcmDspDidInfoRef=DidInfo_BluetoothModuleScanOn
            Status (DcmDspDidSignal): DcmDspDidDataPos=0, DcmDspDidDataRef=BluetoothModuleScanOn_Status
          BluetoothAudioPlayPause: DcmDspDidIdentifier=48711, DcmDspDidInfoRef=DidInfo_BluetoothAudioPlayPause
            Status (DcmDspDidSignal): DcmDspDidDataPos=0, DcmDspDidDataRef=BluetoothAudioPlayPause_Status
          BluetoothAudioPlayMode: DcmDspDidIdentifier=48712, DcmDspDidInfoRef=DidInfo_BluetoothAudioPlayMode
            Play_Mode (DcmDspDidSignal): DcmDspDidDataPos=0, DcmDspDidDataRef=BluetoothAudioPlayMode_Play_Mode
          BluetoothAudioForward_Rewind: DcmDspDidIdentifier=48713, DcmDspDidInfoRef=DidInfo_BluetoothAudioForward_Rewind
            Forward_Rewind (DcmDspDidSignal): DcmDspDidDataPos=0, DcmDspDidDataRef=BluetoothAudioForward_Rewind_Forward_Rewind
          BluetoothAudioSkipTrack: DcmDspDidIdentifier=48714, DcmDspDidInfoRef=DidInfo_BluetoothAudioSkipTrack
            Skip (DcmDspDidSignal): DcmDspDidDataPos=0, DcmDspDidDataRef=BluetoothAudioSkipTrack_Skip
          BluetoothPairListInformation: DcmDspDidIdentifier=48715, DcmDspDidInfoRef=DidInfo_BluetoothPairListInformation
            Clear (DcmDspDidSignal): DcmDspDidDataPos=0, DcmDspDidDataRef=BluetoothPairListInformation_Clear
          EnterBluetoothMaximumPowerMode: DcmDspDidIdentifier=48716, DcmDspDidInfoRef=DidInfo_EnterBluetoothMaximumPowerMode
            Maximum_Power_Mode (DcmDspDidSignal): DcmDspDidDataPos=0, DcmDspDidDataRef=EnterBluetoothMaximumPowerMode_Maximum_Power_Mode
          BTPairbyBTAddress: DcmDspDidIdentifier=48717, DcmDspDidInfoRef=DidInfo_BTPairbyBTAddress
            BT_Address (DcmDspDidSignal): DcmDspDidDataPos=0, DcmDspDidDataRef=BTPairbyBTAddress_BT_Address
          BTPairConfirm: DcmDspDidIdentifier=48718, DcmDspDidInfoRef=DidInfo_BTPairConfirm
            Confirm (DcmDspDidSignal): DcmDspDidDataPos=0, DcmDspDidDataRef=BTPairConfirm_Confirm
          ReadBTBER: DcmDspDidIdentifier=48719, DcmDspDidInfoRef=DidInfo_ReadBTBER
            ReadBTBER (DcmDspDidSignal): DcmDspDidDataPos=0, DcmDspDidDataRef=ReadBTBER_ReadBTBER
          WiFiTestModeSwitch: DcmDspDidIdentifier=48720, DcmDspDidInfoRef=DidInfo_WiFiTestModeSwitch
            Wifi_Test_Mode_ON_OFF (DcmDspDidSignal): DcmDspDidDataPos=0, DcmDspDidDataRef=WiFiTestModeSwitch_Wifi_Test_Mode_ON_OFF
          WiFiFriendlyName: DcmDspDidIdentifier=48721, DcmDspDidInfoRef=DidInfo_WiFiFriendlyName
            WiFi_Friendly_Name (DcmDspDidSignal): DcmDspDidDataPos=0, DcmDspDidDataRef=WiFiFriendlyName_WiFi_Friendly_Name
          WiFiConnectStatus: DcmDspDidIdentifier=48722, DcmDspDidInfoRef=DidInfo_WiFiConnectStatus
            Wifi_Station_ON_OFF (DcmDspDidSignal): DcmDspDidDataPos=0, DcmDspDidDataRef=WiFiConnectStatus_Wifi_Station_ON_OFF
          WriteWiFiBand: DcmDspDidIdentifier=48723, DcmDspDidInfoRef=DidInfo_WriteWiFiBand
            WiFi_Band (DcmDspDidSignal): DcmDspDidDataPos=0, DcmDspDidDataRef=WriteWiFiBand_WiFi_Band
          WiFiChannel: DcmDspDidIdentifier=48724, DcmDspDidInfoRef=DidInfo_WiFiChannel
            WiFi_Channel (DcmDspDidSignal): DcmDspDidDataPos=0, DcmDspDidDataRef=WiFiChannel_WiFi_Channel
          WiFiProtocol: DcmDspDidIdentifier=48725, DcmDspDidInfoRef=DidInfo_WiFiProtocol
            WiFi_Protocol (DcmDspDidSignal): DcmDspDidDataPos=0, DcmDspDidDataRef=WiFiProtocol_WiFi_Protocol
          WiFiPackageErrorRate: DcmDspDidIdentifier=48726, DcmDspDidInfoRef=DidInfo_WiFiPackageErrorRate
            WiFi_PER (DcmDspDidSignal): DcmDspDidDataPos=0, DcmDspDidDataRef=WiFiPackageErrorRate_WiFi_PER
          WiFiMaximumPowerModestatus: DcmDspDidIdentifier=48727, DcmDspDidInfoRef=DidInfo_WiFiMaximumPowerModestatus
            WiFi_Maximum_Power_Mode (DcmDspDidSignal): DcmDspDidDataPos=0, DcmDspDidDataRef=WiFiMaximumPowerModestatus_WiFi_Maximum_Power_Mode
          ReadWiFiConnectStatus: DcmDspDidIdentifier=48728, DcmDspDidInfoRef=DidInfo_ReadWiFiConnectStatus
            INVALID_SHORTNAME_0xFD4C (DcmDspDidSignal): DcmDspDidDataPos=0, DcmDspDidDataRef=ReadWiFiConnectStatus_0xFD4C
          WiFiSignalStrength: DcmDspDidIdentifier=48729, DcmDspDidInfoRef=DidInfo_WiFiSignalStrength
            Signal_Strength (DcmDspDidSignal): DcmDspDidDataPos=0, DcmDspDidDataRef=WiFiSignalStrength_Signal_Strength
          WiFiConnecttoSpecifiedAP: DcmDspDidIdentifier=48730, DcmDspDidInfoRef=DidInfo_WiFiConnecttoSpecifiedAP
            WiFiConnecttoSpecifiedAP (DcmDspDidSignal): DcmDspDidDataPos=0, DcmDspDidDataRef=WiFiConnecttoSpecifiedAP_WiFiConnecttoSpecifiedAP
          WiFiMACAddress: DcmDspDidIdentifier=48731, DcmDspDidInfoRef=DidInfo_WiFiMACAddress
            Mac_Address (DcmDspDidSignal): DcmDspDidDataPos=0, DcmDspDidDataRef=WiFiMACAddress_Mac_Address
          EthernetTestModeSwitch: DcmDspDidIdentifier=48736, DcmDspDidInfoRef=DidInfo_EthernetTestModeSwitch
            Status (DcmDspDidSignal): DcmDspDidDataPos=0, DcmDspDidDataRef=EthernetTestModeSwitch_Status
          EthernetPackageErrorRate: DcmDspDidIdentifier=48737, DcmDspDidInfoRef=DidInfo_EthernetPackageErrorRate
            Ethernet_PER (DcmDspDidSignal): DcmDspDidDataPos=0, DcmDspDidDataRef=EthernetPackageErrorRate_Ethernet_PER
          EthernetChannelDiagnosticResult: DcmDspDidIdentifier=48740, DcmDspDidInfoRef=DidInfo_EthernetChannelDiagnosticResult
            Ethernet_Channel_Diagnostic_Result (DcmDspDidSignal): DcmDspDidDataPos=0, DcmDspDidDataRef=EthernetChannelDiagnosticResult_Ethernet_Channel_Diagnostic_Result
          IPAddress: DcmDspDidIdentifier=48743, DcmDspDidInfoRef=DidInfo_IPAddress
            IP_Address (DcmDspDidSignal): DcmDspDidDataPos=0, DcmDspDidDataRef=IPAddress_IP_Address
          AudioSource: DcmDspDidIdentifier=48752, DcmDspDidInfoRef=DidInfo_AudioSource
            Audio_Source (DcmDspDidSignal): DcmDspDidDataPos=0, DcmDspDidDataRef=AudioSource_Audio_Source
          VolumeLevel: DcmDspDidIdentifier=48753, DcmDspDidInfoRef=DidInfo_VolumeLevel
            Volume_Level (DcmDspDidSignal): DcmDspDidDataPos=0, DcmDspDidDataRef=VolumeLevel_Volume_Level
          MuteStatus: DcmDspDidIdentifier=48754, DcmDspDidInfoRef=DidInfo_MuteStatus
            Mute_status (DcmDspDidSignal): DcmDspDidDataPos=0, DcmDspDidDataRef=MuteStatus_Mute_status
          BassLevel: DcmDspDidIdentifier=48755, DcmDspDidInfoRef=DidInfo_BassLevel
            Bass_Level (DcmDspDidSignal): DcmDspDidDataPos=0, DcmDspDidDataRef=BassLevel_Bass_Level
          MiddleLevel: DcmDspDidIdentifier=48756, DcmDspDidInfoRef=DidInfo_MiddleLevel
            Middle_Level (DcmDspDidSignal): DcmDspDidDataPos=0, DcmDspDidDataRef=MiddleLevel_Middle_Level
          TrebleLevel: DcmDspDidIdentifier=48757, DcmDspDidInfoRef=DidInfo_TrebleLevel
            Treble_Level (DcmDspDidSignal): DcmDspDidDataPos=0, DcmDspDidDataRef=TrebleLevel_Treble_Level
          BalanceLevel: DcmDspDidIdentifier=48758, DcmDspDidInfoRef=DidInfo_BalanceLevel
            Balance_Level (DcmDspDidSignal): DcmDspDidDataPos=0, DcmDspDidDataRef=BalanceLevel_Balance_Level
          FaderLevel: DcmDspDidIdentifier=48759, DcmDspDidInfoRef=DidInfo_FaderLevel
            Fader_Level (DcmDspDidSignal): DcmDspDidDataPos=0, DcmDspDidDataRef=FaderLevel_Fader_Level
          LoudnessStatus: DcmDspDidIdentifier=48760, DcmDspDidInfoRef=DidInfo_LoudnessStatus
            Loudness_Status (DcmDspDidSignal): DcmDspDidDataPos=0, DcmDspDidDataRef=LoudnessStatus_Loudness_Status
          SpeedVolumeStatus: DcmDspDidIdentifier=48761, DcmDspDidInfoRef=DidInfo_SpeedVolumeStatus
            Speed_Volume_Status (DcmDspDidSignal): DcmDspDidDataPos=0, DcmDspDidDataRef=SpeedVolumeStatus_Speed_Volume_Status
          DTSStatus: DcmDspDidIdentifier=48762, DcmDspDidInfoRef=DidInfo_DTSStatus
            DTS_Status (DcmDspDidSignal): DcmDspDidDataPos=0, DcmDspDidDataRef=DTSStatus_DTS_Status
          BEXStatus: DcmDspDidIdentifier=48763, DcmDspDidInfoRef=DidInfo_BEXStatus
            BEX_Status (DcmDspDidSignal): DcmDspDidDataPos=0, DcmDspDidDataRef=BEXStatus_BEX_Status
          BestListeningposition: DcmDspDidIdentifier=48764, DcmDspDidInfoRef=DidInfo_BestListeningposition
            Best_Listening_Position_Status (DcmDspDidSignal): DcmDspDidDataPos=0, DcmDspDidDataRef=BestListeningposition_Best_Listening_Position_Status
          SetTuningParametersFlat: DcmDspDidIdentifier=48765, DcmDspDidInfoRef=DidInfo_SetTuningParametersFlat
            Flat_ON_OFF (DcmDspDidSignal): DcmDspDidDataPos=0, DcmDspDidDataRef=SetTuningParametersFlat_Flat_ON_OFF
          BeepVolume: DcmDspDidIdentifier=48768, DcmDspDidInfoRef=DidInfo_BeepVolume
            Beep_Volume_Level (DcmDspDidSignal): DcmDspDidDataPos=0, DcmDspDidDataRef=BeepVolume_Beep_Volume_Level
          NaviVolume: DcmDspDidIdentifier=48769, DcmDspDidInfoRef=DidInfo_NaviVolume
            Navi_Volume_Level (DcmDspDidSignal): DcmDspDidDataPos=0, DcmDspDidDataRef=NaviVolume_Navi_Volume_Level
          TTSvolume: DcmDspDidIdentifier=48770, DcmDspDidInfoRef=DidInfo_TTSvolume
            TTS_Volume_Level (DcmDspDidSignal): DcmDspDidDataPos=0, DcmDspDidDataRef=TTSvolume_TTS_Volume_Level
          IPwarningVolume: DcmDspDidIdentifier=48771, DcmDspDidInfoRef=DidInfo_IPwarningVolume
            IP_Warning_Volume_Level (DcmDspDidSignal): DcmDspDidDataPos=0, DcmDspDidDataRef=IPwarningVolume_IP_Warning_Volume_Level
          BTCallvolume: DcmDspDidIdentifier=48772, DcmDspDidInfoRef=DidInfo_BTCallvolume
            BT_Call_Volume_Level (DcmDspDidSignal): DcmDspDidDataPos=0, DcmDspDidDataRef=BTCallvolume_BT_Call_Volume_Level
          BTRingvolume: DcmDspDidIdentifier=48773, DcmDspDidInfoRef=DidInfo_BTRingvolume
            BT_Ring_Volume_Level (DcmDspDidSignal): DcmDspDidDataPos=0, DcmDspDidDataRef=BTRingvolume_BT_Ring_Volume_Level
          USB_iPodPlayPause: DcmDspDidIdentifier=48784, DcmDspDidInfoRef=DidInfo_USB_iPodPlayPause
            Play_Pause (DcmDspDidSignal): DcmDspDidDataPos=0, DcmDspDidDataRef=USB_iPodPlayPause_Play_Pause
          USB_iPodPlayMode: DcmDspDidIdentifier=48785, DcmDspDidInfoRef=DidInfo_USB_iPodPlayMode
            Play_Mode (DcmDspDidSignal): DcmDspDidDataPos=0, DcmDspDidDataRef=USB_iPodPlayMode_Play_Mode
          USB_iPodSkipTrack: DcmDspDidIdentifier=48787, DcmDspDidInfoRef=DidInfo_USB_iPodSkipTrack
            Next_Previous (DcmDspDidSignal): DcmDspDidDataPos=0, DcmDspDidDataRef=USB_iPodSkipTrack_Next_Previous
          FM_AM_Current_Status: DcmDspDidIdentifier=48816, DcmDspDidInfoRef=DidInfo_FM_AM_Current_Status
            FM_AMCurrentStatus (DcmDspDidSignal): DcmDspDidDataPos=0, DcmDspDidDataRef=FM_AM_Current_Status_FM_AMCurrentStatus
          FM_AMFrequency: DcmDspDidIdentifier=48819, DcmDspDidInfoRef=DidInfo_FM_AMFrequency
            Frequency (DcmDspDidSignal): DcmDspDidDataPos=0, DcmDspDidDataRef=FM_AMFrequency_Frequency
          FM_AMSeek: DcmDspDidIdentifier=48821, DcmDspDidInfoRef=DidInfo_FM_AMSeek
            Seek (DcmDspDidSignal): DcmDspDidDataPos=0, DcmDspDidDataRef=FM_AMSeek_Seek
          TunerUpdateFM_List: DcmDspDidIdentifier=48822, DcmDspDidInfoRef=DidInfo_TunerUpdateFM_List
            Update_FM_List (DcmDspDidSignal): DcmDspDidDataPos=0, DcmDspDidDataRef=TunerUpdateFM_List_Update_FM_List
          FM_AMSignalStrength: DcmDspDidIdentifier=48823, DcmDspDidInfoRef=DidInfo_FM_AMSignalStrength
            Signal_Strength (DcmDspDidSignal): DcmDspDidDataPos=0, DcmDspDidDataRef=FM_AMSignalStrength_Signal_Strength
          DID_0xFDB0_1: DcmDspDidIdentifier=48832, DcmDspDidInfoRef=DidInfo_DID_0xFDB0_1
            DABCurrentStatus (DcmDspDidSignal): DcmDspDidDataPos=0, DcmDspDidDataRef=DID_0xFDB0_1_DABCurrentStatus
          DABPSName: DcmDspDidIdentifier=48833, DcmDspDidInfoRef=DidInfo_DABPSName
            Curent_DAB_PS_Name (DcmDspDidSignal): DcmDspDidDataPos=0, DcmDspDidDataRef=DABPSName_Curent_DAB_PS_Name
          DABFrequency: DcmDspDidIdentifier=48834, DcmDspDidInfoRef=DidInfo_DABFrequency
            DAB_Frequency_Name (DcmDspDidSignal): DcmDspDidDataPos=0, DcmDspDidDataRef=DABFrequency_DAB_Frequency_Name
          DABBank: DcmDspDidIdentifier=48835, DcmDspDidInfoRef=DidInfo_DABBank
            DAB_Bank (DcmDspDidSignal): DcmDspDidDataPos=0, DcmDspDidDataRef=DABBank_DAB_Bank
          DABPreset: DcmDspDidIdentifier=48836, DcmDspDidInfoRef=DidInfo_DABPreset
            Preset_number (DcmDspDidSignal): DcmDspDidDataPos=0, DcmDspDidDataRef=DABPreset_Preset_number
          DABSeek: DcmDspDidIdentifier=48837, DcmDspDidInfoRef=DidInfo_DABSeek
            Seek (DcmDspDidSignal): DcmDspDidDataPos=0, DcmDspDidDataRef=DABSeek_Seek
          DABEnsembleID: DcmDspDidIdentifier=48838, DcmDspDidInfoRef=DidInfo_DABEnsembleID
            Ensemble_ID (DcmDspDidSignal): DcmDspDidDataPos=0, DcmDspDidDataRef=DABEnsembleID_Ensemble_ID
          DABStationID: DcmDspDidIdentifier=48839, DcmDspDidInfoRef=DidInfo_DABStationID
            DABStationID (DcmDspDidSignal): DcmDspDidDataPos=0, DcmDspDidDataRef=DABStationID_DABStationID
          DABBitErrorRatio: DcmDspDidIdentifier=48840, DcmDspDidInfoRef=DidInfo_DABBitErrorRatio
            Bit_Error_Ratio (DcmDspDidSignal): DcmDspDidDataPos=0, DcmDspDidDataRef=DABBitErrorRatio_Bit_Error_Ratio
          DABReceivedSignalStrength: DcmDspDidIdentifier=48841, DcmDspDidInfoRef=DidInfo_DABReceivedSignalStrength
            RSS (DcmDspDidSignal): DcmDspDidDataPos=0, DcmDspDidDataRef=DABReceivedSignalStrength_RSS
          DABTestTone: DcmDspDidIdentifier=48842, DcmDspDidInfoRef=DidInfo_DABTestTone
            Test_tone_type (DcmDspDidSignal): DcmDspDidDataPos=0, DcmDspDidDataRef=DABTestTone_Test_tone_type
          SwitchFunction: DcmDspDidIdentifier=48848, DcmDspDidInfoRef=DidInfo_SwitchFunction
            SwitchFunction (DcmDspDidSignal): DcmDspDidDataPos=0, DcmDspDidDataRef=SwitchFunction_SwitchFunction
          Gyro_Status: DcmDspDidIdentifier=48855, DcmDspDidInfoRef=DidInfo_Gyro_Status
            GyroStatus (DcmDspDidSignal): DcmDspDidDataPos=0, DcmDspDidDataRef=Gyro_Status_GyroStatus
          ReadGPSSatelliteCount: DcmDspDidIdentifier=48857, DcmDspDidInfoRef=DidInfo_ReadGPSSatelliteCount
            ReadGPSSatelliteCount (DcmDspDidSignal): DcmDspDidDataPos=0, DcmDspDidDataRef=ReadGPSSatelliteCount_ReadGPSSatelliteCount
          IVIDisplayNight_DayMode: DcmDspDidIdentifier=48864, DcmDspDidInfoRef=DidInfo_IVIDisplayNight_DayMode
            Day_Night_Mode (DcmDspDidSignal): DcmDspDidDataPos=0, DcmDspDidDataRef=IVIDisplayNight_DayMode_Day_Night_Mode
          IVIDisplayBrightness: DcmDspDidIdentifier=48865, DcmDspDidInfoRef=DidInfo_IVIDisplayBrightness
            Brightness (DcmDspDidSignal): DcmDspDidDataPos=0, DcmDspDidDataRef=IVIDisplayBrightness_Brightness
          IVI_Display_Voltage: DcmDspDidIdentifier=48868, DcmDspDidInfoRef=DidInfo_IVI_Display_Voltage
            IVI_Display_Voltage (DcmDspDidSignal): DcmDspDidDataPos=0, DcmDspDidDataRef=IVI_Display_Voltage_IVI_Display_Voltage
          IVIDisplayPatternsTest: DcmDspDidIdentifier=48869, DcmDspDidInfoRef=DidInfo_IVIDisplayPatternsTest
            Manufacture_Date (DcmDspDidSignal): DcmDspDidDataPos=0, DcmDspDidDataRef=IVIDisplayPatternsTest_Manufacture_Date
          ClearIVIDisplayDTCInformation: DcmDspDidIdentifier=48870, DcmDspDidInfoRef=DidInfo_ClearIVIDisplayDTCInformation
            INVALID_SHORTNAME_0xFE62 (DcmDspDidSignal): DcmDspDidDataPos=0, DcmDspDidDataRef=ClearIVIDisplayDTCInformation_0xFE62
          IVIDisplayReset: DcmDspDidIdentifier=48871, DcmDspDidInfoRef=DidInfo_IVIDisplayReset
            IVIDisplayReset (DcmDspDidSignal): DcmDspDidDataPos=0, DcmDspDidDataRef=IVIDisplayReset_IVIDisplayReset
          EnterEOLSession: DcmDspDidIdentifier=48872, DcmDspDidInfoRef=DidInfo_EnterEOLSession
            EnterEOLSession (DcmDspDidSignal): DcmDspDidDataPos=0, DcmDspDidDataRef=EnterEOLSession_EnterEOLSession
          ClusterBrightness: DcmDspDidIdentifier=48882, DcmDspDidInfoRef=DidInfo_ClusterBrightness
            Brightness (DcmDspDidSignal): DcmDspDidDataPos=0, DcmDspDidDataRef=ClusterBrightness_Brightness
          DID_0xFE62_1: DcmDspDidIdentifier=48885, DcmDspDidInfoRef=DidInfo_DID_0xFE62_1
            Cluster_Display_Voltage (DcmDspDidSignal): DcmDspDidDataPos=0, DcmDspDidDataRef=DID_0xFE62_1_Cluster_Display_Voltage
          ClusterDisplayPatternsTest: DcmDspDidIdentifier=48886, DcmDspDidInfoRef=DidInfo_ClusterDisplayPatternsTest
            Manufacture_Date (DcmDspDidSignal): DcmDspDidDataPos=0, DcmDspDidDataRef=ClusterDisplayPatternsTest_Manufacture_Date
          ClusterDisplaySupplierInformation: DcmDspDidIdentifier=48887, DcmDspDidInfoRef=DidInfo_ClusterDisplaySupplierInformation
            Supplier_Information (DcmDspDidSignal): DcmDspDidDataPos=0, DcmDspDidDataRef=ClusterDisplaySupplierInformation_Supplier_Information
          ClusterDisplaySizeofScreen: DcmDspDidIdentifier=48888, DcmDspDidInfoRef=DidInfo_ClusterDisplaySizeofScreen
            Size (DcmDspDidSignal): DcmDspDidDataPos=0, DcmDspDidDataRef=ClusterDisplaySizeofScreen_Size
          ClusterDisplayResolution: DcmDspDidIdentifier=48889, DcmDspDidInfoRef=DidInfo_ClusterDisplayResolution
            Resolution (DcmDspDidSignal): DcmDspDidDataPos=0, DcmDspDidDataRef=ClusterDisplayResolution_Resolution
          ClusterDisplayType: DcmDspDidIdentifier=48890, DcmDspDidInfoRef=DidInfo_ClusterDisplayType
            Display_Type (DcmDspDidSignal): DcmDspDidDataPos=0, DcmDspDidDataRef=ClusterDisplayType_Display_Type
          ClusterDisplayLVDSsignalstandard: DcmDspDidIdentifier=48891, DcmDspDidInfoRef=DidInfo_ClusterDisplayLVDSsignalstandard
            Display_Type (DcmDspDidSignal): DcmDspDidDataPos=0, DcmDspDidDataRef=ClusterDisplayLVDSsignalstandard_Display_Type
          ClearCluster: DcmDspDidIdentifier=48892, DcmDspDidInfoRef=DidInfo_ClearCluster
            DisplayDTCInformation (DcmDspDidSignal): DcmDspDidDataPos=0, DcmDspDidDataRef=ClearCluster_DisplayDTCInformation
          ClusterDisplayReset: DcmDspDidIdentifier=48893, DcmDspDidInfoRef=DidInfo_ClusterDisplayReset
            ClusterDisplayReset (DcmDspDidSignal): DcmDspDidDataPos=0, DcmDspDidDataRef=ClusterDisplayReset_ClusterDisplayReset
          ControlDisplayBrightness: DcmDspDidIdentifier=48896, DcmDspDidInfoRef=DidInfo_ControlDisplayBrightness
            Brightness (DcmDspDidSignal): DcmDspDidDataPos=0, DcmDspDidDataRef=ControlDisplayBrightness_Brightness
          PassengerDisplayBrightness: DcmDspDidIdentifier=48928, DcmDspDidInfoRef=DidInfo_PassengerDisplayBrightness
            Brightness (DcmDspDidSignal): DcmDspDidDataPos=0, DcmDspDidDataRef=PassengerDisplayBrightness_Brightness
          Radio_Antenna_Status: DcmDspDidIdentifier=48960, DcmDspDidInfoRef=DidInfo_Radio_Antenna_Status
            RadioAntennaStatus (DcmDspDidSignal): DcmDspDidDataPos=0, DcmDspDidDataRef=Radio_Antenna_Status_RadioAntennaStatus
          MICStatus: DcmDspDidIdentifier=48961, DcmDspDidInfoRef=DidInfo_MICStatus
            MICStatus (DcmDspDidSignal): DcmDspDidDataPos=0, DcmDspDidDataRef=MICStatus_MICStatus
          SpeakerStatus: DcmDspDidIdentifier=48962, DcmDspDidInfoRef=DidInfo_SpeakerStatus
            SpeakerStatus (DcmDspDidSignal): DcmDspDidDataPos=0, DcmDspDidDataRef=SpeakerStatus_SpeakerStatus
          ExternalAmpStatus: DcmDspDidIdentifier=48963, DcmDspDidInfoRef=DidInfo_ExternalAmpStatus
            Amplifier (DcmDspDidSignal): DcmDspDidDataPos=0, DcmDspDidDataRef=ExternalAmpStatus_Amplifier
          ReadCamera: DcmDspDidIdentifier=48970, DcmDspDidInfoRef=DidInfo_ReadCamera
            LinkStatus (DcmDspDidSignal): DcmDspDidDataPos=0, DcmDspDidDataRef=ReadCamera_LinkStatus
          ReadDisplayLinkStatus: DcmDspDidIdentifier=48971, DcmDspDidInfoRef=DidInfo_ReadDisplayLinkStatus
            INVALID_SHORTNAME_0xFDF7 (DcmDspDidSignal): DcmDspDidDataPos=0, DcmDspDidDataRef=ReadDisplayLinkStatus_0xFDF7
          CameraSwitch: DcmDspDidIdentifier=48972, DcmDspDidInfoRef=DidInfo_CameraSwitch
            RVC_AVM_Camera (DcmDspDidSignal): DcmDspDidDataPos=0, DcmDspDidDataRef=CameraSwitch_RVC_AVM_Camera
          DMSCameraDisplay0xFDF8: DcmDspDidIdentifier=48974, DcmDspDidInfoRef=DidInfo_DMSCameraDisplay0xFDF8
            INVALID_SHORTNAME_ON_OFF (DcmDspDidSignal): DcmDspDidDataPos=0, DcmDspDidDataRef=DMSCameraDisplay0xFDF8_ON_OFF
          InCarCameraDisplay0xFDF9: DcmDspDidIdentifier=48975, DcmDspDidInfoRef=DidInfo_InCarCameraDisplay0xFDF9
            ON_OFF (DcmDspDidSignal): DcmDspDidDataPos=0, DcmDspDidDataRef=InCarCameraDisplay0xFDF9_ON_OFF
          DVRCameraDisplaySwitchONOFF: DcmDspDidIdentifier=48976, DcmDspDidInfoRef=DidInfo_DVRCameraDisplaySwitchONOFF
            DVRCameraDisplaySwitchONOFF (DcmDspDidSignal): DcmDspDidDataPos=0, DcmDspDidDataRef=DVRCameraDisplaySwitchONOFF_DVRCameraDisplaySwitchONOFF
          GestureCameraDisplay: DcmDspDidIdentifier=48977, DcmDspDidInfoRef=DidInfo_GestureCameraDisplay
            GestureCameraDisplay (DcmDspDidSignal): DcmDspDidDataPos=0, DcmDspDidDataRef=GestureCameraDisplay_GestureCameraDisplay
          MICTestSwitch: DcmDspDidIdentifier=48978, DcmDspDidInfoRef=DidInfo_MICTestSwitch
            MICTestSwitch (DcmDspDidSignal): DcmDspDidDataPos=0, DcmDspDidDataRef=MICTestSwitch_MICTestSwitch
          AudioOutputbyAmp_A2B: DcmDspDidIdentifier=48979, DcmDspDidInfoRef=DidInfo_AudioOutputbyAmp_A2B
            INVALID_SHORTNAME_0xFDFA (DcmDspDidSignal): DcmDspDidDataPos=0, DcmDspDidDataRef=AudioOutputbyAmp_A2B_0xFDFA
          ClusterHardwareInput: DcmDspDidIdentifier=48980, DcmDspDidInfoRef=DidInfo_ClusterHardwareInput
            ClusterHardwareInput (DcmDspDidSignal): DcmDspDidDataPos=0, DcmDspDidDataRef=ClusterHardwareInput_ClusterHardwareInput
          Display_enablingValues: DcmDspDidIdentifier=48981, DcmDspDidInfoRef=DidInfo_Display_enablingValues
            Display_enablingValues (DcmDspDidSignal): DcmDspDidDataPos=0, DcmDspDidDataRef=Display_enablingValues_Display_enablingValues
          TBOXMuteValue: DcmDspDidIdentifier=48982, DcmDspDidInfoRef=DidInfo_TBOXMuteValue
            Mute_value (DcmDspDidSignal): DcmDspDidDataPos=0, DcmDspDidDataRef=TBOXMuteValue_Mute_value
          A2BTestSwitch: DcmDspDidIdentifier=48983, DcmDspDidInfoRef=DidInfo_A2BTestSwitch
            ON_OFF (DcmDspDidSignal): DcmDspDidDataPos=0, DcmDspDidDataRef=A2BTestSwitch_ON_OFF
          AUXTestSwitch: DcmDspDidIdentifier=48984, DcmDspDidInfoRef=DidInfo_AUXTestSwitch
            ON_OFF (DcmDspDidSignal): DcmDspDidDataPos=0, DcmDspDidDataRef=AUXTestSwitch_ON_OFF
          ReadUSB20PID: DcmDspDidIdentifier=48985, DcmDspDidInfoRef=DidInfo_ReadUSB20PID
            INVALID_SHORTNAME_0xFE50 (DcmDspDidSignal): DcmDspDidDataPos=0, DcmDspDidDataRef=ReadUSB20PID_0xFE50
          ReadUSB30PID: DcmDspDidIdentifier=48986, DcmDspDidInfoRef=DidInfo_ReadUSB30PID
            INVALID_SHORTNAME_0xFE51 (DcmDspDidSignal): DcmDspDidDataPos=0, DcmDspDidDataRef=ReadUSB30PID_0xFE51
          InternalAVMCameraON_OFF: DcmDspDidIdentifier=48987, DcmDspDidInfoRef=DidInfo_InternalAVMCameraON_OFF
            InternalAVMCameraON_OFF (DcmDspDidSignal): DcmDspDidDataPos=0, DcmDspDidDataRef=InternalAVMCameraON_OFF_InternalAVMCameraON_OFF
          AllCameraDisplayToIVI: DcmDspDidIdentifier=48988, DcmDspDidInfoRef=DidInfo_AllCameraDisplayToIVI
            AllCameraDisplayToIVI (DcmDspDidSignal): DcmDspDidDataPos=0, DcmDspDidDataRef=AllCameraDisplayToIVI_AllCameraDisplayToIVI
          ReadCameraDisplayStatus: DcmDspDidIdentifier=48989, DcmDspDidInfoRef=DidInfo_ReadCameraDisplayStatus
            ReadCameraDisplayStatus (DcmDspDidSignal): DcmDspDidDataPos=0, DcmDspDidDataRef=ReadCameraDisplayStatus_ReadCameraDisplayStatus
          VehicleSpeed: DcmDspDidIdentifier=53249, DcmDspDidInfoRef=DidInfo_VehicleSpeed
            Vehicle_Speed (DcmDspDidSignal): DcmDspDidDataPos=0, DcmDspDidDataRef=VehicleSpeed_Vehicle_Speed
          EngineSpeed: DcmDspDidIdentifier=53250, DcmDspDidInfoRef=DidInfo_EngineSpeed
            EngineSpeed (DcmDspDidSignal): DcmDspDidDataPos=0, DcmDspDidDataRef=EngineSpeed_EngineSpeed
          OperatingVoltage: DcmDspDidIdentifier=53251, DcmDspDidInfoRef=DidInfo_OperatingVoltage
            OperatingVoltage (DcmDspDidSignal): DcmDspDidDataPos=0, DcmDspDidDataRef=OperatingVoltage_OperatingVoltage
          Odometer: DcmDspDidIdentifier=53252, DcmDspDidInfoRef=DidInfo_Odometer
            Odometer (DcmDspDidSignal): DcmDspDidDataPos=0, DcmDspDidDataRef=Odometer_Odometer
          DTCOccurrenceTimer: DcmDspDidIdentifier=53253, DcmDspDidInfoRef=DidInfo_DTCOccurrenceTimer
            DTC_Occurrence_Timer (DcmDspDidSignal): DcmDspDidDataPos=0, DcmDspDidDataRef=DTCOccurrenceTimer_DTC_Occurrence_Timer
          ActualRotationSpeed: DcmDspDidIdentifier=53254, DcmDspDidInfoRef=DidInfo_ActualRotationSpeed
            ActualRotationSpeed (DcmDspDidSignal): DcmDspDidDataPos=0, DcmDspDidDataRef=ActualRotationSpeed_ActualRotationSpeed
          Check_Ethernet_IP_PING_Function: DcmDspDidIdentifier=58368, DcmDspDidInfoRef=DidInfo_Check_Ethernet_IP_PING_Function
            Routine_Status_Record_Byte_1 (DcmDspDidSignal): DcmDspDidDataPos=0, DcmDspDidDataRef=Check_Ethernet_IP_PING_Function_Routine_Status_Record_Byte_1
          IVI_Touch_Test: DcmDspDidIdentifier=58369, DcmDspDidInfoRef=DidInfo_IVI_Touch_Test
            Routine_Status_Record_Byte_1 (DcmDspDidSignal): DcmDspDidDataPos=0, DcmDspDidDataRef=IVI_Touch_Test_Routine_Status_Record_Byte_1
          VehicleModel: DcmDspDidIdentifier=61714, DcmDspDidInfoRef=DidInfo_VehicleModel
            VehicleModel (DcmDspDidSignal): DcmDspDidDataPos=0, DcmDspDidDataRef=VehicleModel_VehicleModel
          VehicleManufacturerSparePartNumber: DcmDspDidIdentifier=61831, DcmDspDidInfoRef=DidInfo_VehicleManufacturerSparePartNumber
            SparePartNumber (DcmDspDidSignal): DcmDspDidDataPos=0, DcmDspDidDataRef=VehicleManufacturerSparePartNumber_SparePartNumber
          SoftwareVersionNumberDataIdentifier: DcmDspDidIdentifier=61833, DcmDspDidInfoRef=DidInfo_SoftwareVersionNumberDataIdentifier
            SoftwareVersion (DcmDspDidSignal): DcmDspDidDataPos=0, DcmDspDidDataRef=SoftwareVersionNumberDataIdentifier_SoftwareVersion
          SystemSupplierIdentifier: DcmDspDidIdentifier=61834, DcmDspDidInfoRef=DidInfo_SystemSupplierIdentifier
            systemSupplierIdentifier (DcmDspDidSignal): DcmDspDidDataPos=0, DcmDspDidDataRef=SystemSupplierIdentifier_systemSupplierIdentifier
          ECUSerialNumber: DcmDspDidIdentifier=61836, DcmDspDidInfoRef=DidInfo_ECUSerialNumber
            ECUSerialNumber (DcmDspDidSignal): DcmDspDidDataPos=0, DcmDspDidDataRef=ECUSerialNumber_ECUSerialNumber
          VehicleIdentificationNumber: DcmDspDidIdentifier=61840, DcmDspDidInfoRef=DidInfo_VehicleIdentificationNumber
            VIN (DcmDspDidSignal): DcmDspDidDataPos=0, DcmDspDidDataRef=VehicleIdentificationNumber_VIN
          SystemSupplierECUHardwareVersionNumber: DcmDspDidIdentifier=61843, DcmDspDidInfoRef=DidInfo_SystemSupplierECUHardwareVersionNumber
            ECUHardwareVersionNumber (DcmDspDidSignal): DcmDspDidDataPos=0, DcmDspDidDataRef=SystemSupplierECUHardwareVersionNumber_ECUHardwareVersionNumber
          SystemSupplierECUSoftwareVersionNumber: DcmDspDidIdentifier=61845, DcmDspDidInfoRef=DidInfo_SystemSupplierECUSoftwareVersionNumber
            ECUSoftwareVersionNumber (DcmDspDidSignal): DcmDspDidDataPos=0, DcmDspDidDataRef=SystemSupplierECUSoftwareVersionNumber_ECUSoftwareVersionNumber
          CMatrixVersion: DcmDspDidIdentifier=61858, DcmDspDidInfoRef=DidInfo_CMatrixVersion
            CMatrixVersion (DcmDspDidSignal): DcmDspDidDataPos=0, DcmDspDidDataRef=CMatrixVersion_CMatrixVersion
          ECUlevelNetworkConfigurationDataIdentifier: DcmDspDidIdentifier=61873, DcmDspDidInfoRef=DidInfo_ECUlevelNetworkConfigurationDataIdentifier
            NetworkConfigurationDataIdentifier (DcmDspDidSignal): DcmDspDidDataPos=0, DcmDspDidDataRef=ECUlevelNetworkConfigurationDataIdentifier_NetworkConfigurationDataIdentifier
          FOTAIndentifier: DcmDspDidIdentifier=61874, DcmDspDidInfoRef=DidInfo_FOTAIndentifier
            New_Data_Object_1 (DcmDspDidSignal): DcmDspDidDataPos=0, DcmDspDidDataRef=FOTAIndentifier_New_Data_Object_1
          NodeAddress: DcmDspDidIdentifier=61875, DcmDspDidInfoRef=DidInfo_NodeAddress
            NodeAddress (DcmDspDidSignal): DcmDspDidDataPos=0, DcmDspDidDataRef=NodeAddress_NodeAddress
          CompID1: DcmDspDidIdentifier=61876, DcmDspDidInfoRef=DidInfo_CompID1
            CompID1 (DcmDspDidSignal): DcmDspDidDataPos=0, DcmDspDidDataRef=CompID1_CompID1
          FOTAName: DcmDspDidIdentifier=61877, DcmDspDidInfoRef=DidInfo_FOTAName
            FOTAName (DcmDspDidSignal): DcmDspDidDataPos=0, DcmDspDidDataRef=FOTAName_FOTAName
          ToolVersion: DcmDspDidIdentifier=61878, DcmDspDidInfoRef=DidInfo_ToolVersion
            ToolVersion (DcmDspDidSignal): DcmDspDidDataPos=0, DcmDspDidDataRef=ToolVersion_ToolVersion
          VehicleManufacturerECUCalibrationSoftwareVersionNumber: DcmDspDidIdentifier=61888, DcmDspDidInfoRef=DidInfo_VehicleManufacturerECUCalibrationSoftwareVersionNumber
            ECUCalibrationSoftwareVersionNumber (DcmDspDidSignal): DcmDspDidDataPos=0, DcmDspDidDataRef=VehicleManufacturerECUCalibrationSoftwareVersionNumber_ECUCalibrationSoftwareVersionNumber
          VehicleManufacturerECUBootSoftwareVersionNumber: DcmDspDidIdentifier=61889, DcmDspDidInfoRef=DidInfo_VehicleManufacturerECUBootSoftwareVersionNumber
            ECUBootSoftwareVersionNumber (DcmDspDidSignal): DcmDspDidDataPos=0, DcmDspDidDataRef=VehicleManufacturerECUBootSoftwareVersionNumber_ECUBootSoftwareVersionNumber
          FactoryMode: DcmDspDidIdentifier=61890, DcmDspDidInfoRef=DidInfo_FactoryMode
            FactoryMode (DcmDspDidSignal): DcmDspDidDataPos=0, DcmDspDidDataRef=FactoryMode_FactoryMode
          UIN: DcmDspDidIdentifier=61893, DcmDspDidInfoRef=DidInfo_UIN
            UIN (DcmDspDidSignal): DcmDspDidDataPos=0, DcmDspDidDataRef=UIN_UIN
          SecOCKey: DcmDspDidIdentifier=61895, DcmDspDidInfoRef=DidInfo_SecOCKey
            SecOCKey (DcmDspDidSignal): DcmDspDidDataPos=0, DcmDspDidDataRef=SecOCKey_SecOCKey
          SecOCVersionNumber: DcmDspDidIdentifier=61896, DcmDspDidInfoRef=DidInfo_SecOCVersionNumber
            SecOCVersionNumber (DcmDspDidSignal): DcmDspDidDataPos=0, DcmDspDidDataRef=SecOCVersionNumber_SecOCVersionNumber
          SignalLineSCOCNumber: DcmDspDidIdentifier=61907, DcmDspDidInfoRef=DidInfo_SignalLineSCOCNumber
            SignalLineSCOCNumber (DcmDspDidSignal): DcmDspDidDataPos=0, DcmDspDidDataRef=SignalLineSCOCNumber_SignalLineSCOCNumber
          SignalLineCurrentStatus: DcmDspDidIdentifier=61909, DcmDspDidInfoRef=DidInfo_SignalLineCurrentStatus
            SignalLineCurrentStatus (DcmDspDidSignal): DcmDspDidDataPos=0, DcmDspDidDataRef=SignalLineCurrentStatus_SignalLineCurrentStatus
          SwitchARLTable: DcmDspDidIdentifier=61910, DcmDspDidInfoRef=DidInfo_SwitchARLTable
            SwitchARLTable (DcmDspDidSignal): DcmDspDidDataPos=0, DcmDspDidDataRef=SwitchARLTable_SwitchARLTable
          MasterSlaveStatus: DcmDspDidIdentifier=61911, DcmDspDidInfoRef=DidInfo_MasterSlaveStatus
            MasterSlaveStatus (DcmDspDidSignal): DcmDspDidDataPos=0, DcmDspDidDataRef=MasterSlaveStatus_MasterSlaveStatus
          TestModeStatus: DcmDspDidIdentifier=61912, DcmDspDidInfoRef=DidInfo_TestModeStatus
            TestModeStatus (DcmDspDidSignal): DcmDspDidDataPos=0, DcmDspDidDataRef=TestModeStatus_TestModeStatus
          LinkStatus: DcmDspDidIdentifier=61925, DcmDspDidInfoRef=DidInfo_LinkStatus
            LinkStatus (DcmDspDidSignal): DcmDspDidDataPos=0, DcmDspDidDataRef=LinkStatus_LinkStatus
          BASE100SQIThreshold: DcmDspDidIdentifier=61926, DcmDspDidInfoRef=DidInfo_BASE100SQIThreshold
            SQIThreshold (DcmDspDidSignal): DcmDspDidDataPos=0, DcmDspDidDataRef=BASE100SQIThreshold_SQIThreshold
          BASE1000SQIThreshold: DcmDspDidIdentifier=61927, DcmDspDidInfoRef=DidInfo_BASE1000SQIThreshold
            SQIThreshold (DcmDspDidSignal): DcmDspDidDataPos=0, DcmDspDidDataRef=BASE1000SQIThreshold_SQIThreshold
          SQI: DcmDspDidIdentifier=61928, DcmDspDidInfoRef=DidInfo_SQI
            SQI (DcmDspDidSignal): DcmDspDidDataPos=0, DcmDspDidDataRef=SQI_SQI
          SwitchCounter: DcmDspDidIdentifier=61931, DcmDspDidInfoRef=DidInfo_SwitchCounter
            SwitchCounter (DcmDspDidSignal): DcmDspDidDataPos=0, DcmDspDidDataRef=SwitchCounter_SwitchCounter
          MACAddress: DcmDspDidIdentifier=61932, DcmDspDidInfoRef=DidInfo_MACAddress
            MACAddress (DcmDspDidSignal): DcmDspDidDataPos=0, DcmDspDidDataRef=MACAddress_MACAddress
          TankResistanceValue: DcmDspDidIdentifier=61937, DcmDspDidInfoRef=DidInfo_TankResistanceValue
            TankResistanceValue (DcmDspDidSignal): DcmDspDidDataPos=0, DcmDspDidDataRef=TankResistanceValue_TankResistanceValue
          OemSpeedometer: DcmDspDidIdentifier=62080, DcmDspDidInfoRef=DidInfo_OemSpeedometer
            OemSpeedometer (DcmDspDidSignal): DcmDspDidDataPos=0, DcmDspDidDataRef=OemSpeedometer_OemSpeedometer
          OemTachometer: DcmDspDidIdentifier=62081, DcmDspDidInfoRef=DidInfo_OemTachometer
            OemTachometer (DcmDspDidSignal): DcmDspDidDataPos=0, DcmDspDidDataRef=OemTachometer_OemTachometer
          OemCoolant: DcmDspDidIdentifier=62082, DcmDspDidInfoRef=DidInfo_OemCoolant
            OemCoolant (DcmDspDidSignal): DcmDspDidDataPos=0, DcmDspDidDataRef=OemCoolant_OemCoolant
          OemTank: DcmDspDidIdentifier=62083, DcmDspDidInfoRef=DidInfo_OemTank
            OemTank (DcmDspDidSignal): DcmDspDidDataPos=0, DcmDspDidDataRef=OemTank_OemTank
          OdometerInfo: DcmDspDidIdentifier=62089, DcmDspDidInfoRef=DidInfo_OdometerInfo
            OdometerInfo (DcmDspDidSignal): DcmDspDidDataPos=0, DcmDspDidDataRef=OdometerInfo_OdometerInfo
          DID_0xF284_1: DcmDspDidIdentifier=62099, DcmDspDidInfoRef=DidInfo_DID_0xF284_1
            TripComputerDistanceToEmpty (DcmDspDidSignal): DcmDspDidDataPos=0, DcmDspDidDataRef=DID_0xF284_1_TripComputerDistanceToEmpty
          TripComputerAvgFuelConsumption: DcmDspDidIdentifier=62100, DcmDspDidInfoRef=DidInfo_TripComputerAvgFuelConsumption
            TripComputerAvgFuelConsumption (DcmDspDidSignal): DcmDspDidDataPos=0, DcmDspDidDataRef=TripComputerAvgFuelConsumption_TripComputerAvgFuelConsumption
          TripComputerInstFuelConsumption: DcmDspDidIdentifier=62101, DcmDspDidInfoRef=DidInfo_TripComputerInstFuelConsumption
            TripComputerInstFuelConsumption (DcmDspDidSignal): DcmDspDidDataPos=0, DcmDspDidDataRef=TripComputerInstFuelConsumption_TripComputerInstFuelConsumption
          TripComputerAvgVehicleSpeed: DcmDspDidIdentifier=62102, DcmDspDidInfoRef=DidInfo_TripComputerAvgVehicleSpeed
            TripComputerAvgVehicleSpeed (DcmDspDidSignal): DcmDspDidDataPos=0, DcmDspDidDataRef=TripComputerAvgVehicleSpeed_TripComputerAvgVehicleSpeed
          TripComputerDrivingTime: DcmDspDidIdentifier=62103, DcmDspDidInfoRef=DidInfo_TripComputerDrivingTime
            TripComputerDrivingTime (DcmDspDidSignal): DcmDspDidDataPos=0, DcmDspDidDataRef=TripComputerDrivingTime_TripComputerDrivingTime
          TripComputerTripDistance: DcmDspDidIdentifier=62104, DcmDspDidInfoRef=DidInfo_TripComputerTripDistance
            TripComputerTripDistance (DcmDspDidSignal): DcmDspDidDataPos=0, DcmDspDidDataRef=TripComputerTripDistance_TripComputerTripDistance
          ConfigurationInformation: DcmDspDidIdentifier=64768, DcmDspDidInfoRef=DidInfo_ConfigurationInformation
            Configuration (DcmDspDidSignal): DcmDspDidDataPos=0, DcmDspDidDataRef=ConfigurationInformation_Configuration
          SOCPBLBootloaderVersion: DcmDspDidIdentifier=64773, DcmDspDidInfoRef=DidInfo_SOCPBLBootloaderVersion
            SOCPBLBootloaderVersion (DcmDspDidSignal): DcmDspDidDataPos=0, DcmDspDidDataRef=SOCPBLBootloaderVersion_SOCPBLBootloaderVersion
          SOCXBLBootloaderVersion: DcmDspDidIdentifier=64774, DcmDspDidInfoRef=DidInfo_SOCXBLBootloaderVersion
            SOCXBLBootloaderVersion (DcmDspDidSignal): DcmDspDidDataPos=0, DcmDspDidDataRef=SOCXBLBootloaderVersion_SOCXBLBootloaderVersion
          SOCABLBootloaderVersion: DcmDspDidIdentifier=64775, DcmDspDidInfoRef=DidInfo_SOCABLBootloaderVersion
            SOCABLBootloaderVersion (DcmDspDidSignal): DcmDspDidDataPos=0, DcmDspDidDataRef=SOCABLBootloaderVersion_SOCABLBootloaderVersion
          InternalComponentsVoltage: DcmDspDidIdentifier=64785, DcmDspDidInfoRef=DidInfo_InternalComponentsVoltage
            InternalComponentsVoltage (DcmDspDidSignal): DcmDspDidDataPos=0, DcmDspDidDataRef=InternalComponentsVoltage_InternalComponentsVoltage
          SleepMode: DcmDspDidIdentifier=64786, DcmDspDidInfoRef=DidInfo_SleepMode
            Power_State (DcmDspDidSignal): DcmDspDidDataPos=0, DcmDspDidDataRef=SleepMode_Power_State
          SkipHighTemperaturewarning: DcmDspDidIdentifier=64792, DcmDspDidInfoRef=DidInfo_SkipHighTemperaturewarning
            Skip_UserInfo_Input (DcmDspDidSignal): DcmDspDidDataPos=0, DcmDspDidDataRef=SkipHighTemperaturewarning_Skip_UserInfo_Input
          WriteEOLFactoryMode: DcmDspDidIdentifier=64793, DcmDspDidInfoRef=DidInfo_WriteEOLFactoryMode
            Factory_Mode (DcmDspDidSignal): DcmDspDidDataPos=0, DcmDspDidDataRef=WriteEOLFactoryMode_Factory_Mode
          FM_RSQ: DcmDspDidIdentifier=64800, DcmDspDidInfoRef=DidInfo_FM_RSQ
            FM_RSQ (DcmDspDidSignal): DcmDspDidDataPos=0, DcmDspDidDataRef=FM_RSQ_FM_RSQ
          DID_0xFD1A_1: DcmDspDidIdentifier=64803, DcmDspDidInfoRef=DidInfo_DID_0xFD1A_1
            ECU_error_log (DcmDspDidSignal): DcmDspDidDataPos=0, DcmDspDidDataRef=DID_0xFD1A_1_ECU_error_log
          DID_0xFD41_1: DcmDspDidIdentifier=64833, DcmDspDidInfoRef=DidInfo_DID_0xFD41_1
            New_Data_Object (DcmDspDidSignal): DcmDspDidDataPos=0, DcmDspDidDataRef=DID_0xFD41_1_New_Data_Object
          EthernetLinkStatus: DcmDspDidIdentifier=64850, DcmDspDidInfoRef=DidInfo_EthernetLinkStatus
            Ethernet_Link_Status (DcmDspDidSignal): DcmDspDidDataPos=0, DcmDspDidDataRef=EthernetLinkStatus_Ethernet_Link_Status
          EthernetSQL: DcmDspDidIdentifier=64851, DcmDspDidInfoRef=DidInfo_EthernetSQL
            Ethernet_SQL (DcmDspDidSignal): DcmDspDidDataPos=0, DcmDspDidDataRef=EthernetSQL_Ethernet_SQL
          PHYMaster_SlaveMode: DcmDspDidIdentifier=64853, DcmDspDidInfoRef=DidInfo_PHYMaster_SlaveMode
            Master_Slave (DcmDspDidSignal): DcmDspDidDataPos=0, DcmDspDidDataRef=PHYMaster_SlaveMode_Master_Slave
          EthernetMacAddress: DcmDspDidIdentifier=64854, DcmDspDidInfoRef=DidInfo_EthernetMacAddress
            Mac_Address (DcmDspDidSignal): DcmDspDidDataPos=0, DcmDspDidDataRef=EthernetMacAddress_Mac_Address
          ParkingReducevolumelevel: DcmDspDidIdentifier=64871, DcmDspDidInfoRef=DidInfo_ParkingReducevolumelevel
            Parking_Reduce_Volume_Level (DcmDspDidSignal): DcmDspDidDataPos=0, DcmDspDidDataRef=ParkingReducevolumelevel_Parking_Reduce_Volume_Level
          NaviReducevolumelevel: DcmDspDidIdentifier=64872, DcmDspDidInfoRef=DidInfo_NaviReducevolumelevel
            Navi_Reduce_Volume_Level (DcmDspDidSignal): DcmDspDidDataPos=0, DcmDspDidDataRef=NaviReducevolumelevel_Navi_Reduce_Volume_Level
          USB_iPod_Forward_Rewind: DcmDspDidIdentifier=64898, DcmDspDidInfoRef=DidInfo_USB_iPod_Forward_Rewind
            Forward_Rewind (DcmDspDidSignal): DcmDspDidDataPos=0, DcmDspDidDataRef=USB_iPod_Forward_Rewind_Forward_Rewind
          PlayUSBDesiredFile_DesiredTime: DcmDspDidIdentifier=64900, DcmDspDidInfoRef=DidInfo_PlayUSBDesiredFile_DesiredTime
            PlayUSBDesiredFile_DesiredTime (DcmDspDidSignal): DcmDspDidDataPos=0, DcmDspDidDataRef=PlayUSBDesiredFile_DesiredTime_PlayUSBDesiredFile_DesiredTime
          PlayiPodDesiredFile: DcmDspDidIdentifier=64901, DcmDspDidInfoRef=DidInfo_PlayiPodDesiredFile
            Desired_File (DcmDspDidSignal): DcmDspDidDataPos=0, DcmDspDidDataRef=PlayiPodDesiredFile_Desired_File
          USB_iPodCurrentState: DcmDspDidIdentifier=64902, DcmDspDidInfoRef=DidInfo_USB_iPodCurrentState
            USB_iPodCurrentState (DcmDspDidSignal): DcmDspDidDataPos=0, DcmDspDidDataRef=USB_iPodCurrentState_USB_iPodCurrentState
          EjectCDCommand: DcmDspDidIdentifier=64912, DcmDspDidInfoRef=DidInfo_EjectCDCommand
            Eject_CD (DcmDspDidSignal): DcmDspDidDataPos=0, DcmDspDidDataRef=EjectCDCommand_Eject_CD
          CDPlay_Pause: DcmDspDidIdentifier=64913, DcmDspDidInfoRef=DidInfo_CDPlay_Pause
            Play_Pause (DcmDspDidSignal): DcmDspDidDataPos=0, DcmDspDidDataRef=CDPlay_Pause_Play_Pause
          CDPlayMode: DcmDspDidIdentifier=64914, DcmDspDidInfoRef=DidInfo_CDPlayMode
            Play_Mode (DcmDspDidSignal): DcmDspDidDataPos=0, DcmDspDidDataRef=CDPlayMode_Play_Mode
          CDFastForward_Rewind: DcmDspDidIdentifier=64915, DcmDspDidInfoRef=DidInfo_CDFastForward_Rewind
            Forward_Rewind (DcmDspDidSignal): DcmDspDidDataPos=0, DcmDspDidDataRef=CDFastForward_Rewind_Forward_Rewind
          CDSkipTrack: DcmDspDidIdentifier=64916, DcmDspDidInfoRef=DidInfo_CDSkipTrack
            Next_Previous (DcmDspDidSignal): DcmDspDidDataPos=0, DcmDspDidDataRef=CDSkipTrack_Next_Previous
          CDCurrentStatus: DcmDspDidIdentifier=64917, DcmDspDidInfoRef=DidInfo_CDCurrentStatus
            Absolutely_file_number (DcmDspDidSignal): DcmDspDidDataPos=0, DcmDspDidDataRef=CDCurrentStatus_Absolutely_file_number
          FMPSName: DcmDspDidIdentifier=64930, DcmDspDidInfoRef=DidInfo_FMPSName
            Curent_Station_PS_Name (DcmDspDidSignal): DcmDspDidDataPos=0, DcmDspDidDataRef=FMPSName_Curent_Station_PS_Name
          FM_AMPreset: DcmDspDidIdentifier=64932, DcmDspDidInfoRef=DidInfo_FM_AMPreset
            Preset_number (DcmDspDidSignal): DcmDspDidDataPos=0, DcmDspDidDataRef=FM_AMPreset_Preset_number
          TunerProperty: DcmDspDidIdentifier=64936, DcmDspDidInfoRef=DidInfo_TunerProperty
            Tuner_Property (DcmDspDidSignal): DcmDspDidDataPos=0, DcmDspDidDataRef=TunerProperty_Tuner_Property
          AGCStatus: DcmDspDidIdentifier=64937, DcmDspDidInfoRef=DidInfo_AGCStatus
            AGC_Status (DcmDspDidSignal): DcmDspDidDataPos=0, DcmDspDidDataRef=AGCStatus_AGC_Status
          FMSERVO: DcmDspDidIdentifier=64938, DcmDspDidInfoRef=DidInfo_FMSERVO
            FM_SERVO (DcmDspDidSignal): DcmDspDidDataPos=0, DcmDspDidDataRef=FMSERVO_FM_SERVO
          FMSERVOTransform: DcmDspDidIdentifier=64939, DcmDspDidInfoRef=DidInfo_FMSERVOTransform
            FM_SERVO_Transform (DcmDspDidSignal): DcmDspDidDataPos=0, DcmDspDidDataRef=FMSERVOTransform_FM_SERVO_Transform
          AMSERVO: DcmDspDidIdentifier=64940, DcmDspDidInfoRef=DidInfo_AMSERVO
            AM_SERVO (DcmDspDidSignal): DcmDspDidDataPos=0, DcmDspDidDataRef=AMSERVO_AM_SERVO
          AMSERVOTransform: DcmDspDidIdentifier=64941, DcmDspDidInfoRef=DidInfo_AMSERVOTransform
            AM_SERVO_Transform (DcmDspDidSignal): DcmDspDidDataPos=0, DcmDspDidDataRef=AMSERVOTransform_AM_SERVO_Transform
          SetTunerRegister: DcmDspDidIdentifier=64942, DcmDspDidInfoRef=DidInfo_SetTunerRegister
            Tuner_Register (DcmDspDidSignal): DcmDspDidDataPos=0, DcmDspDidDataRef=SetTunerRegister_Tuner_Register
          GetFMRSQ: DcmDspDidIdentifier=64943, DcmDspDidInfoRef=DidInfo_GetFMRSQ
            FM_RSQ (DcmDspDidSignal): DcmDspDidDataPos=0, DcmDspDidDataRef=GetFMRSQ_FM_RSQ
          GPSInformation: DcmDspDidIdentifier=64967, DcmDspDidInfoRef=DidInfo_GPSInformation
            GPSInformation (DcmDspDidSignal): DcmDspDidDataPos=0, DcmDspDidDataRef=GPSInformation_GPSInformation
          RVC_AVMCameraStatus: DcmDspDidIdentifier=64980, DcmDspDidInfoRef=DidInfo_RVC_AVMCameraStatus
            RVC_AVM (DcmDspDidSignal): DcmDspDidDataPos=0, DcmDspDidDataRef=RVC_AVMCameraStatus_RVC_AVM
          DMSCameraStatus: DcmDspDidIdentifier=64981, DcmDspDidInfoRef=DidInfo_DMSCameraStatus
            DMS (DcmDspDidSignal): DcmDspDidDataPos=0, DcmDspDidDataRef=DMSCameraStatus_DMS
          ExternalAVMCameraStatus: DcmDspDidIdentifier=64989, DcmDspDidInfoRef=DidInfo_ExternalAVMCameraStatus
            ExternalAVMCameraStatus (DcmDspDidSignal): DcmDspDidDataPos=0, DcmDspDidDataRef=ExternalAVMCameraStatus_ExternalAVMCameraStatus
          DVRCameraStatus: DcmDspDidIdentifier=64990, DcmDspDidInfoRef=DidInfo_DVRCameraStatus
            DMS_camera_status (DcmDspDidSignal): DcmDspDidDataPos=0, DcmDspDidDataRef=DVRCameraStatus_DMS_camera_status
          In_CarCameraStatus: DcmDspDidIdentifier=64991, DcmDspDidInfoRef=DidInfo_In_CarCameraStatus
            In_Car_camera_status (DcmDspDidSignal): DcmDspDidDataPos=0, DcmDspDidDataRef=In_CarCameraStatus_In_Car_camera_status
          ADCErrorLog: DcmDspDidIdentifier=64992, DcmDspDidInfoRef=DidInfo_ADCErrorLog
            ADCErrorLog (DcmDspDidSignal): DcmDspDidDataPos=0, DcmDspDidDataRef=ADCErrorLog_ADCErrorLog
          EEPROMValue: DcmDspDidIdentifier=64995, DcmDspDidInfoRef=DidInfo_EEPROMValue
            EEPROMValue (DcmDspDidSignal): DcmDspDidDataPos=0, DcmDspDidDataRef=EEPROMValue_EEPROMValue
          OverHeatProtectionSwitch: DcmDspDidIdentifier=64996, DcmDspDidInfoRef=DidInfo_OverHeatProtectionSwitch
            Status (DcmDspDidSignal): DcmDspDidDataPos=0, DcmDspDidDataRef=OverHeatProtectionSwitch_Status
          HighTempWarningTemperatureSet: DcmDspDidIdentifier=64997, DcmDspDidInfoRef=DidInfo_HighTempWarningTemperatureSet
            Temperature (DcmDspDidSignal): DcmDspDidDataPos=0, DcmDspDidDataRef=HighTempWarningTemperatureSet_Temperature
          IVIDisplayManufactureDate: DcmDspDidIdentifier=64998, DcmDspDidInfoRef=DidInfo_IVIDisplayManufactureDate
            IVIDisplayManufactureDate (DcmDspDidSignal): DcmDspDidDataPos=0, DcmDspDidDataRef=IVIDisplayManufactureDate_IVIDisplayManufactureDate
          SparePartnumber: DcmDspDidIdentifier=64999, DcmDspDidInfoRef=DidInfo_SparePartnumber
            SparePartnumber (DcmDspDidSignal): DcmDspDidDataPos=0, DcmDspDidDataRef=SparePartnumber_SparePartnumber
          SoftwareVersion: DcmDspDidIdentifier=65000, DcmDspDidInfoRef=DidInfo_SoftwareVersion
            SoftwareVersion (DcmDspDidSignal): DcmDspDidDataPos=0, DcmDspDidDataRef=SoftwareVersion_SoftwareVersion
          DID_0xFDF9: DcmDspDidIdentifier=65001, DcmDspDidInfoRef=DidInfo_DID_0xFDF9
            HardwareVersion (DcmDspDidSignal): DcmDspDidDataPos=0, DcmDspDidDataRef=DID_0xFDF9_HardwareVersion
          IVIDisplayThemes: DcmDspDidIdentifier=65010, DcmDspDidInfoRef=DidInfo_IVIDisplayThemes
            Themes (DcmDspDidSignal): DcmDspDidDataPos=0, DcmDspDidDataRef=IVIDisplayThemes_Themes
          IVIDisplayLinkStatus: DcmDspDidIdentifier=65011, DcmDspDidInfoRef=DidInfo_IVIDisplayLinkStatus
            LVDS_Link_Status (DcmDspDidSignal): DcmDspDidDataPos=0, DcmDspDidDataRef=IVIDisplayLinkStatus_LVDS_Link_Status
          ClusterThemes: DcmDspDidIdentifier=65024, DcmDspDidInfoRef=DidInfo_ClusterThemes
            Themes (DcmDspDidSignal): DcmDspDidDataPos=0, DcmDspDidDataRef=ClusterThemes_Themes
          ClusterStartupAnimationSwitch: DcmDspDidIdentifier=65025, DcmDspDidInfoRef=DidInfo_ClusterStartupAnimationSwitch
            Animation_ON_OFF (DcmDspDidSignal): DcmDspDidDataPos=0, DcmDspDidDataRef=ClusterStartupAnimationSwitch_Animation_ON_OFF
          TelltaleTest: DcmDspDidIdentifier=65027, DcmDspDidInfoRef=DidInfo_TelltaleTest
            TellTale_Value (DcmDspDidSignal): DcmDspDidDataPos=0, DcmDspDidDataRef=TelltaleTest_TellTale_Value
          ClusterDisplayLinkStatus: DcmDspDidIdentifier=65028, DcmDspDidInfoRef=DidInfo_ClusterDisplayLinkStatus
            LVDS_Link_Status (DcmDspDidSignal): DcmDspDidDataPos=0, DcmDspDidDataRef=ClusterDisplayLinkStatus_LVDS_Link_Status
          ControlDisplayThemes: DcmDspDidIdentifier=65041, DcmDspDidInfoRef=DidInfo_ControlDisplayThemes
            Themes (DcmDspDidSignal): DcmDspDidDataPos=0, DcmDspDidDataRef=ControlDisplayThemes_Themes
          ControlDisplayLinkStatus: DcmDspDidIdentifier=65042, DcmDspDidInfoRef=DidInfo_ControlDisplayLinkStatus
            LVDS_Link_Status (DcmDspDidSignal): DcmDspDidDataPos=0, DcmDspDidDataRef=ControlDisplayLinkStatus_LVDS_Link_Status
          HUDSwitch: DcmDspDidIdentifier=65056, DcmDspDidInfoRef=DidInfo_HUDSwitch
            HUD_ON_OFF (DcmDspDidSignal): DcmDspDidDataPos=0, DcmDspDidDataRef=HUDSwitch_HUD_ON_OFF
          HUDHeight: DcmDspDidIdentifier=65057, DcmDspDidInfoRef=DidInfo_HUDHeight
            HUD_Height (DcmDspDidSignal): DcmDspDidDataPos=0, DcmDspDidDataRef=HUDHeight_HUD_Height
          HUDBrightness: DcmDspDidIdentifier=65058, DcmDspDidInfoRef=DidInfo_HUDBrightness
            Brightness (DcmDspDidSignal): DcmDspDidDataPos=0, DcmDspDidDataRef=HUDBrightness_Brightness
          HUDRotationSet: DcmDspDidIdentifier=65059, DcmDspDidInfoRef=DidInfo_HUDRotationSet
            Rotation_Direction (DcmDspDidSignal): DcmDspDidDataPos=0, DcmDspDidDataRef=HUDRotationSet_Rotation_Direction
          HUDDisplayMode: DcmDspDidIdentifier=65060, DcmDspDidInfoRef=DidInfo_HUDDisplayMode
            Display_Mode (DcmDspDidSignal): DcmDspDidDataPos=0, DcmDspDidDataRef=HUDDisplayMode_Display_Mode
          HUDDisplayContent: DcmDspDidIdentifier=65061, DcmDspDidInfoRef=DidInfo_HUDDisplayContent
            HUDDisplayContent (DcmDspDidSignal): DcmDspDidDataPos=0, DcmDspDidDataRef=HUDDisplayContent_HUDDisplayContent
          HUDDisplayLinkStatus: DcmDspDidIdentifier=65062, DcmDspDidInfoRef=DidInfo_HUDDisplayLinkStatus
            LVDS_Link_Status (DcmDspDidSignal): DcmDspDidDataPos=0, DcmDspDidDataRef=HUDDisplayLinkStatus_LVDS_Link_Status
          PassengerDisplayLinkStatus: DcmDspDidIdentifier=65073, DcmDspDidInfoRef=DidInfo_PassengerDisplayLinkStatus
            LVDS_Link_Status (DcmDspDidSignal): DcmDspDidDataPos=0, DcmDspDidDataRef=PassengerDisplayLinkStatus_LVDS_Link_Status
          IVI_Touch_Information: DcmDspDidIdentifier=65088, DcmDspDidInfoRef=DidInfo_IVI_Touch_Information
            Touch_information (DcmDspDidSignal): DcmDspDidDataPos=0, DcmDspDidDataRef=IVI_Touch_Information_Touch_information
          ControlTouchInformation: DcmDspDidIdentifier=65089, DcmDspDidInfoRef=DidInfo_ControlTouchInformation
            Touch_information (DcmDspDidSignal): DcmDspDidDataPos=0, DcmDspDidDataRef=ControlTouchInformation_Touch_information
          PassengerTouchInformation: DcmDspDidIdentifier=65090, DcmDspDidInfoRef=DidInfo_PassengerTouchInformation
            IVI_Gesture_information (DcmDspDidSignal): DcmDspDidDataPos=0, DcmDspDidDataRef=PassengerTouchInformation_IVI_Gesture_information
          IVIGestureInformation: DcmDspDidIdentifier=65091, DcmDspDidInfoRef=DidInfo_IVIGestureInformation
            Touch_information (DcmDspDidSignal): DcmDspDidDataPos=0, DcmDspDidDataRef=IVIGestureInformation_Touch_information
          PassengerGestureInformation: DcmDspDidIdentifier=65092, DcmDspDidInfoRef=DidInfo_PassengerGestureInformation
            Passenger_Gesture_information (DcmDspDidSignal): DcmDspDidDataPos=0, DcmDspDidDataRef=PassengerGestureInformation_Passenger_Gesture_information
          HUTDisplaySignalStandard: DcmDspDidIdentifier=65263, DcmDspDidInfoRef=DidInfo_HUTDisplaySignalStandard
            INVALID_SHORTNAME_HUTDisplaySignalStandard (DcmDspDidSignal): DcmDspDidDataPos=0, DcmDspDidDataRef=HUTDisplaySignalStandard_HUTDisplaySignalStandard
          HUTDisplayScreenType: DcmDspDidIdentifier=65264, DcmDspDidInfoRef=DidInfo_HUTDisplayScreenType
            HUTDisplayScreenType (DcmDspDidSignal): DcmDspDidDataPos=0, DcmDspDidDataRef=HUTDisplayScreenType_HUTDisplayScreenType
          HUTDisplayResolution: DcmDspDidIdentifier=65265, DcmDspDidInfoRef=DidInfo_HUTDisplayResolution
            HUTDisplayResolution (DcmDspDidSignal): DcmDspDidDataPos=0, DcmDspDidDataRef=HUTDisplayResolution_HUTDisplayResolution
          HUTDisplayScreenSize: DcmDspDidIdentifier=65266, DcmDspDidInfoRef=DidInfo_HUTDisplayScreenSize
            HUTDisplayScreenSize (DcmDspDidSignal): DcmDspDidDataPos=0, DcmDspDidDataRef=HUTDisplayScreenSize_HUTDisplayScreenSize
          HUTDisplaySupplierInformation: DcmDspDidIdentifier=65267, DcmDspDidInfoRef=DidInfo_HUTDisplaySupplierInformation
            HUT_Display_Supplier_Information (DcmDspDidSignal): DcmDspDidDataPos=0, DcmDspDidDataRef=HUTDisplaySupplierInformation_HUT_Display_Supplier_Information
          HUTDisplayTPVersionNumber: DcmDspDidIdentifier=65268, DcmDspDidInfoRef=DidInfo_HUTDisplayTPVersionNumber
            HUTDisplayTPVersionNumber (DcmDspDidSignal): DcmDspDidDataPos=0, DcmDspDidDataRef=HUTDisplayTPVersionNumber_HUTDisplayTPVersionNumber
          HUTDisplayTemperature: DcmDspDidIdentifier=65269, DcmDspDidInfoRef=DidInfo_HUTDisplayTemperature
            HUT_Display_LCD_Temperature (DcmDspDidSignal): DcmDspDidDataPos=0, DcmDspDidDataRef=HUTDisplayTemperature_HUT_Display_LCD_Temperature
          HUTDisplayManufacturingDate: DcmDspDidIdentifier=65270, DcmDspDidInfoRef=DidInfo_HUTDisplayManufacturingDate
            HUTDisplayManufacturingDate (DcmDspDidSignal): DcmDspDidDataPos=0, DcmDspDidDataRef=HUTDisplayManufacturingDate_HUTDisplayManufacturingDate
          HUTDisplaySparePartNumber: DcmDspDidIdentifier=65271, DcmDspDidInfoRef=DidInfo_HUTDisplaySparePartNumber
            HUTDisplaySparePartNumber (DcmDspDidSignal): DcmDspDidDataPos=0, DcmDspDidDataRef=HUTDisplaySparePartNumber_HUTDisplaySparePartNumber
          HUTDisplaySoftwareVersionNumber: DcmDspDidIdentifier=65272, DcmDspDidInfoRef=DidInfo_HUTDisplaySoftwareVersionNumber
            HUTDisplaySoftwareVersionNumber (DcmDspDidSignal): DcmDspDidDataPos=0, DcmDspDidDataRef=HUTDisplaySoftwareVersionNumber_HUTDisplaySoftwareVersionNumber
          HUTDisplayHardwareVersionNumber: DcmDspDidIdentifier=65273, DcmDspDidInfoRef=DidInfo_HUTDisplayHardwareVersionNumber
            HUTDisplayHardwareVersionNumber (DcmDspDidSignal): DcmDspDidDataPos=0, DcmDspDidDataRef=HUTDisplayHardwareVersionNumber_HUTDisplayHardwareVersionNumber
          IPDisplaySession: DcmDspDidIdentifier=65274, DcmDspDidInfoRef=DidInfo_IPDisplaySession
            IPDisplaySession (DcmDspDidSignal): DcmDspDidDataPos=0, DcmDspDidDataRef=IPDisplaySession_IPDisplaySession
          IPDisplayTemperature: DcmDspDidIdentifier=65275, DcmDspDidInfoRef=DidInfo_IPDisplayTemperature
            IPDisplayTemperature (DcmDspDidSignal): DcmDspDidDataPos=0, DcmDspDidDataRef=IPDisplayTemperature_IPDisplayTemperature
          IPDisplayManufacturingDate: DcmDspDidIdentifier=65276, DcmDspDidInfoRef=DidInfo_IPDisplayManufacturingDate
            IPDisplayManufacturingDate (DcmDspDidSignal): DcmDspDidDataPos=0, DcmDspDidDataRef=IPDisplayManufacturingDate_IPDisplayManufacturingDate
          IPDisplaySparePartNumber: DcmDspDidIdentifier=65277, DcmDspDidInfoRef=DidInfo_IPDisplaySparePartNumber
            IPDisplaSparePartNumber (DcmDspDidSignal): DcmDspDidDataPos=0, DcmDspDidDataRef=IPDisplaySparePartNumber_IPDisplaSparePartNumber
          IPDisplaySoftwareVersionNumber: DcmDspDidIdentifier=65278, DcmDspDidInfoRef=DidInfo_IPDisplaySoftwareVersionNumber
            IPDisplaySupplierECUSoftwareVersionNumber (DcmDspDidSignal): DcmDspDidDataPos=0, DcmDspDidDataRef=IPDisplaySoftwareVersionNumber_IPDisplaySupplierECUSoftwareVersionNumber
          IPDisplayHardwareVersionNumber: DcmDspDidIdentifier=65279, DcmDspDidInfoRef=DidInfo_IPDisplayHardwareVersionNumber
            IPDisplayHardwareVersionNumber (DcmDspDidSignal): DcmDspDidDataPos=0, DcmDspDidDataRef=IPDisplayHardwareVersionNumber_IPDisplayHardwareVersionNumber
