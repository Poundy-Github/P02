[part 3 of 3: package /InitialEcuC]
AUTOSAR XML (schema 00046)
package /InitialEcuC  (continued)
  module config Dem: module-description=Dem_Impl
    DemConfigSet
      DTCClass_DTC_0x908987 (DemDTCClass): DemDTCSeverity=DEM_DTC_SEV_NO_SEVERITY, DemUdsDTC=9472391
      Lost_communication_with_RVC_Missing_Message (DemEventParameter):
        DemEventKind = DEM_EVENT_KIND_SWC
        DemMaxNumberFreezeFrameRecords = 1
        DemEventLatchTestFailed = false
        DemDTCClassRef = DTCClass_DTC_0x908987
        DemExtendedDataClassRef = ExtendedDataClass_4f5344cd
        DemFreezeFrameClassRef = FreezeFrameClass_80c88891
        DemEventClass:
          DemAgingAllowed = true
          DemAgingCycleCounterThreshold = 40
          DemEventDestination = DEM_DTC_ORIGIN_PRIMARY_MEMORY
          DemEventPriority = 2
          DemEventSignificance = DEM_EVENT_SIGNIFICANCE_FAULT
          DemAgingCycleRef = Ignition_on_off
          DemOperationCycleRef = Ignition_on_off
          DemDebounceAlgorithmClass
            DemDebounceMonitorInternal
              DemCallbackGetFDC
      DTCClass_DTC_0x908a87 (DemDTCClass): DemDTCSeverity=DEM_DTC_SEV_NO_SEVERITY, DemUdsDTC=9472647
      Lost_communication_with_AVM_Missing_Message (DemEventParameter):
        DemEventKind = DEM_EVENT_KIND_SWC
        DemMaxNumberFreezeFrameRecords = 1
        DemEventLatchTestFailed = false
        DemDTCClassRef = DTCClass_DTC_0x908a87
        DemExtendedDataClassRef = ExtendedDataClass_4f5344cd
        DemFreezeFrameClassRef = FreezeFrameClass_80c88891
        DemEventClass:
          DemAgingAllowed = true
          DemAgingCycleCounterThreshold = 40
          DemEventDestination = DEM_DTC_ORIGIN_PRIMARY_MEMORY
          DemEventPriority = 2
          DemEventSignificance = DEM_EVENT_SIGNIFICANCE_FAULT
          DemAgingCycleRef = Ignition_on_off
          DemOperationCycleRef = Ignition_on_off
          DemDebounceAlgorithmClass
            DemDebounceMonitorInternal
              DemCallbackGetFDC
      DTCClass_DTC_0x908b87 (DemDTCClass): DemDTCSeverity=DEM_DTC_SEV_NO_SEVERITY, DemUdsDTC=9472903
      Lost_communication_with_W_HUD_Missing_Message (DemEventParameter):
        DemEventKind = DEM_EVENT_KIND_SWC
        DemMaxNumberFreezeFrameRecords = 1
        DemEventLatchTestFailed = false
        DemDTCClassRef = DTCClass_DTC_0x908b87
        DemExtendedDataClassRef = ExtendedDataClass_4f5344cd
        DemFreezeFrameClassRef = FreezeFrameClass_80c88891
        DemEventClass:
          DemAgingAllowed = true
          DemAgingCycleCounterThreshold = 40
          DemEventDestination = DEM_DTC_ORIGIN_PRIMARY_MEMORY
          DemEventPriority = 2
          DemEventSignificance = DEM_EVENT_SIGNIFICANCE_FAULT
          DemAgingCycleRef = Ignition_on_off
          DemOperationCycleRef = Ignition_on_off
          DemDebounceAlgorithmClass
            DemDebounceMonitorInternal
              DemCallbackGetFDC
      DTCClass_DTC_0x908d87 (DemDTCClass): DemDTCSeverity=DEM_DTC_SEV_NO_SEVERITY, DemUdsDTC=9473415
      Lost_communication_with_IP_Display_Front_Missing_Message (DemEventParameter):
        DemEventKind = DEM_EVENT_KIND_SWC
        DemMaxNumberFreezeFrameRecords = 1
        DemEventLatchTestFailed = false
        DemDTCClassRef = DTCClass_DTC_0x908d87
        DemExtendedDataClassRef = ExtendedDataClass_4f5344cd
        DemFreezeFrameClassRef = FreezeFrameClass_80c88891
        DemEventClass:
          DemAgingAllowed = true
          DemAgingCycleCounterThreshold = 40
          DemEventDestination = DEM_DTC_ORIGIN_PRIMARY_MEMORY
          DemEventPriority = 2
          DemEventSignificance = DEM_EVENT_SIGNIFICANCE_FAULT
          DemAgingCycleRef = Ignition_on_off
          DemOperationCycleRef = Ignition_on_off
          DemDebounceAlgorithmClass
            DemDebounceMonitorInternal
              DemCallbackGetFDC
      DTCClass_DTC_0x908e87 (DemDTCClass): DemDTCSeverity=DEM_DTC_SEV_NO_SEVERITY, DemUdsDTC=9473671
      Lost_communication_with_IVI_Display_Front_Missing_Message (DemEventParameter):
        DemEventKind = DEM_EVENT_KIND_SWC
        DemMaxNumberFreezeFrameRecords = 1
        DemEventLatchTestFailed = false
        DemDTCClassRef = DTCClass_DTC_0x908e87
        DemExtendedDataClassRef = ExtendedDataClass_4f5344cd
        DemFreezeFrameClassRef = FreezeFrameClass_80c88891
        DemEventClass:
          DemAgingAllowed = true
          DemAgingCycleCounterThreshold = 40
          DemEventDestination = DEM_DTC_ORIGIN_PRIMARY_MEMORY
          DemEventPriority = 2
          DemEventSignificance = DEM_EVENT_SIGNIFICANCE_FAULT
          DemAgingCycleRef = Ignition_on_off
          DemOperationCycleRef = Ignition_on_off
          DemDebounceAlgorithmClass
            DemDebounceMonitorInternal
              DemCallbackGetFDC
      DTCClass_DTC_0x927312 (DemDTCClass): DemDTCSeverity=DEM_DTC_SEV_NO_SEVERITY, DemUdsDTC=9597714
      Fuel_sensor1_short_to_BAT_Circuit_Short_To_Battery (DemEventParameter):
        DemEventKind = DEM_EVENT_KIND_SWC
        DemMaxNumberFreezeFrameRecords = 1
        DemEventLatchTestFailed = false
        DemDTCClassRef = DTCClass_DTC_0x927312
        DemExtendedDataClassRef = ExtendedDataClass_4f5344cd
        DemFreezeFrameClassRef = FreezeFrameClass_80c88891
        DemEventClass:
          DemAgingAllowed = true
          DemAgingCycleCounterThreshold = 40
          DemEventDestination = DEM_DTC_ORIGIN_PRIMARY_MEMORY
          DemEventPriority = 2
          DemEventSignificance = DEM_EVENT_SIGNIFICANCE_FAULT
          DemAgingCycleRef = Ignition_on_off
          DemEnableConditionGroupRef = EnableConditionGroup_IgnOn
          DemOperationCycleRef = Ignition_on_off
          DemDebounceAlgorithmClass
            DemDebounceTimeBase: DemDebounceTimeFailedThreshold=3, DemDebounceTimePassedThreshold=3, DemDebounceBehavior=DEM_DEBOUNCE_FREEZE
      DTCClass_DTC_0x927344 (DemDTCClass): DemDTCSeverity=DEM_DTC_SEV_NO_SEVERITY, DemUdsDTC=9597764
      ODO_Failure_Data_Memory_Failure (DemEventParameter):
        DemEventKind = DEM_EVENT_KIND_SWC
        DemMaxNumberFreezeFrameRecords = 1
        DemEventLatchTestFailed = false
        DemDTCClassRef = DTCClass_DTC_0x927344
        DemExtendedDataClassRef = ExtendedDataClass_4f5344cd
        DemFreezeFrameClassRef = FreezeFrameClass_80c88891
        DemEventClass:
          DemAgingAllowed = true
          DemAgingCycleCounterThreshold = 40
          DemEventDestination = DEM_DTC_ORIGIN_PRIMARY_MEMORY
          DemEventPriority = 2
          DemEventSignificance = DEM_EVENT_SIGNIFICANCE_FAULT
          DemAgingCycleRef = Ignition_on_off
          DemEnableConditionGroupRef = EnableConditionGroup_IgnOn
          DemOperationCycleRef = Ignition_on_off
          DemDebounceAlgorithmClass
            DemDebounceMonitorInternal
              DemCallbackGetFDC
      DTCClass_DTC_0x927412 (DemDTCClass): DemDTCSeverity=DEM_DTC_SEV_NO_SEVERITY, DemUdsDTC=9597970
      Fuel_sensor2_short_to_BAT_Circuit_Short_To_Battery (DemEventParameter):
        DemEventKind = DEM_EVENT_KIND_SWC
        DemMaxNumberFreezeFrameRecords = 1
        DemEventLatchTestFailed = false
        DemDTCClassRef = DTCClass_DTC_0x927412
        DemExtendedDataClassRef = ExtendedDataClass_4f5344cd
        DemFreezeFrameClassRef = FreezeFrameClass_80c88891
        DemEventClass:
          DemAgingAllowed = true
          DemAgingCycleCounterThreshold = 40
          DemEventDestination = DEM_DTC_ORIGIN_PRIMARY_MEMORY
          DemEventPriority = 2
          DemEventSignificance = DEM_EVENT_SIGNIFICANCE_FAULT
          DemAgingCycleRef = Ignition_on_off
          DemEnableConditionGroupRef = EnableConditionGroup_IgnOn
          DemOperationCycleRef = Ignition_on_off
          DemDebounceAlgorithmClass
            DemDebounceTimeBase: DemDebounceTimeFailedThreshold=3, DemDebounceTimePassedThreshold=3, DemDebounceBehavior=DEM_DEBOUNCE_FREEZE
      DTCClass_DTC_0x92764b (DemDTCClass): DemDTCSeverity=DEM_DTC_SEV_NO_SEVERITY, DemUdsDTC=9598539
      INVALID_SHORTNAME_Over_Temperature_Over_Temperature (DemEventParameter):
        DemEventKind = DEM_EVENT_KIND_SWC
        DemMaxNumberFreezeFrameRecords = 1
        DemEventLatchTestFailed = false
        DemDTCClassRef = DTCClass_DTC_0x92764b
        DemExtendedDataClassRef = ExtendedDataClass_4f5344cd
        DemFreezeFrameClassRef = FreezeFrameClass_80c88891
        DemEventClass:
          DemAgingAllowed = true
          DemAgingCycleCounterThreshold = 40
          DemEventDestination = DEM_DTC_ORIGIN_PRIMARY_MEMORY
          DemEventPriority = 2
          DemEventSignificance = DEM_EVENT_SIGNIFICANCE_FAULT
          DemAgingCycleRef = Ignition_on_off
          DemEnableConditionGroupRef = EnableConditionGroup_IgnOn
          DemOperationCycleRef = Ignition_on_off
          DemDebounceAlgorithmClass
            DemDebounceTimeBase: DemDebounceTimeFailedThreshold=5, DemDebounceTimePassedThreshold=3, DemDebounceBehavior=DEM_DEBOUNCE_FREEZE
      DTCClass_DTC_0x93f511 (DemDTCClass): DemDTCSeverity=DEM_DTC_SEV_NO_SEVERITY, DemUdsDTC=9696529
      Mic_1_short_to_GND_Circuit_Short_To_Ground (DemEventParameter):
        DemEventKind = DEM_EVENT_KIND_SWC
        DemMaxNumberFreezeFrameRecords = 1
        DemEventLatchTestFailed = false
        DemDTCClassRef = DTCClass_DTC_0x93f511
        DemExtendedDataClassRef = ExtendedDataClass_4f5344cd
        DemFreezeFrameClassRef = FreezeFrameClass_80c88891
        DemEventClass:
          DemAgingAllowed = true
          DemAgingCycleCounterThreshold = 40
          DemEventDestination = DEM_DTC_ORIGIN_PRIMARY_MEMORY
          DemEventPriority = 2
          DemEventSignificance = DEM_EVENT_SIGNIFICANCE_FAULT
          DemAgingCycleRef = Ignition_on_off
          DemEnableConditionGroupRef = EnableConditionGroup_PowerModeOn
          DemOperationCycleRef = Ignition_on_off
          DemDebounceAlgorithmClass
            DemDebounceTimeBase: DemDebounceTimeFailedThreshold=5, DemDebounceTimePassedThreshold=1, DemDebounceBehavior=DEM_DEBOUNCE_FREEZE
      DTCClass_DTC_0x93f512 (DemDTCClass): DemDTCSeverity=DEM_DTC_SEV_NO_SEVERITY, DemUdsDTC=9696530
      Mic_1_short_to_BAT_Circuit_Short_To_Battery (DemEventParameter):
        DemEventKind = DEM_EVENT_KIND_SWC
        DemMaxNumberFreezeFrameRecords = 1
        DemEventLatchTestFailed = false
        DemDTCClassRef = DTCClass_DTC_0x93f512
        DemExtendedDataClassRef = ExtendedDataClass_4f5344cd
        DemFreezeFrameClassRef = FreezeFrameClass_80c88891
        DemEventClass:
          DemAgingAllowed = true
          DemAgingCycleCounterThreshold = 40
          DemEventDestination = DEM_DTC_ORIGIN_PRIMARY_MEMORY
          DemEventPriority = 2
          DemEventSignificance = DEM_EVENT_SIGNIFICANCE_FAULT
          DemAgingCycleRef = Ignition_on_off
          DemEnableConditionGroupRef = EnableConditionGroup_PowerModeOn
          DemOperationCycleRef = Ignition_on_off
          DemDebounceAlgorithmClass
            DemDebounceTimeBase: DemDebounceTimeFailedThreshold=5, DemDebounceTimePassedThreshold=1, DemDebounceBehavior=DEM_DEBOUNCE_FREEZE
      DTCClass_DTC_0x93f513 (DemDTCClass): DemDTCSeverity=DEM_DTC_SEV_NO_SEVERITY, DemUdsDTC=9696531
      Mic_1_open_Circuit_Open (DemEventParameter):
        DemEventKind = DEM_EVENT_KIND_SWC
        DemMaxNumberFreezeFrameRecords = 1
        DemEventLatchTestFailed = false
        DemDTCClassRef = DTCClass_DTC_0x93f513
        DemExtendedDataClassRef = ExtendedDataClass_4f5344cd
        DemFreezeFrameClassRef = FreezeFrameClass_80c88891
        DemEventClass:
          DemAgingAllowed = true
          DemAgingCycleCounterThreshold = 40
          DemEventDestination = DEM_DTC_ORIGIN_PRIMARY_MEMORY
          DemEventPriority = 2
          DemEventSignificance = DEM_EVENT_SIGNIFICANCE_FAULT
          DemAgingCycleRef = Ignition_on_off
          DemEnableConditionGroupRef = EnableConditionGroup_PowerModeOn
          DemOperationCycleRef = Ignition_on_off
          DemDebounceAlgorithmClass
            DemDebounceTimeBase: DemDebounceTimeFailedThreshold=5, DemDebounceTimePassedThreshold=1, DemDebounceBehavior=DEM_DEBOUNCE_FREEZE
      DTCClass_DTC_0x93f611 (DemDTCClass): DemDTCSeverity=DEM_DTC_SEV_NO_SEVERITY, DemUdsDTC=9696785
      Mic_2_short_to_GND_Circuit_Short_To_Ground (DemEventParameter):
        DemEventKind = DEM_EVENT_KIND_SWC
        DemMaxNumberFreezeFrameRecords = 1
        DemEventLatchTestFailed = false
        DemDTCClassRef = DTCClass_DTC_0x93f611
        DemExtendedDataClassRef = ExtendedDataClass_4f5344cd
        DemFreezeFrameClassRef = FreezeFrameClass_80c88891
        DemEventClass:
          DemAgingAllowed = true
          DemAgingCycleCounterThreshold = 40
          DemEventDestination = DEM_DTC_ORIGIN_PRIMARY_MEMORY
          DemEventPriority = 2
          DemEventSignificance = DEM_EVENT_SIGNIFICANCE_FAULT
          DemAgingCycleRef = Ignition_on_off
          DemEnableConditionGroupRef = EnableConditionGroup_PowerModeOn
          DemOperationCycleRef = Ignition_on_off
          DemDebounceAlgorithmClass
            DemDebounceTimeBase: DemDebounceTimeFailedThreshold=5, DemDebounceTimePassedThreshold=1, DemDebounceBehavior=DEM_DEBOUNCE_FREEZE
      DTCClass_DTC_0x93f612 (DemDTCClass): DemDTCSeverity=DEM_DTC_SEV_NO_SEVERITY, DemUdsDTC=9696786
      Mic_2_short_to_BAT_Circuit_Short_To_Battery (DemEventParameter):
        DemEventKind = DEM_EVENT_KIND_SWC
        DemMaxNumberFreezeFrameRecords = 1
        DemEventLatchTestFailed = false
        DemDTCClassRef = DTCClass_DTC_0x93f612
        DemExtendedDataClassRef = ExtendedDataClass_4f5344cd
        DemFreezeFrameClassRef = FreezeFrameClass_80c88891
        DemEventClass:
          DemAgingAllowed = true
          DemAgingCycleCounterThreshold = 40
          DemEventDestination = DEM_DTC_ORIGIN_PRIMARY_MEMORY
          DemEventPriority = 2
          DemEventSignificance = DEM_EVENT_SIGNIFICANCE_FAULT
          DemAgingCycleRef = Ignition_on_off
          DemEnableConditionGroupRef = EnableConditionGroup_PowerModeOn
          DemOperationCycleRef = Ignition_on_off
          DemDebounceAlgorithmClass
            DemDebounceTimeBase: DemDebounceTimeFailedThreshold=5, DemDebounceTimePassedThreshold=1, DemDebounceBehavior=DEM_DEBOUNCE_FREEZE
      DTCClass_DTC_0x93f613 (DemDTCClass): DemDTCSeverity=DEM_DTC_SEV_NO_SEVERITY, DemUdsDTC=9696787
      Mic_2_open_Circuit_Open (DemEventParameter):
        DemEventKind = DEM_EVENT_KIND_SWC
        DemMaxNumberFreezeFrameRecords = 1
        DemEventLatchTestFailed = false
        DemDTCClassRef = DTCClass_DTC_0x93f613
        DemExtendedDataClassRef = ExtendedDataClass_4f5344cd
        DemFreezeFrameClassRef = FreezeFrameClass_80c88891
        DemEventClass:
          DemAgingAllowed = true
          DemAgingCycleCounterThreshold = 40
          DemEventDestination = DEM_DTC_ORIGIN_PRIMARY_MEMORY
          DemEventPriority = 2
          DemEventSignificance = DEM_EVENT_SIGNIFICANCE_FAULT
          DemAgingCycleRef = Ignition_on_off
          DemEnableConditionGroupRef = EnableConditionGroup_PowerModeOn
          DemOperationCycleRef = Ignition_on_off
          DemDebounceAlgorithmClass
            DemDebounceTimeBase: DemDebounceTimeFailedThreshold=5, DemDebounceTimePassedThreshold=1, DemDebounceBehavior=DEM_DEBOUNCE_FREEZE
      DTCClass_DTC_0x95f811 (DemDTCClass): DemDTCSeverity=DEM_DTC_SEV_NO_SEVERITY, DemUdsDTC=9828369
      A2B_short_to_ground_Circuit_Short_To_Ground (DemEventParameter):
        DemEventKind = DEM_EVENT_KIND_SWC
        DemMaxNumberFreezeFrameRecords = 1
        DemEventLatchTestFailed = false
        DemDTCClassRef = DTCClass_DTC_0x95f811
        DemExtendedDataClassRef = ExtendedDataClass_4f5344cd
        DemFreezeFrameClassRef = FreezeFrameClass_80c88891
        DemEventClass:
          DemAgingAllowed = true
          DemAgingCycleCounterThreshold = 40
          DemEventDestination = DEM_DTC_ORIGIN_PRIMARY_MEMORY
          DemEventPriority = 2
          DemEventSignificance = DEM_EVENT_SIGNIFICANCE_FAULT
          DemAgingCycleRef = Ignition_on_off
          DemOperationCycleRef = Ignition_on_off
          DemDebounceAlgorithmClass
            DemDebounceMonitorInternal
              DemCallbackGetFDC
      DTCClass_DTC_0x95f812 (DemDTCClass): DemDTCSeverity=DEM_DTC_SEV_NO_SEVERITY, DemUdsDTC=9828370
      A2B_short_to_battery_Circuit_Short_To_Battery (DemEventParameter):
        DemEventKind = DEM_EVENT_KIND_SWC
        DemMaxNumberFreezeFrameRecords = 1
        DemEventLatchTestFailed = false
        DemDTCClassRef = DTCClass_DTC_0x95f812
        DemExtendedDataClassRef = ExtendedDataClass_4f5344cd
        DemFreezeFrameClassRef = FreezeFrameClass_80c88891
        DemEventClass:
          DemAgingAllowed = true
          DemAgingCycleCounterThreshold = 40
          DemEventDestination = DEM_DTC_ORIGIN_PRIMARY_MEMORY
          DemEventPriority = 2
          DemEventSignificance = DEM_EVENT_SIGNIFICANCE_FAULT
          DemAgingCycleRef = Ignition_on_off
          DemOperationCycleRef = Ignition_on_off
          DemDebounceAlgorithmClass
            DemDebounceMonitorInternal
              DemCallbackGetFDC
      DTCClass_DTC_0x95f813 (DemDTCClass): DemDTCSeverity=DEM_DTC_SEV_NO_SEVERITY, DemUdsDTC=9828371
      A2B_open_Circuit_Open (DemEventParameter):
        DemEventKind = DEM_EVENT_KIND_SWC
        DemMaxNumberFreezeFrameRecords = 1
        DemEventLatchTestFailed = false
        DemDTCClassRef = DTCClass_DTC_0x95f813
        DemExtendedDataClassRef = ExtendedDataClass_4f5344cd
        DemFreezeFrameClassRef = FreezeFrameClass_80c88891
        DemEventClass:
          DemAgingAllowed = true
          DemAgingCycleCounterThreshold = 40
          DemEventDestination = DEM_DTC_ORIGIN_PRIMARY_MEMORY
          DemEventPriority = 2
          DemEventSignificance = DEM_EVENT_SIGNIFICANCE_FAULT
          DemAgingCycleRef = Ignition_on_off
          DemOperationCycleRef = Ignition_on_off
          DemDebounceAlgorithmClass
            DemDebounceMonitorInternal
              DemCallbackGetFDC
      DTCClass_DTC_0x9a0101 (DemDTCClass): DemDTCSeverity=DEM_DTC_SEV_NO_SEVERITY, DemUdsDTC=10092801
      Speaker_FL_short_across_General_Electrical_Failure (DemEventParameter):
        DemEventKind = DEM_EVENT_KIND_SWC
        DemMaxNumberFreezeFrameRecords = 1
        DemEventLatchTestFailed = false
        DemDTCClassRef = DTCClass_DTC_0x9a0101
        DemExtendedDataClassRef = ExtendedDataClass_4f5344cd
        DemFreezeFrameClassRef = FreezeFrameClass_80c88891
        DemEventClass:
          DemAgingAllowed = true
          DemAgingCycleCounterThreshold = 40
          DemEventDestination = DEM_DTC_ORIGIN_PRIMARY_MEMORY
          DemEventPriority = 2
          DemEventSignificance = DEM_EVENT_SIGNIFICANCE_FAULT
          DemAgingCycleRef = Ignition_on_off
          DemEnableConditionGroupRef = EnableConditionGroup_PowerModeOn
          DemOperationCycleRef = Ignition_on_off
          DemDebounceAlgorithmClass
            DemDebounceTimeBase: DemDebounceTimeFailedThreshold=5, DemDebounceTimePassedThreshold=1, DemDebounceBehavior=DEM_DEBOUNCE_FREEZE
      DTCClass_DTC_0x9a0111 (DemDTCClass): DemDTCSeverity=DEM_DTC_SEV_NO_SEVERITY, DemUdsDTC=10092817
      Speaker_FL_short_to_ground_Circuit_Short_To_Ground (DemEventParameter):
        DemEventKind = DEM_EVENT_KIND_SWC
        DemMaxNumberFreezeFrameRecords = 1
        DemEventLatchTestFailed = false
        DemDTCClassRef = DTCClass_DTC_0x9a0111
        DemExtendedDataClassRef = ExtendedDataClass_4f5344cd
        DemFreezeFrameClassRef = FreezeFrameClass_80c88891
        DemEventClass:
          DemAgingAllowed = true
          DemAgingCycleCounterThreshold = 40
          DemEventDestination = DEM_DTC_ORIGIN_PRIMARY_MEMORY
          DemEventPriority = 2
          DemEventSignificance = DEM_EVENT_SIGNIFICANCE_FAULT
          DemAgingCycleRef = Ignition_on_off
          DemEnableConditionGroupRef = EnableConditionGroup_PowerModeOn
          DemOperationCycleRef = Ignition_on_off
          DemDebounceAlgorithmClass
            DemDebounceTimeBase: DemDebounceTimeFailedThreshold=5, DemDebounceTimePassedThreshold=1, DemDebounceBehavior=DEM_DEBOUNCE_FREEZE
      DTCClass_DTC_0x9a0112 (DemDTCClass): DemDTCSeverity=DEM_DTC_SEV_NO_SEVERITY, DemUdsDTC=10092818
      Speaker_FL_short_to_battery_Circuit_Short_To_Battery (DemEventParameter):
        DemEventKind = DEM_EVENT_KIND_SWC
        DemMaxNumberFreezeFrameRecords = 1
        DemEventLatchTestFailed = false
        DemDTCClassRef = DTCClass_DTC_0x9a0112
        DemExtendedDataClassRef = ExtendedDataClass_4f5344cd
        DemFreezeFrameClassRef = FreezeFrameClass_80c88891
        DemEventClass:
          DemAgingAllowed = true
          DemAgingCycleCounterThreshold = 40
          DemEventDestination = DEM_DTC_ORIGIN_PRIMARY_MEMORY
          DemEventPriority = 2
          DemEventSignificance = DEM_EVENT_SIGNIFICANCE_FAULT
          DemAgingCycleRef = Ignition_on_off
          DemEnableConditionGroupRef = EnableConditionGroup_PowerModeOn
          DemOperationCycleRef = Ignition_on_off
          DemDebounceAlgorithmClass
            DemDebounceTimeBase: DemDebounceTimeFailedThreshold=5, DemDebounceTimePassedThreshold=1, DemDebounceBehavior=DEM_DEBOUNCE_FREEZE
      DTCClass_DTC_0x9a0113 (DemDTCClass): DemDTCSeverity=DEM_DTC_SEV_NO_SEVERITY, DemUdsDTC=10092819
      Speaker_FL_open_Circuit_Open (DemEventParameter):
        DemEventKind = DEM_EVENT_KIND_SWC
        DemMaxNumberFreezeFrameRecords = 1
        DemEventLatchTestFailed = false
        DemDTCClassRef = DTCClass_DTC_0x9a0113
        DemExtendedDataClassRef = ExtendedDataClass_4f5344cd
        DemFreezeFrameClassRef = FreezeFrameClass_80c88891
        DemEventClass:
          DemAgingAllowed = true
          DemAgingCycleCounterThreshold = 40
          DemEventDestination = DEM_DTC_ORIGIN_PRIMARY_MEMORY
          DemEventPriority = 2
          DemEventSignificance = DEM_EVENT_SIGNIFICANCE_FAULT
          DemAgingCycleRef = Ignition_on_off
          DemEnableConditionGroupRef = EnableConditionGroup_PowerModeOn
          DemOperationCycleRef = Ignition_on_off
          DemDebounceAlgorithmClass
            DemDebounceTimeBase: DemDebounceTimeFailedThreshold=5, DemDebounceTimePassedThreshold=1, DemDebounceBehavior=DEM_DEBOUNCE_FREEZE
      DTCClass_DTC_0x9a011e (DemDTCClass): DemDTCSeverity=DEM_DTC_SEV_NO_SEVERITY, DemUdsDTC=10092830
      Speaker_FL_resistance_out_of_range_Circuit_Resistance_Out_of_Range (DemEventParameter):
        DemEventKind = DEM_EVENT_KIND_SWC
        DemMaxNumberFreezeFrameRecords = 1
        DemEventLatchTestFailed = false
        DemDTCClassRef = DTCClass_DTC_0x9a011e
        DemExtendedDataClassRef = ExtendedDataClass_4f5344cd
        DemFreezeFrameClassRef = FreezeFrameClass_80c88891
        DemEventClass:
          DemAgingAllowed = true
          DemAgingCycleCounterThreshold = 40
          DemEventDestination = DEM_DTC_ORIGIN_PRIMARY_MEMORY
          DemEventPriority = 2
          DemEventSignificance = DEM_EVENT_SIGNIFICANCE_FAULT
          DemAgingCycleRef = Ignition_on_off
          DemEnableConditionGroupRef = EnableConditionGroup_PowerModeOn
          DemOperationCycleRef = Ignition_on_off
          DemDebounceAlgorithmClass
            DemDebounceTimeBase: DemDebounceTimeFailedThreshold=5, DemDebounceTimePassedThreshold=1, DemDebounceBehavior=DEM_DEBOUNCE_FREEZE
      DTCClass_DTC_0x9a0125 (DemDTCClass): DemDTCSeverity=DEM_DTC_SEV_NO_SEVERITY, DemUdsDTC=10092837
      Speaker_FL_output_waveform_lack_fidelity_Signal_Shape_Waveform_Failure (DemEventParameter):
        DemEventKind = DEM_EVENT_KIND_SWC
        DemMaxNumberFreezeFrameRecords = 1
        DemEventLatchTestFailed = false
        DemDTCClassRef = DTCClass_DTC_0x9a0125
        DemExtendedDataClassRef = ExtendedDataClass_4f5344cd
        DemFreezeFrameClassRef = FreezeFrameClass_80c88891
        DemEventClass:
          DemAgingAllowed = true
          DemAgingCycleCounterThreshold = 40
          DemEventDestination = DEM_DTC_ORIGIN_PRIMARY_MEMORY
          DemEventPriority = 2
          DemEventSignificance = DEM_EVENT_SIGNIFICANCE_FAULT
          DemAgingCycleRef = Ignition_on_off
          DemEnableConditionGroupRef = EnableConditionGroup_PowerModeOn
          DemOperationCycleRef = Ignition_on_off
          DemDebounceAlgorithmClass
            DemDebounceTimeBase: DemDebounceTimeFailedThreshold=5, DemDebounceTimePassedThreshold=1, DemDebounceBehavior=DEM_DEBOUNCE_FREEZE
      DTCClass_DTC_0x9a0201 (DemDTCClass): DemDTCSeverity=DEM_DTC_SEV_NO_SEVERITY, DemUdsDTC=10093057
      Speaker_FR_short_across_General_Electrical_Failure (DemEventParameter):
        DemEventKind = DEM_EVENT_KIND_SWC
        DemMaxNumberFreezeFrameRecords = 1
        DemEventLatchTestFailed = false
        DemDTCClassRef = DTCClass_DTC_0x9a0201
        DemExtendedDataClassRef = ExtendedDataClass_4f5344cd
        DemFreezeFrameClassRef = FreezeFrameClass_80c88891
        DemEventClass:
          DemAgingAllowed = true
          DemAgingCycleCounterThreshold = 40
          DemEventDestination = DEM_DTC_ORIGIN_PRIMARY_MEMORY
          DemEventPriority = 2
          DemEventSignificance = DEM_EVENT_SIGNIFICANCE_FAULT
          DemAgingCycleRef = Ignition_on_off
          DemEnableConditionGroupRef = EnableConditionGroup_PowerModeOn
          DemOperationCycleRef = Ignition_on_off
          DemDebounceAlgorithmClass
            DemDebounceTimeBase: DemDebounceTimeFailedThreshold=5, DemDebounceTimePassedThreshold=1, DemDebounceBehavior=DEM_DEBOUNCE_FREEZE
      DTCClass_DTC_0x9a0211 (DemDTCClass): DemDTCSeverity=DEM_DTC_SEV_NO_SEVERITY, DemUdsDTC=10093073
      Speaker_FR_short_to_ground_Circuit_Short_To_Ground (DemEventParameter):
        DemEventKind = DEM_EVENT_KIND_SWC
        DemMaxNumberFreezeFrameRecords = 1
        DemEventLatchTestFailed = false
        DemDTCClassRef = DTCClass_DTC_0x9a0211
        DemExtendedDataClassRef = ExtendedDataClass_4f5344cd
        DemFreezeFrameClassRef = FreezeFrameClass_80c88891
        DemEventClass:
          DemAgingAllowed = true
          DemAgingCycleCounterThreshold = 40
          DemEventDestination = DEM_DTC_ORIGIN_PRIMARY_MEMORY
          DemEventPriority = 2
          DemEventSignificance = DEM_EVENT_SIGNIFICANCE_FAULT
          DemAgingCycleRef = Ignition_on_off
          DemEnableConditionGroupRef = EnableConditionGroup_PowerModeOn
          DemOperationCycleRef = Ignition_on_off
          DemDebounceAlgorithmClass
            DemDebounceTimeBase: DemDebounceTimeFailedThreshold=5, DemDebounceTimePassedThreshold=1, DemDebounceBehavior=DEM_DEBOUNCE_FREEZE
      DTCClass_DTC_0x9a0212 (DemDTCClass): DemDTCSeverity=DEM_DTC_SEV_NO_SEVERITY, DemUdsDTC=10093074
      Speaker_FR_short_to_battery_Circuit_Short_To_Battery (DemEventParameter):
        DemEventKind = DEM_EVENT_KIND_SWC
        DemMaxNumberFreezeFrameRecords = 1
        DemEventLatchTestFailed = false
        DemDTCClassRef = DTCClass_DTC_0x9a0212
        DemExtendedDataClassRef = ExtendedDataClass_4f5344cd
        DemFreezeFrameClassRef = FreezeFrameClass_80c88891
        DemEventClass:
          DemAgingAllowed = true
          DemAgingCycleCounterThreshold = 40
          DemEventDestination = DEM_DTC_ORIGIN_PRIMARY_MEMORY
          DemEventPriority = 2
          DemEventSignificance = DEM_EVENT_SIGNIFICANCE_FAULT
          DemAgingCycleRef = Ignition_on_off
          DemEnableConditionGroupRef = EnableConditionGroup_PowerModeOn
          DemOperationCycleRef = Ignition_on_off
          DemDebounceAlgorithmClass
            DemDebounceTimeBase: DemDebounceTimeFailedThreshold=5, DemDebounceTimePassedThreshold=1, DemDebounceBehavior=DEM_DEBOUNCE_FREEZE
      DTCClass_DTC_0x9a0213 (DemDTCClass): DemDTCSeverity=DEM_DTC_SEV_NO_SEVERITY, DemUdsDTC=10093075
      Speaker_FR_open_Circuit_Open (DemEventParameter):
        DemEventKind = DEM_EVENT_KIND_SWC
        DemMaxNumberFreezeFrameRecords = 1
        DemEventLatchTestFailed = false
        DemDTCClassRef = DTCClass_DTC_0x9a0213
        DemExtendedDataClassRef = ExtendedDataClass_4f5344cd
        DemFreezeFrameClassRef = FreezeFrameClass_80c88891
        DemEventClass:
          DemAgingAllowed = true
          DemAgingCycleCounterThreshold = 40
          DemEventDestination = DEM_DTC_ORIGIN_PRIMARY_MEMORY
          DemEventPriority = 2
          DemEventSignificance = DEM_EVENT_SIGNIFICANCE_FAULT
          DemAgingCycleRef = Ignition_on_off
          DemEnableConditionGroupRef = EnableConditionGroup_PowerModeOn
          DemOperationCycleRef = Ignition_on_off
          DemDebounceAlgorithmClass
            DemDebounceTimeBase: DemDebounceTimeFailedThreshold=5, DemDebounceTimePassedThreshold=1, DemDebounceBehavior=DEM_DEBOUNCE_FREEZE
      DTCClass_DTC_0x9a021e (DemDTCClass): DemDTCSeverity=DEM_DTC_SEV_NO_SEVERITY, DemUdsDTC=10093086
      Speaker_FR_resistance_out_of_range_Circuit_Resistance_Out_of_Range (DemEventParameter):
        DemEventKind = DEM_EVENT_KIND_SWC
        DemMaxNumberFreezeFrameRecords = 1
        DemEventLatchTestFailed = false
        DemDTCClassRef = DTCClass_DTC_0x9a021e
        DemExtendedDataClassRef = ExtendedDataClass_4f5344cd
        DemFreezeFrameClassRef = FreezeFrameClass_80c88891
        DemEventClass:
          DemAgingAllowed = true
          DemAgingCycleCounterThreshold = 40
          DemEventDestination = DEM_DTC_ORIGIN_PRIMARY_MEMORY
          DemEventPriority = 2
          DemEventSignificance = DEM_EVENT_SIGNIFICANCE_FAULT
          DemAgingCycleRef = Ignition_on_off
          DemEnableConditionGroupRef = EnableConditionGroup_PowerModeOn
          DemOperationCycleRef = Ignition_on_off
          DemDebounceAlgorithmClass
            DemDebounceTimeBase: DemDebounceTimeFailedThreshold=5, DemDebounceTimePassedThreshold=1, DemDebounceBehavior=DEM_DEBOUNCE_FREEZE
      DTCClass_DTC_0x9a0225 (DemDTCClass): DemDTCSeverity=DEM_DTC_SEV_NO_SEVERITY, DemUdsDTC=10093093
      Speaker_FR_output_waveform_lack_fidelity_Signal_Shape_Waveform_Failure (DemEventParameter):
        DemEventKind = DEM_EVENT_KIND_SWC
        DemMaxNumberFreezeFrameRecords = 1
        DemEventLatchTestFailed = false
        DemDTCClassRef = DTCClass_DTC_0x9a0225
        DemExtendedDataClassRef = ExtendedDataClass_4f5344cd
        DemFreezeFrameClassRef = FreezeFrameClass_80c88891
        DemEventClass:
          DemAgingAllowed = true
          DemAgingCycleCounterThreshold = 40
          DemEventDestination = DEM_DTC_ORIGIN_PRIMARY_MEMORY
          DemEventPriority = 2
          DemEventSignificance = DEM_EVENT_SIGNIFICANCE_FAULT
          DemAgingCycleRef = Ignition_on_off
          DemEnableConditionGroupRef = EnableConditionGroup_PowerModeOn
          DemOperationCycleRef = Ignition_on_off
          DemDebounceAlgorithmClass
            DemDebounceTimeBase: DemDebounceTimeFailedThreshold=5, DemDebounceTimePassedThreshold=1, DemDebounceBehavior=DEM_DEBOUNCE_FREEZE
      DTCClass_DTC_0x9a0301 (DemDTCClass): DemDTCSeverity=DEM_DTC_SEV_NO_SEVERITY, DemUdsDTC=10093313
      Speaker_RL_short_across_General_Electrical_Failure (DemEventParameter):
        DemEventKind = DEM_EVENT_KIND_SWC
        DemMaxNumberFreezeFrameRecords = 1
        DemEventLatchTestFailed = false
        DemDTCClassRef = DTCClass_DTC_0x9a0301
        DemExtendedDataClassRef = ExtendedDataClass_4f5344cd
        DemFreezeFrameClassRef = FreezeFrameClass_80c88891
        DemEventClass:
          DemAgingAllowed = true
          DemAgingCycleCounterThreshold = 40
          DemEventDestination = DEM_DTC_ORIGIN_PRIMARY_MEMORY
          DemEventPriority = 2
          DemEventSignificance = DEM_EVENT_SIGNIFICANCE_FAULT
          DemAgingCycleRef = Ignition_on_off
          DemEnableConditionGroupRef = EnableConditionGroup_PowerModeOn
          DemOperationCycleRef = Ignition_on_off
          DemDebounceAlgorithmClass
            DemDebounceTimeBase: DemDebounceTimeFailedThreshold=5, DemDebounceTimePassedThreshold=1, DemDebounceBehavior=DEM_DEBOUNCE_FREEZE
      DTCClass_DTC_0x9a0311 (DemDTCClass): DemDTCSeverity=DEM_DTC_SEV_NO_SEVERITY, DemUdsDTC=10093329
      Speaker_RL_short_to_ground_Circuit_Short_To_Ground (DemEventParameter):
        DemEventKind = DEM_EVENT_KIND_SWC
        DemMaxNumberFreezeFrameRecords = 1
        DemEventLatchTestFailed = false
        DemDTCClassRef = DTCClass_DTC_0x9a0311
        DemExtendedDataClassRef = ExtendedDataClass_4f5344cd
        DemFreezeFrameClassRef = FreezeFrameClass_80c88891
        DemEventClass:
          DemAgingAllowed = true
          DemAgingCycleCounterThreshold = 40
          DemEventDestination = DEM_DTC_ORIGIN_PRIMARY_MEMORY
          DemEventPriority = 2
          DemEventSignificance = DEM_EVENT_SIGNIFICANCE_FAULT
          DemAgingCycleRef = Ignition_on_off
          DemEnableConditionGroupRef = EnableConditionGroup_PowerModeOn
          DemOperationCycleRef = Ignition_on_off
          DemDebounceAlgorithmClass
            DemDebounceTimeBase: DemDebounceTimeFailedThreshold=5, DemDebounceTimePassedThreshold=1, DemDebounceBehavior=DEM_DEBOUNCE_FREEZE
      DTCClass_DTC_0x9a0312 (DemDTCClass): DemDTCSeverity=DEM_DTC_SEV_NO_SEVERITY, DemUdsDTC=10093330
      Speaker_RL_short_to_battery_Circuit_Short_To_Battery (DemEventParameter):
        DemEventKind = DEM_EVENT_KIND_SWC
        DemMaxNumberFreezeFrameRecords = 1
        DemEventLatchTestFailed = false
        DemDTCClassRef = DTCClass_DTC_0x9a0312
        DemExtendedDataClassRef = ExtendedDataClass_4f5344cd
        DemFreezeFrameClassRef = FreezeFrameClass_80c88891
        DemEventClass:
          DemAgingAllowed = true
          DemAgingCycleCounterThreshold = 40
          DemEventDestination = DEM_DTC_ORIGIN_PRIMARY_MEMORY
          DemEventPriority = 2
          DemEventSignificance = DEM_EVENT_SIGNIFICANCE_FAULT
          DemAgingCycleRef = Ignition_on_off
          DemEnableConditionGroupRef = EnableConditionGroup_PowerModeOn
          DemOperationCycleRef = Ignition_on_off
          DemDebounceAlgorithmClass
            DemDebounceTimeBase: DemDebounceTimeFailedThreshold=5, DemDebounceTimePassedThreshold=1, DemDebounceBehavior=DEM_DEBOUNCE_FREEZE
      DTCClass_DTC_0x9a0313 (DemDTCClass): DemDTCSeverity=DEM_DTC_SEV_NO_SEVERITY, DemUdsDTC=10093331
      Speaker_RL_open_Circuit_Open (DemEventParameter):
        DemEventKind = DEM_EVENT_KIND_SWC
        DemMaxNumberFreezeFrameRecords = 1
        DemEventLatchTestFailed = false
        DemDTCClassRef = DTCClass_DTC_0x9a0313
        DemExtendedDataClassRef = ExtendedDataClass_4f5344cd
        DemFreezeFrameClassRef = FreezeFrameClass_80c88891
        DemEventClass:
          DemAgingAllowed = true
          DemAgingCycleCounterThreshold = 40
          DemEventDestination = DEM_DTC_ORIGIN_PRIMARY_MEMORY
          DemEventPriority = 2
          DemEventSignificance = DEM_EVENT_SIGNIFICANCE_FAULT
          DemAgingCycleRef = Ignition_on_off
          DemEnableConditionGroupRef = EnableConditionGroup_PowerModeOn
          DemOperationCycleRef = Ignition_on_off
          DemDebounceAlgorithmClass
            DemDebounceTimeBase: DemDebounceTimeFailedThreshold=5, DemDebounceTimePassedThreshold=1, DemDebounceBehavior=DEM_DEBOUNCE_FREEZE
      DTCClass_DTC_0x9a031e (DemDTCClass): DemDTCSeverity=DEM_DTC_SEV_NO_SEVERITY, DemUdsDTC=10093342
      Speaker_RL_resistance_out_of_range_Circuit_Resistance_Out_of_Range (DemEventParameter):
        DemEventKind = DEM_EVENT_KIND_SWC
        DemMaxNumberFreezeFrameRecords = 1
        DemEventLatchTestFailed = false
        DemDTCClassRef = DTCClass_DTC_0x9a031e
        DemExtendedDataClassRef = ExtendedDataClass_4f5344cd
        DemFreezeFrameClassRef = FreezeFrameClass_80c88891
        DemEventClass:
          DemAgingAllowed = true
          DemAgingCycleCounterThreshold = 40
          DemEventDestination = DEM_DTC_ORIGIN_PRIMARY_MEMORY
          DemEventPriority = 2
          DemEventSignificance = DEM_EVENT_SIGNIFICANCE_FAULT
          DemAgingCycleRef = Ignition_on_off
          DemEnableConditionGroupRef = EnableConditionGroup_PowerModeOn
          DemOperationCycleRef = Ignition_on_off
          DemDebounceAlgorithmClass
            DemDebounceTimeBase: DemDebounceTimeFailedThreshold=5, DemDebounceTimePassedThreshold=1, DemDebounceBehavior=DEM_DEBOUNCE_FREEZE
      DTCClass_DTC_0x9a0325 (DemDTCClass): DemDTCSeverity=DEM_DTC_SEV_NO_SEVERITY, DemUdsDTC=10093349
      Speaker_RL_output_waveform_lack_fidelity_Signal_Shape_Waveform_Failure (DemEventParameter):
        DemEventKind = DEM_EVENT_KIND_SWC
        DemMaxNumberFreezeFrameRecords = 1
        DemEventLatchTestFailed = false
        DemDTCClassRef = DTCClass_DTC_0x9a0325
        DemExtendedDataClassRef = ExtendedDataClass_4f5344cd
        DemFreezeFrameClassRef = FreezeFrameClass_80c88891
        DemEventClass:
          DemAgingAllowed = true
          DemAgingCycleCounterThreshold = 40
          DemEventDestination = DEM_DTC_ORIGIN_PRIMARY_MEMORY
          DemEventPriority = 2
          DemEventSignificance = DEM_EVENT_SIGNIFICANCE_FAULT
          DemAgingCycleRef = Ignition_on_off
          DemEnableConditionGroupRef = EnableConditionGroup_PowerModeOn
          DemOperationCycleRef = Ignition_on_off
          DemDebounceAlgorithmClass
            DemDebounceTimeBase: DemDebounceTimeFailedThreshold=5, DemDebounceTimePassedThreshold=1, DemDebounceBehavior=DEM_DEBOUNCE_FREEZE
      DTCClass_DTC_0x9a0401 (DemDTCClass): DemDTCSeverity=DEM_DTC_SEV_NO_SEVERITY, DemUdsDTC=10093569
      Speaker_RR_short_across_General_Electrical_Failure (DemEventParameter):
        DemEventKind = DEM_EVENT_KIND_SWC
        DemMaxNumberFreezeFrameRecords = 1
        DemEventLatchTestFailed = false
        DemDTCClassRef = DTCClass_DTC_0x9a0401
        DemExtendedDataClassRef = ExtendedDataClass_4f5344cd
        DemFreezeFrameClassRef = FreezeFrameClass_80c88891
        DemEventClass:
          DemAgingAllowed = true
          DemAgingCycleCounterThreshold = 40
          DemEventDestination = DEM_DTC_ORIGIN_PRIMARY_MEMORY
          DemEventPriority = 2
          DemEventSignificance = DEM_EVENT_SIGNIFICANCE_FAULT
          DemAgingCycleRef = Ignition_on_off
          DemEnableConditionGroupRef = EnableConditionGroup_PowerModeOn
          DemOperationCycleRef = Ignition_on_off
          DemDebounceAlgorithmClass
            DemDebounceTimeBase: DemDebounceTimeFailedThreshold=5, DemDebounceTimePassedThreshold=1, DemDebounceBehavior=DEM_DEBOUNCE_FREEZE
      DTCClass_DTC_0x9a0411 (DemDTCClass): DemDTCSeverity=DEM_DTC_SEV_NO_SEVERITY, DemUdsDTC=10093585
      Speaker_RR_short_to_ground_Circuit_Short_To_Ground (DemEventParameter):
        DemEventKind = DEM_EVENT_KIND_SWC
        DemMaxNumberFreezeFrameRecords = 1
        DemEventLatchTestFailed = false
        DemDTCClassRef = DTCClass_DTC_0x9a0411
        DemExtendedDataClassRef = ExtendedDataClass_4f5344cd
        DemFreezeFrameClassRef = FreezeFrameClass_80c88891
        DemEventClass:
          DemAgingAllowed = true
          DemAgingCycleCounterThreshold = 40
          DemEventDestination = DEM_DTC_ORIGIN_PRIMARY_MEMORY
          DemEventPriority = 2
          DemEventSignificance = DEM_EVENT_SIGNIFICANCE_FAULT
          DemAgingCycleRef = Ignition_on_off
          DemEnableConditionGroupRef = EnableConditionGroup_PowerModeOn
          DemOperationCycleRef = Ignition_on_off
          DemDebounceAlgorithmClass
            DemDebounceTimeBase: DemDebounceTimeFailedThreshold=5, DemDebounceTimePassedThreshold=1, DemDebounceBehavior=DEM_DEBOUNCE_FREEZE
      DTCClass_DTC_0x9a0412 (DemDTCClass): DemDTCSeverity=DEM_DTC_SEV_NO_SEVERITY, DemUdsDTC=10093586
      Speaker_RR_short_to_battery_Circuit_Short_To_Battery (DemEventParameter):
        DemEventKind = DEM_EVENT_KIND_SWC
        DemMaxNumberFreezeFrameRecords = 1
        DemEventLatchTestFailed = false
        DemDTCClassRef = DTCClass_DTC_0x9a0412
        DemExtendedDataClassRef = ExtendedDataClass_4f5344cd
        DemFreezeFrameClassRef = FreezeFrameClass_80c88891
        DemEventClass:
          DemAgingAllowed = true
          DemAgingCycleCounterThreshold = 40
          DemEventDestination = DEM_DTC_ORIGIN_PRIMARY_MEMORY
          DemEventPriority = 2
          DemEventSignificance = DEM_EVENT_SIGNIFICANCE_FAULT
          DemAgingCycleRef = Ignition_on_off
          DemEnableConditionGroupRef = EnableConditionGroup_PowerModeOn
          DemOperationCycleRef = Ignition_on_off
          DemDebounceAlgorithmClass
            DemDebounceTimeBase: DemDebounceTimeFailedThreshold=5, DemDebounceTimePassedThreshold=1, DemDebounceBehavior=DEM_DEBOUNCE_FREEZE
      DTCClass_DTC_0x9a0413 (DemDTCClass): DemDTCSeverity=DEM_DTC_SEV_NO_SEVERITY, DemUdsDTC=10093587
      Speaker_RR_open_Circuit_Open (DemEventParameter):
        DemEventKind = DEM_EVENT_KIND_SWC
        DemMaxNumberFreezeFrameRecords = 1
        DemEventLatchTestFailed = false
        DemDTCClassRef = DTCClass_DTC_0x9a0413
        DemExtendedDataClassRef = ExtendedDataClass_4f5344cd
        DemFreezeFrameClassRef = FreezeFrameClass_80c88891
        DemEventClass:
          DemAgingAllowed = true
          DemAgingCycleCounterThreshold = 40
          DemEventDestination = DEM_DTC_ORIGIN_PRIMARY_MEMORY
          DemEventPriority = 2
          DemEventSignificance = DEM_EVENT_SIGNIFICANCE_FAULT
          DemAgingCycleRef = Ignition_on_off
          DemEnableConditionGroupRef = EnableConditionGroup_PowerModeOn
          DemOperationCycleRef = Ignition_on_off
          DemDebounceAlgorithmClass
            DemDebounceTimeBase: DemDebounceTimeFailedThreshold=5, DemDebounceTimePassedThreshold=1, DemDebounceBehavior=DEM_DEBOUNCE_FREEZE
      DTCClass_DTC_0x9a041e (DemDTCClass): DemDTCSeverity=DEM_DTC_SEV_NO_SEVERITY, DemUdsDTC=10093598
      Speaker_RR_resistance_out_of_range_Circuit_Resistance_Out_of_Range (DemEventParameter):
        DemEventKind = DEM_EVENT_KIND_SWC
        DemMaxNumberFreezeFrameRecords = 1
        DemEventLatchTestFailed = false
        DemDTCClassRef = DTCClass_DTC_0x9a041e
        DemExtendedDataClassRef = ExtendedDataClass_4f5344cd
        DemFreezeFrameClassRef = FreezeFrameClass_80c88891
        DemEventClass:
          DemAgingAllowed = true
          DemAgingCycleCounterThreshold = 40
          DemEventDestination = DEM_DTC_ORIGIN_PRIMARY_MEMORY
          DemEventPriority = 2
          DemEventSignificance = DEM_EVENT_SIGNIFICANCE_FAULT
          DemAgingCycleRef = Ignition_on_off
          DemEnableConditionGroupRef = EnableConditionGroup_PowerModeOn
          DemOperationCycleRef = Ignition_on_off
          DemDebounceAlgorithmClass
            DemDebounceTimeBase: DemDebounceTimeFailedThreshold=5, DemDebounceTimePassedThreshold=1, DemDebounceBehavior=DEM_DEBOUNCE_FREEZE
      DTCClass_DTC_0x9a0425 (DemDTCClass): DemDTCSeverity=DEM_DTC_SEV_NO_SEVERITY, DemUdsDTC=10093605
      Speaker_RR_output_waveform_lack_fidelity_Signal_Shape_Waveform_Failure (DemEventParameter):
        DemEventKind = DEM_EVENT_KIND_SWC
        DemMaxNumberFreezeFrameRecords = 1
        DemEventLatchTestFailed = false
        DemDTCClassRef = DTCClass_DTC_0x9a0425
        DemExtendedDataClassRef = ExtendedDataClass_4f5344cd
        DemFreezeFrameClassRef = FreezeFrameClass_80c88891
        DemEventClass:
          DemAgingAllowed = true
          DemAgingCycleCounterThreshold = 40
          DemEventDestination = DEM_DTC_ORIGIN_PRIMARY_MEMORY
          DemEventPriority = 2
          DemEventSignificance = DEM_EVENT_SIGNIFICANCE_FAULT
          DemAgingCycleRef = Ignition_on_off
          DemEnableConditionGroupRef = EnableConditionGroup_PowerModeOn
          DemOperationCycleRef = Ignition_on_off
          DemDebounceAlgorithmClass
            DemDebounceTimeBase: DemDebounceTimeFailedThreshold=5, DemDebounceTimePassedThreshold=1, DemDebounceBehavior=DEM_DEBOUNCE_FREEZE
      DTCClass_DTC_0x9a0501 (DemDTCClass): DemDTCSeverity=DEM_DTC_SEV_NO_SEVERITY, DemUdsDTC=10093825
      Speaker_Center_short_across_General_Electrical_Failure (DemEventParameter):
        DemEventKind = DEM_EVENT_KIND_SWC
        DemMaxNumberFreezeFrameRecords = 1
        DemEventLatchTestFailed = false
        DemDTCClassRef = DTCClass_DTC_0x9a0501
        DemExtendedDataClassRef = ExtendedDataClass_4f5344cd
        DemFreezeFrameClassRef = FreezeFrameClass_80c88891
        DemEventClass:
          DemAgingAllowed = true
          DemAgingCycleCounterThreshold = 40
          DemEventDestination = DEM_DTC_ORIGIN_PRIMARY_MEMORY
          DemEventPriority = 2
          DemEventSignificance = DEM_EVENT_SIGNIFICANCE_FAULT
          DemAgingCycleRef = Ignition_on_off
          DemEnableConditionGroupRef = EnableConditionGroup_PowerModeOn
          DemOperationCycleRef = Ignition_on_off
          DemDebounceAlgorithmClass
            DemDebounceTimeBase: DemDebounceTimeFailedThreshold=5, DemDebounceTimePassedThreshold=1, DemDebounceBehavior=DEM_DEBOUNCE_FREEZE
      DTCClass_DTC_0x9a0511 (DemDTCClass): DemDTCSeverity=DEM_DTC_SEV_NO_SEVERITY, DemUdsDTC=10093841
      Speaker_Center_short_to_ground_Circuit_Short_To_Ground (DemEventParameter):
        DemEventKind = DEM_EVENT_KIND_SWC
        DemMaxNumberFreezeFrameRecords = 1
        DemEventLatchTestFailed = false
        DemDTCClassRef = DTCClass_DTC_0x9a0511
        DemExtendedDataClassRef = ExtendedDataClass_4f5344cd
        DemFreezeFrameClassRef = FreezeFrameClass_80c88891
        DemEventClass:
          DemAgingAllowed = true
          DemAgingCycleCounterThreshold = 40
          DemEventDestination = DEM_DTC_ORIGIN_PRIMARY_MEMORY
          DemEventPriority = 2
          DemEventSignificance = DEM_EVENT_SIGNIFICANCE_FAULT
          DemAgingCycleRef = Ignition_on_off
          DemEnableConditionGroupRef = EnableConditionGroup_PowerModeOn
          DemOperationCycleRef = Ignition_on_off
          DemDebounceAlgorithmClass
            DemDebounceTimeBase: DemDebounceTimeFailedThreshold=5, DemDebounceTimePassedThreshold=1, DemDebounceBehavior=DEM_DEBOUNCE_FREEZE
      DTCClass_DTC_0x9a0512 (DemDTCClass): DemDTCSeverity=DEM_DTC_SEV_NO_SEVERITY, DemUdsDTC=10093842
      Speaker_Center_short_to_battery_Circuit_Short_To_Battery (DemEventParameter):
        DemEventKind = DEM_EVENT_KIND_SWC
        DemMaxNumberFreezeFrameRecords = 1
        DemEventLatchTestFailed = false
        DemDTCClassRef = DTCClass_DTC_0x9a0512
        DemExtendedDataClassRef = ExtendedDataClass_4f5344cd
        DemFreezeFrameClassRef = FreezeFrameClass_80c88891
        DemEventClass:
          DemAgingAllowed = true
          DemAgingCycleCounterThreshold = 40
          DemEventDestination = DEM_DTC_ORIGIN_PRIMARY_MEMORY
          DemEventPriority = 2
          DemEventSignificance = DEM_EVENT_SIGNIFICANCE_FAULT
          DemAgingCycleRef = Ignition_on_off
          DemEnableConditionGroupRef = EnableConditionGroup_PowerModeOn
          DemOperationCycleRef = Ignition_on_off
          DemDebounceAlgorithmClass
            DemDebounceTimeBase: DemDebounceTimeFailedThreshold=5, DemDebounceTimePassedThreshold=1, DemDebounceBehavior=DEM_DEBOUNCE_FREEZE
      DTCClass_DTC_0x9a0513 (DemDTCClass): DemDTCSeverity=DEM_DTC_SEV_NO_SEVERITY, DemUdsDTC=10093843
      Speaker_Center_open_Circuit_Open (DemEventParameter):
        DemEventKind = DEM_EVENT_KIND_SWC
        DemMaxNumberFreezeFrameRecords = 1
        DemEventLatchTestFailed = false
        DemDTCClassRef = DTCClass_DTC_0x9a0513
        DemExtendedDataClassRef = ExtendedDataClass_4f5344cd
        DemFreezeFrameClassRef = FreezeFrameClass_80c88891
        DemEventClass:
          DemAgingAllowed = true
          DemAgingCycleCounterThreshold = 40
          DemEventDestination = DEM_DTC_ORIGIN_PRIMARY_MEMORY
          DemEventPriority = 2
          DemEventSignificance = DEM_EVENT_SIGNIFICANCE_FAULT
          DemAgingCycleRef = Ignition_on_off
          DemEnableConditionGroupRef = EnableConditionGroup_PowerModeOn
          DemOperationCycleRef = Ignition_on_off
          DemDebounceAlgorithmClass
            DemDebounceTimeBase: DemDebounceTimeFailedThreshold=5, DemDebounceTimePassedThreshold=1, DemDebounceBehavior=DEM_DEBOUNCE_FREEZE
      DTCClass_DTC_0x9a051e (DemDTCClass): DemDTCSeverity=DEM_DTC_SEV_NO_SEVERITY, DemUdsDTC=10093854
      Speaker_Center_resistance_out_of_range_Circuit_Resistance_Out_of_Range (DemEventParameter):
        DemEventKind = DEM_EVENT_KIND_SWC
        DemMaxNumberFreezeFrameRecords = 1
        DemEventLatchTestFailed = false
        DemDTCClassRef = DTCClass_DTC_0x9a051e
        DemExtendedDataClassRef = ExtendedDataClass_4f5344cd
        DemFreezeFrameClassRef = FreezeFrameClass_80c88891
        DemEventClass:
          DemAgingAllowed = true
          DemAgingCycleCounterThreshold = 40
          DemEventDestination = DEM_DTC_ORIGIN_PRIMARY_MEMORY
          DemEventPriority = 2
          DemEventSignificance = DEM_EVENT_SIGNIFICANCE_FAULT
          DemAgingCycleRef = Ignition_on_off
          DemEnableConditionGroupRef = EnableConditionGroup_PowerModeOn
          DemOperationCycleRef = Ignition_on_off
          DemDebounceAlgorithmClass
            DemDebounceTimeBase: DemDebounceTimeFailedThreshold=5, DemDebounceTimePassedThreshold=1, DemDebounceBehavior=DEM_DEBOUNCE_FREEZE
      DTCClass_DTC_0x9a0525 (DemDTCClass): DemDTCSeverity=DEM_DTC_SEV_NO_SEVERITY, DemUdsDTC=10093861
      Speaker_Center_output_waveform_lack_fidelity_Signal_Shape_Waveform_Failure (DemEventParameter):
        DemEventKind = DEM_EVENT_KIND_SWC
        DemMaxNumberFreezeFrameRecords = 1
        DemEventLatchTestFailed = false
        DemDTCClassRef = DTCClass_DTC_0x9a0525
        DemExtendedDataClassRef = ExtendedDataClass_4f5344cd
        DemFreezeFrameClassRef = FreezeFrameClass_80c88891
        DemEventClass:
          DemAgingAllowed = true
          DemAgingCycleCounterThreshold = 40
          DemEventDestination = DEM_DTC_ORIGIN_PRIMARY_MEMORY
          DemEventPriority = 2
          DemEventSignificance = DEM_EVENT_SIGNIFICANCE_FAULT
          DemAgingCycleRef = Ignition_on_off
          DemEnableConditionGroupRef = EnableConditionGroup_PowerModeOn
          DemOperationCycleRef = Ignition_on_off
          DemDebounceAlgorithmClass
            DemDebounceTimeBase: DemDebounceTimeFailedThreshold=5, DemDebounceTimePassedThreshold=1, DemDebounceBehavior=DEM_DEBOUNCE_FREEZE
      DTCClass_DTC_0x9a0601 (DemDTCClass): DemDTCSeverity=DEM_DTC_SEV_NO_SEVERITY, DemUdsDTC=10094081
      Speaker_Woofer_short_across_General_Electrical_Failure (DemEventParameter):
        DemEventKind = DEM_EVENT_KIND_SWC
        DemMaxNumberFreezeFrameRecords = 1
        DemEventLatchTestFailed = false
        DemDTCClassRef = DTCClass_DTC_0x9a0601
        DemExtendedDataClassRef = ExtendedDataClass_4f5344cd
        DemFreezeFrameClassRef = FreezeFrameClass_80c88891
        DemEventClass:
          DemAgingAllowed = true
          DemAgingCycleCounterThreshold = 40
          DemEventDestination = DEM_DTC_ORIGIN_PRIMARY_MEMORY
          DemEventPriority = 2
          DemEventSignificance = DEM_EVENT_SIGNIFICANCE_FAULT
          DemAgingCycleRef = Ignition_on_off
          DemEnableConditionGroupRef = EnableConditionGroup_PowerModeOn
          DemOperationCycleRef = Ignition_on_off
          DemDebounceAlgorithmClass
            DemDebounceTimeBase: DemDebounceTimeFailedThreshold=5, DemDebounceTimePassedThreshold=1, DemDebounceBehavior=DEM_DEBOUNCE_FREEZE
      DTCClass_DTC_0x9a0611 (DemDTCClass): DemDTCSeverity=DEM_DTC_SEV_NO_SEVERITY, DemUdsDTC=10094097
      Speaker_Woofer_short_to_ground_Circuit_Short_To_Ground (DemEventParameter):
        DemEventKind = DEM_EVENT_KIND_SWC
        DemMaxNumberFreezeFrameRecords = 1
        DemEventLatchTestFailed = false
        DemDTCClassRef = DTCClass_DTC_0x9a0611
        DemExtendedDataClassRef = ExtendedDataClass_4f5344cd
        DemFreezeFrameClassRef = FreezeFrameClass_80c88891
        DemEventClass:
          DemAgingAllowed = true
          DemAgingCycleCounterThreshold = 40
          DemEventDestination = DEM_DTC_ORIGIN_PRIMARY_MEMORY
          DemEventPriority = 2
          DemEventSignificance = DEM_EVENT_SIGNIFICANCE_FAULT
          DemAgingCycleRef = Ignition_on_off
          DemEnableConditionGroupRef = EnableConditionGroup_PowerModeOn
          DemOperationCycleRef = Ignition_on_off
          DemDebounceAlgorithmClass
            DemDebounceTimeBase: DemDebounceTimeFailedThreshold=5, DemDebounceTimePassedThreshold=1, DemDebounceBehavior=DEM_DEBOUNCE_FREEZE
      DTCClass_DTC_0x9a0612 (DemDTCClass): DemDTCSeverity=DEM_DTC_SEV_NO_SEVERITY, DemUdsDTC=10094098
      Speaker_Woofer_short_to_battery_Circuit_Short_To_Battery (DemEventParameter):
        DemEventKind = DEM_EVENT_KIND_SWC
        DemMaxNumberFreezeFrameRecords = 1
        DemEventLatchTestFailed = false
        DemDTCClassRef = DTCClass_DTC_0x9a0612
        DemExtendedDataClassRef = ExtendedDataClass_4f5344cd
        DemFreezeFrameClassRef = FreezeFrameClass_80c88891
        DemEventClass:
          DemAgingAllowed = true
          DemAgingCycleCounterThreshold = 40
          DemEventDestination = DEM_DTC_ORIGIN_PRIMARY_MEMORY
          DemEventPriority = 2
          DemEventSignificance = DEM_EVENT_SIGNIFICANCE_FAULT
          DemAgingCycleRef = Ignition_on_off
          DemEnableConditionGroupRef = EnableConditionGroup_PowerModeOn
          DemOperationCycleRef = Ignition_on_off
          DemDebounceAlgorithmClass
            DemDebounceTimeBase: DemDebounceTimeFailedThreshold=5, DemDebounceTimePassedThreshold=1, DemDebounceBehavior=DEM_DEBOUNCE_FREEZE
      DTCClass_DTC_0x9a0613 (DemDTCClass): DemDTCSeverity=DEM_DTC_SEV_NO_SEVERITY, DemUdsDTC=10094099
      Speaker_Woofer_open_Circuit_Open (DemEventParameter):
        DemEventKind = DEM_EVENT_KIND_SWC
        DemMaxNumberFreezeFrameRecords = 1
        DemEventLatchTestFailed = false
        DemDTCClassRef = DTCClass_DTC_0x9a0613
        DemExtendedDataClassRef = ExtendedDataClass_4f5344cd
        DemFreezeFrameClassRef = FreezeFrameClass_80c88891
        DemEventClass:
          DemAgingAllowed = true
          DemAgingCycleCounterThreshold = 40
          DemEventDestination = DEM_DTC_ORIGIN_PRIMARY_MEMORY
          DemEventPriority = 2
          DemEventSignificance = DEM_EVENT_SIGNIFICANCE_FAULT
          DemAgingCycleRef = Ignition_on_off
          DemEnableConditionGroupRef = EnableConditionGroup_PowerModeOn
          DemOperationCycleRef = Ignition_on_off
          DemDebounceAlgorithmClass
            DemDebounceTimeBase: DemDebounceTimeFailedThreshold=5, DemDebounceTimePassedThreshold=1, DemDebounceBehavior=DEM_DEBOUNCE_FREEZE
      DTCClass_DTC_0x9a061e (DemDTCClass): DemDTCSeverity=DEM_DTC_SEV_NO_SEVERITY, DemUdsDTC=10094110
      Speaker_Woofer_resistance_out_of_range_Circuit_Resistance_Out_of_Range (DemEventParameter):
        DemEventKind = DEM_EVENT_KIND_SWC
        DemMaxNumberFreezeFrameRecords = 1
        DemEventLatchTestFailed = false
        DemDTCClassRef = DTCClass_DTC_0x9a061e
        DemExtendedDataClassRef = ExtendedDataClass_4f5344cd
        DemFreezeFrameClassRef = FreezeFrameClass_80c88891
        DemEventClass:
          DemAgingAllowed = true
          DemAgingCycleCounterThreshold = 40
          DemEventDestination = DEM_DTC_ORIGIN_PRIMARY_MEMORY
          DemEventPriority = 2
          DemEventSignificance = DEM_EVENT_SIGNIFICANCE_FAULT
          DemAgingCycleRef = Ignition_on_off
          DemEnableConditionGroupRef = EnableConditionGroup_PowerModeOn
          DemOperationCycleRef = Ignition_on_off
          DemDebounceAlgorithmClass
            DemDebounceTimeBase: DemDebounceTimeFailedThreshold=5, DemDebounceTimePassedThreshold=1, DemDebounceBehavior=DEM_DEBOUNCE_FREEZE
      DTCClass_DTC_0x9a0625 (DemDTCClass): DemDTCSeverity=DEM_DTC_SEV_NO_SEVERITY, DemUdsDTC=10094117
      Speaker_Woofer_output_waveform_lack_fidelity_Signal_Shape_Waveform_Failure (DemEventParameter):
        DemEventKind = DEM_EVENT_KIND_SWC
        DemMaxNumberFreezeFrameRecords = 1
        DemEventLatchTestFailed = false
        DemDTCClassRef = DTCClass_DTC_0x9a0625
        DemExtendedDataClassRef = ExtendedDataClass_4f5344cd
        DemFreezeFrameClassRef = FreezeFrameClass_80c88891
        DemEventClass:
          DemAgingAllowed = true
          DemAgingCycleCounterThreshold = 40
          DemEventDestination = DEM_DTC_ORIGIN_PRIMARY_MEMORY
          DemEventPriority = 2
          DemEventSignificance = DEM_EVENT_SIGNIFICANCE_FAULT
          DemAgingCycleRef = Ignition_on_off
          DemEnableConditionGroupRef = EnableConditionGroup_PowerModeOn
          DemOperationCycleRef = Ignition_on_off
          DemDebounceAlgorithmClass
            DemDebounceTimeBase: DemDebounceTimeFailedThreshold=5, DemDebounceTimePassedThreshold=1, DemDebounceBehavior=DEM_DEBOUNCE_FREEZE
      DTCClass_DTC_0x9a1011 (DemDTCClass): DemDTCSeverity=DEM_DTC_SEV_NO_SEVERITY, DemUdsDTC=10096657
      TUNER_FM1_short_to_groud_Circuit_Short_To_Ground (DemEventParameter):
        DemEventKind = DEM_EVENT_KIND_SWC
        DemMaxNumberFreezeFrameRecords = 1
        DemEventLatchTestFailed = false
        DemDTCClassRef = DTCClass_DTC_0x9a1011
        DemExtendedDataClassRef = ExtendedDataClass_4f5344cd
        DemFreezeFrameClassRef = FreezeFrameClass_80c88891
        DemEventClass:
          DemAgingAllowed = true
          DemAgingCycleCounterThreshold = 40
          DemEventDestination = DEM_DTC_ORIGIN_PRIMARY_MEMORY
          DemEventPriority = 2
          DemEventSignificance = DEM_EVENT_SIGNIFICANCE_FAULT
          DemAgingCycleRef = Ignition_on_off
          DemOperationCycleRef = Ignition_on_off
          DemDebounceAlgorithmClass
            DemDebounceMonitorInternal
              DemCallbackGetFDC
      DTCClass_DTC_0x9a1012 (DemDTCClass): DemDTCSeverity=DEM_DTC_SEV_NO_SEVERITY, DemUdsDTC=10096658
      TUNER_FM1_short_to_battary_Circuit_Short_To_Battery (DemEventParameter):
        DemEventKind = DEM_EVENT_KIND_SWC
        DemMaxNumberFreezeFrameRecords = 1
        DemEventLatchTestFailed = false
        DemDTCClassRef = DTCClass_DTC_0x9a1012
        DemExtendedDataClassRef = ExtendedDataClass_4f5344cd
        DemFreezeFrameClassRef = FreezeFrameClass_80c88891
        DemEventClass:
          DemAgingAllowed = true
          DemAgingCycleCounterThreshold = 40
          DemEventDestination = DEM_DTC_ORIGIN_PRIMARY_MEMORY
          DemEventPriority = 2
          DemEventSignificance = DEM_EVENT_SIGNIFICANCE_FAULT
          DemAgingCycleRef = Ignition_on_off
          DemOperationCycleRef = Ignition_on_off
          DemDebounceAlgorithmClass
            DemDebounceMonitorInternal
              DemCallbackGetFDC
      DTCClass_DTC_0x9a1013 (DemDTCClass): DemDTCSeverity=DEM_DTC_SEV_NO_SEVERITY, DemUdsDTC=10096659
      TUNER_FM1_open_Circuit_Open (DemEventParameter):
        DemEventKind = DEM_EVENT_KIND_SWC
        DemMaxNumberFreezeFrameRecords = 1
        DemEventLatchTestFailed = false
        DemDTCClassRef = DTCClass_DTC_0x9a1013
        DemExtendedDataClassRef = ExtendedDataClass_4f5344cd
        DemFreezeFrameClassRef = FreezeFrameClass_80c88891
        DemEventClass:
          DemAgingAllowed = true
          DemAgingCycleCounterThreshold = 40
          DemEventDestination = DEM_DTC_ORIGIN_PRIMARY_MEMORY
          DemEventPriority = 2
          DemEventSignificance = DEM_EVENT_SIGNIFICANCE_FAULT
          DemAgingCycleRef = Ignition_on_off
          DemOperationCycleRef = Ignition_on_off
          DemDebounceAlgorithmClass
            DemDebounceMonitorInternal
              DemCallbackGetFDC
      DTCClass_DTC_0x9a1019 (DemDTCClass): DemDTCSeverity=DEM_DTC_SEV_NO_SEVERITY, DemUdsDTC=10096665
      TUNER_FM1_over_current_detection_Circuit_Current_Above_Threshold (DemEventParameter):
        DemEventKind = DEM_EVENT_KIND_SWC
        DemMaxNumberFreezeFrameRecords = 1
        DemEventLatchTestFailed = false
        DemDTCClassRef = DTCClass_DTC_0x9a1019
        DemExtendedDataClassRef = ExtendedDataClass_4f5344cd
        DemFreezeFrameClassRef = FreezeFrameClass_80c88891
        DemEventClass:
          DemAgingAllowed = true
          DemAgingCycleCounterThreshold = 40
          DemEventDestination = DEM_DTC_ORIGIN_PRIMARY_MEMORY
          DemEventPriority = 2
          DemEventSignificance = DEM_EVENT_SIGNIFICANCE_FAULT
          DemAgingCycleRef = Ignition_on_off
          DemOperationCycleRef = Ignition_on_off
          DemDebounceAlgorithmClass
            DemDebounceMonitorInternal
              DemCallbackGetFDC
      DTCClass_DTC_0x9a1111 (DemDTCClass): DemDTCSeverity=DEM_DTC_SEV_NO_SEVERITY, DemUdsDTC=10096913
      TUNER_FM2_short_to_groud_Circuit_Short_To_Ground (DemEventParameter):
        DemEventKind = DEM_EVENT_KIND_SWC
        DemMaxNumberFreezeFrameRecords = 1
        DemEventLatchTestFailed = false
        DemDTCClassRef = DTCClass_DTC_0x9a1111
        DemExtendedDataClassRef = ExtendedDataClass_4f5344cd
        DemFreezeFrameClassRef = FreezeFrameClass_80c88891
        DemEventClass:
          DemAgingAllowed = true
          DemAgingCycleCounterThreshold = 40
          DemEventDestination = DEM_DTC_ORIGIN_PRIMARY_MEMORY
          DemEventPriority = 2
          DemEventSignificance = DEM_EVENT_SIGNIFICANCE_FAULT
          DemAgingCycleRef = Ignition_on_off
          DemOperationCycleRef = Ignition_on_off
          DemDebounceAlgorithmClass
            DemDebounceMonitorInternal
              DemCallbackGetFDC
      DTCClass_DTC_0x9a1112 (DemDTCClass): DemDTCSeverity=DEM_DTC_SEV_NO_SEVERITY, DemUdsDTC=10096914
      TUNER_FM2_short_to_battary_Circuit_Short_To_Battery (DemEventParameter):
        DemEventKind = DEM_EVENT_KIND_SWC
        DemMaxNumberFreezeFrameRecords = 1
        DemEventLatchTestFailed = false
        DemDTCClassRef = DTCClass_DTC_0x9a1112
        DemExtendedDataClassRef = ExtendedDataClass_4f5344cd
        DemFreezeFrameClassRef = FreezeFrameClass_80c88891
        DemEventClass:
          DemAgingAllowed = true
          DemAgingCycleCounterThreshold = 40
          DemEventDestination = DEM_DTC_ORIGIN_PRIMARY_MEMORY
          DemEventPriority = 2
          DemEventSignificance = DEM_EVENT_SIGNIFICANCE_FAULT
          DemAgingCycleRef = Ignition_on_off
          DemOperationCycleRef = Ignition_on_off
          DemDebounceAlgorithmClass
            DemDebounceMonitorInternal
              DemCallbackGetFDC
      DTCClass_DTC_0x9a1113 (DemDTCClass): DemDTCSeverity=DEM_DTC_SEV_NO_SEVERITY, DemUdsDTC=10096915
      TUNER_FM2_open_Circuit_Open (DemEventParameter):
        DemEventKind = DEM_EVENT_KIND_SWC
        DemMaxNumberFreezeFrameRecords = 1
        DemEventLatchTestFailed = false
        DemDTCClassRef = DTCClass_DTC_0x9a1113
        DemExtendedDataClassRef = ExtendedDataClass_4f5344cd
        DemFreezeFrameClassRef = FreezeFrameClass_80c88891
        DemEventClass:
          DemAgingAllowed = true
          DemAgingCycleCounterThreshold = 40
          DemEventDestination = DEM_DTC_ORIGIN_PRIMARY_MEMORY
          DemEventPriority = 2
          DemEventSignificance = DEM_EVENT_SIGNIFICANCE_FAULT
          DemAgingCycleRef = Ignition_on_off
          DemOperationCycleRef = Ignition_on_off
          DemDebounceAlgorithmClass
            DemDebounceMonitorInternal
              DemCallbackGetFDC
      DTCClass_DTC_0x9a1119 (DemDTCClass): DemDTCSeverity=DEM_DTC_SEV_NO_SEVERITY, DemUdsDTC=10096921
      TUNER_FM2_over_current_detection_Circuit_Current_Above_Threshold (DemEventParameter):
        DemEventKind = DEM_EVENT_KIND_SWC
        DemMaxNumberFreezeFrameRecords = 1
        DemEventLatchTestFailed = false
        DemDTCClassRef = DTCClass_DTC_0x9a1119
        DemExtendedDataClassRef = ExtendedDataClass_4f5344cd
        DemFreezeFrameClassRef = FreezeFrameClass_80c88891
        DemEventClass:
          DemAgingAllowed = true
          DemAgingCycleCounterThreshold = 40
          DemEventDestination = DEM_DTC_ORIGIN_PRIMARY_MEMORY
          DemEventPriority = 2
          DemEventSignificance = DEM_EVENT_SIGNIFICANCE_FAULT
          DemAgingCycleRef = Ignition_on_off
          DemOperationCycleRef = Ignition_on_off
          DemDebounceAlgorithmClass
            DemDebounceMonitorInternal
              DemCallbackGetFDC
      DTCClass_DTC_0xa10017 (DemDTCClass): DemDTCSeverity=DEM_DTC_SEV_NO_SEVERITY, DemUdsDTC=10551319
      IP_Display_ICD_Over_voltage_Circuit_Voltage_Above_Threshold (DemEventParameter):
        DemEventKind = DEM_EVENT_KIND_SWC
        DemMaxNumberFreezeFrameRecords = 1
        DemEventLatchTestFailed = false
        DemDTCClassRef = DTCClass_DTC_0xa10017
        DemExtendedDataClassRef = ExtendedDataClass_4f5344cd
        DemFreezeFrameClassRef = FreezeFrameClass_80c88891
        DemEventClass:
          DemAgingAllowed = true
          DemAgingCycleCounterThreshold = 40
          DemEventDestination = DEM_DTC_ORIGIN_PRIMARY_MEMORY
          DemEventPriority = 2
          DemEventSignificance = DEM_EVENT_SIGNIFICANCE_FAULT
          DemAgingCycleRef = Ignition_on_off
          DemOperationCycleRef = Ignition_on_off
          DemDebounceAlgorithmClass
            DemDebounceMonitorInternal
              DemCallbackGetFDC
      DTCClass_DTC_0xa10049 (DemDTCClass): DemDTCSeverity=DEM_DTC_SEV_NO_SEVERITY, DemUdsDTC=10551369
      IP_Display_ICD_Dimming_module_status_Internal_Electronic_Failure (DemEventParameter):
        DemEventKind = DEM_EVENT_KIND_SWC
        DemMaxNumberFreezeFrameRecords = 1
        DemEventLatchTestFailed = false
        DemDTCClassRef = DTCClass_DTC_0xa10049
        DemExtendedDataClassRef = ExtendedDataClass_4f5344cd
        DemFreezeFrameClassRef = FreezeFrameClass_80c88891
        DemEventClass:
          DemAgingAllowed = true
          DemAgingCycleCounterThreshold = 40
          DemEventDestination = DEM_DTC_ORIGIN_PRIMARY_MEMORY
          DemEventPriority = 2
          DemEventSignificance = DEM_EVENT_SIGNIFICANCE_FAULT
          DemAgingCycleRef = Ignition_on_off
          DemOperationCycleRef = Ignition_on_off
          DemDebounceAlgorithmClass
            DemDebounceMonitorInternal
              DemCallbackGetFDC
      DTCClass_DTC_0xa10116 (DemDTCClass): DemDTCSeverity=DEM_DTC_SEV_NO_SEVERITY, DemUdsDTC=10551574
      IP_Display_ICD_Low_voltage_Circuit_Voltage_Below_Threshold (DemEventParameter):
        DemEventKind = DEM_EVENT_KIND_SWC
        DemMaxNumberFreezeFrameRecords = 1
        DemEventLatchTestFailed = false
        DemDTCClassRef = DTCClass_DTC_0xa10116
        DemExtendedDataClassRef = ExtendedDataClass_4f5344cd
        DemFreezeFrameClassRef = FreezeFrameClass_80c88891
        DemEventClass:
          DemAgingAllowed = true
          DemAgingCycleCounterThreshold = 40
          DemEventDestination = DEM_DTC_ORIGIN_PRIMARY_MEMORY
          DemEventPriority = 2
          DemEventSignificance = DEM_EVENT_SIGNIFICANCE_FAULT
          DemAgingCycleRef = Ignition_on_off
          DemOperationCycleRef = Ignition_on_off
          DemDebounceAlgorithmClass
            DemDebounceMonitorInternal
              DemCallbackGetFDC
      DTCClass_DTC_0xa10149 (DemDTCClass): DemDTCSeverity=DEM_DTC_SEV_NO_SEVERITY, DemUdsDTC=10551625
      IP_Display_ICD_screen_IC_failure_Internal_Electronic_Failure (DemEventParameter):
        DemEventKind = DEM_EVENT_KIND_SWC
        DemMaxNumberFreezeFrameRecords = 1
        DemEventLatchTestFailed = false
        DemDTCClassRef = DTCClass_DTC_0xa10149
        DemExtendedDataClassRef = ExtendedDataClass_4f5344cd
        DemFreezeFrameClassRef = FreezeFrameClass_80c88891
        DemEventClass:
          DemAgingAllowed = true
          DemAgingCycleCounterThreshold = 40
          DemEventDestination = DEM_DTC_ORIGIN_PRIMARY_MEMORY
          DemEventPriority = 2
          DemEventSignificance = DEM_EVENT_SIGNIFICANCE_FAULT
          DemAgingCycleRef = Ignition_on_off
          DemOperationCycleRef = Ignition_on_off
          DemDebounceAlgorithmClass
            DemDebounceMonitorInternal
              DemCallbackGetFDC
      DTCClass_DTC_0xa10249 (DemDTCClass): DemDTCSeverity=DEM_DTC_SEV_NO_SEVERITY, DemUdsDTC=10551881
      IP_Display_ASIC_failure_Internal_Electronic_Failure (DemEventParameter):
        DemEventKind = DEM_EVENT_KIND_SWC
        DemMaxNumberFreezeFrameRecords = 1
        DemEventLatchTestFailed = false
        DemDTCClassRef = DTCClass_DTC_0xa10249
        DemExtendedDataClassRef = ExtendedDataClass_4f5344cd
        DemFreezeFrameClassRef = FreezeFrameClass_80c88891
        DemEventClass:
          DemAgingAllowed = true
          DemAgingCycleCounterThreshold = 40
          DemEventDestination = DEM_DTC_ORIGIN_PRIMARY_MEMORY
          DemEventPriority = 2
          DemEventSignificance = DEM_EVENT_SIGNIFICANCE_FAULT
          DemAgingCycleRef = Ignition_on_off
          DemOperationCycleRef = Ignition_on_off
          DemDebounceAlgorithmClass
            DemDebounceMonitorInternal
              DemCallbackGetFDC
      DTCClass_DTC_0xa10349 (DemDTCClass): DemDTCSeverity=DEM_DTC_SEV_NO_SEVERITY, DemUdsDTC=10552137
      IP_Display_PRNDM_Telltale_failure_Internal_Electronic_Failure (DemEventParameter):
        DemEventKind = DEM_EVENT_KIND_SWC
        DemMaxNumberFreezeFrameRecords = 1
        DemEventLatchTestFailed = false
        DemDTCClassRef = DTCClass_DTC_0xa10349
        DemExtendedDataClassRef = ExtendedDataClass_4f5344cd
        DemFreezeFrameClassRef = FreezeFrameClass_80c88891
        DemEventClass:
          DemAgingAllowed = true
          DemAgingCycleCounterThreshold = 40
          DemEventDestination = DEM_DTC_ORIGIN_PRIMARY_MEMORY
          DemEventPriority = 2
          DemEventSignificance = DEM_EVENT_SIGNIFICANCE_FAULT
          DemAgingCycleRef = Ignition_on_off
          DemOperationCycleRef = Ignition_on_off
          DemDebounceAlgorithmClass
            DemDebounceMonitorInternal
              DemCallbackGetFDC
      DTCClass_DTC_0xa10408 (DemDTCClass): DemDTCSeverity=DEM_DTC_SEV_NO_SEVERITY, DemUdsDTC=10552328
      IP_Display_IIC_communication_failure_Bus_Signal_Message_Failure (DemEventParameter):
        DemEventKind = DEM_EVENT_KIND_SWC
        DemMaxNumberFreezeFrameRecords = 1
        DemEventLatchTestFailed = false
        DemDTCClassRef = DTCClass_DTC_0xa10408
        DemExtendedDataClassRef = ExtendedDataClass_4f5344cd
        DemFreezeFrameClassRef = FreezeFrameClass_80c88891
        DemEventClass:
          DemAgingAllowed = true
          DemAgingCycleCounterThreshold = 40
          DemEventDestination = DEM_DTC_ORIGIN_PRIMARY_MEMORY
          DemEventPriority = 2
          DemEventSignificance = DEM_EVENT_SIGNIFICANCE_FAULT
          DemAgingCycleRef = Ignition_on_off
          DemOperationCycleRef = Ignition_on_off
          DemDebounceAlgorithmClass
            DemDebounceMonitorInternal
              DemCallbackGetFDC
      DTCClass_DTC_0xa13011 (DemDTCClass): DemDTCSeverity=DEM_DTC_SEV_NO_SEVERITY, DemUdsDTC=10563601
      Fuel_sensor1_short_to_GND_Circuit_Short_To_Ground (DemEventParameter):
        DemEventKind = DEM_EVENT_KIND_SWC
        DemMaxNumberFreezeFrameRecords = 1
        DemEventLatchTestFailed = false
        DemDTCClassRef = DTCClass_DTC_0xa13011
        DemExtendedDataClassRef = ExtendedDataClass_4f5344cd
        DemFreezeFrameClassRef = FreezeFrameClass_80c88891
        DemEventClass:
          DemAgingAllowed = true
          DemAgingCycleCounterThreshold = 40
          DemEventDestination = DEM_DTC_ORIGIN_PRIMARY_MEMORY
          DemEventPriority = 2
          DemEventSignificance = DEM_EVENT_SIGNIFICANCE_FAULT
          DemAgingCycleRef = Ignition_on_off
          DemEnableConditionGroupRef = EnableConditionGroup_IgnOn
          DemOperationCycleRef = Ignition_on_off
          DemDebounceAlgorithmClass
            DemDebounceTimeBase: DemDebounceTimeFailedThreshold=3, DemDebounceTimePassedThreshold=3, DemDebounceBehavior=DEM_DEBOUNCE_FREEZE
      DTCClass_DTC_0xa13111 (DemDTCClass): DemDTCSeverity=DEM_DTC_SEV_NO_SEVERITY, DemUdsDTC=10563857
      Fuel_sensor2_short_to_GND_Circuit_Short_To_Ground (DemEventParameter):
        DemEventKind = DEM_EVENT_KIND_SWC
        DemMaxNumberFreezeFrameRecords = 1
        DemEventLatchTestFailed = false
        DemDTCClassRef = DTCClass_DTC_0xa13111
        DemExtendedDataClassRef = ExtendedDataClass_4f5344cd
        DemFreezeFrameClassRef = FreezeFrameClass_80c88891
        DemEventClass:
          DemAgingAllowed = true
          DemAgingCycleCounterThreshold = 40
          DemEventDestination = DEM_DTC_ORIGIN_PRIMARY_MEMORY
          DemEventPriority = 2
          DemEventSignificance = DEM_EVENT_SIGNIFICANCE_FAULT
          DemAgingCycleRef = Ignition_on_off
          DemEnableConditionGroupRef = EnableConditionGroup_IgnOn
          DemOperationCycleRef = Ignition_on_off
          DemDebounceAlgorithmClass
            DemDebounceTimeBase: DemDebounceTimeFailedThreshold=3, DemDebounceTimePassedThreshold=3, DemDebounceBehavior=DEM_DEBOUNCE_FREEZE
      DTCClass_DTC_0xa20008 (DemDTCClass): DemDTCSeverity=DEM_DTC_SEV_NO_SEVERITY, DemUdsDTC=10616840
      INVALID_SHORTNAME_HUT_Display_not_received_backlight_value_Bus_Signal_Message_Failure (DemEventParameter):
        DemEventKind = DEM_EVENT_KIND_SWC
        DemMaxNumberFreezeFrameRecords = 1
        DemDTCClassRef = DTCClass_DTC_0xa20008
        DemExtendedDataClassRef = ExtendedDataClass_4f5344cd
        DemFreezeFrameClassRef = FreezeFrameClass_80c88891
        DemEventClass:
          DemAgingAllowed = true
          DemAgingCycleCounterThreshold = 40
          DemEventDestination = DEM_DTC_ORIGIN_PRIMARY_MEMORY
          DemEventPriority = 2
          DemEventSignificance = DEM_EVENT_SIGNIFICANCE_FAULT
          DemAgingCycleRef = Ignition_on_off
          DemOperationCycleRef = Ignition_on_off
          DemDebounceAlgorithmClass
            DemDebounceMonitorInternal
              DemCallbackGetFDC
      DTCClass_DTC_0xa20017 (DemDTCClass): DemDTCSeverity=DEM_DTC_SEV_NO_SEVERITY, DemUdsDTC=10616855
      INVALID_SHORTNAME_HUT_Display_Over_voltage_Circuit_Voltage_Above_Threshold (DemEventParameter):
        DemEventKind = DEM_EVENT_KIND_SWC
        DemMaxNumberFreezeFrameRecords = 1
        DemDTCClassRef = DTCClass_DTC_0xa20017
        DemExtendedDataClassRef = ExtendedDataClass_4f5344cd
        DemFreezeFrameClassRef = FreezeFrameClass_80c88891
        DemEventClass:
          DemAgingAllowed = true
          DemAgingCycleCounterThreshold = 40
          DemEventDestination = DEM_DTC_ORIGIN_PRIMARY_MEMORY
          DemEventPriority = 2
          DemEventSignificance = DEM_EVENT_SIGNIFICANCE_FAULT
          DemAgingCycleRef = Ignition_on_off
          DemOperationCycleRef = Ignition_on_off
          DemDebounceAlgorithmClass
            DemDebounceMonitorInternal
              DemCallbackGetFDC
      DTCClass_DTC_0xa20116 (DemDTCClass): DemDTCSeverity=DEM_DTC_SEV_NO_SEVERITY, DemUdsDTC=10617110
      INVALID_SHORTNAME_HUT_Display_Low_voltage_Circuit_Voltage_Below_Threshold (DemEventParameter):
        DemEventKind = DEM_EVENT_KIND_SWC
        DemMaxNumberFreezeFrameRecords = 1
        DemEventLatchTestFailed = false
        DemDTCClassRef = DTCClass_DTC_0xa20116
        DemExtendedDataClassRef = ExtendedDataClass_4f5344cd
        DemFreezeFrameClassRef = FreezeFrameClass_80c88891
        DemEventClass:
          DemAgingAllowed = true
          DemAgingCycleCounterThreshold = 40
          DemEventDestination = DEM_DTC_ORIGIN_PRIMARY_MEMORY
          DemEventPriority = 2
          DemEventSignificance = DEM_EVENT_SIGNIFICANCE_FAULT
          DemAgingCycleRef = Ignition_on_off
          DemOperationCycleRef = Ignition_on_off
          DemDebounceAlgorithmClass
            DemDebounceMonitorInternal
              DemCallbackGetFDC
      DTCClass_DTC_0xa20149 (DemDTCClass): DemDTCSeverity=DEM_DTC_SEV_NO_SEVERITY, DemUdsDTC=10617161
      INVALID_SHORTNAME_HUT_Display_backlight_module_status_Internal_Electronic_Failure (DemEventParameter):
        DemEventKind = DEM_EVENT_KIND_SWC
        DemMaxNumberFreezeFrameRecords = 1
        DemEventLatchTestFailed = false
        DemDTCClassRef = DTCClass_DTC_0xa20149
        DemExtendedDataClassRef = ExtendedDataClass_4f5344cd
        DemFreezeFrameClassRef = FreezeFrameClass_80c88891
        DemEventClass:
          DemAgingAllowed = true
          DemAgingCycleCounterThreshold = 40
          DemEventDestination = DEM_DTC_ORIGIN_PRIMARY_MEMORY
          DemEventPriority = 2
          DemEventSignificance = DEM_EVENT_SIGNIFICANCE_FAULT
          DemAgingCycleRef = Ignition_on_off
          DemOperationCycleRef = Ignition_on_off
          DemDebounceAlgorithmClass
            DemDebounceMonitorInternal
              DemCallbackGetFDC
      DTCClass_DTC_0xa20249 (DemDTCClass): DemDTCSeverity=DEM_DTC_SEV_NO_SEVERITY, DemUdsDTC=10617417
      INVALID_SHORTNAME_HUT_Display_TFT_failure_Internal_Electronic_Failure (DemEventParameter):
        DemEventKind = DEM_EVENT_KIND_SWC
        DemMaxNumberFreezeFrameRecords = 1
        DemEventLatchTestFailed = false
        DemDTCClassRef = DTCClass_DTC_0xa20249
        DemExtendedDataClassRef = ExtendedDataClass_4f5344cd
        DemFreezeFrameClassRef = FreezeFrameClass_80c88891
        DemEventClass:
          DemAgingAllowed = true
          DemAgingCycleCounterThreshold = 40
          DemEventDestination = DEM_DTC_ORIGIN_PRIMARY_MEMORY
          DemEventPriority = 2
          DemEventSignificance = DEM_EVENT_SIGNIFICANCE_FAULT
          DemAgingCycleRef = Ignition_on_off
          DemOperationCycleRef = Ignition_on_off
          DemDebounceAlgorithmClass
            DemDebounceMonitorInternal
              DemCallbackGetFDC
      DTCClass_DTC_0xa20349 (DemDTCClass): DemDTCSeverity=DEM_DTC_SEV_NO_SEVERITY, DemUdsDTC=10617673
      INVALID_SHORTNAME_HUT_Display_video_signal_connect_failure_Internal_Electronic_Failure (DemEventParameter):
        DemEventKind = DEM_EVENT_KIND_SWC
        DemMaxNumberFreezeFrameRecords = 1
        DemEventLatchTestFailed = false
        DemDTCClassRef = DTCClass_DTC_0xa20349
        DemExtendedDataClassRef = ExtendedDataClass_4f5344cd
        DemFreezeFrameClassRef = FreezeFrameClass_80c88891
        DemEventClass:
          DemAgingAllowed = true
          DemAgingCycleCounterThreshold = 40
          DemEventDestination = DEM_DTC_ORIGIN_PRIMARY_MEMORY
          DemEventPriority = 2
          DemEventSignificance = DEM_EVENT_SIGNIFICANCE_FAULT
          DemAgingCycleRef = Ignition_on_off
          DemOperationCycleRef = Ignition_on_off
          DemDebounceAlgorithmClass
            DemDebounceMonitorInternal
              DemCallbackGetFDC
      DTCClass_DTC_0xa20449 (DemDTCClass): DemDTCSeverity=DEM_DTC_SEV_NO_SEVERITY, DemUdsDTC=10617929
      INVALID_SHORTNAME_HUT_Display_Touch_Panel_failure_Internal_Electronic_Failure (DemEventParameter):
        DemEventKind = DEM_EVENT_KIND_SWC
        DemMaxNumberFreezeFrameRecords = 1
        DemEventLatchTestFailed = false
        DemDTCClassRef = DTCClass_DTC_0xa20449
        DemExtendedDataClassRef = ExtendedDataClass_4f5344cd
        DemFreezeFrameClassRef = FreezeFrameClass_80c88891
        DemEventClass:
          DemAgingAllowed = true
          DemAgingCycleCounterThreshold = 40
          DemEventDestination = DEM_DTC_ORIGIN_PRIMARY_MEMORY
          DemEventPriority = 2
          DemEventSignificance = DEM_EVENT_SIGNIFICANCE_FAULT
          DemAgingCycleRef = Ignition_on_off
          DemOperationCycleRef = Ignition_on_off
          DemDebounceAlgorithmClass
            DemDebounceMonitorInternal
              DemCallbackGetFDC
      DTCClass_DTC_0xc07388 (DemDTCClass): DemDTCSeverity=DEM_DTC_SEV_NO_SEVERITY, DemUdsDTC=12612488
      ControlModuleCANBus_off_Bus_off (DemEventParameter):
        DemEventKind = DEM_EVENT_KIND_SWC
        DemMaxNumberFreezeFrameRecords = 1
        DemEventLatchTestFailed = false
        DemDTCClassRef = DTCClass_DTC_0xc07388
        DemExtendedDataClassRef = ExtendedDataClass_4f5344cd
        DemFreezeFrameClassRef = FreezeFrameClass_80c88891
        DemEventClass:
          DemAgingAllowed = true
          DemAgingCycleCounterThreshold = 40
          DemEventDestination = DEM_DTC_ORIGIN_PRIMARY_MEMORY
          DemEventPriority = 2
          DemEventSignificance = DEM_EVENT_SIGNIFICANCE_FAULT
          DemAgingCycleRef = Ignition_on_off
          DemEnableConditionGroupRef = EnableConditionGroup_Wakeup
          DemOperationCycleRef = Ignition_on_off
          DemDebounceAlgorithmClass
            DemDebounceMonitorInternal
              DemCallbackGetFDC
      DTCClass_DTC_0xc10087 (DemDTCClass): DemDTCSeverity=DEM_DTC_SEV_NO_SEVERITY, DemUdsDTC=12648583
      Missing_Engine_Control_Module_Missing_Message (DemEventParameter):
        DemEventKind = DEM_EVENT_KIND_SWC
        DemMaxNumberFreezeFrameRecords = 1
        DemEventLatchTestFailed = false
        DemDTCClassRef = DTCClass_DTC_0xc10087
        DemExtendedDataClassRef = ExtendedDataClass_4f5344cd
        DemFreezeFrameClassRef = FreezeFrameClass_80c88891
        DemEventClass:
          DemAgingAllowed = true
          DemAgingCycleCounterThreshold = 40
          DemEventDestination = DEM_DTC_ORIGIN_PRIMARY_MEMORY
          DemEventPriority = 2
          DemEventSignificance = DEM_EVENT_SIGNIFICANCE_FAULT
          DemAgingCycleRef = Ignition_on_off
          DemEnableConditionGroupRef = EnableConditionGroup_Wakeup
          DemOperationCycleRef = Ignition_on_off
          DemDebounceAlgorithmClass
            DemDebounceCounterBased:
              DemDebounceCounterDecrementStepSize = 25
              DemDebounceCounterIncrementStepSize = 25
              DemDebounceCounterJumpDown = false
              DemDebounceCounterJumpUp = false
              DemDebounceCounterJumpUpValue = 1
              DemDebounceCounterFailedThreshold = 125
              DemDebounceCounterPassedThreshold = -125
              DemEventDebounceCounterStorageThreshold = 0
              DemDebounceCounterStorage = false
              DemDebounceBehavior = DEM_DEBOUNCE_FREEZE
      DTCClass_DTC_0xc10187 (DemDTCClass): DemDTCSeverity=DEM_DTC_SEV_NO_SEVERITY, DemUdsDTC=12648839
      Missing_Transmission_Control_Until_PTCAN_Missing_Message (DemEventParameter):
        DemEventKind = DEM_EVENT_KIND_SWC
        DemMaxNumberFreezeFrameRecords = 1
        DemEventLatchTestFailed = false
        DemDTCClassRef = DTCClass_DTC_0xc10187
        DemExtendedDataClassRef = ExtendedDataClass_4f5344cd
        DemFreezeFrameClassRef = FreezeFrameClass_80c88891
        DemEventClass:
          DemAgingAllowed = true
          DemAgingCycleCounterThreshold = 40
          DemEventDestination = DEM_DTC_ORIGIN_PRIMARY_MEMORY
          DemEventPriority = 2
          DemEventSignificance = DEM_EVENT_SIGNIFICANCE_FAULT
          DemAgingCycleRef = Ignition_on_off
          DemEnableConditionGroupRef = EnableConditionGroup_Wakeup
          DemOperationCycleRef = Ignition_on_off
          DemDebounceAlgorithmClass
            DemDebounceCounterBased:
              DemDebounceCounterDecrementStepSize = 25
              DemDebounceCounterIncrementStepSize = 25
              DemDebounceCounterJumpDown = false
              DemDebounceCounterJumpUp = false
              DemDebounceCounterJumpUpValue = 1
              DemDebounceCounterFailedThreshold = 125
              DemDebounceCounterPassedThreshold = -125
              DemEventDebounceCounterStorageThreshold = 0
              DemDebounceCounterStorage = false
              DemDebounceBehavior = DEM_DEBOUNCE_FREEZE
      DTCClass_DTC_0xc10487 (DemDTCClass): DemDTCSeverity=DEM_DTC_SEV_NO_SEVERITY, DemUdsDTC=12649607
      missing_Adaptive_Cruise_Control_system_Radar_Control_Module (DemEventParameter):
        DemEventKind = DEM_EVENT_KIND_SWC
        DemMaxNumberFreezeFrameRecords = 1
        DemEventLatchTestFailed = false
        DemDTCClassRef = DTCClass_DTC_0xc10487
        DemExtendedDataClassRef = ExtendedDataClass_4f5344cd
        DemFreezeFrameClassRef = FreezeFrameClass_80c88891
        DemEventClass:
          DemAgingAllowed = true
          DemAgingCycleCounterThreshold = 40
          DemEventDestination = DEM_DTC_ORIGIN_PRIMARY_MEMORY
          DemEventPriority = 2
          DemEventSignificance = DEM_EVENT_SIGNIFICANCE_FAULT
          DemEventFailureCycleCounterThreshold = 5
          DemAgingCycleRef = Ignition_on_off
          DemEnableConditionGroupRef = EnableConditionGroup_Wakeup
          DemOperationCycleRef = Ignition_on_off
          DemDebounceAlgorithmClass
            DemDebounceCounterBased:
              DemDebounceCounterDecrementStepSize = 25
              DemDebounceCounterIncrementStepSize = 25
              DemDebounceCounterJumpDown = false
              DemDebounceCounterJumpUp = false
              DemDebounceCounterJumpUpValue = 1
              DemDebounceCounterFailedThreshold = 125
              DemDebounceCounterPassedThreshold = -125
              DemEventDebounceCounterStorageThreshold = 0
              DemDebounceCounterStorage = false
              DemDebounceBehavior = DEM_DEBOUNCE_FREEZE
      DTCClass_DTC_0xc11187 (DemDTCClass): DemDTCSeverity=DEM_DTC_SEV_NO_SEVERITY, DemUdsDTC=12652935
      MissingBattery_Management_System (DemEventParameter):
        DemEventKind = DEM_EVENT_KIND_SWC
        DemMaxNumberFreezeFrameRecords = 1
        DemEventLatchTestFailed = false
        DemDTCClassRef = DTCClass_DTC_0xc11187
        DemExtendedDataClassRef = ExtendedDataClass_4f5344cd
        DemFreezeFrameClassRef = FreezeFrameClass_80c88891
        DemEventClass:
          DemAgingAllowed = true
          DemAgingCycleCounterThreshold = 40
          DemEventDestination = DEM_DTC_ORIGIN_PRIMARY_MEMORY
          DemEventPriority = 2
          DemEventSignificance = DEM_EVENT_SIGNIFICANCE_FAULT
          DemEventFailureCycleCounterThreshold = 5
          DemAgingCycleRef = Ignition_on_off
          DemEnableConditionGroupRef = EnableConditionGroup_Wakeup
          DemOperationCycleRef = Ignition_on_off
          DemDebounceAlgorithmClass
            DemDebounceCounterBased:
              DemDebounceCounterDecrementStepSize = 25
              DemDebounceCounterIncrementStepSize = 25
              DemDebounceCounterJumpDown = false
              DemDebounceCounterJumpUp = false
              DemDebounceCounterJumpUpValue = 1
              DemDebounceCounterFailedThreshold = 125
              DemDebounceCounterPassedThreshold = -125
              DemEventDebounceCounterStorageThreshold = 0
              DemDebounceCounterStorage = false
              DemDebounceBehavior = DEM_DEBOUNCE_FREEZE
      DTCClass_DTC_0xc11487 (DemDTCClass): DemDTCSeverity=DEM_DTC_SEV_NO_SEVERITY, DemUdsDTC=12653703
      Missing_Nextrac_Torque_On_Demand_Missing_Message (DemEventParameter):
        DemEventKind = DEM_EVENT_KIND_SWC
        DemMaxNumberFreezeFrameRecords = 1
        DemEventLatchTestFailed = false
        DemDTCClassRef = DTCClass_DTC_0xc11487
        DemExtendedDataClassRef = ExtendedDataClass_4f5344cd
        DemFreezeFrameClassRef = FreezeFrameClass_80c88891
        DemEventClass:
          DemAgingAllowed = true
          DemAgingCycleCounterThreshold = 40
          DemEventDestination = DEM_DTC_ORIGIN_PRIMARY_MEMORY
          DemEventPriority = 2
          DemEventSignificance = DEM_EVENT_SIGNIFICANCE_FAULT
          DemEventFailureCycleCounterThreshold = 5
          DemAgingCycleRef = Ignition_on_off
          DemEnableConditionGroupRef = EnableConditionGroup_Wakeup
          DemOperationCycleRef = Ignition_on_off
          DemDebounceAlgorithmClass
            DemDebounceCounterBased:
              DemDebounceCounterDecrementStepSize = 25
              DemDebounceCounterIncrementStepSize = 25
              DemDebounceCounterJumpDown = false
              DemDebounceCounterJumpUp = false
              DemDebounceCounterJumpUpValue = 1
              DemDebounceCounterFailedThreshold = 125
              DemDebounceCounterPassedThreshold = -125
              DemEventDebounceCounterStorageThreshold = 0
              DemDebounceCounterStorage = false
              DemDebounceBehavior = DEM_DEBOUNCE_FREEZE
      DTCClass_DTC_0xc11587 (DemDTCClass): DemDTCSeverity=DEM_DTC_SEV_NO_SEVERITY, DemUdsDTC=12653959
      Missing_Electronic_Gerodisc_Missing_Message (DemEventParameter):
        DemEventKind = DEM_EVENT_KIND_SWC
        DemMaxNumberFreezeFrameRecords = 1
        DemEventLatchTestFailed = false
        DemDTCClassRef = DTCClass_DTC_0xc11587
        DemExtendedDataClassRef = ExtendedDataClass_4f5344cd
        DemFreezeFrameClassRef = FreezeFrameClass_80c88891
        DemEventClass:
          DemAgingAllowed = true
          DemAgingCycleCounterThreshold = 40
          DemEventDestination = DEM_DTC_ORIGIN_PRIMARY_MEMORY
          DemEventPriority = 2
          DemEventSignificance = DEM_EVENT_SIGNIFICANCE_FAULT
          DemEventFailureCycleCounterThreshold = 5
          DemAgingCycleRef = Ignition_on_off
          DemEnableConditionGroupRef = EnableConditionGroup_Wakeup
          DemOperationCycleRef = Ignition_on_off
          DemDebounceAlgorithmClass
            DemDebounceCounterBased:
              DemDebounceCounterDecrementStepSize = 25
              DemDebounceCounterIncrementStepSize = 25
              DemDebounceCounterJumpDown = false
              DemDebounceCounterJumpUp = false
              DemDebounceCounterJumpUpValue = 1
              DemDebounceCounterFailedThreshold = 125
              DemDebounceCounterPassedThreshold = -125
              DemEventDebounceCounterStorageThreshold = 0
              DemDebounceCounterStorage = false
              DemDebounceBehavior = DEM_DEBOUNCE_FREEZE
      DTCClass_DTC_0xc12287 (DemDTCClass): DemDTCSeverity=DEM_DTC_SEV_NO_SEVERITY, DemUdsDTC=12657287
      Missing_Electrical_Stable_Program_Antilock_Brake_System_Missing_Message (DemEventParameter):
        DemEventKind = DEM_EVENT_KIND_SWC
        DemMaxNumberFreezeFrameRecords = 1
        DemEventLatchTestFailed = false
        DemDTCClassRef = DTCClass_DTC_0xc12287
        DemExtendedDataClassRef = ExtendedDataClass_4f5344cd
        DemFreezeFrameClassRef = FreezeFrameClass_80c88891
        DemEventClass:
          DemAgingAllowed = true
          DemAgingCycleCounterThreshold = 40
          DemEventDestination = DEM_DTC_ORIGIN_PRIMARY_MEMORY
          DemEventPriority = 2
          DemEventSignificance = DEM_EVENT_SIGNIFICANCE_FAULT
          DemEventFailureCycleCounterThreshold = 5
          DemAgingCycleRef = Ignition_on_off
          DemEnableConditionGroupRef = EnableConditionGroup_Wakeup
          DemOperationCycleRef = Ignition_on_off
          DemDebounceAlgorithmClass
            DemDebounceCounterBased:
              DemDebounceCounterDecrementStepSize = 25
              DemDebounceCounterIncrementStepSize = 25
              DemDebounceCounterJumpDown = false
              DemDebounceCounterJumpUp = false
              DemDebounceCounterJumpUpValue = 1
              DemDebounceCounterFailedThreshold = 125
              DemDebounceCounterPassedThreshold = -125
              DemEventDebounceCounterStorageThreshold = 0
              DemDebounceCounterStorage = false
              DemDebounceBehavior = DEM_DEBOUNCE_FREEZE
      DTCClass_DTC_0xc12787 (DemDTCClass): DemDTCSeverity=DEM_DTC_SEV_NO_SEVERITY, DemUdsDTC=12658567
      missing_Tyre_Pressure_Monitoring_Systems_Missing_Message (DemEventParameter):
        DemEventKind = DEM_EVENT_KIND_SWC
        DemMaxNumberFreezeFrameRecords = 1
        DemEventLatchTestFailed = false
        DemDTCClassRef = DTCClass_DTC_0xc12787
        DemExtendedDataClassRef = ExtendedDataClass_4f5344cd
        DemFreezeFrameClassRef = FreezeFrameClass_80c88891
        DemEventClass:
          DemAgingAllowed = true
          DemAgingCycleCounterThreshold = 40
          DemEventDestination = DEM_DTC_ORIGIN_PRIMARY_MEMORY
          DemEventPriority = 2
          DemEventSignificance = DEM_EVENT_SIGNIFICANCE_FAULT
          DemEventFailureCycleCounterThreshold = 5
          DemAgingCycleRef = Ignition_on_off
          DemEnableConditionGroupRef = EnableConditionGroup_Wakeup
          DemOperationCycleRef = Ignition_on_off
          DemDebounceAlgorithmClass
            DemDebounceCounterBased:
              DemDebounceCounterDecrementStepSize = 25
              DemDebounceCounterIncrementStepSize = 25
              DemDebounceCounterJumpDown = false
              DemDebounceCounterJumpUp = false
              DemDebounceCounterJumpUpValue = 1
              DemDebounceCounterFailedThreshold = 125
              DemDebounceCounterPassedThreshold = -125
              DemEventDebounceCounterStorageThreshold = 0
              DemDebounceCounterStorage = false
              DemDebounceBehavior = DEM_DEBOUNCE_FREEZE
      DTCClass_DTC_0xc12887 (DemDTCClass): DemDTCSeverity=DEM_DTC_SEV_NO_SEVERITY, DemUdsDTC=12658823
      Missing_Electric_Park_Brake_controller (DemEventParameter):
        DemEventKind = DEM_EVENT_KIND_SWC
        DemMaxNumberFreezeFrameRecords = 1
        DemDTCClassRef = DTCClass_DTC_0xc12887
        DemExtendedDataClassRef = ExtendedDataClass_4f5344cd
        DemFreezeFrameClassRef = FreezeFrameClass_80c88891
        DemEventClass:
          DemAgingAllowed = true
          DemAgingCycleCounterThreshold = 40
          DemEventDestination = DEM_DTC_ORIGIN_PRIMARY_MEMORY
          DemEventPriority = 2
          DemEventSignificance = DEM_EVENT_SIGNIFICANCE_FAULT
          DemEventFailureCycleCounterThreshold = 5
          DemAgingCycleRef = Ignition_on_off
          DemEnableConditionGroupRef = EnableConditionGroup_Wakeup
          DemOperationCycleRef = Ignition_on_off
          DemDebounceAlgorithmClass
            DemDebounceCounterBased:
              DemDebounceCounterDecrementStepSize = 25
              DemDebounceCounterIncrementStepSize = 25
              DemDebounceCounterJumpDown = false
              DemDebounceCounterJumpUp = false
              DemDebounceCounterJumpUpValue = 1
              DemDebounceCounterFailedThreshold = 125
              DemDebounceCounterPassedThreshold = -125
              DemEventDebounceCounterStorageThreshold = 0
              DemDebounceCounterStorage = false
              DemDebounceBehavior = DEM_DEBOUNCE_FREEZE
      DTCClass_DTC_0xc13187 (DemDTCClass): DemDTCSeverity=DEM_DTC_SEV_NO_SEVERITY, DemUdsDTC=12661127
      Missing_Electric_Power_Steering_system_Missing_Message (DemEventParameter):
        DemEventKind = DEM_EVENT_KIND_SWC
        DemMaxNumberFreezeFrameRecords = 1
        DemEventLatchTestFailed = false
        DemDTCClassRef = DTCClass_DTC_0xc13187
        DemExtendedDataClassRef = ExtendedDataClass_4f5344cd
        DemFreezeFrameClassRef = FreezeFrameClass_80c88891
        DemEventClass:
          DemAgingAllowed = true
          DemAgingCycleCounterThreshold = 40
          DemEventDestination = DEM_DTC_ORIGIN_PRIMARY_MEMORY
          DemEventPriority = 2
          DemEventSignificance = DEM_EVENT_SIGNIFICANCE_FAULT
          DemEventFailureCycleCounterThreshold = 5
          DemAgingCycleRef = Ignition_on_off
          DemEnableConditionGroupRef = EnableConditionGroup_Wakeup
          DemOperationCycleRef = Ignition_on_off
          DemDebounceAlgorithmClass
            DemDebounceCounterBased:
              DemDebounceCounterDecrementStepSize = 25
              DemDebounceCounterIncrementStepSize = 25
              DemDebounceCounterJumpDown = false
              DemDebounceCounterJumpUp = false
              DemDebounceCounterJumpUpValue = 1
              DemDebounceCounterFailedThreshold = 125
              DemDebounceCounterPassedThreshold = -125
              DemEventDebounceCounterStorageThreshold = 0
              DemDebounceCounterStorage = false
              DemDebounceBehavior = DEM_DEBOUNCE_FREEZE
      DTCClass_DTC_0xc14187 (DemDTCClass): DemDTCSeverity=DEM_DTC_SEV_NO_SEVERITY, DemUdsDTC=12665223
      missing_Trailer_Missing_Message (DemEventParameter):
        DemEventKind = DEM_EVENT_KIND_SWC
        DemMaxNumberFreezeFrameRecords = 1
        DemEventLatchTestFailed = false
        DemDTCClassRef = DTCClass_DTC_0xc14187
        DemExtendedDataClassRef = ExtendedDataClass_4f5344cd
        DemFreezeFrameClassRef = FreezeFrameClass_80c88891
        DemEventClass:
          DemAgingAllowed = true
          DemAgingCycleCounterThreshold = 40
          DemEventDestination = DEM_DTC_ORIGIN_PRIMARY_MEMORY
          DemEventPriority = 2
          DemEventSignificance = DEM_EVENT_SIGNIFICANCE_FAULT
          DemEventFailureCycleCounterThreshold = 5
          DemAgingCycleRef = Ignition_on_off
          DemEnableConditionGroupRef = EnableConditionGroup_Wakeup
          DemOperationCycleRef = Ignition_on_off
          DemDebounceAlgorithmClass
            DemDebounceCounterBased:
              DemDebounceCounterDecrementStepSize = 25
              DemDebounceCounterIncrementStepSize = 25
              DemDebounceCounterJumpDown = false
              DemDebounceCounterJumpUp = false
              DemDebounceCounterJumpUpValue = 1
              DemDebounceCounterFailedThreshold = 125
              DemDebounceCounterPassedThreshold = -125
              DemEventDebounceCounterStorageThreshold = 0
              DemDebounceCounterStorage = false
              DemDebounceBehavior = DEM_DEBOUNCE_FREEZE
      DTCClass_DTC_0xc14387 (DemDTCClass): DemDTCSeverity=DEM_DTC_SEV_NO_SEVERITY, DemUdsDTC=12665735
      missing_Intelligent_Forward_View_Camera_Lane_Detection_Warning_system_Intelligent_Forward_Camera_Missing_Message (DemEventParameter):
        DemEventKind = DEM_EVENT_KIND_SWC
        DemMaxNumberFreezeFrameRecords = 1
        DemEventLatchTestFailed = false
        DemDTCClassRef = DTCClass_DTC_0xc14387
        DemExtendedDataClassRef = ExtendedDataClass_4f5344cd
        DemFreezeFrameClassRef = FreezeFrameClass_80c88891
        DemEventClass:
          DemAgingAllowed = true
          DemAgingCycleCounterThreshold = 40
          DemEventDestination = DEM_DTC_ORIGIN_PRIMARY_MEMORY
          DemEventPriority = 2
          DemEventSignificance = DEM_EVENT_SIGNIFICANCE_FAULT
          DemEventFailureCycleCounterThreshold = 5
          DemAgingCycleRef = Ignition_on_off
          DemEnableConditionGroupRef = EnableConditionGroup_Wakeup
          DemOperationCycleRef = Ignition_on_off
          DemDebounceAlgorithmClass
            DemDebounceCounterBased:
              DemDebounceCounterDecrementStepSize = 25
              DemDebounceCounterIncrementStepSize = 25
              DemDebounceCounterJumpDown = false
              DemDebounceCounterJumpUp = false
              DemDebounceCounterJumpUpValue = 1
              DemDebounceCounterFailedThreshold = 125
              DemDebounceCounterPassedThreshold = -125
              DemEventDebounceCounterStorageThreshold = 0
              DemDebounceCounterStorage = false
              DemDebounceBehavior = DEM_DEBOUNCE_FREEZE
      DTCClass_DTC_0xc14687 (DemDTCClass): DemDTCSeverity=DEM_DTC_SEV_NO_SEVERITY, DemUdsDTC=12666503
      Missing_Gateway_Missing_Message (DemEventParameter):
        DemEventKind = DEM_EVENT_KIND_SWC
        DemMaxNumberFreezeFrameRecords = 1
        DemEventLatchTestFailed = false
        DemDTCClassRef = DTCClass_DTC_0xc14687
        DemExtendedDataClassRef = ExtendedDataClass_4f5344cd
        DemFreezeFrameClassRef = FreezeFrameClass_80c88891
        DemEventClass:
          DemAgingAllowed = true
          DemAgingCycleCounterThreshold = 40
          DemEventDestination = DEM_DTC_ORIGIN_PRIMARY_MEMORY
          DemEventPriority = 2
          DemEventSignificance = DEM_EVENT_SIGNIFICANCE_FAULT
          DemEventFailureCycleCounterThreshold = 5
          DemAgingCycleRef = Ignition_on_off
          DemEnableConditionGroupRef = EnableConditionGroup_Wakeup
          DemOperationCycleRef = Ignition_on_off
          DemDebounceAlgorithmClass
            DemDebounceCounterBased:
              DemDebounceCounterDecrementStepSize = 25
              DemDebounceCounterIncrementStepSize = 25
              DemDebounceCounterJumpDown = false
              DemDebounceCounterJumpUp = false
              DemDebounceCounterJumpUpValue = 1
              DemDebounceCounterFailedThreshold = 125
              DemDebounceCounterPassedThreshold = -125
              DemEventDebounceCounterStorageThreshold = 0
              DemDebounceCounterStorage = false
              DemDebounceBehavior = DEM_DEBOUNCE_FREEZE
      DTCClass_DTC_0xc15887 (DemDTCClass): DemDTCSeverity=DEM_DTC_SEV_NO_SEVERITY, DemUdsDTC=12671111
      Missing_Head_Up_Display_Augmented_Reality_Head_Up_Display_Missing_Message (DemEventParameter):
        DemEventKind = DEM_EVENT_KIND_SWC
        DemMaxNumberFreezeFrameRecords = 1
        DemEventLatchTestFailed = false
        DemDTCClassRef = DTCClass_DTC_0xc15887
        DemExtendedDataClassRef = ExtendedDataClass_4f5344cd
        DemFreezeFrameClassRef = FreezeFrameClass_80c88891
        DemEventClass:
          DemAgingAllowed = true
          DemAgingCycleCounterThreshold = 40
          DemEventDestination = DEM_DTC_ORIGIN_PRIMARY_MEMORY
          DemEventPriority = 2
          DemEventSignificance = DEM_EVENT_SIGNIFICANCE_FAULT
          DemEventFailureCycleCounterThreshold = 5
          DemAgingCycleRef = Ignition_on_off
          DemEnableConditionGroupRef = EnableConditionGroup_Wakeup
          DemOperationCycleRef = Ignition_on_off
          DemDebounceAlgorithmClass
            DemDebounceCounterBased:
              DemDebounceCounterDecrementStepSize = 25
              DemDebounceCounterIncrementStepSize = 25
              DemDebounceCounterJumpDown = false
              DemDebounceCounterJumpUp = false
              DemDebounceCounterJumpUpValue = 1
              DemDebounceCounterFailedThreshold = 125
              DemDebounceCounterPassedThreshold = -125
              DemEventDebounceCounterStorageThreshold = 0
              DemDebounceCounterStorage = false
              DemDebounceBehavior = DEM_DEBOUNCE_FREEZE
      DTCClass_DTC_0xc15c87 (DemDTCClass): DemDTCSeverity=DEM_DTC_SEV_NO_SEVERITY, DemUdsDTC=12672135
      Missing_Intelligent_Driving_Controller_Level2 (DemEventParameter):
        DemEventKind = DEM_EVENT_KIND_SWC
        DemMaxNumberFreezeFrameRecords = 1
        DemEventLatchTestFailed = false
        DemDTCClassRef = DTCClass_DTC_0xc15c87
        DemExtendedDataClassRef = ExtendedDataClass_4f5344cd
        DemFreezeFrameClassRef = FreezeFrameClass_80c88891
        DemEventClass:
          DemAgingAllowed = true
          DemAgingCycleCounterThreshold = 40
          DemEventDestination = DEM_DTC_ORIGIN_PRIMARY_MEMORY
          DemEventPriority = 2
          DemEventSignificance = DEM_EVENT_SIGNIFICANCE_FAULT
          DemEventFailureCycleCounterThreshold = 5
          DemAgingCycleRef = Ignition_on_off
          DemEnableConditionGroupRef = EnableConditionGroup_Wakeup
          DemOperationCycleRef = Ignition_on_off
          DemDebounceAlgorithmClass
            DemDebounceCounterBased:
              DemDebounceCounterDecrementStepSize = 25
              DemDebounceCounterIncrementStepSize = 25
              DemDebounceCounterJumpDown = false
              DemDebounceCounterJumpUp = false
              DemDebounceCounterJumpUpValue = 1
              DemDebounceCounterFailedThreshold = 125
              DemDebounceCounterPassedThreshold = -125
              DemEventDebounceCounterStorageThreshold = 0
              DemDebounceCounterStorage = false
              DemDebounceBehavior = DEM_DEBOUNCE_FREEZE
      DTCClass_DTC_0xc16487 (DemDTCClass): DemDTCSeverity=DEM_DTC_SEV_NO_SEVERITY, DemUdsDTC=12674183
      Missing_AC_Air_Condition_Rear_Front_Control_panel_Missing_Message (DemEventParameter):
        DemEventKind = DEM_EVENT_KIND_SWC
        DemMaxNumberFreezeFrameRecords = 1
        DemEventLatchTestFailed = false
        DemDTCClassRef = DTCClass_DTC_0xc16487
        DemExtendedDataClassRef = ExtendedDataClass_4f5344cd
        DemFreezeFrameClassRef = FreezeFrameClass_80c88891
        DemEventClass:
          DemAgingAllowed = true
          DemAgingCycleCounterThreshold = 40
          DemEventDestination = DEM_DTC_ORIGIN_PRIMARY_MEMORY
          DemEventPriority = 2
          DemEventSignificance = DEM_EVENT_SIGNIFICANCE_FAULT
          DemEventFailureCycleCounterThreshold = 5
          DemAgingCycleRef = Ignition_on_off
          DemEnableConditionGroupRef = EnableConditionGroup_Wakeup
          DemOperationCycleRef = Ignition_on_off
          DemDebounceAlgorithmClass
            DemDebounceCounterBased:
              DemDebounceCounterDecrementStepSize = 25
              DemDebounceCounterIncrementStepSize = 25
              DemDebounceCounterJumpDown = false
              DemDebounceCounterJumpUp = false
              DemDebounceCounterJumpUpValue = 1
              DemDebounceCounterFailedThreshold = 125
              DemDebounceCounterPassedThreshold = -125
              DemEventDebounceCounterStorageThreshold = 0
              DemDebounceCounterStorage = false
              DemDebounceBehavior = DEM_DEBOUNCE_FREEZE
      DTCClass_DTC_0xc19887 (DemDTCClass): DemDTCSeverity=DEM_DTC_SEV_NO_SEVERITY, DemUdsDTC=12687495
      missing_Telematics_control_Box_Missing_Message (DemEventParameter):
        DemEventKind = DEM_EVENT_KIND_SWC
        DemMaxNumberFreezeFrameRecords = 1
        DemEventLatchTestFailed = false
        DemDTCClassRef = DTCClass_DTC_0xc19887
        DemExtendedDataClassRef = ExtendedDataClass_4f5344cd
        DemFreezeFrameClassRef = FreezeFrameClass_80c88891
        DemEventClass:
          DemAgingAllowed = true
          DemAgingCycleCounterThreshold = 40
          DemEventDestination = DEM_DTC_ORIGIN_PRIMARY_MEMORY
          DemEventPriority = 2
          DemEventSignificance = DEM_EVENT_SIGNIFICANCE_FAULT
          DemEventFailureCycleCounterThreshold = 5
          DemAgingCycleRef = Ignition_on_off
          DemEnableConditionGroupRef = EnableConditionGroup_Wakeup
          DemOperationCycleRef = Ignition_on_off
          DemDebounceAlgorithmClass
            DemDebounceCounterBased:
              DemDebounceCounterDecrementStepSize = 25
              DemDebounceCounterIncrementStepSize = 25
              DemDebounceCounterJumpDown = false
              DemDebounceCounterJumpUp = false
              DemDebounceCounterJumpUpValue = 1
              DemDebounceCounterFailedThreshold = 125
              DemDebounceCounterPassedThreshold = -125
              DemEventDebounceCounterStorageThreshold = 0
              DemDebounceCounterStorage = false
              DemDebounceBehavior = DEM_DEBOUNCE_FREEZE
      DTCClass_DTC_0xc19987 (DemDTCClass): DemDTCSeverity=DEM_DTC_SEV_NO_SEVERITY, DemUdsDTC=12687751
      Missing_Driver_Door_Control_Module_Missing_Message (DemEventParameter):
        DemEventKind = DEM_EVENT_KIND_SWC
        DemMaxNumberFreezeFrameRecords = 1
        DemEventLatchTestFailed = false
        DemDTCClassRef = DTCClass_DTC_0xc19987
        DemExtendedDataClassRef = ExtendedDataClass_4f5344cd
        DemFreezeFrameClassRef = FreezeFrameClass_80c88891
        DemEventClass:
          DemAgingAllowed = true
          DemAgingCycleCounterThreshold = 40
          DemEventDestination = DEM_DTC_ORIGIN_PRIMARY_MEMORY
          DemEventPriority = 2
          DemEventSignificance = DEM_EVENT_SIGNIFICANCE_FAULT
          DemEventFailureCycleCounterThreshold = 5
          DemAgingCycleRef = Ignition_on_off
          DemEnableConditionGroupRef = EnableConditionGroup_Wakeup
          DemOperationCycleRef = Ignition_on_off
          DemDebounceAlgorithmClass
            DemDebounceCounterBased:
              DemDebounceCounterDecrementStepSize = 25
              DemDebounceCounterIncrementStepSize = 25
              DemDebounceCounterJumpDown = false
              DemDebounceCounterJumpUp = false
              DemDebounceCounterJumpUpValue = 1
              DemDebounceCounterFailedThreshold = 125
              DemDebounceCounterPassedThreshold = -125
              DemEventDebounceCounterStorageThreshold = 0
              DemDebounceCounterStorage = false
              DemDebounceBehavior = DEM_DEBOUNCE_FREEZE
      DTCClass_DTC_0xc1bb87 (DemDTCClass): DemDTCSeverity=DEM_DTC_SEV_NO_SEVERITY, DemUdsDTC=12696455
      Missing_Onboard_charger (DemEventParameter):
        DemEventKind = DEM_EVENT_KIND_SWC
        DemMaxNumberFreezeFrameRecords = 1
        DemEventLatchTestFailed = false
        DemDTCClassRef = DTCClass_DTC_0xc1bb87
        DemExtendedDataClassRef = ExtendedDataClass_4f5344cd
        DemFreezeFrameClassRef = FreezeFrameClass_80c88891
        DemEventClass:
          DemAgingAllowed = true
          DemAgingCycleCounterThreshold = 40
          DemEventDestination = DEM_DTC_ORIGIN_PRIMARY_MEMORY
          DemEventPriority = 2
          DemEventSignificance = DEM_EVENT_SIGNIFICANCE_FAULT
          DemEventFailureCycleCounterThreshold = 5
          DemAgingCycleRef = Ignition_on_off
          DemEnableConditionGroupRef = EnableConditionGroup_Wakeup
          DemOperationCycleRef = Ignition_on_off
          DemDebounceAlgorithmClass
            DemDebounceCounterBased:
              DemDebounceCounterDecrementStepSize = 25
              DemDebounceCounterIncrementStepSize = 25
              DemDebounceCounterJumpDown = false
              DemDebounceCounterJumpUp = false
              DemDebounceCounterJumpUpValue = 1
              DemDebounceCounterFailedThreshold = 125
              DemDebounceCounterPassedThreshold = -125
              DemEventDebounceCounterStorageThreshold = 0
              DemDebounceCounterStorage = false
              DemDebounceBehavior = DEM_DEBOUNCE_FREEZE
      DTCClass_DTC_0xc20087 (DemDTCClass): DemDTCSeverity=DEM_DTC_SEV_NO_SEVERITY, DemUdsDTC=12714119
      missing_Passenger_Door_Control_Module_Missing_Message (DemEventParameter):
        DemEventKind = DEM_EVENT_KIND_SWC
        DemMaxNumberFreezeFrameRecords = 1
        DemEventLatchTestFailed = false
        DemDTCClassRef = DTCClass_DTC_0xc20087
        DemExtendedDataClassRef = ExtendedDataClass_4f5344cd
        DemFreezeFrameClassRef = FreezeFrameClass_80c88891
        DemEventClass:
          DemAgingAllowed = true
          DemAgingCycleCounterThreshold = 40
          DemEventDestination = DEM_DTC_ORIGIN_PRIMARY_MEMORY
          DemEventPriority = 2
          DemEventSignificance = DEM_EVENT_SIGNIFICANCE_FAULT
          DemEventFailureCycleCounterThreshold = 5
          DemAgingCycleRef = Ignition_on_off
          DemEnableConditionGroupRef = EnableConditionGroup_Wakeup
          DemOperationCycleRef = Ignition_on_off
          DemDebounceAlgorithmClass
            DemDebounceCounterBased:
              DemDebounceCounterDecrementStepSize = 25
              DemDebounceCounterIncrementStepSize = 25
              DemDebounceCounterJumpDown = false
              DemDebounceCounterJumpUp = false
              DemDebounceCounterJumpUpValue = 1
              DemDebounceCounterFailedThreshold = 125
              DemDebounceCounterPassedThreshold = -125
              DemEventDebounceCounterStorageThreshold = 0
              DemDebounceCounterStorage = false
              DemDebounceBehavior = DEM_DEBOUNCE_FREEZE
      DTCClass_DTC_0xc20887 (DemDTCClass): DemDTCSeverity=DEM_DTC_SEV_NO_SEVERITY, DemUdsDTC=12716167
      Missing_Driver_Seat_Memory_module (DemEventParameter):
        DemEventKind = DEM_EVENT_KIND_SWC
        DemMaxNumberFreezeFrameRecords = 1
        DemEventLatchTestFailed = false
        DemDTCClassRef = DTCClass_DTC_0xc20887
        DemExtendedDataClassRef = ExtendedDataClass_4f5344cd
        DemFreezeFrameClassRef = FreezeFrameClass_80c88891
        DemEventClass:
          DemAgingAllowed = true
          DemAgingCycleCounterThreshold = 40
          DemEventDestination = DEM_DTC_ORIGIN_PRIMARY_MEMORY
          DemEventPriority = 2
          DemEventSignificance = DEM_EVENT_SIGNIFICANCE_FAULT
          DemEventFailureCycleCounterThreshold = 5
          DemAgingCycleRef = Ignition_on_off
          DemEnableConditionGroupRef = EnableConditionGroup_Wakeup
          DemOperationCycleRef = Ignition_on_off
          DemDebounceAlgorithmClass
            DemDebounceCounterBased:
              DemDebounceCounterDecrementStepSize = 25
              DemDebounceCounterIncrementStepSize = 25
              DemDebounceCounterJumpDown = false
              DemDebounceCounterJumpUp = false
              DemDebounceCounterJumpUpValue = 1
              DemDebounceCounterFailedThreshold = 125
              DemDebounceCounterPassedThreshold = -125
              DemEventDebounceCounterStorageThreshold = 0
              DemDebounceCounterStorage = false
              DemDebounceBehavior = DEM_DEBOUNCE_FREEZE
      DTCClass_DTC_0xc23087 (DemDTCClass): DemDTCSeverity=DEM_DTC_SEV_NO_SEVERITY, DemUdsDTC=12726407
      Missing_Power_Lift_Gate_module (DemEventParameter):
        DemEventKind = DEM_EVENT_KIND_SWC
        DemMaxNumberFreezeFrameRecords = 1
        DemEventLatchTestFailed = false
        DemDTCClassRef = DTCClass_DTC_0xc23087
        DemExtendedDataClassRef = ExtendedDataClass_4f5344cd
        DemFreezeFrameClassRef = FreezeFrameClass_80c88891
        DemEventClass:
          DemAgingAllowed = true
          DemAgingCycleCounterThreshold = 40
          DemEventDestination = DEM_DTC_ORIGIN_PRIMARY_MEMORY
          DemEventPriority = 2
          DemEventSignificance = DEM_EVENT_SIGNIFICANCE_FAULT
          DemEventFailureCycleCounterThreshold = 5
          DemAgingCycleRef = Ignition_on_off
          DemEnableConditionGroupRef = EnableConditionGroup_Wakeup
          DemOperationCycleRef = Ignition_on_off
          DemDebounceAlgorithmClass
            DemDebounceCounterBased:
              DemDebounceCounterDecrementStepSize = 25
              DemDebounceCounterIncrementStepSize = 25
              DemDebounceCounterJumpDown = false
              DemDebounceCounterJumpUp = false
              DemDebounceCounterJumpUpValue = 1
              DemDebounceCounterFailedThreshold = 125
              DemDebounceCounterPassedThreshold = -125
              DemEventDebounceCounterStorageThreshold = 0
              DemDebounceCounterStorage = false
              DemDebounceBehavior = DEM_DEBOUNCE_FREEZE
      DTCClass_DTC_0xc23387 (DemDTCClass): DemDTCSeverity=DEM_DTC_SEV_NO_SEVERITY, DemUdsDTC=12727175
      missing_Right_Rear_Side_Detection_System_Missing_Message (DemEventParameter):
        DemEventKind = DEM_EVENT_KIND_SWC
        DemMaxNumberFreezeFrameRecords = 1
        DemEventLatchTestFailed = false
        DemDTCClassRef = DTCClass_DTC_0xc23387
        DemExtendedDataClassRef = ExtendedDataClass_4f5344cd
        DemFreezeFrameClassRef = FreezeFrameClass_80c88891
        DemEventClass:
          DemAgingAllowed = true
          DemAgingCycleCounterThreshold = 40
          DemEventDestination = DEM_DTC_ORIGIN_PRIMARY_MEMORY
          DemEventPriority = 2
          DemEventSignificance = DEM_EVENT_SIGNIFICANCE_FAULT
          DemEventFailureCycleCounterThreshold = 5
          DemAgingCycleRef = Ignition_on_off
          DemEnableConditionGroupRef = EnableConditionGroup_Wakeup
          DemOperationCycleRef = Ignition_on_off
          DemDebounceAlgorithmClass
            DemDebounceCounterBased:
              DemDebounceCounterDecrementStepSize = 25
              DemDebounceCounterIncrementStepSize = 25
              DemDebounceCounterJumpDown = false
              DemDebounceCounterJumpUp = false
              DemDebounceCounterJumpUpValue = 1
              DemDebounceCounterFailedThreshold = 125
              DemDebounceCounterPassedThreshold = -125
              DemEventDebounceCounterStorageThreshold = 0
              DemDebounceCounterStorage = false
              DemDebounceBehavior = DEM_DEBOUNCE_FREEZE
      DTCClass_DTC_0xc24187 (DemDTCClass): DemDTCSeverity=DEM_DTC_SEV_NO_SEVERITY, DemUdsDTC=12730759
      Missing_Controler_Headlamp_Missing_Message (DemEventParameter):
        DemEventKind = DEM_EVENT_KIND_SWC
        DemMaxNumberFreezeFrameRecords = 1
        DemEventLatchTestFailed = false
        DemDTCClassRef = DTCClass_DTC_0xc24187
        DemExtendedDataClassRef = ExtendedDataClass_4f5344cd
        DemFreezeFrameClassRef = FreezeFrameClass_80c88891
        DemEventClass:
          DemAgingAllowed = true
          DemAgingCycleCounterThreshold = 40
          DemEventDestination = DEM_DTC_ORIGIN_PRIMARY_MEMORY
          DemEventPriority = 2
          DemEventSignificance = DEM_EVENT_SIGNIFICANCE_FAULT
          DemEventFailureCycleCounterThreshold = 5
          DemAgingCycleRef = Ignition_on_off
          DemEnableConditionGroupRef = EnableConditionGroup_Wakeup
          DemOperationCycleRef = Ignition_on_off
          DemDebounceAlgorithmClass
            DemDebounceCounterBased:
              DemDebounceCounterDecrementStepSize = 25
              DemDebounceCounterIncrementStepSize = 25
              DemDebounceCounterJumpDown = false
              DemDebounceCounterJumpUp = false
              DemDebounceCounterJumpUpValue = 1
              DemDebounceCounterFailedThreshold = 125
              DemDebounceCounterPassedThreshold = -125
              DemEventDebounceCounterStorageThreshold = 0
              DemDebounceCounterStorage = false
              DemDebounceBehavior = DEM_DEBOUNCE_FREEZE
      DTCClass_DTC_0xc24287 (DemDTCClass): DemDTCSeverity=DEM_DTC_SEV_NO_SEVERITY, DemUdsDTC=12731015
      Missing_Right_Headlamp_Control_Module (DemEventParameter):
        DemEventKind = DEM_EVENT_KIND_SWC
        DemMaxNumberFreezeFrameRecords = 1
        DemEventLatchTestFailed = false
        DemDTCClassRef = DTCClass_DTC_0xc24287
        DemExtendedDataClassRef = ExtendedDataClass_4f5344cd
        DemFreezeFrameClassRef = FreezeFrameClass_80c88891
        DemEventClass:
          DemAgingAllowed = true
          DemAgingCycleCounterThreshold = 40
          DemEventDestination = DEM_DTC_ORIGIN_PRIMARY_MEMORY
          DemEventPriority = 2
          DemEventSignificance = DEM_EVENT_SIGNIFICANCE_FAULT
          DemEventFailureCycleCounterThreshold = 5
          DemAgingCycleRef = Ignition_on_off
          DemEnableConditionGroupRef = EnableConditionGroup_Wakeup
          DemOperationCycleRef = Ignition_on_off
          DemDebounceAlgorithmClass
            DemDebounceCounterBased:
              DemDebounceCounterDecrementStepSize = 25
              DemDebounceCounterIncrementStepSize = 25
              DemDebounceCounterJumpDown = false
              DemDebounceCounterJumpUp = false
              DemDebounceCounterJumpUpValue = 1
              DemDebounceCounterFailedThreshold = 125
              DemDebounceCounterPassedThreshold = -125
              DemEventDebounceCounterStorageThreshold = 0
              DemDebounceCounterStorage = false
              DemDebounceBehavior = DEM_DEBOUNCE_FREEZE
      DTCClass_DTC_0xc24387 (DemDTCClass): DemDTCSeverity=DEM_DTC_SEV_NO_SEVERITY, DemUdsDTC=12731271
      missing_Parking_Assistance_System_Missing_Message (DemEventParameter):
        DemEventKind = DEM_EVENT_KIND_SWC
        DemMaxNumberFreezeFrameRecords = 1
        DemEventLatchTestFailed = false
        DemDTCClassRef = DTCClass_DTC_0xc24387
        DemExtendedDataClassRef = ExtendedDataClass_4f5344cd
        DemFreezeFrameClassRef = FreezeFrameClass_80c88891
        DemEventClass:
          DemAgingAllowed = true
          DemAgingCycleCounterThreshold = 40
          DemEventDestination = DEM_DTC_ORIGIN_PRIMARY_MEMORY
          DemEventPriority = 2
          DemEventSignificance = DEM_EVENT_SIGNIFICANCE_FAULT
          DemEventFailureCycleCounterThreshold = 5
          DemAgingCycleRef = Ignition_on_off
          DemEnableConditionGroupRef = EnableConditionGroup_Wakeup
          DemOperationCycleRef = Ignition_on_off
          DemDebounceAlgorithmClass
            DemDebounceCounterBased:
              DemDebounceCounterDecrementStepSize = 25
              DemDebounceCounterIncrementStepSize = 25
              DemDebounceCounterJumpDown = false
              DemDebounceCounterJumpUp = false
              DemDebounceCounterJumpUpValue = 1
              DemDebounceCounterFailedThreshold = 125
              DemDebounceCounterPassedThreshold = -125
              DemEventDebounceCounterStorageThreshold = 0
              DemDebounceCounterStorage = false
              DemDebounceBehavior = DEM_DEBOUNCE_FREEZE
      DTCClass_DTC_0xc24687 (DemDTCClass): DemDTCSeverity=DEM_DTC_SEV_NO_SEVERITY, DemUdsDTC=12732039
      Missing_Seat_Control_Module (DemEventParameter):
        DemEventKind = DEM_EVENT_KIND_SWC
        DemMaxNumberFreezeFrameRecords = 1
        DemEventLatchTestFailed = false
        DemDTCClassRef = DTCClass_DTC_0xc24687
        DemExtendedDataClassRef = ExtendedDataClass_4f5344cd
        DemFreezeFrameClassRef = FreezeFrameClass_80c88891
        DemEventClass:
          DemAgingAllowed = true
          DemAgingCycleCounterThreshold = 40
          DemEventDestination = DEM_DTC_ORIGIN_PRIMARY_MEMORY
          DemEventPriority = 2
          DemEventSignificance = DEM_EVENT_SIGNIFICANCE_FAULT
          DemEventFailureCycleCounterThreshold = 5
          DemAgingCycleRef = Ignition_on_off
          DemEnableConditionGroupRef = EnableConditionGroup_Wakeup
          DemOperationCycleRef = Ignition_on_off
          DemDebounceAlgorithmClass
            DemDebounceCounterBased:
              DemDebounceCounterDecrementStepSize = 25
              DemDebounceCounterIncrementStepSize = 25
              DemDebounceCounterJumpDown = false
              DemDebounceCounterJumpUp = false
              DemDebounceCounterJumpUpValue = 1
              DemDebounceCounterFailedThreshold = 125
              DemDebounceCounterPassedThreshold = -125
              DemEventDebounceCounterStorageThreshold = 0
              DemDebounceCounterStorage = false
              DemDebounceBehavior = DEM_DEBOUNCE_FREEZE
      DTCClass_DTC_0xc24787 (DemDTCClass): DemDTCSeverity=DEM_DTC_SEV_NO_SEVERITY, DemUdsDTC=12732295
      Missing_Rear_Heat_Vent_Seat_Module (DemEventParameter):
        DemEventKind = DEM_EVENT_KIND_SWC
        DemMaxNumberFreezeFrameRecords = 1
        DemEventLatchTestFailed = false
        DemDTCClassRef = DTCClass_DTC_0xc24787
        DemExtendedDataClassRef = ExtendedDataClass_4f5344cd
        DemFreezeFrameClassRef = FreezeFrameClass_80c88891
        DemEventClass:
          DemAgingAllowed = true
          DemAgingCycleCounterThreshold = 40
          DemEventDestination = DEM_DTC_ORIGIN_PRIMARY_MEMORY
          DemEventPriority = 2
          DemEventSignificance = DEM_EVENT_SIGNIFICANCE_FAULT
          DemEventFailureCycleCounterThreshold = 5
          DemAgingCycleRef = Ignition_on_off
          DemEnableConditionGroupRef = EnableConditionGroup_Wakeup
          DemOperationCycleRef = Ignition_on_off
          DemDebounceAlgorithmClass
            DemDebounceCounterBased:
              DemDebounceCounterDecrementStepSize = 25
              DemDebounceCounterIncrementStepSize = 25
              DemDebounceCounterJumpDown = false
              DemDebounceCounterJumpUp = false
              DemDebounceCounterJumpUpValue = 1
              DemDebounceCounterFailedThreshold = 125
              DemDebounceCounterPassedThreshold = -125
              DemEventDebounceCounterStorageThreshold = 0
              DemDebounceCounterStorage = false
              DemDebounceBehavior = DEM_DEBOUNCE_FREEZE
      DTCClass_DTC_0xc25e87 (DemDTCClass): DemDTCSeverity=DEM_DTC_SEV_NO_SEVERITY, DemUdsDTC=12738183
      Missing_Ibooster (DemEventParameter):
        DemEventKind = DEM_EVENT_KIND_SWC
        DemMaxNumberFreezeFrameRecords = 1
        DemEventLatchTestFailed = false
        DemDTCClassRef = DTCClass_DTC_0xc25e87
        DemExtendedDataClassRef = ExtendedDataClass_4f5344cd
        DemFreezeFrameClassRef = FreezeFrameClass_80c88891
        DemEventClass:
          DemAgingAllowed = true
          DemAgingCycleCounterThreshold = 40
          DemEventDestination = DEM_DTC_ORIGIN_PRIMARY_MEMORY
          DemEventPriority = 2
          DemEventSignificance = DEM_EVENT_SIGNIFICANCE_FAULT
          DemEventFailureCycleCounterThreshold = 5
          DemAgingCycleRef = Ignition_on_off
          DemEnableConditionGroupRef = EnableConditionGroup_Wakeup
          DemOperationCycleRef = Ignition_on_off
          DemDebounceAlgorithmClass
            DemDebounceCounterBased:
              DemDebounceCounterDecrementStepSize = 25
              DemDebounceCounterIncrementStepSize = 25
              DemDebounceCounterJumpDown = false
              DemDebounceCounterJumpUp = false
              DemDebounceCounterJumpUpValue = 1
              DemDebounceCounterFailedThreshold = 125
              DemDebounceCounterPassedThreshold = -125
              DemEventDebounceCounterStorageThreshold = 0
              DemDebounceCounterStorage = false
              DemDebounceBehavior = DEM_DEBOUNCE_FREEZE
      DTCClass_DTC_0xc29387 (DemDTCClass): DemDTCSeverity=DEM_DTC_SEV_NO_SEVERITY, DemUdsDTC=12751751
      Missing_Hybrid_Vehicle_Control_Unit_Vehicle_control_unit_HCCAN (DemEventParameter):
        DemEventKind = DEM_EVENT_KIND_SWC
        DemMaxNumberFreezeFrameRecords = 1
        DemEventLatchTestFailed = false
        DemDTCClassRef = DTCClass_DTC_0xc29387
        DemExtendedDataClassRef = ExtendedDataClass_4f5344cd
        DemFreezeFrameClassRef = FreezeFrameClass_80c88891
        DemEventClass:
          DemAgingAllowed = true
          DemAgingCycleCounterThreshold = 40
          DemEventDestination = DEM_DTC_ORIGIN_PRIMARY_MEMORY
          DemEventPriority = 2
          DemEventSignificance = DEM_EVENT_SIGNIFICANCE_FAULT
          DemEventFailureCycleCounterThreshold = 5
          DemAgingCycleRef = Ignition_on_off
          DemOperationCycleRef = Ignition_on_off
          DemDebounceAlgorithmClass
            DemDebounceCounterBased:
              DemDebounceCounterDecrementStepSize = 25
              DemDebounceCounterIncrementStepSize = 25
              DemDebounceCounterJumpDown = false
              DemDebounceCounterJumpUp = false
              DemDebounceCounterJumpUpValue = 1
              DemDebounceCounterFailedThreshold = 125
              DemDebounceCounterPassedThreshold = -125
              DemEventDebounceCounterStorageThreshold = 0
              DemDebounceCounterStorage = false
              DemDebounceBehavior = DEM_DEBOUNCE_FREEZE
      DTCClass_DTC_0xc2b387 (DemDTCClass): DemDTCSeverity=DEM_DTC_SEV_NO_SEVERITY, DemUdsDTC=12759943
      missing_Driver_Monitoring_System_Missing_Message (DemEventParameter):
        DemEventKind = DEM_EVENT_KIND_SWC
        DemMaxNumberFreezeFrameRecords = 1
        DemEventLatchTestFailed = false
        DemDTCClassRef = DTCClass_DTC_0xc2b387
        DemExtendedDataClassRef = ExtendedDataClass_4f5344cd
        DemFreezeFrameClassRef = FreezeFrameClass_80c88891
        DemEventClass:
          DemAgingAllowed = true
          DemAgingCycleCounterThreshold = 40
          DemEventDestination = DEM_DTC_ORIGIN_PRIMARY_MEMORY
          DemEventPriority = 2
          DemEventSignificance = DEM_EVENT_SIGNIFICANCE_FAULT
          DemEventFailureCycleCounterThreshold = 5
          DemAgingCycleRef = Ignition_on_off
          DemEnableConditionGroupRef = EnableConditionGroup_Wakeup
          DemOperationCycleRef = Ignition_on_off
          DemDebounceAlgorithmClass
            DemDebounceCounterBased:
              DemDebounceCounterDecrementStepSize = 25
              DemDebounceCounterIncrementStepSize = 25
              DemDebounceCounterJumpDown = false
              DemDebounceCounterJumpUp = false
              DemDebounceCounterJumpUpValue = 1
              DemDebounceCounterFailedThreshold = 125
              DemDebounceCounterPassedThreshold = -125
              DemEventDebounceCounterStorageThreshold = 0
              DemDebounceCounterStorage = false
              DemDebounceBehavior = DEM_DEBOUNCE_FREEZE
      DTCClass_DTC_0xc2b587 (DemDTCClass): DemDTCSeverity=DEM_DTC_SEV_NO_SEVERITY, DemUdsDTC=12760455
      missing_Right_Corner_Radar (DemEventParameter):
        DemEventKind = DEM_EVENT_KIND_SWC
        DemMaxNumberFreezeFrameRecords = 1
        DemEventLatchTestFailed = false
        DemDTCClassRef = DTCClass_DTC_0xc2b587
        DemExtendedDataClassRef = ExtendedDataClass_4f5344cd
        DemFreezeFrameClassRef = FreezeFrameClass_80c88891
        DemEventClass:
          DemAgingAllowed = true
          DemAgingCycleCounterThreshold = 40
          DemEventDestination = DEM_DTC_ORIGIN_PRIMARY_MEMORY
          DemEventPriority = 2
          DemEventSignificance = DEM_EVENT_SIGNIFICANCE_FAULT
          DemEventFailureCycleCounterThreshold = 5
          DemAgingCycleRef = Ignition_on_off
          DemEnableConditionGroupRef = EnableConditionGroup_Wakeup
          DemOperationCycleRef = Ignition_on_off
          DemDebounceAlgorithmClass
            DemDebounceCounterBased:
              DemDebounceCounterDecrementStepSize = 25
              DemDebounceCounterIncrementStepSize = 25
              DemDebounceCounterJumpDown = false
              DemDebounceCounterJumpUp = false
              DemDebounceCounterJumpUpValue = 1
              DemDebounceCounterFailedThreshold = 125
              DemDebounceCounterPassedThreshold = -125
              DemEventDebounceCounterStorageThreshold = 0
              DemDebounceCounterStorage = false
              DemDebounceBehavior = DEM_DEBOUNCE_FREEZE
      DTCClass_DTC_0xd00087 (DemDTCClass): DemDTCSeverity=DEM_DTC_SEV_NO_SEVERITY, DemUdsDTC=13631623
      Missing_Airbag_Module_Missing_Message (DemEventParameter):
        DemEventKind = DEM_EVENT_KIND_SWC
        DemMaxNumberFreezeFrameRecords = 1
        DemEventLatchTestFailed = false
        DemDTCClassRef = DTCClass_DTC_0xd00087
        DemExtendedDataClassRef = ExtendedDataClass_4f5344cd
        DemFreezeFrameClassRef = FreezeFrameClass_80c88891
        DemEventClass:
          DemAgingAllowed = true
          DemAgingCycleCounterThreshold = 40
          DemEventDestination = DEM_DTC_ORIGIN_PRIMARY_MEMORY
          DemEventPriority = 2
          DemEventSignificance = DEM_EVENT_SIGNIFICANCE_FAULT
          DemEventFailureCycleCounterThreshold = 5
          DemAgingCycleRef = Ignition_on_off
          DemEnableConditionGroupRef = EnableConditionGroup_Wakeup
          DemOperationCycleRef = Ignition_on_off
          DemDebounceAlgorithmClass
            DemDebounceCounterBased:
              DemDebounceCounterDecrementStepSize = 25
              DemDebounceCounterIncrementStepSize = 25
              DemDebounceCounterJumpDown = false
              DemDebounceCounterJumpUp = false
              DemDebounceCounterJumpUpValue = 1
              DemDebounceCounterFailedThreshold = 125
              DemDebounceCounterPassedThreshold = -125
              DemEventDebounceCounterStorageThreshold = 0
              DemDebounceCounterStorage = false
              DemDebounceBehavior = DEM_DEBOUNCE_FREEZE
      DTCClass_DTC_0xd00287 (DemDTCClass): DemDTCSeverity=DEM_DTC_SEV_NO_SEVERITY, DemUdsDTC=13632135
      Missing_Elec_Region_Control_System_Body_Missing_Message (DemEventParameter):
        DemEventKind = DEM_EVENT_KIND_SWC
        DemMaxNumberFreezeFrameRecords = 1
        DemEventLatchTestFailed = false
        DemDTCClassRef = DTCClass_DTC_0xd00287
        DemExtendedDataClassRef = ExtendedDataClass_4f5344cd
        DemFreezeFrameClassRef = FreezeFrameClass_80c88891
        DemEventClass:
          DemAgingAllowed = true
          DemAgingCycleCounterThreshold = 40
          DemEventDestination = DEM_DTC_ORIGIN_PRIMARY_MEMORY
          DemEventPriority = 2
          DemEventSignificance = DEM_EVENT_SIGNIFICANCE_FAULT
          DemEventFailureCycleCounterThreshold = 5
          DemAgingCycleRef = Ignition_on_off
          DemEnableConditionGroupRef = EnableConditionGroup_Wakeup
          DemOperationCycleRef = Ignition_on_off
          DemDebounceAlgorithmClass
            DemDebounceCounterBased:
              DemDebounceCounterDecrementStepSize = 25
              DemDebounceCounterIncrementStepSize = 25
              DemDebounceCounterJumpDown = false
              DemDebounceCounterJumpUp = false
              DemDebounceCounterJumpUpValue = 1
              DemDebounceCounterFailedThreshold = 125
              DemDebounceCounterPassedThreshold = -125
              DemEventDebounceCounterStorageThreshold = 0
              DemDebounceCounterStorage = false
              DemDebounceBehavior = DEM_DEBOUNCE_FREEZE
      DTCClass_DTC_0xd00487 (DemDTCClass): DemDTCSeverity=DEM_DTC_SEV_NO_SEVERITY, DemUdsDTC=13632647
      Missing_Around_View_Monitoring_system_Highly_Automatic_Parking_Integration_Park_Assistant_System_Missing_Message (DemEventParameter):
        DemEventKind = DEM_EVENT_KIND_SWC
        DemMaxNumberFreezeFrameRecords = 1
        DemEventLatchTestFailed = false
        DemDTCClassRef = DTCClass_DTC_0xd00487
        DemExtendedDataClassRef = ExtendedDataClass_4f5344cd
        DemFreezeFrameClassRef = FreezeFrameClass_80c88891
        DemEventClass:
          DemAgingAllowed = true
          DemAgingCycleCounterThreshold = 40
          DemEventDestination = DEM_DTC_ORIGIN_PRIMARY_MEMORY
          DemEventPriority = 2
          DemEventSignificance = DEM_EVENT_SIGNIFICANCE_FAULT
          DemEventFailureCycleCounterThreshold = 5
          DemAgingCycleRef = Ignition_on_off
          DemEnableConditionGroupRef = EnableConditionGroup_Wakeup
          DemOperationCycleRef = Ignition_on_off
          DemDebounceAlgorithmClass
            DemDebounceCounterBased:
              DemDebounceCounterDecrementStepSize = 25
              DemDebounceCounterIncrementStepSize = 25
              DemDebounceCounterJumpDown = false
              DemDebounceCounterJumpUp = false
              DemDebounceCounterJumpUpValue = 1
              DemDebounceCounterFailedThreshold = 125
              DemDebounceCounterPassedThreshold = -125
              DemEventDebounceCounterStorageThreshold = 0
              DemDebounceCounterStorage = false
              DemDebounceBehavior = DEM_DEBOUNCE_FREEZE
      DTCClass_DTC_0xd00987 (DemDTCClass): DemDTCSeverity=DEM_DTC_SEV_NO_SEVERITY, DemUdsDTC=13633927
      Missing_Controller_Pedal_Missing_Message (DemEventParameter):
        DemEventKind = DEM_EVENT_KIND_SWC
        DemMaxNumberFreezeFrameRecords = 1
        DemEventLatchTestFailed = false
        DemDTCClassRef = DTCClass_DTC_0xd00987
        DemExtendedDataClassRef = ExtendedDataClass_4f5344cd
        DemFreezeFrameClassRef = FreezeFrameClass_80c88891
        DemEventClass:
          DemAgingAllowed = true
          DemAgingCycleCounterThreshold = 40
          DemEventDestination = DEM_DTC_ORIGIN_PRIMARY_MEMORY
          DemEventPriority = 2
          DemEventSignificance = DEM_EVENT_SIGNIFICANCE_FAULT
          DemEventFailureCycleCounterThreshold = 5
          DemAgingCycleRef = Ignition_on_off
          DemEnableConditionGroupRef = EnableConditionGroup_Wakeup
          DemOperationCycleRef = Ignition_on_off
          DemDebounceAlgorithmClass
            DemDebounceCounterBased:
              DemDebounceCounterDecrementStepSize = 25
              DemDebounceCounterIncrementStepSize = 25
              DemDebounceCounterJumpDown = false
              DemDebounceCounterJumpUp = false
              DemDebounceCounterJumpUpValue = 1
              DemDebounceCounterFailedThreshold = 125
              DemDebounceCounterPassedThreshold = -125
              DemEventDebounceCounterStorageThreshold = 0
              DemDebounceCounterStorage = false
              DemDebounceBehavior = DEM_DEBOUNCE_FREEZE
      DTCClass_DTC_0xd00a46 (DemDTCClass): DemDTCSeverity=DEM_DTC_SEV_NO_SEVERITY, DemUdsDTC=13634118
      SecOC_key_storage_exception_Calibration_Parameter_Memory_Failure (DemEventParameter):
        DemEventKind = DEM_EVENT_KIND_BSW
        DemMaxNumberFreezeFrameRecords = 1
        DemEventLatchTestFailed = true
        DemDTCClassRef = DTCClass_DTC_0xd00a46
        DemExtendedDataClassRef = ExtendedDataClass_4f5344cd
        DemFreezeFrameClassRef = FreezeFrameClass_80c88891
        DemEventClass:
          DemAgingAllowed = true
          DemAgingCycleCounterThreshold = 40
          DemEventDestination = DEM_DTC_ORIGIN_PRIMARY_MEMORY
          DemEventPriority = 2
          DemEventSignificance = DEM_EVENT_SIGNIFICANCE_FAULT
          DemAgingCycleRef = Ignition_on_off
          DemOperationCycleRef = Ignition_on_off
          DemDebounceAlgorithmClass
            DemDebounceMonitorInternal
              DemCallbackGetFDC
      DTCClass_DTC_0xd00af3 (DemDTCClass): DemDTCSeverity=DEM_DTC_SEV_NO_SEVERITY, DemUdsDTC=13634291
      SecOC_key_Missing_Manufacturer_Defined (DemEventParameter):
        DemEventKind = DEM_EVENT_KIND_BSW
        DemMaxNumberFreezeFrameRecords = 1
        DemEventLatchTestFailed = true
        DemDTCClassRef = DTCClass_DTC_0xd00af3
        DemExtendedDataClassRef = ExtendedDataClass_4f5344cd
        DemFreezeFrameClassRef = FreezeFrameClass_80c88891
        DemEventClass:
          DemAgingAllowed = true
          DemAgingCycleCounterThreshold = 40
          DemEventDestination = DEM_DTC_ORIGIN_PRIMARY_MEMORY
          DemEventPriority = 2
          DemEventSignificance = DEM_EVENT_SIGNIFICANCE_FAULT
          DemAgingCycleRef = Ignition_on_off
          DemOperationCycleRef = Ignition_on_off
          DemDebounceAlgorithmClass
            DemDebounceMonitorInternal
              DemCallbackGetFDC
      DTCClass_DTC_0xd00e40 (DemDTCClass): DemDTCSeverity=DEM_DTC_SEV_NO_SEVERITY, DemUdsDTC=13635136
      SecOC_FV_synchronization_authentication_message_failed_ISO_SAE_Reserved (DemEventParameter):
        DemEventKind = DEM_EVENT_KIND_BSW
        DemMaxNumberFreezeFrameRecords = 1
        DemEventLatchTestFailed = false
        DemDTCClassRef = DTCClass_DTC_0xd00e40
        DemExtendedDataClassRef = ExtendedDataClass_4f5344cd
        DemFreezeFrameClassRef = FreezeFrameClass_80c88891
        DemEventClass:
          DemAgingAllowed = true
          DemAgingCycleCounterThreshold = 40
          DemEventDestination = DEM_DTC_ORIGIN_PRIMARY_MEMORY
          DemEventPriority = 2
          DemEventSignificance = DEM_EVENT_SIGNIFICANCE_FAULT
          DemAgingCycleRef = Ignition_on_off
          DemOperationCycleRef = Ignition_on_off
          DemDebounceAlgorithmClass
            DemDebounceMonitorInternal
              DemCallbackGetFDC
      DTCClass_DTC_0xd00f94 (DemDTCClass): DemDTCSeverity=DEM_DTC_SEV_NO_SEVERITY, DemUdsDTC=13635476
      SecOC_software_module_running_error_Unexpected_Operation (DemEventParameter):
        DemEventKind = DEM_EVENT_KIND_BSW
        DemMaxNumberFreezeFrameRecords = 1
        DemEventLatchTestFailed = false
        DemDTCClassRef = DTCClass_DTC_0xd00f94
        DemExtendedDataClassRef = ExtendedDataClass_4f5344cd
        DemFreezeFrameClassRef = FreezeFrameClass_80c88891
        DemEventClass:
          DemAgingAllowed = true
          DemAgingCycleCounterThreshold = 40
          DemEventDestination = DEM_DTC_ORIGIN_PRIMARY_MEMORY
          DemEventPriority = 2
          DemEventSignificance = DEM_EVENT_SIGNIFICANCE_FAULT
          DemAgingCycleRef = Ignition_on_off
          DemOperationCycleRef = Ignition_on_off
          DemDebounceAlgorithmClass
            DemDebounceMonitorInternal
              DemCallbackGetFDC
      DTCClass_DTC_0xd01046 (DemDTCClass): DemDTCSeverity=DEM_DTC_SEV_NO_SEVERITY, DemUdsDTC=13635654
      Synchronization_counter_data_NVM_erasure_failed_Calibration_Parameter_Memory_Failure (DemEventParameter):
        DemEventKind = DEM_EVENT_KIND_BSW
        DemMaxNumberFreezeFrameRecords = 1
        DemEventLatchTestFailed = false
        DemDTCClassRef = DTCClass_DTC_0xd01046
        DemExtendedDataClassRef = ExtendedDataClass_4f5344cd
        DemFreezeFrameClassRef = FreezeFrameClass_80c88891
        DemEventClass:
          DemAgingAllowed = true
          DemAgingCycleCounterThreshold = 40
          DemEventDestination = DEM_DTC_ORIGIN_PRIMARY_MEMORY
          DemEventPriority = 2
          DemEventSignificance = DEM_EVENT_SIGNIFICANCE_FAULT
          DemAgingCycleRef = Ignition_on_off
          DemOperationCycleRef = Ignition_on_off
          DemDebounceAlgorithmClass
            DemDebounceMonitorInternal
              DemCallbackGetFDC
      DTCClass_DTC_0xd01587 (DemDTCClass): DemDTCSeverity=DEM_DTC_SEV_NO_SEVERITY, DemUdsDTC=13636999
      Missing_Screen_touch_button_switch_controller_Missing_Message (DemEventParameter):
        DemEventKind = DEM_EVENT_KIND_SWC
        DemMaxNumberFreezeFrameRecords = 1
        DemEventLatchTestFailed = false
        DemDTCClassRef = DTCClass_DTC_0xd01587
        DemExtendedDataClassRef = ExtendedDataClass_4f5344cd
        DemFreezeFrameClassRef = FreezeFrameClass_80c88891
        DemEventClass:
          DemAgingAllowed = true
          DemAgingCycleCounterThreshold = 40
          DemEventDestination = DEM_DTC_ORIGIN_PRIMARY_MEMORY
          DemEventPriority = 2
          DemEventSignificance = DEM_EVENT_SIGNIFICANCE_FAULT
          DemEventFailureCycleCounterThreshold = 5
          DemAgingCycleRef = Ignition_on_off
          DemEnableConditionGroupRef = EnableConditionGroup_Wakeup
          DemOperationCycleRef = Ignition_on_off
          DemDebounceAlgorithmClass
            DemDebounceCounterBased:
              DemDebounceCounterDecrementStepSize = 25
              DemDebounceCounterIncrementStepSize = 25
              DemDebounceCounterJumpDown = false
              DemDebounceCounterJumpUp = false
              DemDebounceCounterJumpUpValue = 1
              DemDebounceCounterFailedThreshold = 125
              DemDebounceCounterPassedThreshold = -125
              DemEventDebounceCounterStorageThreshold = 0
              DemDebounceCounterStorage = false
              DemDebounceBehavior = DEM_DEBOUNCE_FREEZE
      DTCClass_DTC_0xd02687 (DemDTCClass): DemDTCSeverity=DEM_DTC_SEV_NO_SEVERITY, DemUdsDTC=13641351
      Missing_Hybrid_Vehicle_Control_Unit_Vehicle_control_unit_PTCAN (DemEventParameter):
        DemEventKind = DEM_EVENT_KIND_SWC
        DemMaxNumberFreezeFrameRecords = 1
        DemEventLatchTestFailed = false
        DemDTCClassRef = DTCClass_DTC_0xd02687
        DemExtendedDataClassRef = ExtendedDataClass_4f5344cd
        DemFreezeFrameClassRef = FreezeFrameClass_80c88891
        DemEventClass:
          DemAgingAllowed = true
          DemAgingCycleCounterThreshold = 40
          DemEventDestination = DEM_DTC_ORIGIN_PRIMARY_MEMORY
          DemEventPriority = 2
          DemEventSignificance = DEM_EVENT_SIGNIFICANCE_FAULT
          DemEventFailureCycleCounterThreshold = 5
          DemAgingCycleRef = Ignition_on_off
          DemEnableConditionGroupRef = EnableConditionGroup_Wakeup
          DemOperationCycleRef = Ignition_on_off
          DemDebounceAlgorithmClass
            DemDebounceCounterBased:
              DemDebounceCounterDecrementStepSize = 25
              DemDebounceCounterIncrementStepSize = 25
              DemDebounceCounterJumpDown = false
              DemDebounceCounterJumpUp = false
              DemDebounceCounterJumpUpValue = 1
              DemDebounceCounterFailedThreshold = 125
              DemDebounceCounterPassedThreshold = -125
              DemEventDebounceCounterStorageThreshold = 0
              DemDebounceCounterStorage = false
              DemDebounceBehavior = DEM_DEBOUNCE_FREEZE
      DTCClass_DTC_0xd02987 (DemDTCClass): DemDTCSeverity=DEM_DTC_SEV_NO_SEVERITY, DemUdsDTC=13642119
      Missing_Wireless_Power_Charger_Missing_Message (DemEventParameter):
        DemEventKind = DEM_EVENT_KIND_SWC
        DemMaxNumberFreezeFrameRecords = 1
        DemEventLatchTestFailed = false
        DemDTCClassRef = DTCClass_DTC_0xd02987
        DemExtendedDataClassRef = ExtendedDataClass_4f5344cd
        DemFreezeFrameClassRef = FreezeFrameClass_80c88891
        DemEventClass:
          DemAgingAllowed = true
          DemAgingCycleCounterThreshold = 40
          DemEventDestination = DEM_DTC_ORIGIN_PRIMARY_MEMORY
          DemEventPriority = 2
          DemEventSignificance = DEM_EVENT_SIGNIFICANCE_FAULT
          DemEventFailureCycleCounterThreshold = 5
          DemAgingCycleRef = Ignition_on_off
          DemEnableConditionGroupRef = EnableConditionGroup_Wakeup
          DemOperationCycleRef = Ignition_on_off
          DemDebounceAlgorithmClass
            DemDebounceCounterBased:
              DemDebounceCounterDecrementStepSize = 25
              DemDebounceCounterIncrementStepSize = 25
              DemDebounceCounterJumpDown = false
              DemDebounceCounterJumpUp = false
              DemDebounceCounterJumpUpValue = 1
              DemDebounceCounterFailedThreshold = 125
              DemDebounceCounterPassedThreshold = -125
              DemEventDebounceCounterStorageThreshold = 0
              DemDebounceCounterStorage = false
              DemDebounceBehavior = DEM_DEBOUNCE_FREEZE
      DTCClass_DTC_0xd10017 (DemDTCClass): DemDTCSeverity=DEM_DTC_SEV_NO_SEVERITY, DemUdsDTC=13697047
      Over_voltage_Circuit_Voltage_Above_Threshold (DemEventParameter):
        DemEventKind = DEM_EVENT_KIND_SWC
        DemMaxNumberFreezeFrameRecords = 1
        DemEventLatchTestFailed = false
        DemDTCClassRef = DTCClass_DTC_0xd10017
        DemExtendedDataClassRef = ExtendedDataClass_4f5344cd
        DemFreezeFrameClassRef = FreezeFrameClass_80c88891
        DemEventClass:
          DemAgingAllowed = true
          DemAgingCycleCounterThreshold = 40
          DemEventDestination = DEM_DTC_ORIGIN_PRIMARY_MEMORY
          DemEventPriority = 2
          DemEventSignificance = DEM_EVENT_SIGNIFICANCE_FAULT
          DemAgingCycleRef = Ignition_on_off
          DemEnableConditionGroupRef = EnableConditionGroup_Wakeup
          DemOperationCycleRef = Ignition_on_off
          DemDebounceAlgorithmClass
            DemDebounceTimeBase: DemDebounceTimeFailedThreshold=1, DemDebounceTimePassedThreshold=1, DemDebounceBehavior=DEM_DEBOUNCE_FREEZE
      DTCClass_DTC_0xd10116 (DemDTCClass): DemDTCSeverity=DEM_DTC_SEV_NO_SEVERITY, DemUdsDTC=13697302
      Under_voltage_Circuit_Voltage_Below_Threshold (DemEventParameter):
        DemEventKind = DEM_EVENT_KIND_SWC
        DemMaxNumberFreezeFrameRecords = 1
        DemEventLatchTestFailed = false
        DemDTCClassRef = DTCClass_DTC_0xd10116
        DemExtendedDataClassRef = ExtendedDataClass_4f5344cd
        DemFreezeFrameClassRef = FreezeFrameClass_80c88891
        DemEventClass:
          DemAgingAllowed = true
          DemAgingCycleCounterThreshold = 40
          DemEventDestination = DEM_DTC_ORIGIN_PRIMARY_MEMORY
          DemEventPriority = 2
          DemEventSignificance = DEM_EVENT_SIGNIFICANCE_FAULT
          DemAgingCycleRef = Ignition_on_off
          DemEnableConditionGroupRef = EnableConditionGroup_Wakeup
          DemOperationCycleRef = Ignition_on_off
          DemDebounceAlgorithmClass
            DemDebounceTimeBase: DemDebounceTimeFailedThreshold=1, DemDebounceTimePassedThreshold=1, DemDebounceBehavior=DEM_DEBOUNCE_FREEZE
      DTCClass_DTC_0xd10687 (DemDTCClass): DemDTCSeverity=DEM_DTC_SEV_NO_SEVERITY, DemUdsDTC=13698695
      Missing_Combination_Switch_Assembly_Missing_Message (DemEventParameter):
        DemEventKind = DEM_EVENT_KIND_SWC
        DemMaxNumberFreezeFrameRecords = 1
        DemEventLatchTestFailed = false
        DemDTCClassRef = DTCClass_DTC_0xd10687
        DemExtendedDataClassRef = ExtendedDataClass_4f5344cd
        DemFreezeFrameClassRef = FreezeFrameClass_80c88891
        DemEventClass:
          DemAgingAllowed = true
          DemAgingCycleCounterThreshold = 40
          DemEventDestination = DEM_DTC_ORIGIN_PRIMARY_MEMORY
          DemEventPriority = 2
          DemEventSignificance = DEM_EVENT_SIGNIFICANCE_FAULT
          DemAgingCycleRef = Ignition_on_off
          DemEnableConditionGroupRef = EnableConditionGroup_Wakeup
          DemOperationCycleRef = Ignition_on_off
          DemDebounceAlgorithmClass
            DemDebounceCounterBased:
              DemDebounceCounterDecrementStepSize = 25
              DemDebounceCounterIncrementStepSize = 25
              DemDebounceCounterJumpDown = false
              DemDebounceCounterJumpUp = false
              DemDebounceCounterJumpUpValue = 1
              DemDebounceCounterFailedThreshold = 125
              DemDebounceCounterPassedThreshold = -125
              DemEventDebounceCounterStorageThreshold = 0
              DemDebounceCounterStorage = false
              DemDebounceBehavior = DEM_DEBOUNCE_FREEZE
      DTCClass_DTC_0xd10887 (DemDTCClass): DemDTCSeverity=DEM_DTC_SEV_NO_SEVERITY, DemUdsDTC=13699207
      Missing_Front_Power_Box_Missing_Message (DemEventParameter):
        DemEventKind = DEM_EVENT_KIND_SWC
        DemMaxNumberFreezeFrameRecords = 1
        DemEventLatchTestFailed = false
        DemDTCClassRef = DTCClass_DTC_0xd10887
        DemExtendedDataClassRef = ExtendedDataClass_4f5344cd
        DemFreezeFrameClassRef = FreezeFrameClass_80c88891
        DemEventClass:
          DemAgingAllowed = true
          DemAgingCycleCounterThreshold = 40
          DemEventDestination = DEM_DTC_ORIGIN_PRIMARY_MEMORY
          DemEventPriority = 2
          DemEventSignificance = DEM_EVENT_SIGNIFICANCE_FAULT
          DemAgingCycleRef = Ignition_on_off
          DemEnableConditionGroupRef = EnableConditionGroup_Wakeup
          DemOperationCycleRef = Ignition_on_off
          DemDebounceAlgorithmClass
            DemDebounceCounterBased:
              DemDebounceCounterDecrementStepSize = 25
              DemDebounceCounterIncrementStepSize = 25
              DemDebounceCounterJumpDown = false
              DemDebounceCounterJumpUp = false
              DemDebounceCounterJumpUpValue = 1
              DemDebounceCounterFailedThreshold = 125
              DemDebounceCounterPassedThreshold = -125
              DemEventDebounceCounterStorageThreshold = 0
              DemDebounceCounterStorage = false
              DemDebounceBehavior = DEM_DEBOUNCE_FREEZE
      DTCClass_DTC_0xd10987 (DemDTCClass): DemDTCSeverity=DEM_DTC_SEV_NO_SEVERITY, DemUdsDTC=13699463
      Missing_Rear_Power_Box_Missing_Message (DemEventParameter):
        DemEventKind = DEM_EVENT_KIND_SWC
        DemMaxNumberFreezeFrameRecords = 1
        DemEventLatchTestFailed = false
        DemDTCClassRef = DTCClass_DTC_0xd10987
        DemExtendedDataClassRef = ExtendedDataClass_4f5344cd
        DemFreezeFrameClassRef = FreezeFrameClass_80c88891
        DemEventClass:
          DemAgingAllowed = true
          DemAgingCycleCounterThreshold = 40
          DemEventDestination = DEM_DTC_ORIGIN_PRIMARY_MEMORY
          DemEventPriority = 2
          DemEventSignificance = DEM_EVENT_SIGNIFICANCE_FAULT
          DemAgingCycleRef = Ignition_on_off
          DemEnableConditionGroupRef = EnableConditionGroup_Wakeup
          DemOperationCycleRef = Ignition_on_off
          DemDebounceAlgorithmClass
            DemDebounceCounterBased:
              DemDebounceCounterDecrementStepSize = 25
              DemDebounceCounterIncrementStepSize = 25
              DemDebounceCounterJumpDown = false
              DemDebounceCounterJumpUp = false
              DemDebounceCounterJumpUpValue = 1
              DemDebounceCounterFailedThreshold = 125
              DemDebounceCounterPassedThreshold = -125
              DemEventDebounceCounterStorageThreshold = 0
              DemDebounceCounterStorage = false
              DemDebounceBehavior = DEM_DEBOUNCE_FREEZE
      DTCClass_DTC_0xd10b87 (DemDTCClass): DemDTCSeverity=DEM_DTC_SEV_NO_SEVERITY, DemUdsDTC=13699975
      Missing_PrePretensioner_Mechatronic_Integrated (DemEventParameter):
        DemEventKind = DEM_EVENT_KIND_SWC
        DemMaxNumberFreezeFrameRecords = 1
        DemEventLatchTestFailed = false
        DemDTCClassRef = DTCClass_DTC_0xd10b87
        DemExtendedDataClassRef = ExtendedDataClass_4f5344cd
        DemFreezeFrameClassRef = FreezeFrameClass_80c88891
        DemEventClass:
          DemAgingAllowed = true
          DemAgingCycleCounterThreshold = 40
          DemEventDestination = DEM_DTC_ORIGIN_PRIMARY_MEMORY
          DemEventPriority = 2
          DemEventSignificance = DEM_EVENT_SIGNIFICANCE_FAULT
          DemEventFailureCycleCounterThreshold = 5
          DemAgingCycleRef = Ignition_on_off
          DemEnableConditionGroupRef = EnableConditionGroup_Wakeup
          DemOperationCycleRef = Ignition_on_off
          DemDebounceAlgorithmClass
            DemDebounceCounterBased:
              DemDebounceCounterDecrementStepSize = 25
              DemDebounceCounterIncrementStepSize = 25
              DemDebounceCounterJumpDown = false
              DemDebounceCounterJumpUp = false
              DemDebounceCounterJumpUpValue = 1
              DemDebounceCounterFailedThreshold = 125
              DemDebounceCounterPassedThreshold = -125
              DemEventDebounceCounterStorageThreshold = 0
              DemDebounceCounterStorage = false
              DemDebounceBehavior = DEM_DEBOUNCE_FREEZE
      DTCClass_DTC_0xe00083 (DemDTCClass): DemDTCSeverity=DEM_DTC_SEV_NO_SEVERITY, DemUdsDTC=14680195
      Ethernet_CRC_Errors_Value_of_Signal_Protection_Calculation_Incorrect (DemEventParameter):
        DemEventKind = DEM_EVENT_KIND_SWC
        DemMaxNumberFreezeFrameRecords = 1
        DemEventLatchTestFailed = false
        DemDTCClassRef = DTCClass_DTC_0xe00083
        DemExtendedDataClassRef = ExtendedDataClass_4f5344cd
        DemFreezeFrameClassRef = FreezeFrameClass_80c88891
        DemEventClass:
          DemAgingAllowed = true
          DemAgingCycleCounterThreshold = 40
          DemEventDestination = DEM_DTC_ORIGIN_PRIMARY_MEMORY
          DemEventPriority = 2
          DemEventSignificance = DEM_EVENT_SIGNIFICANCE_FAULT
          DemAgingCycleRef = Ignition_on_off
          DemOperationCycleRef = Ignition_on_off
          DemDebounceAlgorithmClass
            DemDebounceMonitorInternal
              DemCallbackGetFDC
      DTCClass_DTC_0xe00187 (DemDTCClass): DemDTCSeverity=DEM_DTC_SEV_NO_SEVERITY, DemUdsDTC=14680455
      Lost_TCP_communication_Missing_Message (DemEventParameter):
        DemEventKind = DEM_EVENT_KIND_SWC
        DemMaxNumberFreezeFrameRecords = 1
        DemEventLatchTestFailed = false
        DemDTCClassRef = DTCClass_DTC_0xe00187
        DemExtendedDataClassRef = ExtendedDataClass_4f5344cd
        DemFreezeFrameClassRef = FreezeFrameClass_80c88891
        DemEventClass:
          DemAgingAllowed = true
          DemAgingCycleCounterThreshold = 40
          DemEventDestination = DEM_DTC_ORIGIN_PRIMARY_MEMORY
          DemEventPriority = 2
          DemEventSignificance = DEM_EVENT_SIGNIFICANCE_FAULT
          DemAgingCycleRef = Ignition_on_off
          DemOperationCycleRef = Ignition_on_off
          DemDebounceAlgorithmClass
            DemDebounceMonitorInternal
              DemCallbackGetFDC
      DTCClass_DTC_0xe00208 (DemDTCClass): DemDTCSeverity=DEM_DTC_SEV_NO_SEVERITY, DemUdsDTC=14680584
      INVALID_SHORTNAME_GW_Ethernet_unexpected_Link_Loss_Bus_Signal_Message_Failure (DemEventParameter):
        DemEventKind = DEM_EVENT_KIND_SWC
        DemMaxNumberFreezeFrameRecords = 1
        DemEventLatchTestFailed = false
        DemDTCClassRef = DTCClass_DTC_0xe00208
        DemExtendedDataClassRef = ExtendedDataClass_4f5344cd
        DemFreezeFrameClassRef = FreezeFrameClass_80c88891
        DemEventClass:
          DemAgingAllowed = true
          DemAgingCycleCounterThreshold = 40
          DemEventDestination = DEM_DTC_ORIGIN_PRIMARY_MEMORY
          DemEventPriority = 2
          DemEventSignificance = DEM_EVENT_SIGNIFICANCE_FAULT
          DemAgingCycleRef = Ignition_on_off
          DemOperationCycleRef = Ignition_on_off
          DemDebounceAlgorithmClass
            DemDebounceMonitorInternal
              DemCallbackGetFDC
      DTCClass_DTC_0xe00784 (DemDTCClass): DemDTCSeverity=DEM_DTC_SEV_NO_SEVERITY, DemUdsDTC=14681988
      INVALID_SHORTNAME_GW_Insufficient_SQI_Signal_Below_Allowable_Range (DemEventParameter):
        DemEventKind = DEM_EVENT_KIND_SWC
        DemMaxNumberFreezeFrameRecords = 1
        DemEventLatchTestFailed = false
        DemDTCClassRef = DTCClass_DTC_0xe00784
        DemExtendedDataClassRef = ExtendedDataClass_4f5344cd
        DemFreezeFrameClassRef = FreezeFrameClass_80c88891
        DemEventClass:
          DemAgingAllowed = true
          DemAgingCycleCounterThreshold = 40
          DemEventDestination = DEM_DTC_ORIGIN_PRIMARY_MEMORY
          DemEventPriority = 2
          DemEventSignificance = DEM_EVENT_SIGNIFICANCE_FAULT
          DemAgingCycleRef = Ignition_on_off
          DemOperationCycleRef = Ignition_on_off
          DemDebounceAlgorithmClass
            DemDebounceMonitorInternal
              DemCallbackGetFDC
      DTCClass_DTC_0xe00c12 (DemDTCClass): DemDTCSeverity=DEM_DTC_SEV_NO_SEVERITY, DemUdsDTC=14683154
      Ethernet_signal_lines_short_circuit_Circuit_Short_To_Battery (DemEventParameter):
        DemEventKind = DEM_EVENT_KIND_SWC
        DemMaxNumberFreezeFrameRecords = 1
        DemEventLatchTestFailed = false
        DemDTCClassRef = DTCClass_DTC_0xe00c12
        DemExtendedDataClassRef = ExtendedDataClass_4f5344cd
        DemFreezeFrameClassRef = FreezeFrameClass_80c88891
        DemEventClass:
          DemAgingAllowed = true
          DemAgingCycleCounterThreshold = 40
          DemEventDestination = DEM_DTC_ORIGIN_PRIMARY_MEMORY
          DemEventPriority = 2
          DemEventSignificance = DEM_EVENT_SIGNIFICANCE_FAULT
          DemAgingCycleRef = Ignition_on_off
          DemOperationCycleRef = Ignition_on_off
          DemDebounceAlgorithmClass
            DemDebounceMonitorInternal
              DemCallbackGetFDC
      DTCClass_DTC_0xe01113 (DemDTCClass): DemDTCSeverity=DEM_DTC_SEV_NO_SEVERITY, DemUdsDTC=14684435
      INVALID_SHORTNAME_GW_Ethernet_signal_lines_open_circuit_Circuit_Open (DemEventParameter):
        DemEventKind = DEM_EVENT_KIND_SWC
        DemMaxNumberFreezeFrameRecords = 1
        DemEventLatchTestFailed = false
        DemDTCClassRef = DTCClass_DTC_0xe01113
        DemExtendedDataClassRef = ExtendedDataClass_4f5344cd
        DemFreezeFrameClassRef = FreezeFrameClass_80c88891
        DemEventClass:
          DemAgingAllowed = true
          DemAgingCycleCounterThreshold = 40
          DemEventDestination = DEM_DTC_ORIGIN_PRIMARY_MEMORY
          DemEventPriority = 2
          DemEventSignificance = DEM_EVENT_SIGNIFICANCE_FAULT
          DemAgingCycleRef = Ignition_on_off
          DemOperationCycleRef = Ignition_on_off
          DemDebounceAlgorithmClass
            DemDebounceMonitorInternal
              DemCallbackGetFDC
      DTCClass_DTC_0xea0040 (DemDTCClass): DemDTCSeverity=DEM_DTC_SEV_NO_SEVERITY, DemUdsDTC=15335488
      Missing_Electric_Park_Brake_controller_Missing_Message (DemEventParameter): DemEventKind=DEM_EVENT_KIND_SWC
        DemEventClass: DemOperationCycleRef=Power_up_down
          DemDebounceAlgorithmClass
            DemDebounceMonitorInternal
              DemCallbackGetFDC
    DemGeneral:
      DemAgingCycleCounterProcessing = DEM_PROCESS_AGINGCTR_INTERN
      DemDebounceCounterBasedSupport = true
      DemDebounceTimeBasedSupport = true
      DemDtcStatusAvailabilityMask = 123
      DemEnableConditionSupport = true
      DemMaxNumberEventEntryMirror = 0
      DemPTOSupport = false
      DemTypeOfFreezeFrameRecordNumeration = DEM_FF_RECNUM_CALCULATED
      6 x DemDidClass:
        VehicleSpeed: DemDidIdentifier=53249, DemDidDataClassRef=DID_0xd001_Vehicle_Speed
        EngineSpeed: DemDidIdentifier=53250, DemDidDataClassRef=DID_0xd002_EngineSpeed
        OperatingVoltage: DemDidIdentifier=53251, DemDidDataClassRef=DID_0xd003_OperatingVoltage
        Odometer: DemDidIdentifier=53252, DemDidDataClassRef=DID_0xd004_Odometer
        DTCOccurrenceTimer: DemDidIdentifier=53253, DemDidDataClassRef=DID_0xd005_DTC_Occurrence_Timer
        ActualRotationSpeed: DemDidIdentifier=53254, DemDidDataClassRef=DID_0xd006_ActualRotationSpeed
      3 x DemEnableCondition:
        IgnOn: DemEnableConditionStatus=false
        PowerModeOn: DemEnableConditionStatus=false
        Wakeup: DemEnableConditionStatus=true
      ExtendedDataClass_4f5344cd (DemExtendedDataClass): DemExtendedDataRecordClassRef=DTCOccurrenceCounter, DemExtendedDataRecordClassRef=SelfAgingCounter
      3 x DemEnableConditionGroup:
        EnableConditionGroup_Wakeup: DemEnableConditionRef=Wakeup
        EnableConditionGroup_IgnOn: DemEnableConditionRef=IgnOn
        EnableConditionGroup_PowerModeOn: DemEnableConditionRef=PowerModeOn
      DTCOccurrenceCounter (DemExtendedDataRecordClass): DemExtendedDataRecordNumber=1, DemDataClassRef=DTCOccurrenceCounter_DTCOccurrenceCounter
      SelfAgingCounter (DemExtendedDataRecordClass): DemExtendedDataRecordNumber=2, DemDataClassRef=SelfAgingCounter_SelfAgingCounter
      FreezeFrameClass_80c88891 (DemFreezeFrameClass):
        DemDidClassRef = DemGeneral/VehicleSpeed
        DemDidClassRef = DemGeneral/EngineSpeed
        DemDidClassRef = DemGeneral/OperatingVoltage
        DemDidClassRef = DemGeneral/Odometer
        DemDidClassRef = DemGeneral/DTCOccurrenceTimer
        DemDidClassRef = DemGeneral/ActualRotationSpeed
      Ignition_on_off (DemOperationCycle): DemOperationCycleAutostart=true, DemOperationCycleType=DEM_OPCYC_IGNITION
      Power_up_down (DemOperationCycle): DemOperationCycleAutostart=true, DemOperationCycleType=DEM_OPCYC_POWER
      8 x DemDataClass, all with DemDataElementUsePort=USE_DATA_CLIENT_SERVER_PORT, DemDataElementStoreNonVolatile=true:
        DTCOccurrenceCounter_DTCOccurrenceCounter: DemDataElementDataSize=1, DemDataElementDataType=UINT8
        DID_0xd003_OperatingVoltage: DemDataElementDataSize=1, DemDataElementDataType=UINT8
        SelfAgingCounter_SelfAgingCounter: DemDataElementDataSize=1, DemDataElementDataType=UINT8
        DID_0xd006_ActualRotationSpeed: DemDataElementDataSize=2, DemDataElementDataType=UINT16, DemDataElementEndianness=BIG_ENDIAN
        DID_0xd002_EngineSpeed: DemDataElementDataSize=2, DemDataElementDataType=UINT16, DemDataElementEndianness=BIG_ENDIAN
        DID_0xd001_Vehicle_Speed: DemDataElementDataSize=2, DemDataElementDataType=UINT16, DemDataElementEndianness=BIG_ENDIAN
        DID_0xd005_DTC_Occurrence_Timer: DemDataElementDataSize=4, DemDataElementDataType=UINT32, DemDataElementEndianness=BIG_ENDIAN
        DID_0xd004_Odometer: DemDataElementDataSize=3, DemDataElementDataType=UINT8_N, DemDataElementEndianness=opaque
