[part 2 of 3: package /InitialEcuC]
AUTOSAR XML (schema 00046)
package /InitialEcuC  (continued)
  module config Dcm: module-description=Dcm_Impl  (continued)
    DcmConfigSet  (continued)
      DcmDsp: DcmDspMaxDidToRead=5  (continued)
        271 x DcmDspDidInfo:
          DidInfo_MaintenanceOdometer
            DcmDspDidAccess
              DcmDspDidRead: DcmDspDidReadSessionRef=DcmDspSession/Default, DcmDspDidReadSessionRef=DcmDspSession/Extended, DcmDspDidReadSessionRef=EOLDiagnosticSession
          DidInfo_KL15Status
            DcmDspDidAccess
              DcmDspDidRead: DcmDspDidReadSessionRef=DcmDspSession/Default, DcmDspDidReadSessionRef=DcmDspSession/Extended, DcmDspDidReadSessionRef=EOLDiagnosticSession
          DidInfo_FactoryReset
            DcmDspDidAccess
              DcmDspDidWrite: DcmDspDidWriteSessionRef=EOLDiagnosticSession, DcmDspDidWriteSecurityLevelRef=Level_EOL_Unlocked
          DidInfo_ChipsTemperature
            DcmDspDidAccess
              DcmDspDidRead: DcmDspDidReadSessionRef=DcmDspSession/Default, DcmDspDidReadSessionRef=DcmDspSession/Extended, DcmDspDidReadSessionRef=EOLDiagnosticSession
          DidInfo_Battery_Voltage
            DcmDspDidAccess
              DcmDspDidRead: DcmDspDidReadSessionRef=DcmDspSession/Default, DcmDspDidReadSessionRef=DcmDspSession/Extended, DcmDspDidReadSessionRef=EOLDiagnosticSession
          DidInfo_VIPSoftwareVersion
            DcmDspDidAccess
              DcmDspDidRead: DcmDspDidReadSessionRef=DcmDspSession/Default, DcmDspDidReadSessionRef=DcmDspSession/Extended, DcmDspDidReadSessionRef=EOLDiagnosticSession
          DidInfo_AndroidSoftwareVersion
            DcmDspDidAccess
              DcmDspDidRead: DcmDspDidReadSessionRef=DcmDspSession/Default, DcmDspDidReadSessionRef=DcmDspSession/Extended, DcmDspDidReadSessionRef=EOLDiagnosticSession
          DidInfo_QNXSoftwareVersion
            DcmDspDidAccess
              DcmDspDidRead: DcmDspDidReadSessionRef=DcmDspSession/Default, DcmDspDidReadSessionRef=DcmDspSession/Extended, DcmDspDidReadSessionRef=EOLDiagnosticSession
          DidInfo_VIPBootloaderVersion
            DcmDspDidAccess
              DcmDspDidRead: DcmDspDidReadSessionRef=DcmDspSession/Default, DcmDspDidReadSessionRef=DcmDspSession/Extended, DcmDspDidReadSessionRef=EOLDiagnosticSession
          DidInfo_ClearTraceLog
            DcmDspDidAccess
              DcmDspDidWrite:
                DcmDspDidWriteSessionRef = DcmDspSession/Extended
                DcmDspDidWriteSessionRef = EOLDiagnosticSession
                DcmDspDidWriteSecurityLevelRef = UnlockedL1
                DcmDspDidWriteSecurityLevelRef = Level_EOL_Unlocked
          DidInfo_WatchDogCounter
            DcmDspDidAccess
              DcmDspDidRead: DcmDspDidReadSessionRef=DcmDspSession/Default, DcmDspDidReadSessionRef=DcmDspSession/Extended, DcmDspDidReadSessionRef=EOLDiagnosticSession
          DidInfo_ResetInformation
            DcmDspDidAccess
              DcmDspDidRead: DcmDspDidReadSessionRef=DcmDspSession/Default, DcmDspDidReadSessionRef=DcmDspSession/Extended, DcmDspDidReadSessionRef=EOLDiagnosticSession
          DidInfo_DID_0xFD1A_1_1
            DcmDspDidAccess
              DcmDspDidRead: DcmDspDidReadSessionRef=DcmDspSession/Default, DcmDspDidReadSessionRef=DcmDspSession/Extended, DcmDspDidReadSessionRef=EOLDiagnosticSession
          DidInfo_GPSSyncSwitch
            DcmDspDidAccess
              DcmDspDidWrite: DcmDspDidWriteSessionRef=EOLDiagnosticSession, DcmDspDidWriteSecurityLevelRef=Level_EOL_Unlocked
          DidInfo_BluetoothTestModeSwitch
            DcmDspDidAccess
              DcmDspDidWrite: DcmDspDidWriteSessionRef=EOLDiagnosticSession, DcmDspDidWriteSecurityLevelRef=Level_EOL_Unlocked
          DidInfo_BluetoothSwitch
            DcmDspDidAccess
              DcmDspDidRead: DcmDspDidReadSessionRef=EOLDiagnosticSession, DcmDspDidReadSecurityLevelRef=Level_EOL_Unlocked
              DcmDspDidWrite: DcmDspDidWriteSessionRef=EOLDiagnosticSession, DcmDspDidWriteSecurityLevelRef=Level_EOL_Unlocked
          DidInfo_BluetoothECNRSwitch
            DcmDspDidAccess
              DcmDspDidRead: DcmDspDidReadSessionRef=EOLDiagnosticSession, DcmDspDidReadSecurityLevelRef=Level_EOL_Unlocked
              DcmDspDidWrite: DcmDspDidWriteSessionRef=EOLDiagnosticSession, DcmDspDidWriteSecurityLevelRef=Level_EOL_Unlocked
          DidInfo_BluetoothAddress
            DcmDspDidAccess
              DcmDspDidRead: DcmDspDidReadSessionRef=EOLDiagnosticSession, DcmDspDidReadSecurityLevelRef=Level_EOL_Unlocked
              DcmDspDidWrite: DcmDspDidWriteSessionRef=EOLDiagnosticSession, DcmDspDidWriteSecurityLevelRef=Level_EOL_Unlocked
          DidInfo_BluetoothFrequencyTrim
            DcmDspDidAccess
              DcmDspDidRead: DcmDspDidReadSessionRef=EOLDiagnosticSession, DcmDspDidReadSecurityLevelRef=Level_EOL_Unlocked
              DcmDspDidWrite: DcmDspDidWriteSessionRef=EOLDiagnosticSession, DcmDspDidWriteSecurityLevelRef=Level_EOL_Unlocked
          DidInfo_BluetoothFriendlyName
            DcmDspDidAccess
              DcmDspDidRead: DcmDspDidReadSessionRef=EOLDiagnosticSession, DcmDspDidReadSecurityLevelRef=Level_EOL_Unlocked
              DcmDspDidWrite: DcmDspDidWriteSessionRef=EOLDiagnosticSession, DcmDspDidWriteSecurityLevelRef=Level_EOL_Unlocked
          DidInfo_BluetoothModuleScanOn
            DcmDspDidAccess
              DcmDspDidWrite: DcmDspDidWriteSessionRef=EOLDiagnosticSession, DcmDspDidWriteSecurityLevelRef=Level_EOL_Unlocked
          DidInfo_BluetoothAudioPlayPause
            DcmDspDidAccess
              DcmDspDidWrite: DcmDspDidWriteSessionRef=EOLDiagnosticSession, DcmDspDidWriteSecurityLevelRef=Level_EOL_Unlocked
          DidInfo_BluetoothAudioPlayMode
            DcmDspDidAccess
              DcmDspDidWrite: DcmDspDidWriteSessionRef=EOLDiagnosticSession, DcmDspDidWriteSecurityLevelRef=Level_EOL_Unlocked
          DidInfo_BluetoothAudioForward_Rewind
            DcmDspDidAccess
              DcmDspDidWrite: DcmDspDidWriteSessionRef=EOLDiagnosticSession, DcmDspDidWriteSecurityLevelRef=Level_EOL_Unlocked
          DidInfo_BluetoothAudioSkipTrack
            DcmDspDidAccess
              DcmDspDidWrite: DcmDspDidWriteSessionRef=EOLDiagnosticSession, DcmDspDidWriteSecurityLevelRef=Level_EOL_Unlocked
          DidInfo_BluetoothPairListInformation
            DcmDspDidAccess
              DcmDspDidWrite: DcmDspDidWriteSessionRef=EOLDiagnosticSession, DcmDspDidWriteSecurityLevelRef=Level_EOL_Unlocked
          DidInfo_EnterBluetoothMaximumPowerMode
            DcmDspDidAccess
              DcmDspDidWrite: DcmDspDidWriteSessionRef=EOLDiagnosticSession, DcmDspDidWriteSecurityLevelRef=Level_EOL_Unlocked
          DidInfo_BTPairbyBTAddress
            DcmDspDidAccess
              DcmDspDidWrite: DcmDspDidWriteSessionRef=EOLDiagnosticSession, DcmDspDidWriteSecurityLevelRef=Level_EOL_Unlocked
          DidInfo_BTPairConfirm
            DcmDspDidAccess
              DcmDspDidWrite: DcmDspDidWriteSessionRef=EOLDiagnosticSession, DcmDspDidWriteSecurityLevelRef=Level_EOL_Unlocked
          DidInfo_ReadBTBER
            DcmDspDidAccess
              DcmDspDidRead: DcmDspDidReadSessionRef=EOLDiagnosticSession, DcmDspDidReadSecurityLevelRef=Level_EOL_Unlocked
          DidInfo_WiFiTestModeSwitch
            DcmDspDidAccess
              DcmDspDidWrite: DcmDspDidWriteSessionRef=EOLDiagnosticSession, DcmDspDidWriteSecurityLevelRef=Level_EOL_Unlocked
          DidInfo_WiFiFriendlyName
            DcmDspDidAccess
              DcmDspDidRead: DcmDspDidReadSessionRef=EOLDiagnosticSession, DcmDspDidReadSecurityLevelRef=Level_EOL_Unlocked
              DcmDspDidWrite: DcmDspDidWriteSessionRef=EOLDiagnosticSession, DcmDspDidWriteSecurityLevelRef=Level_EOL_Unlocked
          DidInfo_WiFiConnectStatus
            DcmDspDidAccess
              DcmDspDidRead: DcmDspDidReadSessionRef=EOLDiagnosticSession, DcmDspDidReadSecurityLevelRef=Level_EOL_Unlocked
              DcmDspDidWrite: DcmDspDidWriteSessionRef=EOLDiagnosticSession, DcmDspDidWriteSecurityLevelRef=Level_EOL_Unlocked
          DidInfo_WriteWiFiBand
            DcmDspDidAccess
              DcmDspDidWrite: DcmDspDidWriteSessionRef=EOLDiagnosticSession, DcmDspDidWriteSecurityLevelRef=Level_EOL_Unlocked
          DidInfo_WiFiChannel
            DcmDspDidAccess
              DcmDspDidWrite: DcmDspDidWriteSessionRef=EOLDiagnosticSession, DcmDspDidWriteSecurityLevelRef=Level_EOL_Unlocked
          DidInfo_WiFiProtocol
            DcmDspDidAccess
              DcmDspDidWrite: DcmDspDidWriteSessionRef=EOLDiagnosticSession, DcmDspDidWriteSecurityLevelRef=Level_EOL_Unlocked
          DidInfo_WiFiPackageErrorRate
            DcmDspDidAccess
              DcmDspDidRead: DcmDspDidReadSessionRef=EOLDiagnosticSession, DcmDspDidReadSecurityLevelRef=Level_EOL_Unlocked
          DidInfo_WiFiMaximumPowerModestatus
            DcmDspDidAccess
              DcmDspDidWrite: DcmDspDidWriteSessionRef=EOLDiagnosticSession, DcmDspDidWriteSecurityLevelRef=Level_EOL_Unlocked
          DidInfo_ReadWiFiConnectStatus
            DcmDspDidAccess
              DcmDspDidRead: DcmDspDidReadSessionRef=EOLDiagnosticSession, DcmDspDidReadSecurityLevelRef=Level_EOL_Unlocked
          DidInfo_WiFiSignalStrength
            DcmDspDidAccess
              DcmDspDidRead: DcmDspDidReadSessionRef=EOLDiagnosticSession, DcmDspDidReadSecurityLevelRef=Level_EOL_Unlocked
          DidInfo_WiFiConnecttoSpecifiedAP
            DcmDspDidAccess
              DcmDspDidWrite: DcmDspDidWriteSessionRef=EOLDiagnosticSession, DcmDspDidWriteSecurityLevelRef=Level_EOL_Unlocked
          DidInfo_WiFiMACAddress
            DcmDspDidAccess
              DcmDspDidRead: DcmDspDidReadSessionRef=DcmDspSession/Default, DcmDspDidReadSessionRef=EOLDiagnosticSession, DcmDspDidReadSecurityLevelRef=Level_EOL_Unlocked
          DidInfo_EthernetTestModeSwitch
            DcmDspDidAccess
              DcmDspDidWrite: DcmDspDidWriteSessionRef=EOLDiagnosticSession, DcmDspDidWriteSecurityLevelRef=Level_EOL_Unlocked
          DidInfo_EthernetPackageErrorRate
            DcmDspDidAccess
              DcmDspDidRead: DcmDspDidReadSessionRef=EOLDiagnosticSession, DcmDspDidReadSecurityLevelRef=Level_EOL_Unlocked
          DidInfo_EthernetChannelDiagnosticResult
            DcmDspDidAccess
              DcmDspDidRead: DcmDspDidReadSessionRef=EOLDiagnosticSession, DcmDspDidReadSecurityLevelRef=Level_EOL_Unlocked
          DidInfo_IPAddress
            DcmDspDidAccess
              DcmDspDidRead: DcmDspDidReadSessionRef=EOLDiagnosticSession, DcmDspDidReadSecurityLevelRef=Level_EOL_Unlocked
          DidInfo_AudioSource
            DcmDspDidAccess
              DcmDspDidRead: DcmDspDidReadSessionRef=EOLDiagnosticSession, DcmDspDidReadSecurityLevelRef=Level_EOL_Unlocked
              DcmDspDidWrite: DcmDspDidWriteSessionRef=EOLDiagnosticSession, DcmDspDidWriteSecurityLevelRef=Level_EOL_Unlocked
          DidInfo_VolumeLevel
            DcmDspDidAccess
              DcmDspDidRead: DcmDspDidReadSessionRef=EOLDiagnosticSession, DcmDspDidReadSecurityLevelRef=Level_EOL_Unlocked
              DcmDspDidWrite:
                DcmDspDidWriteSessionRef = DcmDspSession/Extended
                DcmDspDidWriteSessionRef = EOLDiagnosticSession
                DcmDspDidWriteSecurityLevelRef = UnlockedL1
                DcmDspDidWriteSecurityLevelRef = Level_EOL_Unlocked
          DidInfo_MuteStatus
            DcmDspDidAccess
              DcmDspDidRead: DcmDspDidReadSessionRef=EOLDiagnosticSession, DcmDspDidReadSecurityLevelRef=Level_EOL_Unlocked
              DcmDspDidWrite: DcmDspDidWriteSessionRef=EOLDiagnosticSession, DcmDspDidWriteSecurityLevelRef=Level_EOL_Unlocked
          DidInfo_BassLevel
            DcmDspDidAccess
              DcmDspDidRead: DcmDspDidReadSessionRef=EOLDiagnosticSession, DcmDspDidReadSecurityLevelRef=Level_EOL_Unlocked
              DcmDspDidWrite: DcmDspDidWriteSessionRef=EOLDiagnosticSession, DcmDspDidWriteSecurityLevelRef=Level_EOL_Unlocked
          DidInfo_MiddleLevel
            DcmDspDidAccess
              DcmDspDidRead: DcmDspDidReadSessionRef=EOLDiagnosticSession, DcmDspDidReadSecurityLevelRef=Level_EOL_Unlocked
              DcmDspDidWrite: DcmDspDidWriteSessionRef=EOLDiagnosticSession, DcmDspDidWriteSecurityLevelRef=Level_EOL_Unlocked
          DidInfo_TrebleLevel
            DcmDspDidAccess
              DcmDspDidRead: DcmDspDidReadSessionRef=EOLDiagnosticSession, DcmDspDidReadSecurityLevelRef=Level_EOL_Unlocked
              DcmDspDidWrite: DcmDspDidWriteSessionRef=EOLDiagnosticSession, DcmDspDidWriteSecurityLevelRef=Level_EOL_Unlocked
          DidInfo_BalanceLevel
            DcmDspDidAccess
              DcmDspDidRead: DcmDspDidReadSessionRef=EOLDiagnosticSession, DcmDspDidReadSecurityLevelRef=Level_EOL_Unlocked
              DcmDspDidWrite: DcmDspDidWriteSessionRef=EOLDiagnosticSession, DcmDspDidWriteSecurityLevelRef=Level_EOL_Unlocked
          DidInfo_FaderLevel
            DcmDspDidAccess
              DcmDspDidRead: DcmDspDidReadSessionRef=EOLDiagnosticSession, DcmDspDidReadSecurityLevelRef=Level_EOL_Unlocked
              DcmDspDidWrite: DcmDspDidWriteSessionRef=EOLDiagnosticSession, DcmDspDidWriteSecurityLevelRef=Level_EOL_Unlocked
          DidInfo_LoudnessStatus
            DcmDspDidAccess
              DcmDspDidRead: DcmDspDidReadSessionRef=EOLDiagnosticSession, DcmDspDidReadSecurityLevelRef=Level_EOL_Unlocked
              DcmDspDidWrite: DcmDspDidWriteSessionRef=EOLDiagnosticSession, DcmDspDidWriteSecurityLevelRef=Level_EOL_Unlocked
          DidInfo_SpeedVolumeStatus
            DcmDspDidAccess
              DcmDspDidRead: DcmDspDidReadSessionRef=EOLDiagnosticSession, DcmDspDidReadSecurityLevelRef=Level_EOL_Unlocked
              DcmDspDidWrite: DcmDspDidWriteSessionRef=EOLDiagnosticSession, DcmDspDidWriteSecurityLevelRef=Level_EOL_Unlocked
          DidInfo_DTSStatus
            DcmDspDidAccess
              DcmDspDidRead: DcmDspDidReadSessionRef=EOLDiagnosticSession, DcmDspDidReadSecurityLevelRef=Level_EOL_Unlocked
              DcmDspDidWrite: DcmDspDidWriteSessionRef=EOLDiagnosticSession, DcmDspDidWriteSecurityLevelRef=Level_EOL_Unlocked
          DidInfo_BEXStatus
            DcmDspDidAccess
              DcmDspDidRead: DcmDspDidReadSessionRef=EOLDiagnosticSession, DcmDspDidReadSecurityLevelRef=Level_EOL_Unlocked
              DcmDspDidWrite:
                DcmDspDidWriteSessionRef = DcmDspSession/Extended
                DcmDspDidWriteSessionRef = EOLDiagnosticSession
                DcmDspDidWriteSecurityLevelRef = UnlockedL1
                DcmDspDidWriteSecurityLevelRef = Level_EOL_Unlocked
          DidInfo_BestListeningposition
            DcmDspDidAccess
              DcmDspDidRead: DcmDspDidReadSessionRef=EOLDiagnosticSession, DcmDspDidReadSecurityLevelRef=Level_EOL_Unlocked
              DcmDspDidWrite: DcmDspDidWriteSessionRef=EOLDiagnosticSession, DcmDspDidWriteSecurityLevelRef=Level_EOL_Unlocked
          DidInfo_SetTuningParametersFlat
            DcmDspDidAccess
              DcmDspDidWrite: DcmDspDidWriteSessionRef=EOLDiagnosticSession, DcmDspDidWriteSecurityLevelRef=Level_EOL_Unlocked
          DidInfo_BeepVolume
            DcmDspDidAccess
              DcmDspDidRead: DcmDspDidReadSessionRef=EOLDiagnosticSession, DcmDspDidReadSecurityLevelRef=Level_EOL_Unlocked
              DcmDspDidWrite: DcmDspDidWriteSessionRef=EOLDiagnosticSession, DcmDspDidWriteSecurityLevelRef=Level_EOL_Unlocked
          DidInfo_NaviVolume
            DcmDspDidAccess
              DcmDspDidRead: DcmDspDidReadSessionRef=EOLDiagnosticSession, DcmDspDidReadSecurityLevelRef=Level_EOL_Unlocked
              DcmDspDidWrite: DcmDspDidWriteSessionRef=EOLDiagnosticSession, DcmDspDidWriteSecurityLevelRef=Level_EOL_Unlocked
          DidInfo_TTSvolume
            DcmDspDidAccess
              DcmDspDidRead: DcmDspDidReadSessionRef=EOLDiagnosticSession, DcmDspDidReadSecurityLevelRef=Level_EOL_Unlocked
              DcmDspDidWrite: DcmDspDidWriteSessionRef=EOLDiagnosticSession, DcmDspDidWriteSecurityLevelRef=Level_EOL_Unlocked
          DidInfo_IPwarningVolume
            DcmDspDidAccess
              DcmDspDidRead: DcmDspDidReadSessionRef=EOLDiagnosticSession, DcmDspDidReadSecurityLevelRef=Level_EOL_Unlocked
              DcmDspDidWrite: DcmDspDidWriteSessionRef=EOLDiagnosticSession, DcmDspDidWriteSecurityLevelRef=Level_EOL_Unlocked
          DidInfo_BTCallvolume
            DcmDspDidAccess
              DcmDspDidRead: DcmDspDidReadSessionRef=EOLDiagnosticSession, DcmDspDidReadSecurityLevelRef=Level_EOL_Unlocked
              DcmDspDidWrite: DcmDspDidWriteSessionRef=EOLDiagnosticSession, DcmDspDidWriteSecurityLevelRef=Level_EOL_Unlocked
          DidInfo_BTRingvolume
            DcmDspDidAccess
              DcmDspDidRead: DcmDspDidReadSessionRef=EOLDiagnosticSession, DcmDspDidReadSecurityLevelRef=Level_EOL_Unlocked
              DcmDspDidWrite: DcmDspDidWriteSessionRef=EOLDiagnosticSession, DcmDspDidWriteSecurityLevelRef=Level_EOL_Unlocked
          DidInfo_USB_iPodPlayPause
            DcmDspDidAccess
              DcmDspDidWrite: DcmDspDidWriteSessionRef=EOLDiagnosticSession, DcmDspDidWriteSecurityLevelRef=Level_EOL_Unlocked
          DidInfo_USB_iPodPlayMode
            DcmDspDidAccess
              DcmDspDidWrite: DcmDspDidWriteSessionRef=EOLDiagnosticSession, DcmDspDidWriteSecurityLevelRef=Level_EOL_Unlocked
          DidInfo_USB_iPodSkipTrack
            DcmDspDidAccess
              DcmDspDidWrite: DcmDspDidWriteSessionRef=EOLDiagnosticSession, DcmDspDidWriteSecurityLevelRef=Level_EOL_Unlocked
          DidInfo_FM_AM_Current_Status
            DcmDspDidAccess
              DcmDspDidRead: DcmDspDidReadSessionRef=EOLDiagnosticSession, DcmDspDidReadSecurityLevelRef=Level_EOL_Unlocked
          DidInfo_FM_AMFrequency
            DcmDspDidAccess
              DcmDspDidWrite: DcmDspDidWriteSessionRef=EOLDiagnosticSession, DcmDspDidWriteSecurityLevelRef=Level_EOL_Unlocked
          DidInfo_FM_AMSeek
            DcmDspDidAccess
              DcmDspDidWrite: DcmDspDidWriteSessionRef=EOLDiagnosticSession, DcmDspDidWriteSecurityLevelRef=Level_EOL_Unlocked
          DidInfo_TunerUpdateFM_List
            DcmDspDidAccess
              DcmDspDidWrite: DcmDspDidWriteSessionRef=EOLDiagnosticSession, DcmDspDidWriteSecurityLevelRef=Level_EOL_Unlocked
          DidInfo_FM_AMSignalStrength
            DcmDspDidAccess
              DcmDspDidRead: DcmDspDidReadSessionRef=EOLDiagnosticSession, DcmDspDidReadSecurityLevelRef=Level_EOL_Unlocked
          DidInfo_DID_0xFDB0_1
            DcmDspDidAccess
              DcmDspDidRead: DcmDspDidReadSessionRef=EOLDiagnosticSession, DcmDspDidReadSecurityLevelRef=Level_EOL_Unlocked
          DidInfo_DABPSName
            DcmDspDidAccess
              DcmDspDidRead: DcmDspDidReadSessionRef=EOLDiagnosticSession, DcmDspDidReadSecurityLevelRef=Level_EOL_Unlocked
          DidInfo_DABFrequency
            DcmDspDidAccess
              DcmDspDidWrite: DcmDspDidWriteSessionRef=EOLDiagnosticSession, DcmDspDidWriteSecurityLevelRef=Level_EOL_Unlocked
          DidInfo_DABBank
            DcmDspDidAccess
              DcmDspDidWrite: DcmDspDidWriteSessionRef=EOLDiagnosticSession, DcmDspDidWriteSecurityLevelRef=Level_EOL_Unlocked
          DidInfo_DABPreset
            DcmDspDidAccess
              DcmDspDidWrite: DcmDspDidWriteSessionRef=EOLDiagnosticSession, DcmDspDidWriteSecurityLevelRef=Level_EOL_Unlocked
          DidInfo_DABSeek
            DcmDspDidAccess
              DcmDspDidWrite: DcmDspDidWriteSessionRef=EOLDiagnosticSession, DcmDspDidWriteSecurityLevelRef=Level_EOL_Unlocked
          DidInfo_DABEnsembleID
            DcmDspDidAccess
              DcmDspDidRead: DcmDspDidReadSessionRef=EOLDiagnosticSession, DcmDspDidReadSecurityLevelRef=Level_EOL_Unlocked
          DidInfo_DABStationID
            DcmDspDidAccess
              DcmDspDidRead: DcmDspDidReadSessionRef=DcmDspSession/Default, DcmDspDidReadSessionRef=DcmDspSession/Extended, DcmDspDidReadSessionRef=EOLDiagnosticSession
          DidInfo_DABBitErrorRatio
            DcmDspDidAccess
              DcmDspDidRead: DcmDspDidReadSessionRef=EOLDiagnosticSession, DcmDspDidReadSecurityLevelRef=Level_EOL_Unlocked
          DidInfo_DABReceivedSignalStrength
            DcmDspDidAccess
              DcmDspDidRead: DcmDspDidReadSessionRef=EOLDiagnosticSession, DcmDspDidReadSecurityLevelRef=Level_EOL_Unlocked
          DidInfo_DABTestTone
            DcmDspDidAccess
              DcmDspDidWrite: DcmDspDidWriteSessionRef=EOLDiagnosticSession, DcmDspDidWriteSecurityLevelRef=Level_EOL_Unlocked
          DidInfo_SwitchFunction
            DcmDspDidAccess
              DcmDspDidRead: DcmDspDidReadSessionRef=EOLDiagnosticSession, DcmDspDidReadSecurityLevelRef=Level_EOL_Unlocked
              DcmDspDidWrite: DcmDspDidWriteSessionRef=EOLDiagnosticSession, DcmDspDidWriteSecurityLevelRef=Level_EOL_Unlocked
          DidInfo_Gyro_Status
            DcmDspDidAccess
              DcmDspDidRead: DcmDspDidReadSessionRef=EOLDiagnosticSession, DcmDspDidReadSecurityLevelRef=Level_EOL_Unlocked
          DidInfo_ReadGPSSatelliteCount
            DcmDspDidAccess
              DcmDspDidRead: DcmDspDidReadSessionRef=EOLDiagnosticSession, DcmDspDidReadSecurityLevelRef=Level_EOL_Unlocked
          DidInfo_IVIDisplayNight_DayMode
            DcmDspDidAccess
              DcmDspDidRead: DcmDspDidReadSessionRef=EOLDiagnosticSession, DcmDspDidReadSecurityLevelRef=Level_EOL_Unlocked
              DcmDspDidWrite: DcmDspDidWriteSessionRef=EOLDiagnosticSession, DcmDspDidWriteSecurityLevelRef=Level_EOL_Unlocked
          DidInfo_IVIDisplayBrightness
            DcmDspDidAccess
              DcmDspDidRead: DcmDspDidReadSessionRef=EOLDiagnosticSession, DcmDspDidReadSecurityLevelRef=Level_EOL_Unlocked
              DcmDspDidWrite: DcmDspDidWriteSessionRef=EOLDiagnosticSession, DcmDspDidWriteSecurityLevelRef=Level_EOL_Unlocked
          DidInfo_IVI_Display_Voltage
            DcmDspDidAccess
              DcmDspDidRead: DcmDspDidReadSessionRef=EOLDiagnosticSession, DcmDspDidReadSecurityLevelRef=Level_EOL_Unlocked
          DidInfo_IVIDisplayPatternsTest
            DcmDspDidAccess
              DcmDspDidWrite: DcmDspDidWriteSessionRef=EOLDiagnosticSession, DcmDspDidWriteSecurityLevelRef=Level_EOL_Unlocked
          DidInfo_ClearIVIDisplayDTCInformation
            DcmDspDidAccess
              DcmDspDidWrite: DcmDspDidWriteSessionRef=EOLDiagnosticSession, DcmDspDidWriteSecurityLevelRef=Level_EOL_Unlocked
          DidInfo_IVIDisplayReset
            DcmDspDidAccess
              DcmDspDidWrite: DcmDspDidWriteSessionRef=EOLDiagnosticSession, DcmDspDidWriteSecurityLevelRef=Level_EOL_Unlocked
          DidInfo_EnterEOLSession
            DcmDspDidAccess
              DcmDspDidWrite: DcmDspDidWriteSessionRef=EOLDiagnosticSession, DcmDspDidWriteSecurityLevelRef=Level_EOL_Unlocked
          DidInfo_ClusterBrightness
            DcmDspDidAccess
              DcmDspDidRead: DcmDspDidReadSessionRef=EOLDiagnosticSession, DcmDspDidReadSecurityLevelRef=Level_EOL_Unlocked
              DcmDspDidWrite: DcmDspDidWriteSessionRef=EOLDiagnosticSession, DcmDspDidWriteSecurityLevelRef=Level_EOL_Unlocked
          DidInfo_DID_0xFE62_1
            DcmDspDidAccess
              DcmDspDidRead: DcmDspDidReadSessionRef=EOLDiagnosticSession, DcmDspDidReadSecurityLevelRef=Level_EOL_Unlocked
          DidInfo_ClusterDisplayPatternsTest
            DcmDspDidAccess
              DcmDspDidWrite: DcmDspDidWriteSessionRef=EOLDiagnosticSession, DcmDspDidWriteSecurityLevelRef=Level_EOL_Unlocked
          DidInfo_ClusterDisplaySupplierInformation
            DcmDspDidAccess
              DcmDspDidRead: DcmDspDidReadSessionRef=EOLDiagnosticSession, DcmDspDidReadSecurityLevelRef=Level_EOL_Unlocked
          DidInfo_ClusterDisplaySizeofScreen
            DcmDspDidAccess
              DcmDspDidRead: DcmDspDidReadSessionRef=EOLDiagnosticSession, DcmDspDidReadSecurityLevelRef=Level_EOL_Unlocked
          DidInfo_ClusterDisplayResolution
            DcmDspDidAccess
              DcmDspDidRead: DcmDspDidReadSessionRef=EOLDiagnosticSession, DcmDspDidReadSecurityLevelRef=Level_EOL_Unlocked
          DidInfo_ClusterDisplayType
            DcmDspDidAccess
              DcmDspDidRead: DcmDspDidReadSessionRef=EOLDiagnosticSession, DcmDspDidReadSecurityLevelRef=Level_EOL_Unlocked
          DidInfo_ClusterDisplayLVDSsignalstandard
            DcmDspDidAccess
              DcmDspDidRead: DcmDspDidReadSessionRef=EOLDiagnosticSession, DcmDspDidReadSecurityLevelRef=Level_EOL_Unlocked
          DidInfo_ClearCluster
            DcmDspDidAccess
              DcmDspDidRead: DcmDspDidReadSessionRef=EOLDiagnosticSession, DcmDspDidReadSecurityLevelRef=Level_EOL_Unlocked
              DcmDspDidWrite: DcmDspDidWriteSessionRef=EOLDiagnosticSession, DcmDspDidWriteSecurityLevelRef=Level_EOL_Unlocked
          DidInfo_ClusterDisplayReset
            DcmDspDidAccess
              DcmDspDidWrite: DcmDspDidWriteSessionRef=EOLDiagnosticSession, DcmDspDidWriteSecurityLevelRef=Level_EOL_Unlocked
          DidInfo_ControlDisplayBrightness
            DcmDspDidAccess
              DcmDspDidRead: DcmDspDidReadSessionRef=EOLDiagnosticSession, DcmDspDidReadSecurityLevelRef=Level_EOL_Unlocked
              DcmDspDidWrite: DcmDspDidWriteSessionRef=EOLDiagnosticSession, DcmDspDidWriteSecurityLevelRef=Level_EOL_Unlocked
          DidInfo_PassengerDisplayBrightness
            DcmDspDidAccess
              DcmDspDidRead: DcmDspDidReadSessionRef=EOLDiagnosticSession, DcmDspDidReadSecurityLevelRef=Level_EOL_Unlocked
              DcmDspDidWrite: DcmDspDidWriteSessionRef=EOLDiagnosticSession, DcmDspDidWriteSecurityLevelRef=Level_EOL_Unlocked
          DidInfo_Radio_Antenna_Status
            DcmDspDidAccess
              DcmDspDidRead: DcmDspDidReadSessionRef=EOLDiagnosticSession, DcmDspDidReadSecurityLevelRef=Level_EOL_Unlocked
          DidInfo_MICStatus
            DcmDspDidAccess
              DcmDspDidRead: DcmDspDidReadSessionRef=EOLDiagnosticSession, DcmDspDidReadSecurityLevelRef=Level_EOL_Unlocked
          DidInfo_SpeakerStatus
            DcmDspDidAccess
              DcmDspDidRead: DcmDspDidReadSessionRef=EOLDiagnosticSession, DcmDspDidReadSecurityLevelRef=Level_EOL_Unlocked
          DidInfo_ExternalAmpStatus
            DcmDspDidAccess
              DcmDspDidRead: DcmDspDidReadSessionRef=EOLDiagnosticSession, DcmDspDidReadSecurityLevelRef=Level_EOL_Unlocked
          DidInfo_ReadCamera
            DcmDspDidAccess
              DcmDspDidRead: DcmDspDidReadSessionRef=EOLDiagnosticSession, DcmDspDidReadSecurityLevelRef=Level_EOL_Unlocked
          DidInfo_ReadDisplayLinkStatus
            DcmDspDidAccess
              DcmDspDidRead: DcmDspDidReadSessionRef=EOLDiagnosticSession, DcmDspDidReadSecurityLevelRef=Level_EOL_Unlocked
          DidInfo_CameraSwitch
            DcmDspDidAccess
              DcmDspDidWrite: DcmDspDidWriteSessionRef=EOLDiagnosticSession, DcmDspDidWriteSecurityLevelRef=Level_EOL_Unlocked
          DidInfo_DMSCameraDisplay0xFDF8
            DcmDspDidAccess
              DcmDspDidWrite:
                DcmDspDidWriteSessionRef = DcmDspSession/Extended
                DcmDspDidWriteSessionRef = EOLDiagnosticSession
                DcmDspDidWriteSecurityLevelRef = UnlockedL1
                DcmDspDidWriteSecurityLevelRef = Level_EOL_Unlocked
          DidInfo_InCarCameraDisplay0xFDF9
            DcmDspDidAccess
              DcmDspDidWrite: DcmDspDidWriteSessionRef=EOLDiagnosticSession, DcmDspDidWriteSecurityLevelRef=Level_EOL_Unlocked
          DidInfo_DVRCameraDisplaySwitchONOFF
            DcmDspDidAccess
              DcmDspDidWrite: DcmDspDidWriteSessionRef=EOLDiagnosticSession, DcmDspDidWriteSecurityLevelRef=Level_EOL_Unlocked
          DidInfo_GestureCameraDisplay
            DcmDspDidAccess
              DcmDspDidWrite: DcmDspDidWriteSessionRef=EOLDiagnosticSession, DcmDspDidWriteSecurityLevelRef=Level_EOL_Unlocked
          DidInfo_MICTestSwitch
            DcmDspDidAccess
              DcmDspDidWrite: DcmDspDidWriteSessionRef=EOLDiagnosticSession, DcmDspDidWriteSecurityLevelRef=Level_EOL_Unlocked
          DidInfo_AudioOutputbyAmp_A2B
            DcmDspDidAccess
              DcmDspDidWrite:
                DcmDspDidWriteSessionRef = DcmDspSession/Extended
                DcmDspDidWriteSessionRef = EOLDiagnosticSession
                DcmDspDidWriteSecurityLevelRef = UnlockedL1
                DcmDspDidWriteSecurityLevelRef = Level_EOL_Unlocked
          DidInfo_ClusterHardwareInput
            DcmDspDidAccess
              DcmDspDidRead: DcmDspDidReadSessionRef=EOLDiagnosticSession, DcmDspDidReadSecurityLevelRef=Level_EOL_Unlocked
          DidInfo_Display_enablingValues
            DcmDspDidAccess
              DcmDspDidWrite: DcmDspDidWriteSessionRef=EOLDiagnosticSession, DcmDspDidWriteSecurityLevelRef=Level_EOL_Unlocked
          DidInfo_TBOXMuteValue
            DcmDspDidAccess
              DcmDspDidRead: DcmDspDidReadSessionRef=EOLDiagnosticSession, DcmDspDidReadSecurityLevelRef=Level_EOL_Unlocked
          DidInfo_A2BTestSwitch
            DcmDspDidAccess
              DcmDspDidWrite: DcmDspDidWriteSessionRef=EOLDiagnosticSession, DcmDspDidWriteSecurityLevelRef=Level_EOL_Unlocked
          DidInfo_AUXTestSwitch
            DcmDspDidAccess
              DcmDspDidWrite: DcmDspDidWriteSessionRef=EOLDiagnosticSession, DcmDspDidWriteSecurityLevelRef=Level_EOL_Unlocked
          DidInfo_ReadUSB20PID
            DcmDspDidAccess
              DcmDspDidRead: DcmDspDidReadSessionRef=EOLDiagnosticSession, DcmDspDidReadSecurityLevelRef=Level_EOL_Unlocked
          DidInfo_ReadUSB30PID
            DcmDspDidAccess
              DcmDspDidRead: DcmDspDidReadSessionRef=EOLDiagnosticSession, DcmDspDidReadSecurityLevelRef=Level_EOL_Unlocked
          DidInfo_InternalAVMCameraON_OFF
            DcmDspDidAccess
              DcmDspDidWrite: DcmDspDidWriteSessionRef=EOLDiagnosticSession, DcmDspDidWriteSecurityLevelRef=Level_EOL_Unlocked
          DidInfo_AllCameraDisplayToIVI
            DcmDspDidAccess
              DcmDspDidWrite: DcmDspDidWriteSessionRef=EOLDiagnosticSession, DcmDspDidWriteSecurityLevelRef=Level_EOL_Unlocked
          DidInfo_ReadCameraDisplayStatus
            DcmDspDidAccess
              DcmDspDidRead: DcmDspDidReadSessionRef=EOLDiagnosticSession
          DidInfo_VehicleSpeed
            DcmDspDidAccess
              DcmDspDidRead:
                DcmDspDidReadSessionRef = DcmDspSession/Extended
                DcmDspDidReadSessionRef = EOLDiagnosticSession
                DcmDspDidReadSecurityLevelRef = UnlockedL1
                DcmDspDidReadSecurityLevelRef = Level_EOL_Unlocked
          DidInfo_EngineSpeed
            DcmDspDidAccess
              DcmDspDidRead: DcmDspDidReadSessionRef=DcmDspSession/Default, DcmDspDidReadSessionRef=DcmDspSession/Extended, DcmDspDidReadSessionRef=EOLDiagnosticSession
          DidInfo_OperatingVoltage
            DcmDspDidAccess
              DcmDspDidRead: DcmDspDidReadSessionRef=DcmDspSession/Default, DcmDspDidReadSessionRef=DcmDspSession/Extended, DcmDspDidReadSessionRef=EOLDiagnosticSession
          DidInfo_Odometer
            DcmDspDidAccess
              DcmDspDidRead: DcmDspDidReadSessionRef=DcmDspSession/Default, DcmDspDidReadSessionRef=DcmDspSession/Extended, DcmDspDidReadSessionRef=EOLDiagnosticSession
          DidInfo_DTCOccurrenceTimer
            DcmDspDidAccess
              DcmDspDidRead: DcmDspDidReadSessionRef=DcmDspSession/Default, DcmDspDidReadSessionRef=DcmDspSession/Extended, DcmDspDidReadSessionRef=EOLDiagnosticSession
          DidInfo_ActualRotationSpeed
            DcmDspDidAccess
              DcmDspDidRead: DcmDspDidReadSessionRef=DcmDspSession/Default, DcmDspDidReadSessionRef=DcmDspSession/Extended, DcmDspDidReadSessionRef=EOLDiagnosticSession
          DidInfo_Check_Ethernet_IP_PING_Function
            DcmDspDidAccess
              DcmDspDidRead: DcmDspDidReadSessionRef=DcmDspSession/Default, DcmDspDidReadSessionRef=DcmDspSession/Extended, DcmDspDidReadSessionRef=EOLDiagnosticSession
          DidInfo_IVI_Touch_Test
            DcmDspDidAccess
              DcmDspDidRead: DcmDspDidReadSessionRef=DcmDspSession/Default, DcmDspDidReadSessionRef=DcmDspSession/Extended, DcmDspDidReadSessionRef=EOLDiagnosticSession
          DidInfo_VehicleModel
            DcmDspDidAccess
              DcmDspDidRead: DcmDspDidReadSessionRef=DcmDspSession/Default, DcmDspDidReadSessionRef=DcmDspSession/Extended
              DcmDspDidWrite: DcmDspDidWriteSessionRef=DcmDspSession/Default, DcmDspDidWriteSessionRef=DcmDspSession/Extended
          DidInfo_VehicleManufacturerSparePartNumber
            DcmDspDidAccess
              DcmDspDidRead: DcmDspDidReadSessionRef=DcmDspSession/Default, DcmDspDidReadSessionRef=DcmDspSession/Extended, DcmDspDidReadSessionRef=EOLDiagnosticSession
              DcmDspDidWrite: DcmDspDidWriteSessionRef=EOLDiagnosticSession, DcmDspDidWriteSecurityLevelRef=Level_EOL_Unlocked
          DidInfo_SoftwareVersionNumberDataIdentifier
            DcmDspDidAccess
              DcmDspDidRead: DcmDspDidReadSessionRef=DcmDspSession/Default, DcmDspDidReadSessionRef=DcmDspSession/Extended, DcmDspDidReadSessionRef=EOLDiagnosticSession
          DidInfo_SystemSupplierIdentifier
            DcmDspDidAccess
              DcmDspDidRead: DcmDspDidReadSessionRef=DcmDspSession/Default, DcmDspDidReadSessionRef=DcmDspSession/Extended, DcmDspDidReadSessionRef=EOLDiagnosticSession
          DidInfo_ECUSerialNumber
            DcmDspDidAccess
              DcmDspDidRead: DcmDspDidReadSessionRef=DcmDspSession/Default, DcmDspDidReadSessionRef=DcmDspSession/Extended, DcmDspDidReadSessionRef=EOLDiagnosticSession
              DcmDspDidWrite: DcmDspDidWriteSessionRef=EOLDiagnosticSession, DcmDspDidWriteSecurityLevelRef=Level_EOL_Unlocked
          DidInfo_VehicleIdentificationNumber
            DcmDspDidAccess
              DcmDspDidRead: DcmDspDidReadSessionRef=DcmDspSession/Default, DcmDspDidReadSessionRef=DcmDspSession/Extended, DcmDspDidReadSessionRef=EOLDiagnosticSession
              DcmDspDidWrite: DcmDspDidWriteSessionRef=DcmDspSession/Default, DcmDspDidWriteSessionRef=DcmDspSession/Extended
          DidInfo_SystemSupplierECUHardwareVersionNumber
            DcmDspDidAccess
              DcmDspDidRead: DcmDspDidReadSessionRef=DcmDspSession/Default, DcmDspDidReadSessionRef=DcmDspSession/Extended, DcmDspDidReadSessionRef=EOLDiagnosticSession
              DcmDspDidWrite: DcmDspDidWriteSessionRef=EOLDiagnosticSession, DcmDspDidWriteSecurityLevelRef=Level_EOL_Unlocked
          DidInfo_SystemSupplierECUSoftwareVersionNumber
            DcmDspDidAccess
              DcmDspDidRead: DcmDspDidReadSessionRef=DcmDspSession/Default, DcmDspDidReadSessionRef=DcmDspSession/Extended, DcmDspDidReadSessionRef=EOLDiagnosticSession
          DidInfo_CMatrixVersion
            DcmDspDidAccess
              DcmDspDidRead: DcmDspDidReadSessionRef=DcmDspSession/Default, DcmDspDidReadSessionRef=DcmDspSession/Extended, DcmDspDidReadSessionRef=EOLDiagnosticSession
          DidInfo_ECUlevelNetworkConfigurationDataIdentifier
            DcmDspDidAccess
              DcmDspDidRead: DcmDspDidReadSessionRef=DcmDspSession/Default, DcmDspDidReadSessionRef=DcmDspSession/Extended, DcmDspDidReadSessionRef=EOLDiagnosticSession
              DcmDspDidWrite: DcmDspDidWriteSessionRef=DcmDspSession/Default, DcmDspDidWriteSessionRef=DcmDspSession/Extended
          DidInfo_FOTAIndentifier
            DcmDspDidAccess
              DcmDspDidRead: DcmDspDidReadSessionRef=DcmDspSession/Default, DcmDspDidReadSessionRef=DcmDspSession/Extended, DcmDspDidReadSessionRef=EOLDiagnosticSession
          DidInfo_NodeAddress
            DcmDspDidAccess
              DcmDspDidRead: DcmDspDidReadSessionRef=DcmDspSession/Default, DcmDspDidReadSessionRef=DcmDspSession/Extended, DcmDspDidReadSessionRef=EOLDiagnosticSession
          DidInfo_CompID1
            DcmDspDidAccess
              DcmDspDidRead: DcmDspDidReadSessionRef=DcmDspSession/Default, DcmDspDidReadSessionRef=DcmDspSession/Extended, DcmDspDidReadSessionRef=EOLDiagnosticSession
          DidInfo_FOTAName
            DcmDspDidAccess
              DcmDspDidRead: DcmDspDidReadSessionRef=DcmDspSession/Default, DcmDspDidReadSessionRef=DcmDspSession/Extended, DcmDspDidReadSessionRef=EOLDiagnosticSession
          DidInfo_ToolVersion
            DcmDspDidAccess
              DcmDspDidRead: DcmDspDidReadSessionRef=DcmDspSession/Default, DcmDspDidReadSessionRef=DcmDspSession/Extended, DcmDspDidReadSessionRef=EOLDiagnosticSession
          DidInfo_VehicleManufacturerECUCalibrationSoftwareVersionNumber
            DcmDspDidAccess
              DcmDspDidRead: DcmDspDidReadSessionRef=DcmDspSession/Default, DcmDspDidReadSessionRef=DcmDspSession/Extended, DcmDspDidReadSessionRef=EOLDiagnosticSession
          DidInfo_VehicleManufacturerECUBootSoftwareVersionNumber
            DcmDspDidAccess
              DcmDspDidRead: DcmDspDidReadSessionRef=DcmDspSession/Default, DcmDspDidReadSessionRef=DcmDspSession/Extended, DcmDspDidReadSessionRef=EOLDiagnosticSession
          DidInfo_FactoryMode
            DcmDspDidAccess
              DcmDspDidRead: DcmDspDidReadSessionRef=DcmDspSession/Default, DcmDspDidReadSessionRef=DcmDspSession/Extended, DcmDspDidReadSessionRef=EOLDiagnosticSession
              DcmDspDidWrite: DcmDspDidWriteSessionRef=DcmDspSession/Default, DcmDspDidWriteSessionRef=DcmDspSession/Extended
          DidInfo_UIN
            DcmDspDidAccess
              DcmDspDidRead:
                DcmDspDidReadSessionRef = DcmDspSession/Extended
                DcmDspDidReadSessionRef = EOLDiagnosticSession
                DcmDspDidReadSecurityLevelRef = UnlockedL1
                DcmDspDidReadSecurityLevelRef = Level_EOL_Unlocked
              DcmDspDidWrite: DcmDspDidWriteSessionRef=EOLDiagnosticSession, DcmDspDidWriteSecurityLevelRef=Level_EOL_Unlocked
          DidInfo_SecOCKey
            DcmDspDidAccess
              DcmDspDidRead: DcmDspDidReadSessionRef=DcmDspSession/Default, DcmDspDidReadSessionRef=DcmDspSession/Extended, DcmDspDidReadSessionRef=EOLDiagnosticSession
              DcmDspDidWrite: DcmDspDidWriteSessionRef=DcmDspSession/Default, DcmDspDidWriteSessionRef=DcmDspSession/Extended
          DidInfo_SecOCVersionNumber
            DcmDspDidAccess
              DcmDspDidRead: DcmDspDidReadSessionRef=DcmDspSession/Default, DcmDspDidReadSessionRef=DcmDspSession/Extended, DcmDspDidReadSessionRef=EOLDiagnosticSession
          DidInfo_SignalLineSCOCNumber
            DcmDspDidAccess
              DcmDspDidRead: DcmDspDidReadSessionRef=DcmDspSession/Default, DcmDspDidReadSessionRef=DcmDspSession/Extended, DcmDspDidReadSessionRef=EOLDiagnosticSession
          DidInfo_SignalLineCurrentStatus
            DcmDspDidAccess
              DcmDspDidRead: DcmDspDidReadSessionRef=DcmDspSession/Default, DcmDspDidReadSessionRef=DcmDspSession/Extended, DcmDspDidReadSessionRef=EOLDiagnosticSession
          DidInfo_SwitchARLTable
            DcmDspDidAccess
              DcmDspDidRead: DcmDspDidReadSessionRef=DcmDspSession/Default, DcmDspDidReadSessionRef=DcmDspSession/Extended, DcmDspDidReadSessionRef=EOLDiagnosticSession
              DcmDspDidWrite:
                DcmDspDidWriteSessionRef = DcmDspSession/Extended
                DcmDspDidWriteSessionRef = EOLDiagnosticSession
                DcmDspDidWriteSecurityLevelRef = UnlockedL1
                DcmDspDidWriteSecurityLevelRef = Level_EOL_Unlocked
          DidInfo_MasterSlaveStatus
            DcmDspDidAccess
              DcmDspDidRead: DcmDspDidReadSessionRef=DcmDspSession/Default, DcmDspDidReadSessionRef=DcmDspSession/Extended, DcmDspDidReadSessionRef=EOLDiagnosticSession
              DcmDspDidWrite: DcmDspDidWriteSessionRef=EOLDiagnosticSession, DcmDspDidWriteSecurityLevelRef=Level_EOL_Unlocked
          DidInfo_TestModeStatus
            DcmDspDidAccess
              DcmDspDidRead: DcmDspDidReadSessionRef=DcmDspSession/Default, DcmDspDidReadSessionRef=DcmDspSession/Extended, DcmDspDidReadSessionRef=EOLDiagnosticSession
          DidInfo_LinkStatus
            DcmDspDidAccess
              DcmDspDidRead: DcmDspDidReadSessionRef=DcmDspSession/Default, DcmDspDidReadSessionRef=DcmDspSession/Extended, DcmDspDidReadSessionRef=EOLDiagnosticSession
          DidInfo_BASE100SQIThreshold
            DcmDspDidAccess
              DcmDspDidRead: DcmDspDidReadSessionRef=DcmDspSession/Default, DcmDspDidReadSessionRef=DcmDspSession/Extended, DcmDspDidReadSessionRef=EOLDiagnosticSession
          DidInfo_BASE1000SQIThreshold
            DcmDspDidAccess
              DcmDspDidRead: DcmDspDidReadSessionRef=DcmDspSession/Default, DcmDspDidReadSessionRef=DcmDspSession/Extended, DcmDspDidReadSessionRef=EOLDiagnosticSession
          DidInfo_SQI
            DcmDspDidAccess
              DcmDspDidRead: DcmDspDidReadSessionRef=DcmDspSession/Default, DcmDspDidReadSessionRef=DcmDspSession/Extended, DcmDspDidReadSessionRef=EOLDiagnosticSession
          DidInfo_SwitchCounter
            DcmDspDidAccess
              DcmDspDidRead: DcmDspDidReadSessionRef=DcmDspSession/Default, DcmDspDidReadSessionRef=DcmDspSession/Extended, DcmDspDidReadSessionRef=EOLDiagnosticSession
          DidInfo_MACAddress
            DcmDspDidAccess
              DcmDspDidRead: DcmDspDidReadSessionRef=DcmDspSession/Default, DcmDspDidReadSessionRef=DcmDspSession/Extended, DcmDspDidReadSessionRef=EOLDiagnosticSession
              DcmDspDidWrite: DcmDspDidWriteSessionRef=EOLDiagnosticSession, DcmDspDidWriteSecurityLevelRef=Level_EOL_Unlocked
          DidInfo_TankResistanceValue
            DcmDspDidAccess
              DcmDspDidRead: DcmDspDidReadSessionRef=DcmDspSession/Default, DcmDspDidReadSessionRef=DcmDspSession/Extended, DcmDspDidReadSessionRef=EOLDiagnosticSession
          DidInfo_OemSpeedometer
            DcmDspDidAccess
              DcmDspDidRead: DcmDspDidReadSessionRef=DcmDspSession/Default, DcmDspDidReadSessionRef=DcmDspSession/Extended, DcmDspDidReadSessionRef=EOLDiagnosticSession
          DidInfo_OemTachometer
            DcmDspDidAccess
              DcmDspDidRead: DcmDspDidReadSessionRef=DcmDspSession/Default, DcmDspDidReadSessionRef=DcmDspSession/Extended, DcmDspDidReadSessionRef=EOLDiagnosticSession
          DidInfo_OemCoolant
            DcmDspDidAccess
              DcmDspDidRead: DcmDspDidReadSessionRef=DcmDspSession/Default, DcmDspDidReadSessionRef=DcmDspSession/Extended, DcmDspDidReadSessionRef=EOLDiagnosticSession
          DidInfo_OemTank
            DcmDspDidAccess
              DcmDspDidRead: DcmDspDidReadSessionRef=DcmDspSession/Default, DcmDspDidReadSessionRef=DcmDspSession/Extended, DcmDspDidReadSessionRef=EOLDiagnosticSession
          DidInfo_OdometerInfo
            DcmDspDidAccess
              DcmDspDidRead: DcmDspDidReadSessionRef=DcmDspSession/Default, DcmDspDidReadSessionRef=DcmDspSession/Extended, DcmDspDidReadSessionRef=EOLDiagnosticSession
          DidInfo_DID_0xF284_1
            DcmDspDidAccess
              DcmDspDidRead: DcmDspDidReadSessionRef=DcmDspSession/Default, DcmDspDidReadSessionRef=DcmDspSession/Extended, DcmDspDidReadSessionRef=EOLDiagnosticSession
          DidInfo_TripComputerAvgFuelConsumption
            DcmDspDidAccess
              DcmDspDidRead: DcmDspDidReadSessionRef=DcmDspSession/Default, DcmDspDidReadSessionRef=DcmDspSession/Extended, DcmDspDidReadSessionRef=EOLDiagnosticSession
          DidInfo_TripComputerInstFuelConsumption
            DcmDspDidAccess
              DcmDspDidRead: DcmDspDidReadSessionRef=DcmDspSession/Default, DcmDspDidReadSessionRef=DcmDspSession/Extended, DcmDspDidReadSessionRef=EOLDiagnosticSession
          DidInfo_TripComputerAvgVehicleSpeed
            DcmDspDidAccess
              DcmDspDidRead: DcmDspDidReadSessionRef=DcmDspSession/Default, DcmDspDidReadSessionRef=DcmDspSession/Extended, DcmDspDidReadSessionRef=EOLDiagnosticSession
          DidInfo_TripComputerDrivingTime
            DcmDspDidAccess
              DcmDspDidRead: DcmDspDidReadSessionRef=DcmDspSession/Default, DcmDspDidReadSessionRef=DcmDspSession/Extended, DcmDspDidReadSessionRef=EOLDiagnosticSession
          DidInfo_TripComputerTripDistance
            DcmDspDidAccess
              DcmDspDidRead: DcmDspDidReadSessionRef=DcmDspSession/Default, DcmDspDidReadSessionRef=DcmDspSession/Extended, DcmDspDidReadSessionRef=EOLDiagnosticSession
          DidInfo_ConfigurationInformation
            DcmDspDidAccess
              DcmDspDidRead: DcmDspDidReadSessionRef=DcmDspSession/Default, DcmDspDidReadSessionRef=DcmDspSession/Extended, DcmDspDidReadSessionRef=EOLDiagnosticSession
              DcmDspDidWrite:
                DcmDspDidWriteSessionRef = DcmDspSession/Extended
                DcmDspDidWriteSessionRef = EOLDiagnosticSession
                DcmDspDidWriteSecurityLevelRef = UnlockedL1
                DcmDspDidWriteSecurityLevelRef = Level_EOL_Unlocked
          DidInfo_SOCPBLBootloaderVersion
            DcmDspDidAccess
              DcmDspDidRead: DcmDspDidReadSessionRef=DcmDspSession/Default, DcmDspDidReadSessionRef=DcmDspSession/Extended, DcmDspDidReadSessionRef=EOLDiagnosticSession
          DidInfo_SOCXBLBootloaderVersion
            DcmDspDidAccess
              DcmDspDidRead: DcmDspDidReadSessionRef=DcmDspSession/Default, DcmDspDidReadSessionRef=DcmDspSession/Extended, DcmDspDidReadSessionRef=EOLDiagnosticSession
          DidInfo_SOCABLBootloaderVersion
            DcmDspDidAccess
              DcmDspDidRead: DcmDspDidReadSessionRef=DcmDspSession/Default, DcmDspDidReadSessionRef=DcmDspSession/Extended, DcmDspDidReadSessionRef=EOLDiagnosticSession
          DidInfo_InternalComponentsVoltage
            DcmDspDidAccess
              DcmDspDidRead: DcmDspDidReadSessionRef=DcmDspSession/Default, DcmDspDidReadSessionRef=DcmDspSession/Extended, DcmDspDidReadSessionRef=EOLDiagnosticSession
          DidInfo_SleepMode
            DcmDspDidAccess
              DcmDspDidWrite:
                DcmDspDidWriteSessionRef = DcmDspSession/Extended
                DcmDspDidWriteSessionRef = EOLDiagnosticSession
                DcmDspDidWriteSecurityLevelRef = UnlockedL1
                DcmDspDidWriteSecurityLevelRef = Level_EOL_Unlocked
          DidInfo_SkipHighTemperaturewarning
            DcmDspDidAccess
              DcmDspDidWrite:
                DcmDspDidWriteSessionRef = DcmDspSession/Extended
                DcmDspDidWriteSessionRef = EOLDiagnosticSession
                DcmDspDidWriteSecurityLevelRef = UnlockedL1
                DcmDspDidWriteSecurityLevelRef = Level_EOL_Unlocked
          DidInfo_WriteEOLFactoryMode
            DcmDspDidAccess
              DcmDspDidRead: DcmDspDidReadSessionRef=DcmDspSession/Default, DcmDspDidReadSessionRef=DcmDspSession/Extended, DcmDspDidReadSessionRef=EOLDiagnosticSession
              DcmDspDidWrite:
                DcmDspDidWriteSessionRef = DcmDspSession/Extended
                DcmDspDidWriteSessionRef = EOLDiagnosticSession
                DcmDspDidWriteSecurityLevelRef = UnlockedL1
                DcmDspDidWriteSecurityLevelRef = Level_EOL_Unlocked
          DidInfo_FM_RSQ
            DcmDspDidAccess
              DcmDspDidRead: DcmDspDidReadSessionRef=DcmDspSession/Default, DcmDspDidReadSessionRef=DcmDspSession/Extended, DcmDspDidReadSessionRef=EOLDiagnosticSession
          DidInfo_DID_0xFD1A_1
            DcmDspDidAccess
              DcmDspDidRead: DcmDspDidReadSessionRef=DcmDspSession/Default, DcmDspDidReadSessionRef=DcmDspSession/Extended, DcmDspDidReadSessionRef=EOLDiagnosticSession
          DidInfo_DID_0xFD41_1
            DcmDspDidAccess
              DcmDspDidRead: DcmDspDidReadSessionRef=DcmDspSession/Default, DcmDspDidReadSessionRef=DcmDspSession/Extended, DcmDspDidReadSessionRef=EOLDiagnosticSession
          DidInfo_EthernetLinkStatus
            DcmDspDidAccess
              DcmDspDidRead: DcmDspDidReadSessionRef=DcmDspSession/Default, DcmDspDidReadSessionRef=DcmDspSession/Extended, DcmDspDidReadSessionRef=EOLDiagnosticSession
          DidInfo_EthernetSQL
            DcmDspDidAccess
              DcmDspDidRead: DcmDspDidReadSessionRef=DcmDspSession/Default, DcmDspDidReadSessionRef=DcmDspSession/Extended, DcmDspDidReadSessionRef=EOLDiagnosticSession
          DidInfo_PHYMaster_SlaveMode
            DcmDspDidAccess
              DcmDspDidWrite: DcmDspDidWriteSessionRef=EOLDiagnosticSession, DcmDspDidWriteSecurityLevelRef=Level_EOL_Unlocked
          DidInfo_EthernetMacAddress
            DcmDspDidAccess
              DcmDspDidRead: DcmDspDidReadSessionRef=DcmDspSession/Default, DcmDspDidReadSessionRef=DcmDspSession/Extended, DcmDspDidReadSessionRef=EOLDiagnosticSession
              DcmDspDidWrite: DcmDspDidWriteSessionRef=EOLDiagnosticSession, DcmDspDidWriteSecurityLevelRef=Level_EOL_Unlocked
          DidInfo_ParkingReducevolumelevel
            DcmDspDidAccess
              DcmDspDidRead: DcmDspDidReadSessionRef=DcmDspSession/Default, DcmDspDidReadSessionRef=DcmDspSession/Extended, DcmDspDidReadSessionRef=EOLDiagnosticSession
              DcmDspDidWrite:
                DcmDspDidWriteSessionRef = DcmDspSession/Extended
                DcmDspDidWriteSessionRef = EOLDiagnosticSession
                DcmDspDidWriteSecurityLevelRef = UnlockedL1
                DcmDspDidWriteSecurityLevelRef = Level_EOL_Unlocked
          DidInfo_NaviReducevolumelevel
            DcmDspDidAccess
              DcmDspDidRead: DcmDspDidReadSessionRef=DcmDspSession/Default, DcmDspDidReadSessionRef=DcmDspSession/Extended, DcmDspDidReadSessionRef=EOLDiagnosticSession
              DcmDspDidWrite:
                DcmDspDidWriteSessionRef = DcmDspSession/Extended
                DcmDspDidWriteSessionRef = EOLDiagnosticSession
                DcmDspDidWriteSecurityLevelRef = UnlockedL1
                DcmDspDidWriteSecurityLevelRef = Level_EOL_Unlocked
          DidInfo_USB_iPod_Forward_Rewind
            DcmDspDidAccess
              DcmDspDidWrite:
                DcmDspDidWriteSessionRef = DcmDspSession/Extended
                DcmDspDidWriteSessionRef = EOLDiagnosticSession
                DcmDspDidWriteSecurityLevelRef = UnlockedL1
                DcmDspDidWriteSecurityLevelRef = Level_EOL_Unlocked
          DidInfo_PlayUSBDesiredFile_DesiredTime
            DcmDspDidAccess
              DcmDspDidWrite:
                DcmDspDidWriteSessionRef = DcmDspSession/Extended
                DcmDspDidWriteSessionRef = EOLDiagnosticSession
                DcmDspDidWriteSecurityLevelRef = UnlockedL1
                DcmDspDidWriteSecurityLevelRef = Level_EOL_Unlocked
          DidInfo_PlayiPodDesiredFile
            DcmDspDidAccess
              DcmDspDidWrite:
                DcmDspDidWriteSessionRef = DcmDspSession/Extended
                DcmDspDidWriteSessionRef = EOLDiagnosticSession
                DcmDspDidWriteSecurityLevelRef = UnlockedL1
                DcmDspDidWriteSecurityLevelRef = Level_EOL_Unlocked
          DidInfo_USB_iPodCurrentState
            DcmDspDidAccess
              DcmDspDidRead: DcmDspDidReadSessionRef=DcmDspSession/Default, DcmDspDidReadSessionRef=DcmDspSession/Extended, DcmDspDidReadSessionRef=EOLDiagnosticSession
          DidInfo_EjectCDCommand
            DcmDspDidAccess
              DcmDspDidWrite:
                DcmDspDidWriteSessionRef = DcmDspSession/Extended
                DcmDspDidWriteSessionRef = EOLDiagnosticSession
                DcmDspDidWriteSecurityLevelRef = UnlockedL1
                DcmDspDidWriteSecurityLevelRef = Level_EOL_Unlocked
          DidInfo_CDPlay_Pause
            DcmDspDidAccess
              DcmDspDidWrite:
                DcmDspDidWriteSessionRef = DcmDspSession/Extended
                DcmDspDidWriteSessionRef = EOLDiagnosticSession
                DcmDspDidWriteSecurityLevelRef = UnlockedL1
                DcmDspDidWriteSecurityLevelRef = Level_EOL_Unlocked
          DidInfo_CDPlayMode
            DcmDspDidAccess
              DcmDspDidWrite:
                DcmDspDidWriteSessionRef = DcmDspSession/Extended
                DcmDspDidWriteSessionRef = EOLDiagnosticSession
                DcmDspDidWriteSecurityLevelRef = UnlockedL1
                DcmDspDidWriteSecurityLevelRef = Level_EOL_Unlocked
          DidInfo_CDFastForward_Rewind
            DcmDspDidAccess
              DcmDspDidWrite:
                DcmDspDidWriteSessionRef = DcmDspSession/Extended
                DcmDspDidWriteSessionRef = EOLDiagnosticSession
                DcmDspDidWriteSecurityLevelRef = UnlockedL1
                DcmDspDidWriteSecurityLevelRef = Level_EOL_Unlocked
          DidInfo_CDSkipTrack
            DcmDspDidAccess
              DcmDspDidWrite:
                DcmDspDidWriteSessionRef = DcmDspSession/Extended
                DcmDspDidWriteSessionRef = EOLDiagnosticSession
                DcmDspDidWriteSecurityLevelRef = UnlockedL1
                DcmDspDidWriteSecurityLevelRef = Level_EOL_Unlocked
          DidInfo_CDCurrentStatus
            DcmDspDidAccess
              DcmDspDidRead: DcmDspDidReadSessionRef=DcmDspSession/Default, DcmDspDidReadSessionRef=DcmDspSession/Extended, DcmDspDidReadSessionRef=EOLDiagnosticSession
          DidInfo_FMPSName
            DcmDspDidAccess
              DcmDspDidRead: DcmDspDidReadSessionRef=DcmDspSession/Default, DcmDspDidReadSessionRef=DcmDspSession/Extended, DcmDspDidReadSessionRef=EOLDiagnosticSession
          DidInfo_FM_AMPreset
            DcmDspDidAccess
              DcmDspDidWrite:
                DcmDspDidWriteSessionRef = DcmDspSession/Extended
                DcmDspDidWriteSessionRef = EOLDiagnosticSession
                DcmDspDidWriteSecurityLevelRef = UnlockedL1
                DcmDspDidWriteSecurityLevelRef = Level_EOL_Unlocked
          DidInfo_TunerProperty
            DcmDspDidAccess
              DcmDspDidRead: DcmDspDidReadSessionRef=DcmDspSession/Default, DcmDspDidReadSessionRef=DcmDspSession/Extended, DcmDspDidReadSessionRef=EOLDiagnosticSession
              DcmDspDidWrite:
                DcmDspDidWriteSessionRef = DcmDspSession/Extended
                DcmDspDidWriteSessionRef = EOLDiagnosticSession
                DcmDspDidWriteSecurityLevelRef = UnlockedL1
                DcmDspDidWriteSecurityLevelRef = Level_EOL_Unlocked
          DidInfo_AGCStatus
            DcmDspDidAccess
              DcmDspDidRead: DcmDspDidReadSessionRef=DcmDspSession/Default, DcmDspDidReadSessionRef=DcmDspSession/Extended, DcmDspDidReadSessionRef=EOLDiagnosticSession
          DidInfo_FMSERVO
            DcmDspDidAccess
              DcmDspDidRead: DcmDspDidReadSessionRef=DcmDspSession/Default, DcmDspDidReadSessionRef=DcmDspSession/Extended, DcmDspDidReadSessionRef=EOLDiagnosticSession
              DcmDspDidWrite:
                DcmDspDidWriteSessionRef = DcmDspSession/Extended
                DcmDspDidWriteSessionRef = EOLDiagnosticSession
                DcmDspDidWriteSecurityLevelRef = UnlockedL1
                DcmDspDidWriteSecurityLevelRef = Level_EOL_Unlocked
          DidInfo_FMSERVOTransform
            DcmDspDidAccess
              DcmDspDidRead: DcmDspDidReadSessionRef=DcmDspSession/Default, DcmDspDidReadSessionRef=DcmDspSession/Extended, DcmDspDidReadSessionRef=EOLDiagnosticSession
              DcmDspDidWrite:
                DcmDspDidWriteSessionRef = DcmDspSession/Extended
                DcmDspDidWriteSessionRef = EOLDiagnosticSession
                DcmDspDidWriteSecurityLevelRef = UnlockedL1
                DcmDspDidWriteSecurityLevelRef = Level_EOL_Unlocked
          DidInfo_AMSERVO
            DcmDspDidAccess
              DcmDspDidRead: DcmDspDidReadSessionRef=DcmDspSession/Default, DcmDspDidReadSessionRef=DcmDspSession/Extended, DcmDspDidReadSessionRef=EOLDiagnosticSession
              DcmDspDidWrite:
                DcmDspDidWriteSessionRef = DcmDspSession/Extended
                DcmDspDidWriteSessionRef = EOLDiagnosticSession
                DcmDspDidWriteSecurityLevelRef = UnlockedL1
                DcmDspDidWriteSecurityLevelRef = Level_EOL_Unlocked
          DidInfo_AMSERVOTransform
            DcmDspDidAccess
              DcmDspDidRead: DcmDspDidReadSessionRef=DcmDspSession/Default, DcmDspDidReadSessionRef=DcmDspSession/Extended, DcmDspDidReadSessionRef=EOLDiagnosticSession
              DcmDspDidWrite:
                DcmDspDidWriteSessionRef = DcmDspSession/Extended
                DcmDspDidWriteSessionRef = EOLDiagnosticSession
                DcmDspDidWriteSecurityLevelRef = UnlockedL1
                DcmDspDidWriteSecurityLevelRef = Level_EOL_Unlocked
          DidInfo_SetTunerRegister
            DcmDspDidAccess
              DcmDspDidWrite:
                DcmDspDidWriteSessionRef = DcmDspSession/Extended
                DcmDspDidWriteSessionRef = EOLDiagnosticSession
                DcmDspDidWriteSecurityLevelRef = UnlockedL1
                DcmDspDidWriteSecurityLevelRef = Level_EOL_Unlocked
          DidInfo_GetFMRSQ
            DcmDspDidAccess
              DcmDspDidRead: DcmDspDidReadSessionRef=DcmDspSession/Default, DcmDspDidReadSessionRef=DcmDspSession/Extended, DcmDspDidReadSessionRef=EOLDiagnosticSession
          DidInfo_GPSInformation
            DcmDspDidAccess
              DcmDspDidRead: DcmDspDidReadSessionRef=DcmDspSession/Default, DcmDspDidReadSessionRef=DcmDspSession/Extended, DcmDspDidReadSessionRef=EOLDiagnosticSession
          DidInfo_RVC_AVMCameraStatus
            DcmDspDidAccess
              DcmDspDidRead: DcmDspDidReadSessionRef=DcmDspSession/Default, DcmDspDidReadSessionRef=DcmDspSession/Extended, DcmDspDidReadSessionRef=EOLDiagnosticSession
          DidInfo_DMSCameraStatus
            DcmDspDidAccess
              DcmDspDidRead: DcmDspDidReadSessionRef=DcmDspSession/Default, DcmDspDidReadSessionRef=DcmDspSession/Extended, DcmDspDidReadSessionRef=EOLDiagnosticSession
          DidInfo_ExternalAVMCameraStatus
            DcmDspDidAccess
              DcmDspDidRead: DcmDspDidReadSessionRef=DcmDspSession/Default, DcmDspDidReadSessionRef=DcmDspSession/Extended, DcmDspDidReadSessionRef=EOLDiagnosticSession
              DcmDspDidWrite:
                DcmDspDidWriteSessionRef = DcmDspSession/Extended
                DcmDspDidWriteSessionRef = EOLDiagnosticSession
                DcmDspDidWriteSecurityLevelRef = UnlockedL1
                DcmDspDidWriteSecurityLevelRef = Level_EOL_Unlocked
          DidInfo_DVRCameraStatus
            DcmDspDidAccess
              DcmDspDidRead: DcmDspDidReadSessionRef=DcmDspSession/Default, DcmDspDidReadSessionRef=DcmDspSession/Extended, DcmDspDidReadSessionRef=EOLDiagnosticSession
          DidInfo_In_CarCameraStatus
            DcmDspDidAccess
              DcmDspDidRead: DcmDspDidReadSessionRef=DcmDspSession/Default, DcmDspDidReadSessionRef=DcmDspSession/Extended, DcmDspDidReadSessionRef=EOLDiagnosticSession
          DidInfo_ADCErrorLog
            DcmDspDidAccess
              DcmDspDidRead: DcmDspDidReadSessionRef=DcmDspSession/Default, DcmDspDidReadSessionRef=DcmDspSession/Extended, DcmDspDidReadSessionRef=EOLDiagnosticSession
          DidInfo_EEPROMValue
            DcmDspDidAccess
              DcmDspDidRead: DcmDspDidReadSessionRef=DcmDspSession/Default, DcmDspDidReadSessionRef=DcmDspSession/Extended, DcmDspDidReadSessionRef=EOLDiagnosticSession
          DidInfo_OverHeatProtectionSwitch
            DcmDspDidAccess
              DcmDspDidWrite:
                DcmDspDidWriteSessionRef = DcmDspSession/Extended
                DcmDspDidWriteSessionRef = EOLDiagnosticSession
                DcmDspDidWriteSecurityLevelRef = UnlockedL1
                DcmDspDidWriteSecurityLevelRef = Level_EOL_Unlocked
          DidInfo_HighTempWarningTemperatureSet
            DcmDspDidAccess
              DcmDspDidWrite:
                DcmDspDidWriteSessionRef = DcmDspSession/Extended
                DcmDspDidWriteSessionRef = EOLDiagnosticSession
                DcmDspDidWriteSecurityLevelRef = UnlockedL1
                DcmDspDidWriteSecurityLevelRef = Level_EOL_Unlocked
          DidInfo_IVIDisplayManufactureDate
            DcmDspDidAccess
              DcmDspDidRead: DcmDspDidReadSessionRef=DcmDspSession/Default, DcmDspDidReadSessionRef=DcmDspSession/Extended, DcmDspDidReadSessionRef=EOLDiagnosticSession
          DidInfo_SparePartnumber
            DcmDspDidAccess
              DcmDspDidRead: DcmDspDidReadSessionRef=DcmDspSession/Default, DcmDspDidReadSessionRef=DcmDspSession/Extended, DcmDspDidReadSessionRef=EOLDiagnosticSession
          DidInfo_SoftwareVersion
            DcmDspDidAccess
              DcmDspDidRead: DcmDspDidReadSessionRef=DcmDspSession/Default, DcmDspDidReadSessionRef=DcmDspSession/Extended, DcmDspDidReadSessionRef=EOLDiagnosticSession
          DidInfo_DID_0xFDF9
            DcmDspDidAccess
              DcmDspDidRead: DcmDspDidReadSessionRef=DcmDspSession/Default, DcmDspDidReadSessionRef=DcmDspSession/Extended, DcmDspDidReadSessionRef=EOLDiagnosticSession
          DidInfo_IVIDisplayThemes
            DcmDspDidAccess
              DcmDspDidRead: DcmDspDidReadSessionRef=DcmDspSession/Default, DcmDspDidReadSessionRef=DcmDspSession/Extended, DcmDspDidReadSessionRef=EOLDiagnosticSession
              DcmDspDidWrite:
                DcmDspDidWriteSessionRef = DcmDspSession/Extended
                DcmDspDidWriteSessionRef = EOLDiagnosticSession
                DcmDspDidWriteSecurityLevelRef = UnlockedL1
                DcmDspDidWriteSecurityLevelRef = Level_EOL_Unlocked
          DidInfo_IVIDisplayLinkStatus
            DcmDspDidAccess
              DcmDspDidRead: DcmDspDidReadSessionRef=DcmDspSession/Default, DcmDspDidReadSessionRef=DcmDspSession/Extended, DcmDspDidReadSessionRef=EOLDiagnosticSession
              DcmDspDidWrite:
                DcmDspDidWriteSessionRef = DcmDspSession/Extended
                DcmDspDidWriteSessionRef = EOLDiagnosticSession
                DcmDspDidWriteSecurityLevelRef = UnlockedL1
                DcmDspDidWriteSecurityLevelRef = Level_EOL_Unlocked
          DidInfo_ClusterThemes
            DcmDspDidAccess
              DcmDspDidRead: DcmDspDidReadSessionRef=DcmDspSession/Default, DcmDspDidReadSessionRef=DcmDspSession/Extended, DcmDspDidReadSessionRef=EOLDiagnosticSession
              DcmDspDidWrite:
                DcmDspDidWriteSessionRef = DcmDspSession/Extended
                DcmDspDidWriteSessionRef = EOLDiagnosticSession
                DcmDspDidWriteSecurityLevelRef = UnlockedL1
                DcmDspDidWriteSecurityLevelRef = Level_EOL_Unlocked
          DidInfo_ClusterStartupAnimationSwitch
            DcmDspDidAccess
              DcmDspDidRead: DcmDspDidReadSessionRef=DcmDspSession/Default, DcmDspDidReadSessionRef=DcmDspSession/Extended, DcmDspDidReadSessionRef=EOLDiagnosticSession
              DcmDspDidWrite:
                DcmDspDidWriteSessionRef = DcmDspSession/Extended
                DcmDspDidWriteSessionRef = EOLDiagnosticSession
                DcmDspDidWriteSecurityLevelRef = UnlockedL1
                DcmDspDidWriteSecurityLevelRef = Level_EOL_Unlocked
          DidInfo_TelltaleTest
            DcmDspDidAccess
              DcmDspDidWrite:
                DcmDspDidWriteSessionRef = DcmDspSession/Extended
                DcmDspDidWriteSessionRef = EOLDiagnosticSession
                DcmDspDidWriteSecurityLevelRef = UnlockedL1
                DcmDspDidWriteSecurityLevelRef = Level_EOL_Unlocked
          DidInfo_ClusterDisplayLinkStatus
            DcmDspDidAccess
              DcmDspDidRead: DcmDspDidReadSessionRef=DcmDspSession/Default, DcmDspDidReadSessionRef=DcmDspSession/Extended, DcmDspDidReadSessionRef=EOLDiagnosticSession
          DidInfo_ControlDisplayThemes
            DcmDspDidAccess
              DcmDspDidWrite:
                DcmDspDidWriteSessionRef = DcmDspSession/Extended
                DcmDspDidWriteSessionRef = EOLDiagnosticSession
                DcmDspDidWriteSecurityLevelRef = UnlockedL1
                DcmDspDidWriteSecurityLevelRef = Level_EOL_Unlocked
          DidInfo_ControlDisplayLinkStatus
            DcmDspDidAccess
              DcmDspDidRead: DcmDspDidReadSessionRef=DcmDspSession/Default, DcmDspDidReadSessionRef=DcmDspSession/Extended, DcmDspDidReadSessionRef=EOLDiagnosticSession
          DidInfo_HUDSwitch
            DcmDspDidAccess
              DcmDspDidRead: DcmDspDidReadSessionRef=DcmDspSession/Default, DcmDspDidReadSessionRef=DcmDspSession/Extended, DcmDspDidReadSessionRef=EOLDiagnosticSession
              DcmDspDidWrite:
                DcmDspDidWriteSessionRef = DcmDspSession/Extended
                DcmDspDidWriteSessionRef = EOLDiagnosticSession
                DcmDspDidWriteSecurityLevelRef = UnlockedL1
                DcmDspDidWriteSecurityLevelRef = Level_EOL_Unlocked
          DidInfo_HUDHeight
            DcmDspDidAccess
              DcmDspDidRead: DcmDspDidReadSessionRef=DcmDspSession/Default, DcmDspDidReadSessionRef=DcmDspSession/Extended, DcmDspDidReadSessionRef=EOLDiagnosticSession
              DcmDspDidWrite:
                DcmDspDidWriteSessionRef = DcmDspSession/Extended
                DcmDspDidWriteSessionRef = EOLDiagnosticSession
                DcmDspDidWriteSecurityLevelRef = UnlockedL1
                DcmDspDidWriteSecurityLevelRef = Level_EOL_Unlocked
          DidInfo_HUDBrightness
            DcmDspDidAccess
              DcmDspDidRead: DcmDspDidReadSessionRef=DcmDspSession/Default, DcmDspDidReadSessionRef=DcmDspSession/Extended, DcmDspDidReadSessionRef=EOLDiagnosticSession
              DcmDspDidWrite:
                DcmDspDidWriteSessionRef = DcmDspSession/Extended
                DcmDspDidWriteSessionRef = EOLDiagnosticSession
                DcmDspDidWriteSecurityLevelRef = UnlockedL1
                DcmDspDidWriteSecurityLevelRef = Level_EOL_Unlocked
          DidInfo_HUDRotationSet
            DcmDspDidAccess
              DcmDspDidWrite:
                DcmDspDidWriteSessionRef = DcmDspSession/Extended
                DcmDspDidWriteSessionRef = EOLDiagnosticSession
                DcmDspDidWriteSecurityLevelRef = UnlockedL1
                DcmDspDidWriteSecurityLevelRef = Level_EOL_Unlocked
          DidInfo_HUDDisplayMode
            DcmDspDidAccess
              DcmDspDidRead: DcmDspDidReadSessionRef=DcmDspSession/Default, DcmDspDidReadSessionRef=DcmDspSession/Extended, DcmDspDidReadSessionRef=EOLDiagnosticSession
              DcmDspDidWrite:
                DcmDspDidWriteSessionRef = DcmDspSession/Extended
                DcmDspDidWriteSessionRef = EOLDiagnosticSession
                DcmDspDidWriteSecurityLevelRef = UnlockedL1
                DcmDspDidWriteSecurityLevelRef = Level_EOL_Unlocked
          DidInfo_HUDDisplayContent
            DcmDspDidAccess
              DcmDspDidWrite:
                DcmDspDidWriteSessionRef = DcmDspSession/Extended
                DcmDspDidWriteSessionRef = EOLDiagnosticSession
                DcmDspDidWriteSecurityLevelRef = UnlockedL1
                DcmDspDidWriteSecurityLevelRef = Level_EOL_Unlocked
          DidInfo_HUDDisplayLinkStatus
            DcmDspDidAccess
              DcmDspDidRead: DcmDspDidReadSessionRef=DcmDspSession/Default, DcmDspDidReadSessionRef=DcmDspSession/Extended, DcmDspDidReadSessionRef=EOLDiagnosticSession
          DidInfo_PassengerDisplayLinkStatus
            DcmDspDidAccess
              DcmDspDidRead: DcmDspDidReadSessionRef=DcmDspSession/Default, DcmDspDidReadSessionRef=DcmDspSession/Extended, DcmDspDidReadSessionRef=EOLDiagnosticSession
          DidInfo_IVI_Touch_Information
            DcmDspDidAccess
              DcmDspDidRead: DcmDspDidReadSessionRef=DcmDspSession/Default, DcmDspDidReadSessionRef=DcmDspSession/Extended, DcmDspDidReadSessionRef=EOLDiagnosticSession
          DidInfo_ControlTouchInformation
            DcmDspDidAccess
              DcmDspDidRead: DcmDspDidReadSessionRef=DcmDspSession/Default, DcmDspDidReadSessionRef=DcmDspSession/Extended, DcmDspDidReadSessionRef=EOLDiagnosticSession
          DidInfo_PassengerTouchInformation
            DcmDspDidAccess
              DcmDspDidRead: DcmDspDidReadSessionRef=DcmDspSession/Default, DcmDspDidReadSessionRef=DcmDspSession/Extended, DcmDspDidReadSessionRef=EOLDiagnosticSession
          DidInfo_IVIGestureInformation
            DcmDspDidAccess
              DcmDspDidRead: DcmDspDidReadSessionRef=DcmDspSession/Default, DcmDspDidReadSessionRef=DcmDspSession/Extended, DcmDspDidReadSessionRef=EOLDiagnosticSession
          DidInfo_PassengerGestureInformation
            DcmDspDidAccess
              DcmDspDidRead: DcmDspDidReadSessionRef=DcmDspSession/Default, DcmDspDidReadSessionRef=DcmDspSession/Extended, DcmDspDidReadSessionRef=EOLDiagnosticSession
          DidInfo_HUTDisplaySignalStandard
            DcmDspDidAccess
              DcmDspDidRead: DcmDspDidReadSessionRef=DcmDspSession/Default, DcmDspDidReadSessionRef=DcmDspSession/Extended, DcmDspDidReadSessionRef=EOLDiagnosticSession
          DidInfo_HUTDisplayScreenType
            DcmDspDidAccess
              DcmDspDidRead: DcmDspDidReadSessionRef=DcmDspSession/Default, DcmDspDidReadSessionRef=DcmDspSession/Extended, DcmDspDidReadSessionRef=EOLDiagnosticSession
          DidInfo_HUTDisplayResolution
            DcmDspDidAccess
              DcmDspDidRead: DcmDspDidReadSessionRef=DcmDspSession/Default, DcmDspDidReadSessionRef=DcmDspSession/Extended, DcmDspDidReadSessionRef=EOLDiagnosticSession
          DidInfo_HUTDisplayScreenSize
            DcmDspDidAccess
              DcmDspDidRead: DcmDspDidReadSessionRef=DcmDspSession/Default, DcmDspDidReadSessionRef=DcmDspSession/Extended, DcmDspDidReadSessionRef=EOLDiagnosticSession
          DidInfo_HUTDisplaySupplierInformation
            DcmDspDidAccess
              DcmDspDidRead: DcmDspDidReadSessionRef=DcmDspSession/Default, DcmDspDidReadSessionRef=DcmDspSession/Extended, DcmDspDidReadSessionRef=EOLDiagnosticSession
          DidInfo_HUTDisplayTPVersionNumber
            DcmDspDidAccess
              DcmDspDidRead: DcmDspDidReadSessionRef=DcmDspSession/Default, DcmDspDidReadSessionRef=DcmDspSession/Extended, DcmDspDidReadSessionRef=EOLDiagnosticSession
          DidInfo_HUTDisplayTemperature
            DcmDspDidAccess
              DcmDspDidRead: DcmDspDidReadSessionRef=DcmDspSession/Default, DcmDspDidReadSessionRef=DcmDspSession/Extended, DcmDspDidReadSessionRef=EOLDiagnosticSession
          DidInfo_HUTDisplayManufacturingDate
            DcmDspDidAccess
              DcmDspDidRead: DcmDspDidReadSessionRef=DcmDspSession/Default, DcmDspDidReadSessionRef=DcmDspSession/Extended, DcmDspDidReadSessionRef=EOLDiagnosticSession
              DcmDspDidWrite: DcmDspDidWriteSessionRef=EOLDiagnosticSession, DcmDspDidWriteSecurityLevelRef=Level_EOL_Unlocked
          DidInfo_HUTDisplaySparePartNumber
            DcmDspDidAccess
              DcmDspDidRead: DcmDspDidReadSessionRef=DcmDspSession/Default, DcmDspDidReadSessionRef=DcmDspSession/Extended, DcmDspDidReadSessionRef=EOLDiagnosticSession
          DidInfo_HUTDisplaySoftwareVersionNumber
            DcmDspDidAccess
              DcmDspDidRead: DcmDspDidReadSessionRef=DcmDspSession/Default, DcmDspDidReadSessionRef=DcmDspSession/Extended, DcmDspDidReadSessionRef=EOLDiagnosticSession
          DidInfo_HUTDisplayHardwareVersionNumber
            DcmDspDidAccess
              DcmDspDidRead: DcmDspDidReadSessionRef=DcmDspSession/Default, DcmDspDidReadSessionRef=DcmDspSession/Extended, DcmDspDidReadSessionRef=EOLDiagnosticSession
              DcmDspDidWrite: DcmDspDidWriteSessionRef=EOLDiagnosticSession, DcmDspDidWriteSecurityLevelRef=Level_EOL_Unlocked
          DidInfo_IPDisplaySession
            DcmDspDidAccess
              DcmDspDidRead: DcmDspDidReadSessionRef=DcmDspSession/Default, DcmDspDidReadSessionRef=DcmDspSession/Extended, DcmDspDidReadSessionRef=EOLDiagnosticSession
          DidInfo_IPDisplayTemperature
            DcmDspDidAccess
              DcmDspDidRead: DcmDspDidReadSessionRef=DcmDspSession/Default, DcmDspDidReadSessionRef=DcmDspSession/Extended, DcmDspDidReadSessionRef=EOLDiagnosticSession
          DidInfo_IPDisplayManufacturingDate
            DcmDspDidAccess
              DcmDspDidRead: DcmDspDidReadSessionRef=DcmDspSession/Default, DcmDspDidReadSessionRef=DcmDspSession/Extended, DcmDspDidReadSessionRef=EOLDiagnosticSession
              DcmDspDidWrite: DcmDspDidWriteSessionRef=EOLDiagnosticSession, DcmDspDidWriteSecurityLevelRef=Level_EOL_Unlocked
          DidInfo_IPDisplaySparePartNumber
            DcmDspDidAccess
              DcmDspDidRead: DcmDspDidReadSessionRef=DcmDspSession/Default, DcmDspDidReadSessionRef=DcmDspSession/Extended, DcmDspDidReadSessionRef=EOLDiagnosticSession
              DcmDspDidWrite: DcmDspDidWriteSessionRef=EOLDiagnosticSession, DcmDspDidWriteSecurityLevelRef=Level_EOL_Unlocked
          DidInfo_IPDisplaySoftwareVersionNumber
            DcmDspDidAccess
              DcmDspDidRead: DcmDspDidReadSessionRef=DcmDspSession/Default, DcmDspDidReadSessionRef=DcmDspSession/Extended, DcmDspDidReadSessionRef=EOLDiagnosticSession
          DidInfo_IPDisplayHardwareVersionNumber
            DcmDspDidAccess
              DcmDspDidRead: DcmDspDidReadSessionRef=DcmDspSession/Default, DcmDspDidReadSessionRef=DcmDspSession/Extended, DcmDspDidReadSessionRef=EOLDiagnosticSession
        20 x DcmDspRoutine:
          MaintenanceOdometer_001: DcmDspRequestResultsRoutineSupported=false, DcmDspStopRoutineSupported=true, DcmDspRoutineIdentifier=517, DcmDspRoutineInfoRef=RoutineInfo_MaintenanceOdometer
          SpeedometerTest: DcmDspRequestResultsRoutineSupported=false, DcmDspStopRoutineSupported=true, DcmDspRoutineIdentifier=784, DcmDspRoutineInfoRef=RoutineInfo_SpeedometerTest
          TachometerTest: DcmDspRequestResultsRoutineSupported=false, DcmDspStopRoutineSupported=true, DcmDspRoutineIdentifier=785, DcmDspRoutineInfoRef=RoutineInfo_TachometerTest
          CoolantTempTest: DcmDspRequestResultsRoutineSupported=false, DcmDspStopRoutineSupported=true, DcmDspRoutineIdentifier=786, DcmDspRoutineInfoRef=RoutineInfo_CoolantTempTest
          TankTest: DcmDspRequestResultsRoutineSupported=false, DcmDspStopRoutineSupported=true, DcmDspRoutineIdentifier=787, DcmDspRoutineInfoRef=RoutineInfo_TankTest
          DampingSetting: DcmDspRequestResultsRoutineSupported=false, DcmDspStopRoutineSupported=true, DcmDspRoutineIdentifier=788, DcmDspRoutineInfoRef=RoutineInfo_DampingSetting
          ODOReset: DcmDspRequestResultsRoutineSupported=false, DcmDspStopRoutineSupported=false, DcmDspRoutineIdentifier=791, DcmDspRoutineInfoRef=RoutineInfo_ODOReset
          CheckEthernetIPPINGFunction: DcmDspRequestResultsRoutineSupported=true, DcmDspStopRoutineSupported=false, DcmDspRoutineIdentifier=1024, DcmDspRoutineInfoRef=RoutineInfo_CheckEthernetIPPINGFunction
          IVITouchTest: DcmDspRequestResultsRoutineSupported=true, DcmDspStopRoutineSupported=false, DcmDspRoutineIdentifier=1025, DcmDspRoutineInfoRef=RoutineInfo_IVITouchTest
          AVMRegister: DcmDspRequestResultsRoutineSupported=true, DcmDspStopRoutineSupported=false, DcmDspRoutineIdentifier=1026, DcmDspRoutineInfoRef=RoutineInfo_AVMRegister
          AMPCalibration: DcmDspRequestResultsRoutineSupported=true, DcmDspStopRoutineSupported=false, DcmDspRoutineIdentifier=1027, DcmDspRoutineInfoRef=RoutineInfo_AMPCalibration
          PhyTestMode: DcmDspRequestResultsRoutineSupported=false, DcmDspStopRoutineSupported=false, DcmDspRoutineIdentifier=41377, DcmDspRoutineInfoRef=RoutineInfo_PhyTestMode
          CableDiagnostics: DcmDspRequestResultsRoutineSupported=false, DcmDspStopRoutineSupported=false, DcmDspRoutineIdentifier=41378, DcmDspRoutineInfoRef=RoutineInfo_CableDiagnostics
          ResetSwitchStatistics: DcmDspRequestResultsRoutineSupported=false, DcmDspStopRoutineSupported=false, DcmDspRoutineIdentifier=41379, DcmDspRoutineInfoRef=RoutineInfo_ResetSwitchStatistics
          FrontCameraParameters: DcmDspRequestResultsRoutineSupported=true, DcmDspStopRoutineSupported=false, DcmDspRoutineIdentifier=61472, DcmDspRoutineInfoRef=RoutineInfo_FrontCameraParameters
          RearCameraParameters: DcmDspRequestResultsRoutineSupported=true, DcmDspStopRoutineSupported=false, DcmDspRoutineIdentifier=61473, DcmDspRoutineInfoRef=RoutineInfo_RearCameraParameters
          LeftCameraParameters: DcmDspRequestResultsRoutineSupported=true, DcmDspStopRoutineSupported=false, DcmDspRoutineIdentifier=61474, DcmDspRoutineInfoRef=RoutineInfo_LeftCameraParameters
          RightCameraParameters: DcmDspRequestResultsRoutineSupported=true, DcmDspStopRoutineSupported=false, DcmDspRoutineIdentifier=61475, DcmDspRoutineInfoRef=RoutineInfo_RightCameraParameters
          AVMEnvironmentCheck: DcmDspRequestResultsRoutineSupported=true, DcmDspStopRoutineSupported=false, DcmDspRoutineIdentifier=61488, DcmDspRoutineInfoRef=RoutineInfo_AVMEnvironmentCheck
          AVMCalibration: DcmDspRequestResultsRoutineSupported=true, DcmDspStopRoutineSupported=false, DcmDspRoutineIdentifier=61489, DcmDspRoutineInfoRef=RoutineInfo_AVMCalibration
        20 x DcmDspRoutineInfo:
          RoutineInfo_MaintenanceOdometer
            DcmDspRoutineAuthorization:
              DcmDspRoutineSessionRef = DcmDspSession/Extended
              DcmDspRoutineSessionRef = EOLDiagnosticSession
              DcmDspRoutineSecurityLevelRef = UnlockedL1
              DcmDspRoutineSecurityLevelRef = Level_EOL_Unlocked
            DcmDspStartRoutineIn
              In_MaintenanceOdometerControl (DcmDspStartRoutineInSignal): DcmDspRoutineSignalLength=32, DcmDspRoutineSignalType=UINT32, DcmDspRoutineSignalEndianness=BIG_ENDIAN, DcmDspRoutineSignalPos=0
            DcmDspStartRoutineOut
              Out_MaintenanceOdometerStatus (DcmDspStartRoutineOutSignal): DcmDspRoutineSignalLength=8, DcmDspRoutineSignalType=UINT8, DcmDspRoutineSignalPos=0
          RoutineInfo_SpeedometerTest
            DcmDspRoutineAuthorization:
              DcmDspRoutineSessionRef = DcmDspSession/Extended
              DcmDspRoutineSessionRef = EOLDiagnosticSession
              DcmDspRoutineSecurityLevelRef = UnlockedL1
              DcmDspRoutineSecurityLevelRef = Level_EOL_Unlocked
            DcmDspStartRoutineIn
              In_SpeedometerTestSpeed (DcmDspStartRoutineInSignal): DcmDspRoutineSignalLength=16, DcmDspRoutineSignalType=UINT16, DcmDspRoutineSignalEndianness=BIG_ENDIAN, DcmDspRoutineSignalPos=0
          RoutineInfo_TachometerTest
            DcmDspRoutineAuthorization:
              DcmDspRoutineSessionRef = DcmDspSession/Extended
              DcmDspRoutineSessionRef = EOLDiagnosticSession
              DcmDspRoutineSecurityLevelRef = UnlockedL1
              DcmDspRoutineSecurityLevelRef = Level_EOL_Unlocked
            DcmDspStartRoutineIn
              In_TachometerTestTach (DcmDspStartRoutineInSignal): DcmDspRoutineSignalLength=16, DcmDspRoutineSignalType=UINT16, DcmDspRoutineSignalEndianness=BIG_ENDIAN, DcmDspRoutineSignalPos=0
          RoutineInfo_CoolantTempTest
            DcmDspRoutineAuthorization:
              DcmDspRoutineSessionRef = DcmDspSession/Extended
              DcmDspRoutineSessionRef = EOLDiagnosticSession
              DcmDspRoutineSecurityLevelRef = UnlockedL1
              DcmDspRoutineSecurityLevelRef = Level_EOL_Unlocked
            DcmDspStartRoutineIn
              In_CoolantTempTestTemp (DcmDspStartRoutineInSignal): DcmDspRoutineSignalLength=8, DcmDspRoutineSignalType=UINT8, DcmDspRoutineSignalPos=0
          RoutineInfo_TankTest
            DcmDspRoutineAuthorization:
              DcmDspRoutineSessionRef = DcmDspSession/Extended
              DcmDspRoutineSessionRef = EOLDiagnosticSession
              DcmDspRoutineSecurityLevelRef = UnlockedL1
              DcmDspRoutineSecurityLevelRef = Level_EOL_Unlocked
            DcmDspStartRoutineIn
              In_TankTestVolumn (DcmDspStartRoutineInSignal): DcmDspRoutineSignalLength=8, DcmDspRoutineSignalType=UINT8, DcmDspRoutineSignalPos=0
          RoutineInfo_DampingSetting
            DcmDspRoutineAuthorization:
              DcmDspRoutineSessionRef = DcmDspSession/Extended
              DcmDspRoutineSessionRef = EOLDiagnosticSession
              DcmDspRoutineSecurityLevelRef = UnlockedL1
              DcmDspRoutineSecurityLevelRef = Level_EOL_Unlocked
            DcmDspStartRoutineIn
              In_DampingSettingDamping (DcmDspStartRoutineInSignal): DcmDspRoutineSignalLength=8, DcmDspRoutineSignalType=UINT8, DcmDspRoutineSignalPos=0
          RoutineInfo_ODOReset
            DcmDspRoutineAuthorization:
              DcmDspRoutineSessionRef = DcmDspSession/Extended
              DcmDspRoutineSessionRef = EOLDiagnosticSession
              DcmDspRoutineSecurityLevelRef = UnlockedL1
              DcmDspRoutineSecurityLevelRef = Level_EOL_Unlocked
            DcmDspStartRoutineOut
              Out_ODOReset (DcmDspStartRoutineOutSignal): DcmDspRoutineSignalLength=8, DcmDspRoutineSignalType=UINT8, DcmDspRoutineSignalPos=0
          RoutineInfo_CheckEthernetIPPINGFunction
            DcmDspRoutineAuthorization: DcmDspRoutineSessionRef=EOLDiagnosticSession, DcmDspRoutineSecurityLevelRef=Level_EOL_Unlocked
            DcmDspStartRoutineIn
              In_Start (DcmDspStartRoutineInSignal): DcmDspRoutineSignalLength=32, DcmDspRoutineSignalType=UINT32, DcmDspRoutineSignalEndianness=BIG_ENDIAN, DcmDspRoutineSignalPos=0
            DcmDspRoutineRequestResOut
              Out_0xF003 (DcmDspRoutineRequestResOutSignal): DcmDspRoutineSignalLength=8, DcmDspRoutineSignalType=UINT8, DcmDspRoutineSignalPos=0
          RoutineInfo_IVITouchTest
            DcmDspRoutineAuthorization: DcmDspRoutineSessionRef=DcmDspSession/Extended, DcmDspRoutineSessionRef=EOLDiagnosticSession
            DcmDspStartRoutineOut
              Out_0xF004 (DcmDspStartRoutineOutSignal): DcmDspRoutineSignalLength=8, DcmDspRoutineSignalType=UINT8, DcmDspRoutineSignalPos=0
            DcmDspRoutineRequestResOut
              Out_0xF004 (DcmDspRoutineRequestResOutSignal): DcmDspRoutineSignalLength=160, DcmDspRoutineSignalType=UINT8, DcmDspRoutineSignalEndianness=opaque, DcmDspRoutineSignalPos=0
          RoutineInfo_AVMRegister
            DcmDspRoutineAuthorization: DcmDspRoutineSessionRef=DcmDspSession/Extended, DcmDspRoutineSessionRef=EOLDiagnosticSession
            DcmDspStartRoutineOut
              Out_AVMRegister (DcmDspStartRoutineOutSignal): DcmDspRoutineSignalLength=8, DcmDspRoutineSignalType=UINT8, DcmDspRoutineSignalPos=0
            DcmDspRoutineRequestResOut
              Out_AVMRegister (DcmDspRoutineRequestResOutSignal): DcmDspRoutineSignalLength=8, DcmDspRoutineSignalType=UINT8, DcmDspRoutineSignalPos=0
          RoutineInfo_AMPCalibration
            DcmDspRoutineAuthorization: DcmDspRoutineSessionRef=EOLDiagnosticSession, DcmDspRoutineSessionRef=UFSKeepProgrammingSession
            DcmDspStartRoutineOut
              Out_RoutineStatusRecord (DcmDspStartRoutineOutSignal): DcmDspRoutineSignalLength=8, DcmDspRoutineSignalType=UINT8, DcmDspRoutineSignalPos=0
            DcmDspRoutineRequestResOut
              Out_AmpValue (DcmDspRoutineRequestResOutSignal): DcmDspRoutineSignalLength=16, DcmDspRoutineSignalType=UINT16, DcmDspRoutineSignalEndianness=BIG_ENDIAN, DcmDspRoutineSignalPos=0
          RoutineInfo_PhyTestMode
            DcmDspRoutineAuthorization: DcmDspRoutineSessionRef=DcmDspSession/Extended, DcmDspRoutineSecurityLevelRef=UnlockedL1
            DcmDspStartRoutineIn
              In_PhyTestModeControl (DcmDspStartRoutineInSignal): DcmDspRoutineSignalLength=16, DcmDspRoutineSignalType=UINT16, DcmDspRoutineSignalEndianness=BIG_ENDIAN, DcmDspRoutineSignalPos=0
            DcmDspStartRoutineOut
              4 x DcmDspStartRoutineOutSignal, all with DcmDspRoutineSignalLength=8, DcmDspRoutineSignalType=UINT8:
                Out_TestMode1: DcmDspRoutineSignalPos=0
                Out_TestMode2: DcmDspRoutineSignalPos=8
                Out_TestMode3: DcmDspRoutineSignalPos=16
                Out_TestMode4: DcmDspRoutineSignalPos=24
          RoutineInfo_CableDiagnostics
            DcmDspRoutineAuthorization: DcmDspRoutineSessionRef=DcmDspSession/Extended, DcmDspRoutineSecurityLevelRef=UnlockedL1
            DcmDspStartRoutineIn
              In_CableDiagnosticsControl (DcmDspStartRoutineInSignal): DcmDspRoutineSignalLength=16, DcmDspRoutineSignalType=UINT16, DcmDspRoutineSignalEndianness=BIG_ENDIAN, DcmDspRoutineSignalPos=0
            DcmDspStartRoutineOut
              4 x DcmDspStartRoutineOutSignal, all with DcmDspRoutineSignalLength=8, DcmDspRoutineSignalType=UINT8:
                Out_Result1: DcmDspRoutineSignalPos=0
                Out_Result2: DcmDspRoutineSignalPos=8
                Out_Result3: DcmDspRoutineSignalPos=16
                Out_Result4: DcmDspRoutineSignalPos=24
          RoutineInfo_ResetSwitchStatistics
            DcmDspRoutineAuthorization: DcmDspRoutineSessionRef=DcmDspSession/Extended, DcmDspRoutineSecurityLevelRef=UnlockedL1
            DcmDspStartRoutineOut
              Out_ResetSwitchStatisticsStatus (DcmDspStartRoutineOutSignal): DcmDspRoutineSignalLength=8, DcmDspRoutineSignalType=UINT8, DcmDspRoutineSignalPos=0
          RoutineInfo_FrontCameraParameters
            DcmDspRoutineAuthorization: DcmDspRoutineSessionRef=DcmDspSession/Extended, DcmDspRoutineSessionRef=EOLDiagnosticSession
            DcmDspRoutineRequestResOut
              Out_FrontCameraParametersResult (DcmDspRoutineRequestResOutSignal): DcmDspRoutineSignalLength=8, DcmDspRoutineSignalType=UINT8, DcmDspRoutineSignalPos=0
          RoutineInfo_RearCameraParameters
            DcmDspRoutineAuthorization: DcmDspRoutineSessionRef=DcmDspSession/Extended, DcmDspRoutineSessionRef=EOLDiagnosticSession
            DcmDspRoutineRequestResOut
              Out_RearCameraParametersResult (DcmDspRoutineRequestResOutSignal): DcmDspRoutineSignalLength=8, DcmDspRoutineSignalType=UINT8, DcmDspRoutineSignalPos=0
          RoutineInfo_LeftCameraParameters
            DcmDspRoutineAuthorization: DcmDspRoutineSessionRef=DcmDspSession/Extended, DcmDspRoutineSessionRef=EOLDiagnosticSession
            DcmDspRoutineRequestResOut
              Out_LeftCameraParametersResult (DcmDspRoutineRequestResOutSignal): DcmDspRoutineSignalLength=8, DcmDspRoutineSignalType=UINT8, DcmDspRoutineSignalPos=0
              Out_New_Data_Object (DcmDspRoutineRequestResOutSignal): DcmDspRoutineSignalLength=8, DcmDspRoutineSignalType=UINT8, DcmDspRoutineSignalPos=8
          RoutineInfo_RightCameraParameters
            DcmDspRoutineAuthorization: DcmDspRoutineSessionRef=DcmDspSession/Extended, DcmDspRoutineSessionRef=EOLDiagnosticSession
            DcmDspRoutineRequestResOut
              Out_RightCameraParametersResult (DcmDspRoutineRequestResOutSignal): DcmDspRoutineSignalLength=8, DcmDspRoutineSignalType=UINT8, DcmDspRoutineSignalPos=0
          RoutineInfo_AVMEnvironmentCheck
            DcmDspRoutineAuthorization: DcmDspRoutineSessionRef=DcmDspSession/Extended, DcmDspRoutineSessionRef=EOLDiagnosticSession
            DcmDspRoutineRequestResOut
              Out_AVMEnvironmentCheckResult (DcmDspRoutineRequestResOutSignal): DcmDspRoutineSignalLength=8, DcmDspRoutineSignalType=UINT8, DcmDspRoutineSignalPos=0
          RoutineInfo_AVMCalibration
            DcmDspRoutineAuthorization: DcmDspRoutineSessionRef=DcmDspSession/Extended, DcmDspRoutineSessionRef=EOLDiagnosticSession
            DcmDspRoutineRequestResOut
              Out_AVMCalibrationResult (DcmDspRoutineRequestResOutSignal): DcmDspRoutineSignalLength=8, DcmDspRoutineSignalType=UINT8, DcmDspRoutineSignalPos=0
        DcmDspSecurity
          UnlockedL1 (DcmDspSecurityRow):
            DcmDspSecurityDelayTime = 10
            DcmDspSecurityDelayTimeOnBoot = 0
            DcmDspSecurityKeySize = 4
            DcmDspSecurityLevel = 1
            DcmDspSecurityNumAttDelay = 3
            DcmDspSecuritySeedSize = 4
          Level_EOL_Unlocked (DcmDspSecurityRow):
            DcmDspSecurityDelayTime = 10
            DcmDspSecurityDelayTimeOnBoot = 0
            DcmDspSecurityKeySize = 8
            DcmDspSecurityLevel = 49
            DcmDspSecurityNumAttDelay = 2
            DcmDspSecuritySeedSize = 4
        DcmDspSession
          4 x DcmDspSessionRow, all with DcmDspSessionP2ServerMax=0.05, DcmDspSessionP2StarServerMax=5:
            Default: DcmDspSessionLevel=1, DcmDspSessionForBoot=DCM_NO_BOOT
            Extended: DcmDspSessionLevel=3, DcmDspSessionForBoot=DCM_NO_BOOT
            EOLDiagnosticSession: DcmDspSessionLevel=96
            UFSKeepProgrammingSession: DcmDspSessionLevel=111
        ComControl (DcmDspComControl)
          DspComContolAllChannel (DcmDspComControlAllChannel)
