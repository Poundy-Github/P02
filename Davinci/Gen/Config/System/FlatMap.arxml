AUTOSAR XML (schema 00046)
package /COM/VECTOR/CFG/WORKFLOW/SYSDESC/SYNC
  flat map FLATMAP
    432 x flat instance descriptor:
      EOL: upstream-reference=EcuSwComposition.Manager_Swc.EOL, ecu-extract-reference=COMPOSITIONTYPE.EOL
      RTC: upstream-reference=EcuSwComposition.BSW_CDD.RTC, ecu-extract-reference=COMPOSITIONTYPE.RTC
      IPC: upstream-reference=EcuSwComposition.BSW_CDD.IPC, ecu-extract-reference=COMPOSITIONTYPE.IPC
      AC_FrntWinHeatDislSts: upstream-reference=EcuSwComposition.AC_FrntWinHeatDislSts, ecu-extract-reference=COMPOSITIONTYPE.AC_FrntWinHeatDislSts
      IIC: upstream-reference=EcuSwComposition.BSW_CDD.IIC, ecu-extract-reference=COMPOSITIONTYPE.IIC
      AMP: upstream-reference=EcuSwComposition.BSW_CDD.AMP, ecu-extract-reference=COMPOSITIONTYPE.AMP
      Gyro: upstream-reference=EcuSwComposition.BSW_CDD.Gyro, ecu-extract-reference=COMPOSITIONTYPE.Gyro
      Log: upstream-reference=EcuSwComposition.BSW_CDD.Log, ecu-extract-reference=COMPOSITIONTYPE.Log
      Upgrade: upstream-reference=EcuSwComposition.Manager_Swc.Upgrade, ecu-extract-reference=COMPOSITIONTYPE.Upgrade
      Vconfig: upstream-reference=EcuSwComposition.Manager_Swc.Vconfig, ecu-extract-reference=COMPOSITIONTYPE.Vconfig
      Misc: upstream-reference=EcuSwComposition.BSW_CDD.Misc, ecu-extract-reference=COMPOSITIONTYPE.Misc
      IoHwAb: upstream-reference=EcuSwComposition.BSW_CDD.IoHwAb, ecu-extract-reference=COMPOSITIONTYPE.IoHwAb
      SOCManager: upstream-reference=EcuSwComposition.Manager_Swc.SOCManager, ecu-extract-reference=COMPOSITIONTYPE.SOCManager
      SG_ACC7_ACC_FD2: upstream-reference=EcuSwComposition.SG_ACC7_ACC_FD2, ecu-extract-reference=COMPOSITIONTYPE.SG_ACC7_ACC_FD2
      SysPowerMod: upstream-reference=EcuSwComposition.SysPowerMod, ecu-extract-reference=COMPOSITIONTYPE.SysPowerMod
      SysPowerModVld: upstream-reference=EcuSwComposition.SysPowerModVld, ecu-extract-reference=COMPOSITIONTYPE.SysPowerModVld
      DrvDoorLockSts: upstream-reference=EcuSwComposition.DrvDoorLockSts, ecu-extract-reference=COMPOSITIONTYPE.DrvDoorLockSts
      DrvDoorSts: upstream-reference=EcuSwComposition.DrvDoorSts, ecu-extract-reference=COMPOSITIONTYPE.DrvDoorSts
      CURRENT_GEAR: upstream-reference=EcuSwComposition.CURRENT_GEAR, ecu-extract-reference=COMPOSITIONTYPE.CURRENT_GEAR
      TranPMode_Sts: upstream-reference=EcuSwComposition.TranPMode_Sts, ecu-extract-reference=COMPOSITIONTYPE.TranPMode_Sts
      LvPwrSysErr: upstream-reference=EcuSwComposition.LvPwrSysErr, ecu-extract-reference=COMPOSITIONTYPE.LvPwrSysErr
      Stat_PwrSv_Lvl: upstream-reference=EcuSwComposition.Stat_PwrSv_Lvl, ecu-extract-reference=COMPOSITIONTYPE.Stat_PwrSv_Lvl
      HUD_SwtSts: upstream-reference=EcuSwComposition.HUD_SwtSts, ecu-extract-reference=COMPOSITIONTYPE.HUD_SwtSts
      DCM_Server: upstream-reference=EcuSwComposition.Manager_Swc.DCM_Server, ecu-extract-reference=COMPOSITIONTYPE.DCM_Server
      ABS3_0x265: upstream-reference=EcuSwComposition.ABS3_0x265, ecu-extract-reference=COMPOSITIONTYPE.ABS3_0x265
      BMS19_0x352: upstream-reference=EcuSwComposition.BMS19_0x352, ecu-extract-reference=COMPOSITIONTYPE.BMS19_0x352
      ECM1_0x111: upstream-reference=EcuSwComposition.ECM1_0x111, ecu-extract-reference=COMPOSITIONTYPE.ECM1_0x111
      ECM3_0x371: upstream-reference=EcuSwComposition.ECM3_0x371, ecu-extract-reference=COMPOSITIONTYPE.ECM3_0x371
      ESP2_0x145: upstream-reference=EcuSwComposition.ESP2_0x145, ecu-extract-reference=COMPOSITIONTYPE.ESP2_0x145
      ESP_FD2_0x137: upstream-reference=EcuSwComposition.ESP_FD2_0x137, ecu-extract-reference=COMPOSITIONTYPE.ESP_FD2_0x137
      HCU_PT5_0x330: upstream-reference=EcuSwComposition.HCU_PT5_0x330, ecu-extract-reference=COMPOSITIONTYPE.HCU_PT5_0x330
      Tgtgear_Down: upstream-reference=EcuSwComposition.Tgtgear_Down, ecu-extract-reference=COMPOSITIONTYPE.Tgtgear_Down
      Tgtgear_Up: upstream-reference=EcuSwComposition.Tgtgear_Up, ecu-extract-reference=COMPOSITIONTYPE.Tgtgear_Up
      TgtEngSpdIP: upstream-reference=EcuSwComposition.TgtEngSpdIP, ecu-extract-reference=COMPOSITIONTYPE.TgtEngSpdIP
      TgtEngSpdIPValid: upstream-reference=EcuSwComposition.TgtEngSpdIPValid, ecu-extract-reference=COMPOSITIONTYPE.TgtEngSpdIPValid
      EngSpd_ForIP: upstream-reference=EcuSwComposition.EngSpd_ForIP, ecu-extract-reference=COMPOSITIONTYPE.EngSpd_ForIP
      EngSpdVldty: upstream-reference=EcuSwComposition.EngSpdVldty, ecu-extract-reference=COMPOSITIONTYPE.EngSpdVldty
      EngSpd: upstream-reference=EcuSwComposition.EngSpd, ecu-extract-reference=COMPOSITIONTYPE.EngSpd
      ECM_VehDstBackup: upstream-reference=EcuSwComposition.ECM_VehDstBackup, ecu-extract-reference=COMPOSITIONTYPE.ECM_VehDstBackup
      ECM_VIN: upstream-reference=EcuSwComposition.ECM_VIN, ecu-extract-reference=COMPOSITIONTYPE.ECM_VIN
      SG_ESP1_ESP_FD2: upstream-reference=EcuSwComposition.SG_ESP1_ESP_FD2, ecu-extract-reference=COMPOSITIONTYPE.SG_ESP1_ESP_FD2
      Power: upstream-reference=EcuSwComposition.Manager_Swc.Power, ecu-extract-reference=COMPOSITIONTYPE.Power
      Common_Normal: upstream-reference=EcuSwComposition.Cluster_App.Common_Normal, ecu-extract-reference=COMPOSITIONTYPE.Common_Normal
      Common_GateWay: upstream-reference=EcuSwComposition.Cluster_App.Common_GateWay, ecu-extract-reference=COMPOSITIONTYPE.Common_GateWay
      Common_NormalNvMNotifyJobFinished_NvBlockNeed_Block_MaintainOdoNvM_NvM_RpNotifyJobEnd_Common_NormalNvBlockNeed_Block_Maintai: upstream-reference=COMPOSITIONTYPE.Common_Normal.NvBlockNeed_Block_MaintainOdo, ecu-extract-reference=Common_NormalNvMNotifyJobFinished_NvBlockNeed_Block_MaintainOdoNvM_NvM_RpNotifyJobEnd_Common_NormalNvBlockNeed_Block_Maintai
      Common_NormalNvMService_AC3_SRBS_Defs_NvBlockNeed_Block_MaintainOdoNvM_PS_Common_NormalNvBlockNeed_Block_MaintainOdo: upstream-reference=COMPOSITIONTYPE.Common_Normal.NvBlockNeed_Block_MaintainOdo, ecu-extract-reference=Common_NormalNvMService_AC3_SRBS_Defs_NvBlockNeed_Block_MaintainOdoNvM_PS_Common_NormalNvBlockNeed_Block_MaintainOdo
      Common_NormalNvBlockNeed_Block_MaintainOdo: upstream-reference=COMPOSITIONTYPE.Common_Normal.NvBlockNeed_Block_MaintainOdo
      Common_NormalNvMNotifyJobFinished_NvBlockNeed_Block_ODO_1NvM_NvM_RpNotifyJobEnd_Common_NormalNvBlockNeed_Block_ODO_1: upstream-reference=COMPOSITIONTYPE.Common_Normal.NvBlockNeed_Block_ODO_1, ecu-extract-reference=Common_NormalNvMNotifyJobFinished_NvBlockNeed_Block_ODO_1NvM_NvM_RpNotifyJobEnd_Common_NormalNvBlockNeed_Block_ODO_1
      Common_NormalNvMService_AC3_SRBS_Defs_NvBlockNeed_Block_ODO_1NvM_PS_Common_NormalNvBlockNeed_Block_ODO_1: upstream-reference=COMPOSITIONTYPE.Common_Normal.NvBlockNeed_Block_ODO_1, ecu-extract-reference=Common_NormalNvMService_AC3_SRBS_Defs_NvBlockNeed_Block_ODO_1NvM_PS_Common_NormalNvBlockNeed_Block_ODO_1
      Common_NormalNvBlockNeed_Block_ODO_1: upstream-reference=COMPOSITIONTYPE.Common_Normal.NvBlockNeed_Block_ODO_1
      Common_NormalNvMNotifyJobFinished_NvBlockNeed_Block_ODO_2NvM_NvM_RpNotifyJobEnd_Common_NormalNvBlockNeed_Block_ODO_2: upstream-reference=COMPOSITIONTYPE.Common_Normal.NvBlockNeed_Block_ODO_2, ecu-extract-reference=Common_NormalNvMNotifyJobFinished_NvBlockNeed_Block_ODO_2NvM_NvM_RpNotifyJobEnd_Common_NormalNvBlockNeed_Block_ODO_2
      Common_NormalNvMService_AC3_SRBS_Defs_NvBlockNeed_Block_ODO_2NvM_PS_Common_NormalNvBlockNeed_Block_ODO_2: upstream-reference=COMPOSITIONTYPE.Common_Normal.NvBlockNeed_Block_ODO_2, ecu-extract-reference=Common_NormalNvMService_AC3_SRBS_Defs_NvBlockNeed_Block_ODO_2NvM_PS_Common_NormalNvBlockNeed_Block_ODO_2
      Common_NormalNvBlockNeed_Block_ODO_2: upstream-reference=COMPOSITIONTYPE.Common_Normal.NvBlockNeed_Block_ODO_2
      Common_NormalNvMNotifyJobFinished_NvBlockNeed_Block_ODO_3NvM_NvM_RpNotifyJobEnd_Common_NormalNvBlockNeed_Block_ODO_3: upstream-reference=COMPOSITIONTYPE.Common_Normal.NvBlockNeed_Block_ODO_3, ecu-extract-reference=Common_NormalNvMNotifyJobFinished_NvBlockNeed_Block_ODO_3NvM_NvM_RpNotifyJobEnd_Common_NormalNvBlockNeed_Block_ODO_3
      Common_NormalNvMService_AC3_SRBS_Defs_NvBlockNeed_Block_ODO_3NvM_PS_Common_NormalNvBlockNeed_Block_ODO_3: upstream-reference=COMPOSITIONTYPE.Common_Normal.NvBlockNeed_Block_ODO_3, ecu-extract-reference=Common_NormalNvMService_AC3_SRBS_Defs_NvBlockNeed_Block_ODO_3NvM_PS_Common_NormalNvBlockNeed_Block_ODO_3
      Common_NormalNvBlockNeed_Block_ODO_3: upstream-reference=COMPOSITIONTYPE.Common_Normal.NvBlockNeed_Block_ODO_3
      Common_NormalNvMNotifyJobFinished_NvBlockNeed_Block_ODO_4NvM_NvM_RpNotifyJobEnd_Common_NormalNvBlockNeed_Block_ODO_4: upstream-reference=COMPOSITIONTYPE.Common_Normal.NvBlockNeed_Block_ODO_4, ecu-extract-reference=Common_NormalNvMNotifyJobFinished_NvBlockNeed_Block_ODO_4NvM_NvM_RpNotifyJobEnd_Common_NormalNvBlockNeed_Block_ODO_4
      Common_NormalNvMService_AC3_SRBS_Defs_NvBlockNeed_Block_ODO_4NvM_PS_Common_NormalNvBlockNeed_Block_ODO_4: upstream-reference=COMPOSITIONTYPE.Common_Normal.NvBlockNeed_Block_ODO_4, ecu-extract-reference=Common_NormalNvMService_AC3_SRBS_Defs_NvBlockNeed_Block_ODO_4NvM_PS_Common_NormalNvBlockNeed_Block_ODO_4
      Common_NormalNvBlockNeed_Block_ODO_4: upstream-reference=COMPOSITIONTYPE.Common_Normal.NvBlockNeed_Block_ODO_4
      Common_NormalNvMNotifyJobFinished_NvBlockNeed_Block_ODO_5NvM_NvM_RpNotifyJobEnd_Common_NormalNvBlockNeed_Block_ODO_5: upstream-reference=COMPOSITIONTYPE.Common_Normal.NvBlockNeed_Block_ODO_5, ecu-extract-reference=Common_NormalNvMNotifyJobFinished_NvBlockNeed_Block_ODO_5NvM_NvM_RpNotifyJobEnd_Common_NormalNvBlockNeed_Block_ODO_5
      Common_NormalNvMService_AC3_SRBS_Defs_NvBlockNeed_Block_ODO_5NvM_PS_Common_NormalNvBlockNeed_Block_ODO_5: upstream-reference=COMPOSITIONTYPE.Common_Normal.NvBlockNeed_Block_ODO_5, ecu-extract-reference=Common_NormalNvMService_AC3_SRBS_Defs_NvBlockNeed_Block_ODO_5NvM_PS_Common_NormalNvBlockNeed_Block_ODO_5
      Common_NormalNvBlockNeed_Block_ODO_5: upstream-reference=COMPOSITIONTYPE.Common_Normal.NvBlockNeed_Block_ODO_5
      Common_NormalNvMNotifyJobFinished_NvBlockNeed_Block_TripNvM_NvM_RpNotifyJobEnd_Common_NormalNvBlockNeed_Block_Trip: upstream-reference=COMPOSITIONTYPE.Common_Normal.NvBlockNeed_Block_Trip, ecu-extract-reference=Common_NormalNvMNotifyJobFinished_NvBlockNeed_Block_TripNvM_NvM_RpNotifyJobEnd_Common_NormalNvBlockNeed_Block_Trip
      Common_NormalNvMService_AC3_SRBS_Defs_NvBlockNeed_Block_TripNvM_PS_Common_NormalNvBlockNeed_Block_Trip: upstream-reference=COMPOSITIONTYPE.Common_Normal.NvBlockNeed_Block_Trip, ecu-extract-reference=Common_NormalNvMService_AC3_SRBS_Defs_NvBlockNeed_Block_TripNvM_PS_Common_NormalNvBlockNeed_Block_Trip
      Common_NormalNvBlockNeed_Block_Trip: upstream-reference=COMPOSITIONTYPE.Common_Normal.NvBlockNeed_Block_Trip
      SG_ABS3_ESP_FD2: upstream-reference=EcuSwComposition.SG_ABS3_ESP_FD2, ecu-extract-reference=COMPOSITIONTYPE.SG_ABS3_ESP_FD2
      Common_Safety: upstream-reference=EcuSwComposition.Cluster_App.Common_Safety, ecu-extract-reference=COMPOSITIONTYPE.Common_Safety
      SG_EPB1: upstream-reference=EcuSwComposition.SG_EPB1, ecu-extract-reference=COMPOSITIONTYPE.SG_EPB1
      SG_ESP2: upstream-reference=EcuSwComposition.SG_ESP2, ecu-extract-reference=COMPOSITIONTYPE.SG_ESP2
      SG_ESP2_ESP_FD2: upstream-reference=EcuSwComposition.SG_ESP2_ESP_FD2, ecu-extract-reference=COMPOSITIONTYPE.SG_ESP2_ESP_FD2
      SG_EPS1: upstream-reference=EcuSwComposition.SG_EPS1, ecu-extract-reference=COMPOSITIONTYPE.SG_EPS1
      SG_ABM1: upstream-reference=EcuSwComposition.SG_ABM1, ecu-extract-reference=COMPOSITIONTYPE.SG_ABM1
      SG_AEB2_AEB_FD2: upstream-reference=EcuSwComposition.SG_AEB2_AEB_FD2, ecu-extract-reference=COMPOSITIONTYPE.SG_AEB2_AEB_FD2
      SG_AEB3_AEB_FD2: upstream-reference=EcuSwComposition.SG_AEB3_AEB_FD2, ecu-extract-reference=COMPOSITIONTYPE.SG_AEB3_AEB_FD2
      MILSts: upstream-reference=EcuSwComposition.MILSts, ecu-extract-reference=COMPOSITIONTYPE.MILSts
      EngSVSSig: upstream-reference=EcuSwComposition.EngSVSSig, ecu-extract-reference=COMPOSITIONTYPE.EngSVSSig
      EngClntTempWarn: upstream-reference=EcuSwComposition.EngClntTempWarn, ecu-extract-reference=COMPOSITIONTYPE.EngClntTempWarn
      CruiseCtrlSts: upstream-reference=EcuSwComposition.CruiseCtrlSts, ecu-extract-reference=COMPOSITIONTYPE.CruiseCtrlSts
      CruiseCtrlSts_PHEV: upstream-reference=EcuSwComposition.CruiseCtrlSts_PHEV, ecu-extract-reference=COMPOSITIONTYPE.CruiseCtrlSts_PHEV
      SG_ACC4_ACC_FD2: upstream-reference=EcuSwComposition.SG_ACC4_ACC_FD2, ecu-extract-reference=COMPOSITIONTYPE.SG_ACC4_ACC_FD2
      SS_Enable_Lamp: upstream-reference=EcuSwComposition.SS_Enable_Lamp, ecu-extract-reference=COMPOSITIONTYPE.SS_Enable_Lamp
      SS_Fault_Lamp: upstream-reference=EcuSwComposition.SS_Fault_Lamp, ecu-extract-reference=COMPOSITIONTYPE.SS_Fault_Lamp
      TirePressSysFailrIndcn: upstream-reference=EcuSwComposition.TirePressSysFailrIndcn, ecu-extract-reference=COMPOSITIONTYPE.TirePressSysFailrIndcn
      FLTirePressIndSts: upstream-reference=EcuSwComposition.FLTirePressIndSts, ecu-extract-reference=COMPOSITIONTYPE.FLTirePressIndSts
      FRTirePressIndSts: upstream-reference=EcuSwComposition.FRTirePressIndSts, ecu-extract-reference=COMPOSITIONTYPE.FRTirePressIndSts
      RLTirePressIndSts: upstream-reference=EcuSwComposition.RLTirePressIndSts, ecu-extract-reference=COMPOSITIONTYPE.RLTirePressIndSts
      RRTirePressIndSts: upstream-reference=EcuSwComposition.RRTirePressIndSts, ecu-extract-reference=COMPOSITIONTYPE.RRTirePressIndSts
      FLTireTempSts: upstream-reference=EcuSwComposition.FLTireTempSts, ecu-extract-reference=COMPOSITIONTYPE.FLTireTempSts
      FRTireTempSts: upstream-reference=EcuSwComposition.FRTireTempSts, ecu-extract-reference=COMPOSITIONTYPE.FRTireTempSts
      RLTireTempSts: upstream-reference=EcuSwComposition.RLTireTempSts, ecu-extract-reference=COMPOSITIONTYPE.RLTireTempSts
      RRTireTempSts: upstream-reference=EcuSwComposition.RRTireTempSts, ecu-extract-reference=COMPOSITIONTYPE.RRTireTempSts
      SG_EPS1_FD1: upstream-reference=EcuSwComposition.SG_EPS1_FD1, ecu-extract-reference=COMPOSITIONTYPE.SG_EPS1_FD1
      SG_IFC4_IFC_FD2: upstream-reference=EcuSwComposition.SG_IFC4_IFC_FD2, ecu-extract-reference=COMPOSITIONTYPE.SG_IFC4_IFC_FD2
      ESP_HMI_WarningOn: upstream-reference=EcuSwComposition.ESP_HMI_WarningOn, ecu-extract-reference=COMPOSITIONTYPE.ESP_HMI_WarningOn
      IB_Warn: upstream-reference=EcuSwComposition.IB_Warn, ecu-extract-reference=COMPOSITIONTYPE.IB_Warn
      FFogLmpSts_F_Pbox: upstream-reference=EcuSwComposition.FFogLmpSts_F_Pbox, ecu-extract-reference=COMPOSITIONTYPE.FFogLmpSts_F_Pbox
      RFogLmpFailSts_R_Pbox: upstream-reference=EcuSwComposition.RFogLmpFailSts_R_Pbox, ecu-extract-reference=COMPOSITIONTYPE.RFogLmpFailSts_R_Pbox
      SG_HC1: upstream-reference=EcuSwComposition.SG_HC1, ecu-extract-reference=COMPOSITIONTYPE.SG_HC1
      LTurnLmpFailSts: upstream-reference=EcuSwComposition.LTurnLmpFailSts, ecu-extract-reference=COMPOSITIONTYPE.LTurnLmpFailSts
      LTurnLmpSts_R_Pbox: upstream-reference=EcuSwComposition.LTurnLmpSts_R_Pbox, ecu-extract-reference=COMPOSITIONTYPE.LTurnLmpSts_R_Pbox
      RTurnLmpSts_R_Pbox: upstream-reference=EcuSwComposition.RTurnLmpSts_R_Pbox, ecu-extract-reference=COMPOSITIONTYPE.RTurnLmpSts_R_Pbox
      PosnLmpOutpSts_R_Pbox: upstream-reference=EcuSwComposition.PosnLmpOutpSts_R_Pbox, ecu-extract-reference=COMPOSITIONTYPE.PosnLmpOutpSts_R_Pbox
      TrailerSts: upstream-reference=EcuSwComposition.TrailerSts, ecu-extract-reference=COMPOSITIONTYPE.TrailerSts
      SG_DCT7: upstream-reference=EcuSwComposition.SG_DCT7, ecu-extract-reference=COMPOSITIONTYPE.SG_DCT7
      HiLowBeamSts: upstream-reference=EcuSwComposition.HiLowBeamSts, ecu-extract-reference=COMPOSITIONTYPE.HiLowBeamSts
      HCU_EVLmpSts: upstream-reference=EcuSwComposition.HCU_EVLmpSts, ecu-extract-reference=COMPOSITIONTYPE.HCU_EVLmpSts
      HCU_ChrgSysLmpSts: upstream-reference=EcuSwComposition.HCU_ChrgSysLmpSts, ecu-extract-reference=COMPOSITIONTYPE.HCU_ChrgSysLmpSts
      ParkLmpSts_R_Pbox: upstream-reference=EcuSwComposition.ParkLmpSts_R_Pbox, ecu-extract-reference=COMPOSITIONTYPE.ParkLmpSts_R_Pbox
      TgtRcprtnTrqSts: upstream-reference=EcuSwComposition.TgtRcprtnTrqSts, ecu-extract-reference=COMPOSITIONTYPE.TgtRcprtnTrqSts
      CCO_Active: upstream-reference=EcuSwComposition.CCO_Active, ecu-extract-reference=COMPOSITIONTYPE.CCO_Active
      RSDS_CTA_Actv: upstream-reference=EcuSwComposition.RSDS_CTA_Actv, ecu-extract-reference=COMPOSITIONTYPE.RSDS_CTA_Actv
      RSDS_ErrSts: upstream-reference=EcuSwComposition.RSDS_ErrSts, ecu-extract-reference=COMPOSITIONTYPE.RSDS_ErrSts
      RemoteModSts: upstream-reference=EcuSwComposition.RemoteModSts, ecu-extract-reference=COMPOSITIONTYPE.RemoteModSts
      KL30BRelaySts: upstream-reference=EcuSwComposition.KL30BRelaySts, ecu-extract-reference=COMPOSITIONTYPE.KL30BRelaySts
      BMS_SOCLowWarn: upstream-reference=EcuSwComposition.BMS_SOCLowWarn, ecu-extract-reference=COMPOSITIONTYPE.BMS_SOCLowWarn
      TSRSts: upstream-reference=EcuSwComposition.TSRSts, ecu-extract-reference=COMPOSITIONTYPE.TSRSts
      TSRSpdLimSts: upstream-reference=EcuSwComposition.TSRSpdLimSts, ecu-extract-reference=COMPOSITIONTYPE.TSRSpdLimSts
      TSRSpdLim: upstream-reference=EcuSwComposition.TSRSpdLim, ecu-extract-reference=COMPOSITIONTYPE.TSRSpdLim
      TSRSpdLimWarn: upstream-reference=EcuSwComposition.TSRSpdLimWarn, ecu-extract-reference=COMPOSITIONTYPE.TSRSpdLimWarn
      TSRTrfcSignVal: upstream-reference=EcuSwComposition.TSRTrfcSignVal, ecu-extract-reference=COMPOSITIONTYPE.TSRTrfcSignVal
      Can_Server: upstream-reference=EcuSwComposition.Manager_Swc.Can_Server, ecu-extract-reference=COMPOSITIONTYPE.Can_Server
      AC2_0x385: upstream-reference=EcuSwComposition.AC2_0x385, ecu-extract-reference=COMPOSITIONTYPE.AC2_0x385
      HUT1_0x367: upstream-reference=EcuSwComposition.HUT1_0x367, ecu-extract-reference=COMPOSITIONTYPE.HUT1_0x367
      AC1_0x29D: upstream-reference=EcuSwComposition.AC1_0x29D, ecu-extract-reference=COMPOSITIONTYPE.AC1_0x29D
      DidDataProcess: upstream-reference=EcuSwComposition.Manager_Swc.DidDataProcess, ecu-extract-reference=COMPOSITIONTYPE.DidDataProcess
      DidDataProcessNvMNotifyJobFinished_NvBlockNeed_FactoryModeNvM_NvM_RpNotifyJobEnd_DidDataProcessNvBlockNeed_FactoryMode: upstream-reference=COMPOSITIONTYPE.DidDataProcess.NvBlockNeed_FactoryMode, ecu-extract-reference=DidDataProcessNvMNotifyJobFinished_NvBlockNeed_FactoryModeNvM_NvM_RpNotifyJobEnd_DidDataProcessNvBlockNeed_FactoryMode
      DidDataProcessNvMService_AC2_SRBS_NvBlockNeed_FactoryModeNvM_PS_DidDataProcessNvBlockNeed_FactoryMode: upstream-reference=COMPOSITIONTYPE.DidDataProcess.NvBlockNeed_FactoryMode, ecu-extract-reference=DidDataProcessNvMService_AC2_SRBS_NvBlockNeed_FactoryModeNvM_PS_DidDataProcessNvBlockNeed_FactoryMode
      DidDataProcessNvBlockNeed_FactoryMode: upstream-reference=COMPOSITIONTYPE.DidDataProcess.NvBlockNeed_FactoryMode
      DidDataProcessNvMNotifyJobFinished_NvBlockNeed_VIN_NvM_NvM_RpNotifyJobEnd_DidDataProcessNvBlockNeed_VIN: upstream-reference=COMPOSITIONTYPE.DidDataProcess.NvBlockNeed_VIN, ecu-extract-reference=DidDataProcessNvMNotifyJobFinished_NvBlockNeed_VIN_NvM_NvM_RpNotifyJobEnd_DidDataProcessNvBlockNeed_VIN
      DidDataProcessNvMService_AC2_SRBS_NvBlockNeed_VIN_NvM_PS_DidDataProcessNvBlockNeed_VIN: upstream-reference=COMPOSITIONTYPE.DidDataProcess.NvBlockNeed_VIN, ecu-extract-reference=DidDataProcessNvMService_AC2_SRBS_NvBlockNeed_VIN_NvM_PS_DidDataProcessNvBlockNeed_VIN
      DidDataProcessNvBlockNeed_VIN: upstream-reference=COMPOSITIONTYPE.DidDataProcess.NvBlockNeed_VIN
      DidDataProcessNvMNotifyJobFinished_NvBlockNeed_VehicleModeNvM_NvM_RpNotifyJobEnd_DidDataProcessNvBlockNeed_VehicleMode: upstream-reference=COMPOSITIONTYPE.DidDataProcess.NvBlockNeed_VehicleMode, ecu-extract-reference=DidDataProcessNvMNotifyJobFinished_NvBlockNeed_VehicleModeNvM_NvM_RpNotifyJobEnd_DidDataProcessNvBlockNeed_VehicleMode
      DidDataProcessNvMService_AC2_SRBS_NvBlockNeed_VehicleModeNvM_PS_DidDataProcessNvBlockNeed_VehicleMode: upstream-reference=COMPOSITIONTYPE.DidDataProcess.NvBlockNeed_VehicleMode, ecu-extract-reference=DidDataProcessNvMService_AC2_SRBS_NvBlockNeed_VehicleModeNvM_PS_DidDataProcessNvBlockNeed_VehicleMode
      DidDataProcessNvBlockNeed_VehicleMode: upstream-reference=COMPOSITIONTYPE.DidDataProcess.NvBlockNeed_VehicleMode
      ACC_FD2_0x2AB: upstream-reference=EcuSwComposition.ACC_FD2_0x2AB, ecu-extract-reference=COMPOSITIONTYPE.ACC_FD2_0x2AB
      AEB_FD2_0x227: upstream-reference=EcuSwComposition.AEB_FD2_0x227, ecu-extract-reference=COMPOSITIONTYPE.AEB_FD2_0x227
      BCM1_0x319: upstream-reference=EcuSwComposition.BCM1_0x319, ecu-extract-reference=COMPOSITIONTYPE.BCM1_0x319
      BCM3_0x345: upstream-reference=EcuSwComposition.BCM3_0x345, ecu-extract-reference=COMPOSITIONTYPE.BCM3_0x345
      BCM8_0x29F: upstream-reference=EcuSwComposition.BCM8_0x29F, ecu-extract-reference=COMPOSITIONTYPE.BCM8_0x29F
      BMS4_0xF1: upstream-reference=EcuSwComposition.BMS4_0xF1, ecu-extract-reference=COMPOSITIONTYPE.BMS4_0xF1
      BMS30_0x3F1: upstream-reference=EcuSwComposition.BMS30_0x3F1, ecu-extract-reference=COMPOSITIONTYPE.BMS30_0x3F1
      BMS35_0x2C4: upstream-reference=EcuSwComposition.BMS35_0x2C4, ecu-extract-reference=COMPOSITIONTYPE.BMS35_0x2C4
      CP1_0x35E: upstream-reference=EcuSwComposition.CP1_0x35E, ecu-extract-reference=COMPOSITIONTYPE.CP1_0x35E
      CSA1_0x165: upstream-reference=EcuSwComposition.CSA1_0x165, ecu-extract-reference=COMPOSITIONTYPE.CSA1_0x165
      CSA2_0xA1: upstream-reference=EcuSwComposition.CSA2_0xA1, ecu-extract-reference=COMPOSITIONTYPE.CSA2_0xA1
      CSA3_0x244: upstream-reference=EcuSwComposition.CSA3_0x244, ecu-extract-reference=COMPOSITIONTYPE.CSA3_0x244
      DCT5_0x221: upstream-reference=EcuSwComposition.DCT5_0x221, ecu-extract-reference=COMPOSITIONTYPE.DCT5_0x221
      DCT7_0x235: upstream-reference=EcuSwComposition.DCT7_0x235, ecu-extract-reference=COMPOSITIONTYPE.DCT7_0x235
      DDCM1_0x2CA: upstream-reference=EcuSwComposition.DDCM1_0x2CA, ecu-extract-reference=COMPOSITIONTYPE.DDCM1_0x2CA
      DHT_FD1_0xC1: upstream-reference=EcuSwComposition.DHT_FD1_0xC1, ecu-extract-reference=COMPOSITIONTYPE.DHT_FD1_0xC1
      DMS_FD1_0x24D: upstream-reference=EcuSwComposition.DMS_FD1_0x24D, ecu-extract-reference=COMPOSITIONTYPE.DMS_FD1_0x24D
      ECM2_0x271: upstream-reference=EcuSwComposition.ECM2_0x271, ecu-extract-reference=COMPOSITIONTYPE.ECM2_0x271
      ECM_PT7_0x117: upstream-reference=EcuSwComposition.ECM_PT7_0x117, ecu-extract-reference=COMPOSITIONTYPE.ECM_PT7_0x117
      EEM1_0x2A8: upstream-reference=EcuSwComposition.EEM1_0x2A8, ecu-extract-reference=COMPOSITIONTYPE.EEM1_0x2A8
      ELD1_0x152: upstream-reference=EcuSwComposition.ELD1_0x152, ecu-extract-reference=COMPOSITIONTYPE.ELD1_0x152
      EPB1_0x16B: upstream-reference=EcuSwComposition.EPB1_0x16B, ecu-extract-reference=COMPOSITIONTYPE.EPB1_0x16B
      EPS1_0x168: upstream-reference=EcuSwComposition.EPS1_0x168, ecu-extract-reference=COMPOSITIONTYPE.EPS1_0x168
      EPS_FD1_0x147: upstream-reference=EcuSwComposition.EPS_FD1_0x147, ecu-extract-reference=COMPOSITIONTYPE.EPS_FD1_0x147
      ESCL2_0x303: upstream-reference=EcuSwComposition.ESCL2_0x303, ecu-extract-reference=COMPOSITIONTYPE.ESCL2_0x303
      ESP1_0x149: upstream-reference=EcuSwComposition.ESP1_0x149, ecu-extract-reference=COMPOSITIONTYPE.ESP1_0x149
      ESP8_0x170: upstream-reference=EcuSwComposition.ESP8_0x170, ecu-extract-reference=COMPOSITIONTYPE.ESP8_0x170
      ESP10_0xD8: upstream-reference=EcuSwComposition.ESP10_0xD8, ecu-extract-reference=COMPOSITIONTYPE.ESP10_0xD8
      ESP11_0xC8: upstream-reference=EcuSwComposition.ESP11_0xC8, ecu-extract-reference=COMPOSITIONTYPE.ESP11_0xC8
      F_PBox1_0x19B: upstream-reference=EcuSwComposition.F_PBox1_0x19B, ecu-extract-reference=COMPOSITIONTYPE.F_PBox1_0x19B
      FPAS1_0x26D: upstream-reference=EcuSwComposition.FPAS1_0x26D, ecu-extract-reference=COMPOSITIONTYPE.FPAS1_0x26D
      Haldex1_0x251: upstream-reference=EcuSwComposition.Haldex1_0x251, ecu-extract-reference=COMPOSITIONTYPE.Haldex1_0x251
      HAP_FD1_0x15B: upstream-reference=EcuSwComposition.HAP_FD1_0x15B, ecu-extract-reference=COMPOSITIONTYPE.HAP_FD1_0x15B
      HAP_FD2_0x274: upstream-reference=EcuSwComposition.HAP_FD2_0x274, ecu-extract-reference=COMPOSITIONTYPE.HAP_FD2_0x274
      HAP_FD3_0x298: upstream-reference=EcuSwComposition.HAP_FD3_0x298, ecu-extract-reference=COMPOSITIONTYPE.HAP_FD3_0x298
      HC1_0x287: upstream-reference=EcuSwComposition.HC1_0x287, ecu-extract-reference=COMPOSITIONTYPE.HC1_0x287
      HCU_HC6_0x314: upstream-reference=EcuSwComposition.HCU_HC6_0x314, ecu-extract-reference=COMPOSITIONTYPE.HCU_HC6_0x314
      HCU_HC7_0x3C2: upstream-reference=EcuSwComposition.HCU_HC7_0x3C2, ecu-extract-reference=COMPOSITIONTYPE.HCU_HC7_0x3C2
      HCU_PT4_0x2FA: upstream-reference=EcuSwComposition.HCU_PT4_0x2FA, ecu-extract-reference=COMPOSITIONTYPE.HCU_PT4_0x2FA
      HCU_PT7_0x248: upstream-reference=EcuSwComposition.HCU_PT7_0x248, ecu-extract-reference=COMPOSITIONTYPE.HCU_PT7_0x248
      HCU_PT8_0x1C0: upstream-reference=EcuSwComposition.HCU_PT8_0x1C0, ecu-extract-reference=COMPOSITIONTYPE.HCU_PT8_0x1C0
      HUD1_0x325: upstream-reference=EcuSwComposition.HUD1_0x325, ecu-extract-reference=COMPOSITIONTYPE.HUD1_0x325
      HUT2_0x369: upstream-reference=EcuSwComposition.HUT2_0x369, ecu-extract-reference=COMPOSITIONTYPE.HUT2_0x369
      HUT4_0x36D: upstream-reference=EcuSwComposition.HUT4_0x36D, ecu-extract-reference=COMPOSITIONTYPE.HUT4_0x36D
      HUT10_0x331: upstream-reference=EcuSwComposition.HUT10_0x331, ecu-extract-reference=COMPOSITIONTYPE.HUT10_0x331
      HUT17_0x33B: upstream-reference=EcuSwComposition.HUT17_0x33B, ecu-extract-reference=COMPOSITIONTYPE.HUT17_0x33B
      HUT25_0x339: upstream-reference=EcuSwComposition.HUT25_0x339, ecu-extract-reference=COMPOSITIONTYPE.HUT25_0x339
      HUT32_0x26F: upstream-reference=EcuSwComposition.HUT32_0x26F, ecu-extract-reference=COMPOSITIONTYPE.HUT32_0x26F
      HUT33_0x1ED: upstream-reference=EcuSwComposition.HUT33_0x1ED, ecu-extract-reference=COMPOSITIONTYPE.HUT33_0x1ED
      HUT_IP2_0x27F: upstream-reference=EcuSwComposition.HUT_IP2_0x27F, ecu-extract-reference=COMPOSITIONTYPE.HUT_IP2_0x27F
      Ibooster_FD2_0x120: upstream-reference=EcuSwComposition.Ibooster_FD2_0x120, ecu-extract-reference=COMPOSITIONTYPE.Ibooster_FD2_0x120
      IFC_FD3_0x2CF: upstream-reference=EcuSwComposition.IFC_FD3_0x2CF, ecu-extract-reference=COMPOSITIONTYPE.IFC_FD3_0x2CF
      OBC1_0x316: upstream-reference=EcuSwComposition.OBC1_0x316, ecu-extract-reference=COMPOSITIONTYPE.OBC1_0x316
      OBC2_0x317: upstream-reference=EcuSwComposition.OBC2_0x317, ecu-extract-reference=COMPOSITIONTYPE.OBC2_0x317
      PDCM1_0x2CD: upstream-reference=EcuSwComposition.PDCM1_0x2CD, ecu-extract-reference=COMPOSITIONTYPE.PDCM1_0x2CD
      PEPS2_0x295: upstream-reference=EcuSwComposition.PEPS2_0x295, ecu-extract-reference=COMPOSITIONTYPE.PEPS2_0x295
      PEPS4_0x302: upstream-reference=EcuSwComposition.PEPS4_0x302, ecu-extract-reference=COMPOSITIONTYPE.PEPS4_0x302
      R_PBox1_0x19C: upstream-reference=EcuSwComposition.R_PBox1_0x19C, ecu-extract-reference=COMPOSITIONTYPE.R_PBox1_0x19C
      RPAS1_0x26E: upstream-reference=EcuSwComposition.RPAS1_0x26E, ecu-extract-reference=COMPOSITIONTYPE.RPAS1_0x26E
      RSDS_FD1_0x16F: upstream-reference=EcuSwComposition.RSDS_FD1_0x16F, ecu-extract-reference=COMPOSITIONTYPE.RSDS_FD1_0x16F
      SCM1_0x2D1: upstream-reference=EcuSwComposition.SCM1_0x2D1, ecu-extract-reference=COMPOSITIONTYPE.SCM1_0x2D1
      T_Box_FD1_0x33: upstream-reference=EcuSwComposition.T_Box_FD1_0x33, ecu-extract-reference=COMPOSITIONTYPE.T_Box_FD1_0x33
      T_Box_FD3_0x3E9: upstream-reference=EcuSwComposition.T_Box_FD3_0x3E9, ecu-extract-reference=COMPOSITIONTYPE.T_Box_FD3_0x3E9
      TPMS1_0x341: upstream-reference=EcuSwComposition.TPMS1_0x341, ecu-extract-reference=COMPOSITIONTYPE.TPMS1_0x341
      TPMS2_0x395: upstream-reference=EcuSwComposition.TPMS2_0x395, ecu-extract-reference=COMPOSITIONTYPE.TPMS2_0x395
      Trailer1_0x273: upstream-reference=EcuSwComposition.Trailer1_0x273, ecu-extract-reference=COMPOSITIONTYPE.Trailer1_0x273
      VSG1_0x2E1: upstream-reference=EcuSwComposition.VSG1_0x2E1, ecu-extract-reference=COMPOSITIONTYPE.VSG1_0x2E1
      WPC1_0x2BA: upstream-reference=EcuSwComposition.WPC1_0x2BA, ecu-extract-reference=COMPOSITIONTYPE.WPC1_0x2BA
      TM: upstream-reference=EcuSwComposition.BSW_CDD.TM, ecu-extract-reference=COMPOSITIONTYPE.TM
      DidDataProcessNvMNotifyJobFinished_NvBlockNeed_ECUlevelNetworkConfigurationDataNvM_NvM_RpNotifyJobEnd_DidDataProcessNvBlockN: upstream-reference=COMPOSITIONTYPE.DidDataProcess.NvBlockNeed_ECUlevelNetworkConfigurationData, ecu-extract-reference=DidDataProcessNvMNotifyJobFinished_NvBlockNeed_ECUlevelNetworkConfigurationDataNvM_NvM_RpNotifyJobEnd_DidDataProcessNvBlockN
      DidDataProcessNvMService_AC2_SRBS_NvBlockNeed_ECUlevelNetworkConfigurationDataNvM_PS_DidDataProcessNvBlockNeed_ECUlevelNetwo: upstream-reference=COMPOSITIONTYPE.DidDataProcess.NvBlockNeed_ECUlevelNetworkConfigurationData, ecu-extract-reference=DidDataProcessNvMService_AC2_SRBS_NvBlockNeed_ECUlevelNetworkConfigurationDataNvM_PS_DidDataProcessNvBlockNeed_ECUlevelNetwo
      DidDataProcessNvBlockNeed_ECUlevelNetworkConfigurationData: upstream-reference=COMPOSITIONTYPE.DidDataProcess.NvBlockNeed_ECUlevelNetworkConfigurationData
      EOL_NvMNotifyJobFinished_0xF18C_NvM_NvM_RpNotifyJobEnd_EOL_NvBlockNeed_0xF18C: upstream-reference=COMPOSITIONTYPE.EOL.NvBlockNeed_0xF18C, ecu-extract-reference=EOL_NvMNotifyJobFinished_0xF18C_NvM_NvM_RpNotifyJobEnd_EOL_NvBlockNeed_0xF18C
      EOL_NvMService_AC2_SRBS_0xF18C_NvM_PS_EOL_NvBlockNeed_0xF18C: upstream-reference=COMPOSITIONTYPE.EOL.NvBlockNeed_0xF18C, ecu-extract-reference=EOL_NvMService_AC2_SRBS_0xF18C_NvM_PS_EOL_NvBlockNeed_0xF18C
      EOL_NvBlockNeed_0xF18C: upstream-reference=COMPOSITIONTYPE.EOL.NvBlockNeed_0xF18C
      EOL_NvMNotifyJobFinished_0xF193NvM_NvM_RpNotifyJobEnd_EOL_NvBlockNeed_0xF193: upstream-reference=COMPOSITIONTYPE.EOL.NvBlockNeed_0xF193, ecu-extract-reference=EOL_NvMNotifyJobFinished_0xF193NvM_NvM_RpNotifyJobEnd_EOL_NvBlockNeed_0xF193
      EOL_NvMService_AC2_SRBS_0xF193NvM_PS_EOL_NvBlockNeed_0xF193: upstream-reference=COMPOSITIONTYPE.EOL.NvBlockNeed_0xF193, ecu-extract-reference=EOL_NvMService_AC2_SRBS_0xF193NvM_PS_EOL_NvBlockNeed_0xF193
      EOL_NvBlockNeed_0xF193: upstream-reference=COMPOSITIONTYPE.EOL.NvBlockNeed_0xF193
      EOL_NvMNotifyJobFinished_0xF195NvM_NvM_RpNotifyJobEnd_EOL_NvBlockNeed_0xF195: upstream-reference=COMPOSITIONTYPE.EOL.NvBlockNeed_0xF195, ecu-extract-reference=EOL_NvMNotifyJobFinished_0xF195NvM_NvM_RpNotifyJobEnd_EOL_NvBlockNeed_0xF195
      EOL_NvMService_AC2_SRBS_0xF195NvM_PS_EOL_NvBlockNeed_0xF195: upstream-reference=COMPOSITIONTYPE.EOL.NvBlockNeed_0xF195, ecu-extract-reference=EOL_NvMService_AC2_SRBS_0xF195NvM_PS_EOL_NvBlockNeed_0xF195
      EOL_NvBlockNeed_0xF195: upstream-reference=COMPOSITIONTYPE.EOL.NvBlockNeed_0xF195
      EOL_NvMNotifyJobFinished_0xFD00NvM_NvM_RpNotifyJobEnd_EOL_NvBlockNeed_0xFD00: upstream-reference=COMPOSITIONTYPE.EOL.NvBlockNeed_0xFD00, ecu-extract-reference=EOL_NvMNotifyJobFinished_0xFD00NvM_NvM_RpNotifyJobEnd_EOL_NvBlockNeed_0xFD00
      EOL_NvMService_AC2_SRBS_0xFD00NvM_PS_EOL_NvBlockNeed_0xFD00: upstream-reference=COMPOSITIONTYPE.EOL.NvBlockNeed_0xFD00, ecu-extract-reference=EOL_NvMService_AC2_SRBS_0xFD00NvM_PS_EOL_NvBlockNeed_0xFD00
      EOL_NvBlockNeed_0xFD00: upstream-reference=COMPOSITIONTYPE.EOL.NvBlockNeed_0xFD00
      EOL_NvMNotifyJobFinished_0xFD19NvM_NvM_RpNotifyJobEnd_EOL_NvBlockNeed_0xFD19: upstream-reference=COMPOSITIONTYPE.EOL.NvBlockNeed_0xFD19, ecu-extract-reference=EOL_NvMNotifyJobFinished_0xFD19NvM_NvM_RpNotifyJobEnd_EOL_NvBlockNeed_0xFD19
      EOL_NvMService_AC2_SRBS_0xFD19NvM_PS_EOL_NvBlockNeed_0xFD19: upstream-reference=COMPOSITIONTYPE.EOL.NvBlockNeed_0xFD19, ecu-extract-reference=EOL_NvMService_AC2_SRBS_0xFD19NvM_PS_EOL_NvBlockNeed_0xFD19
      EOL_NvBlockNeed_0xFD19: upstream-reference=COMPOSITIONTYPE.EOL.NvBlockNeed_0xFD19
      EOL_NvMNotifyJobFinished_0xFE20NvM_NvM_RpNotifyJobEnd_EOL_NvBlockNeed_0xFE20: upstream-reference=COMPOSITIONTYPE.EOL.NvBlockNeed_0xFE20, ecu-extract-reference=EOL_NvMNotifyJobFinished_0xFE20NvM_NvM_RpNotifyJobEnd_EOL_NvBlockNeed_0xFE20
      EOL_NvMService_AC2_SRBS_0xFE20NvM_PS_EOL_NvBlockNeed_0xFE20: upstream-reference=COMPOSITIONTYPE.EOL.NvBlockNeed_0xFE20, ecu-extract-reference=EOL_NvMService_AC2_SRBS_0xFE20NvM_PS_EOL_NvBlockNeed_0xFE20
      EOL_NvBlockNeed_0xFE20: upstream-reference=COMPOSITIONTYPE.EOL.NvBlockNeed_0xFE20
      EOL_NvMNotifyJobFinished_0xFE21NvM_NvM_RpNotifyJobEnd_EOL_NvBlockNeed_0xFE21: upstream-reference=COMPOSITIONTYPE.EOL.NvBlockNeed_0xFE21, ecu-extract-reference=EOL_NvMNotifyJobFinished_0xFE21NvM_NvM_RpNotifyJobEnd_EOL_NvBlockNeed_0xFE21
      EOL_NvMService_AC2_SRBS_0xFE21NvM_PS_EOL_NvBlockNeed_0xFE21: upstream-reference=COMPOSITIONTYPE.EOL.NvBlockNeed_0xFE21, ecu-extract-reference=EOL_NvMService_AC2_SRBS_0xFE21NvM_PS_EOL_NvBlockNeed_0xFE21
      EOL_NvBlockNeed_0xFE21: upstream-reference=COMPOSITIONTYPE.EOL.NvBlockNeed_0xFE21
      EOL_NvMNotifyJobFinished_0xFE22NvM_NvM_RpNotifyJobEnd_EOL_NvBlockNeed_0xFE22: upstream-reference=COMPOSITIONTYPE.EOL.NvBlockNeed_0xFE22, ecu-extract-reference=EOL_NvMNotifyJobFinished_0xFE22NvM_NvM_RpNotifyJobEnd_EOL_NvBlockNeed_0xFE22
      EOL_NvMService_AC2_SRBS_0xFE22NvM_PS_EOL_NvBlockNeed_0xFE22: upstream-reference=COMPOSITIONTYPE.EOL.NvBlockNeed_0xFE22, ecu-extract-reference=EOL_NvMService_AC2_SRBS_0xFE22NvM_PS_EOL_NvBlockNeed_0xFE22
      EOL_NvBlockNeed_0xFE22: upstream-reference=COMPOSITIONTYPE.EOL.NvBlockNeed_0xFE22
      EOL_NvMNotifyJobFinished_0xFE23NvM_NvM_RpNotifyJobEnd_EOL_NvBlockNeed_0xFE23: upstream-reference=COMPOSITIONTYPE.EOL.NvBlockNeed_0xFE23, ecu-extract-reference=EOL_NvMNotifyJobFinished_0xFE23NvM_NvM_RpNotifyJobEnd_EOL_NvBlockNeed_0xFE23
      EOL_NvMService_AC2_SRBS_0xFE23NvM_PS_EOL_NvBlockNeed_0xFE23: upstream-reference=COMPOSITIONTYPE.EOL.NvBlockNeed_0xFE23, ecu-extract-reference=EOL_NvMService_AC2_SRBS_0xFE23NvM_PS_EOL_NvBlockNeed_0xFE23
      EOL_NvBlockNeed_0xFE23: upstream-reference=COMPOSITIONTYPE.EOL.NvBlockNeed_0xFE23
      EOL_NvMNotifyJobFinished_0xFE24NvM_NvM_RpNotifyJobEnd_EOL_NvBlockNeed_0xFE24: upstream-reference=COMPOSITIONTYPE.EOL.NvBlockNeed_0xFE24, ecu-extract-reference=EOL_NvMNotifyJobFinished_0xFE24NvM_NvM_RpNotifyJobEnd_EOL_NvBlockNeed_0xFE24
      EOL_NvMService_AC2_SRBS_0xFE24NvM_PS_EOL_NvBlockNeed_0xFE24: upstream-reference=COMPOSITIONTYPE.EOL.NvBlockNeed_0xFE24, ecu-extract-reference=EOL_NvMService_AC2_SRBS_0xFE24NvM_PS_EOL_NvBlockNeed_0xFE24
      EOL_NvBlockNeed_0xFE24: upstream-reference=COMPOSITIONTYPE.EOL.NvBlockNeed_0xFE24
      EOL_NvMNotifyJobFinished_0xFE25NvM_NvM_RpNotifyJobEnd_EOL_NvBlockNeed_0xFE25: upstream-reference=COMPOSITIONTYPE.EOL.NvBlockNeed_0xFE25, ecu-extract-reference=EOL_NvMNotifyJobFinished_0xFE25NvM_NvM_RpNotifyJobEnd_EOL_NvBlockNeed_0xFE25
      EOL_NvMService_AC2_SRBS_0xFE25NvM_PS_EOL_NvBlockNeed_0xFE25: upstream-reference=COMPOSITIONTYPE.EOL.NvBlockNeed_0xFE25, ecu-extract-reference=EOL_NvMService_AC2_SRBS_0xFE25NvM_PS_EOL_NvBlockNeed_0xFE25
      EOL_NvBlockNeed_0xFE25: upstream-reference=COMPOSITIONTYPE.EOL.NvBlockNeed_0xFE25
      SocDtcProcess: upstream-reference=EcuSwComposition.Manager_Swc.SocDtcProcess, ecu-extract-reference=COMPOSITIONTYPE.SocDtcProcess
      SG_IFC5_IFC_FD2: upstream-reference=EcuSwComposition.SG_IFC5_IFC_FD2, ecu-extract-reference=COMPOSITIONTYPE.SG_IFC5_IFC_FD2
      RSDS_IPSoundReq: upstream-reference=EcuSwComposition.RSDS_IPSoundReq, ecu-extract-reference=COMPOSITIONTYPE.RSDS_IPSoundReq
      TSRSpdLimCfdc: upstream-reference=EcuSwComposition.TSRSpdLimCfdc, ecu-extract-reference=COMPOSITIONTYPE.TSRSpdLimCfdc
      PASWorkCmd: upstream-reference=EcuSwComposition.PASWorkCmd, ecu-extract-reference=COMPOSITIONTYPE.PASWorkCmd
      RPAS_WorkSts: upstream-reference=EcuSwComposition.RPAS_WorkSts, ecu-extract-reference=COMPOSITIONTYPE.RPAS_WorkSts
      RPAS_SoundIndcn: upstream-reference=EcuSwComposition.RPAS_SoundIndcn, ecu-extract-reference=COMPOSITIONTYPE.RPAS_SoundIndcn
      APS_FLSideSnsrFailSts: upstream-reference=EcuSwComposition.APS_FLSideSnsrFailSts, ecu-extract-reference=COMPOSITIONTYPE.APS_FLSideSnsrFailSts
      APS_FRSideSnsrFailSts: upstream-reference=EcuSwComposition.APS_FRSideSnsrFailSts, ecu-extract-reference=COMPOSITIONTYPE.APS_FRSideSnsrFailSts
      APS_RLSideSnsrFailSts: upstream-reference=EcuSwComposition.APS_RLSideSnsrFailSts, ecu-extract-reference=COMPOSITIONTYPE.APS_RLSideSnsrFailSts
      APS_RRSideSnsrFailSts: upstream-reference=EcuSwComposition.APS_RRSideSnsrFailSts, ecu-extract-reference=COMPOSITIONTYPE.APS_RRSideSnsrFailSts
      SDW_SoundIndcn: upstream-reference=EcuSwComposition.SDW_SoundIndcn, ecu-extract-reference=COMPOSITIONTYPE.SDW_SoundIndcn
      SDWActiveSts: upstream-reference=EcuSwComposition.SDWActiveSts, ecu-extract-reference=COMPOSITIONTYPE.SDWActiveSts
      APS_WorkSts: upstream-reference=EcuSwComposition.APS_WorkSts, ecu-extract-reference=COMPOSITIONTYPE.APS_WorkSts
      APS_SysSoundIndcn: upstream-reference=EcuSwComposition.APS_SysSoundIndcn, ecu-extract-reference=COMPOSITIONTYPE.APS_SysSoundIndcn
      RPAS_WorkSts_FD: upstream-reference=EcuSwComposition.RPAS_WorkSts_FD, ecu-extract-reference=COMPOSITIONTYPE.RPAS_WorkSts_FD
      RPAS_SoundIndcn_FD: upstream-reference=EcuSwComposition.RPAS_SoundIndcn_FD, ecu-extract-reference=COMPOSITIONTYPE.RPAS_SoundIndcn_FD
      FLTirePress: upstream-reference=EcuSwComposition.FLTirePress, ecu-extract-reference=COMPOSITIONTYPE.FLTirePress
      FRTirePress: upstream-reference=EcuSwComposition.FRTirePress, ecu-extract-reference=COMPOSITIONTYPE.FRTirePress
      FRTireTemp: upstream-reference=EcuSwComposition.FRTireTemp, ecu-extract-reference=COMPOSITIONTYPE.FRTireTemp
      FLTireTemp: upstream-reference=EcuSwComposition.FLTireTemp, ecu-extract-reference=COMPOSITIONTYPE.FLTireTemp
      RLTireTemp: upstream-reference=EcuSwComposition.RLTireTemp, ecu-extract-reference=COMPOSITIONTYPE.RLTireTemp
      RLTirePress: upstream-reference=EcuSwComposition.RLTirePress, ecu-extract-reference=COMPOSITIONTYPE.RLTirePress
      RRTirePress: upstream-reference=EcuSwComposition.RRTirePress, ecu-extract-reference=COMPOSITIONTYPE.RRTirePress
      RRTireTemp: upstream-reference=EcuSwComposition.RRTireTemp, ecu-extract-reference=COMPOSITIONTYPE.RRTireTemp
      IFC_FD2_0x23D: upstream-reference=EcuSwComposition.IFC_FD2_0x23D, ecu-extract-reference=COMPOSITIONTYPE.IFC_FD2_0x23D
      ABM1_0x351: upstream-reference=EcuSwComposition.ABM1_0x351, ecu-extract-reference=COMPOSITIONTYPE.ABM1_0x351
      BMS_IntelEngIdlChrgnSts: upstream-reference=EcuSwComposition.BMS_IntelEngIdlChrgnSts, ecu-extract-reference=COMPOSITIONTYPE.BMS_IntelEngIdlChrgnSts
      BMS_BattHeatRunaway: upstream-reference=EcuSwComposition.BMS_BattHeatRunaway, ecu-extract-reference=COMPOSITIONTYPE.BMS_BattHeatRunaway
      GentrWarnLmpSts: upstream-reference=EcuSwComposition.GentrWarnLmpSts, ecu-extract-reference=COMPOSITIONTYPE.GentrWarnLmpSts
      FPAS_SoundIndcn: upstream-reference=EcuSwComposition.FPAS_SoundIndcn, ecu-extract-reference=COMPOSITIONTYPE.FPAS_SoundIndcn
      FPAS_SoundIndcn_FD: upstream-reference=EcuSwComposition.FPAS_SoundIndcn_FD, ecu-extract-reference=COMPOSITIONTYPE.FPAS_SoundIndcn_FD
      FPAS_WorkSts: upstream-reference=EcuSwComposition.FPAS_WorkSts, ecu-extract-reference=COMPOSITIONTYPE.FPAS_WorkSts
      FPAS_WorkSts_FD: upstream-reference=EcuSwComposition.FPAS_WorkSts_FD, ecu-extract-reference=COMPOSITIONTYPE.FPAS_WorkSts_FD
      TGS_LEVER: upstream-reference=EcuSwComposition.TGS_LEVER, ecu-extract-reference=COMPOSITIONTYPE.TGS_LEVER
      DCT3_0xA6: upstream-reference=EcuSwComposition.DCT3_0xA6, ecu-extract-reference=COMPOSITIONTYPE.DCT3_0xA6
      HUT15_0x1EE: upstream-reference=EcuSwComposition.HUT15_0x1EE, ecu-extract-reference=COMPOSITIONTYPE.HUT15_0x1EE
      ECM11_0x2D3: upstream-reference=EcuSwComposition.ECM11_0x2D3, ecu-extract-reference=COMPOSITIONTYPE.ECM11_0x2D3
      HUT30_0x1E9: upstream-reference=EcuSwComposition.HUT30_0x1E9, ecu-extract-reference=COMPOSITIONTYPE.HUT30_0x1E9
      HUT_FD1_0x2C3: upstream-reference=EcuSwComposition.HUT_FD1_0x2C3, ecu-extract-reference=COMPOSITIONTYPE.HUT_FD1_0x2C3
      IFC_FD5_0x19F: upstream-reference=EcuSwComposition.IFC_FD5_0x19F, ecu-extract-reference=COMPOSITIONTYPE.IFC_FD5_0x19F
      IFC_FD6_0x222: upstream-reference=EcuSwComposition.IFC_FD6_0x222, ecu-extract-reference=COMPOSITIONTYPE.IFC_FD6_0x222
      CR_FD1_0x15E: upstream-reference=EcuSwComposition.CR_FD1_0x15E, ecu-extract-reference=COMPOSITIONTYPE.CR_FD1_0x15E
      AntitheftSts: upstream-reference=EcuSwComposition.AntitheftSts, ecu-extract-reference=COMPOSITIONTYPE.AntitheftSts
      EOL_NvMNotifyJobFinished_0xF187NvM_NvM_RpNotifyJobEnd_EOL_NvBlockNeed_0xF187: upstream-reference=COMPOSITIONTYPE.EOL.NvBlockNeed_0xF187, ecu-extract-reference=EOL_NvMNotifyJobFinished_0xF187NvM_NvM_RpNotifyJobEnd_EOL_NvBlockNeed_0xF187
      EOL_NvMService_AC2_SRBS_0xF187NvM_PS_EOL_NvBlockNeed_0xF187: upstream-reference=COMPOSITIONTYPE.EOL.NvBlockNeed_0xF187, ecu-extract-reference=EOL_NvMService_AC2_SRBS_0xF187NvM_PS_EOL_NvBlockNeed_0xF187
      EOL_NvBlockNeed_0xF187: upstream-reference=COMPOSITIONTYPE.EOL.NvBlockNeed_0xF187
      Common_GateWayNvBlockNeed_Block_IPC_Config_Data: upstream-reference=COMPOSITIONTYPE.Common_GateWay.NvBlockNeed_Block_IPC_Config_Data
      Common_GateWayNvBlockNeed_Block_IPC_CAN_Data: upstream-reference=COMPOSITIONTYPE.Common_GateWay.NvBlockNeed_Block_IPC_CAN_Data
      Common_GateWayNvMNotifyJobFinished_NvBlockNeed_Block_IPC_Config_DataNvM_NvM_RpNotifyJobEnd_Common_GateWayNvBlockNeed_Block_I: upstream-reference=COMPOSITIONTYPE.Common_GateWay.NvBlockNeed_Block_IPC_Config_Data, ecu-extract-reference=Common_GateWayNvMNotifyJobFinished_NvBlockNeed_Block_IPC_Config_DataNvM_NvM_RpNotifyJobEnd_Common_GateWayNvBlockNeed_Block_I
      Common_GateWayNvMService_AC3_Defs_NvBlockNeed_Block_IPC_Config_DataNvM_PS_Common_GateWayNvBlockNeed_Block_IPC_Config_Data: upstream-reference=COMPOSITIONTYPE.Common_GateWay.NvBlockNeed_Block_IPC_Config_Data, ecu-extract-reference=Common_GateWayNvMService_AC3_Defs_NvBlockNeed_Block_IPC_Config_DataNvM_PS_Common_GateWayNvBlockNeed_Block_IPC_Config_Data
      Common_GateWayNvMNotifyJobFinished_NvBlockNeed_Block_IPC_CAN_DataNvM_NvM_RpNotifyJobEnd_Common_GateWayNvBlockNeed_Block_IPC_: upstream-reference=COMPOSITIONTYPE.Common_GateWay.NvBlockNeed_Block_IPC_CAN_Data, ecu-extract-reference=Common_GateWayNvMNotifyJobFinished_NvBlockNeed_Block_IPC_CAN_DataNvM_NvM_RpNotifyJobEnd_Common_GateWayNvBlockNeed_Block_IPC_
      Common_GateWayNvMService_AC3_Defs_NvBlockNeed_Block_IPC_CAN_DataNvM_PS_Common_GateWayNvBlockNeed_Block_IPC_CAN_Data: upstream-reference=COMPOSITIONTYPE.Common_GateWay.NvBlockNeed_Block_IPC_CAN_Data, ecu-extract-reference=Common_GateWayNvMService_AC3_Defs_NvBlockNeed_Block_IPC_CAN_DataNvM_PS_Common_GateWayNvBlockNeed_Block_IPC_CAN_Data
      AMP2_0x3E3: upstream-reference=EcuSwComposition.AMP2_0x3E3, ecu-extract-reference=COMPOSITIONTYPE.AMP2_0x3E3
      AMP3_0x3E5: upstream-reference=EcuSwComposition.AMP3_0x3E5, ecu-extract-reference=COMPOSITIONTYPE.AMP3_0x3E5
      BCM12_0x238: upstream-reference=EcuSwComposition.BCM12_0x238, ecu-extract-reference=COMPOSITIONTYPE.BCM12_0x238
      DSM1_0x2C1: upstream-reference=EcuSwComposition.DSM1_0x2C1, ecu-extract-reference=COMPOSITIONTYPE.DSM1_0x2C1
      GW_FD1_0x2BB: upstream-reference=EcuSwComposition.GW_FD1_0x2BB, ecu-extract-reference=COMPOSITIONTYPE.GW_FD1_0x2BB
      RPAS2_0x2ED: upstream-reference=EcuSwComposition.RPAS2_0x2ED, ecu-extract-reference=COMPOSITIONTYPE.RPAS2_0x2ED
      RSDS_FD2_0x30A: upstream-reference=EcuSwComposition.RSDS_FD2_0x30A, ecu-extract-reference=COMPOSITIONTYPE.RSDS_FD2_0x30A
      TMCU_FD3_0x3C9: upstream-reference=EcuSwComposition.TMCU_FD3_0x3C9, ecu-extract-reference=COMPOSITIONTYPE.TMCU_FD3_0x3C9
      HUT13_0x31C: upstream-reference=EcuSwComposition.HUT13_0x31C, ecu-extract-reference=COMPOSITIONTYPE.HUT13_0x31C
      HUT19_0x415: upstream-reference=EcuSwComposition.HUT19_0x415, ecu-extract-reference=COMPOSITIONTYPE.HUT19_0x415
      HUT20_0x2DE: upstream-reference=EcuSwComposition.HUT20_0x2DE, ecu-extract-reference=COMPOSITIONTYPE.HUT20_0x2DE
      HUT21_0x2DD: upstream-reference=EcuSwComposition.HUT21_0x2DD, ecu-extract-reference=COMPOSITIONTYPE.HUT21_0x2DD
      HUT22_0x2DA: upstream-reference=EcuSwComposition.HUT22_0x2DA, ecu-extract-reference=COMPOSITIONTYPE.HUT22_0x2DA
      HUT23_0x2D8: upstream-reference=EcuSwComposition.HUT23_0x2D8, ecu-extract-reference=COMPOSITIONTYPE.HUT23_0x2D8
      HUT26_0x2B6: upstream-reference=EcuSwComposition.HUT26_0x2B6, ecu-extract-reference=COMPOSITIONTYPE.HUT26_0x2B6
      HUT39_0x1EB: upstream-reference=EcuSwComposition.HUT39_0x1EB, ecu-extract-reference=COMPOSITIONTYPE.HUT39_0x1EB
      HUT6_0x4A: upstream-reference=EcuSwComposition.HUT6_0x4A, ecu-extract-reference=COMPOSITIONTYPE.HUT6_0x4A
      TMCU_ActSpd_RM: upstream-reference=EcuSwComposition.TMCU_ActSpd_RM, ecu-extract-reference=COMPOSITIONTYPE.TMCU_ActSpd_RM
      MiscNvBlockNeed_ResetInfomation: upstream-reference=COMPOSITIONTYPE.Misc.NvBlockNeed_ResetInfomation
      MiscNvMService_AC3_Defs_NvBlockNeed_ResetInfomationNvM_PS_MiscNvBlockNeed_ResetInfomation: upstream-reference=COMPOSITIONTYPE.Misc.NvBlockNeed_ResetInfomation, ecu-extract-reference=MiscNvMService_AC3_Defs_NvBlockNeed_ResetInfomationNvM_PS_MiscNvBlockNeed_ResetInfomation
      FuelConsumption: upstream-reference=EcuSwComposition.FuelConsumption, ecu-extract-reference=COMPOSITIONTYPE.FuelConsumption
      FCTA_Warn: upstream-reference=EcuSwComposition.FCTA_Warn, ecu-extract-reference=COMPOSITIONTYPE.FCTA_Warn
      FCTBTrig: upstream-reference=EcuSwComposition.FCTBTrig, ecu-extract-reference=COMPOSITIONTYPE.FCTBTrig
      CR_BliSts: upstream-reference=EcuSwComposition.CR_BliSts, ecu-extract-reference=COMPOSITIONTYPE.CR_BliSts
      FCTA_B_FuncSts: upstream-reference=EcuSwComposition.FCTA_B_FuncSts, ecu-extract-reference=COMPOSITIONTYPE.FCTA_B_FuncSts
      SG_ACC8_ACC_FD2: upstream-reference=EcuSwComposition.SG_ACC8_ACC_FD2, ecu-extract-reference=COMPOSITIONTYPE.SG_ACC8_ACC_FD2
      SG_IFC3_IFC_FD2: upstream-reference=EcuSwComposition.SG_IFC3_IFC_FD2, ecu-extract-reference=COMPOSITIONTYPE.SG_IFC3_IFC_FD2
      DCM_ServerNvMService_AC2_SRBS_NvBlockNeedSecAttemptCountNvM_PS_DCM_ServerNvBlockNeedSecAttemptCount: upstream-reference=COMPOSITIONTYPE.DCM_Server.NvBlockNeedSecAttemptCount, ecu-extract-reference=DCM_ServerNvMService_AC2_SRBS_NvBlockNeedSecAttemptCountNvM_PS_DCM_ServerNvBlockNeedSecAttemptCount
      DCM_ServerNvBlockNeedSecAttemptCount: upstream-reference=COMPOSITIONTYPE.DCM_Server.NvBlockNeedSecAttemptCount
      SG_ACC3_ACC_FD2: upstream-reference=EcuSwComposition.SG_ACC3_ACC_FD2, ecu-extract-reference=COMPOSITIONTYPE.SG_ACC3_ACC_FD2
      DCM_ServerNvMService_AC2_SRBS_EOL_UnlockCntNvM_PS_DCM_ServerNvBlockNeed_EOLUnlockCnt: upstream-reference=COMPOSITIONTYPE.DCM_Server.NvBlockNeed_EOLUnlockCnt, ecu-extract-reference=DCM_ServerNvMService_AC2_SRBS_EOL_UnlockCntNvM_PS_DCM_ServerNvBlockNeed_EOLUnlockCnt
      DCM_ServerNvBlockNeed_EOLUnlockCnt: upstream-reference=COMPOSITIONTYPE.DCM_Server.NvBlockNeed_EOLUnlockCnt
      SG_HUT_IP2: upstream-reference=EcuSwComposition.SG_HUT_IP2, ecu-extract-reference=COMPOSITIONTYPE.SG_HUT_IP2
      EngCoolantTemp: upstream-reference=EcuSwComposition.EngCoolantTemp, ecu-extract-reference=COMPOSITIONTYPE.EngCoolantTemp
      EngClntTempVldty: upstream-reference=EcuSwComposition.EngClntTempVldty, ecu-extract-reference=COMPOSITIONTYPE.EngClntTempVldty
      DidDataProcessNvMNotifyJobFinished_NvBlockNeed_ClusterInternalConfigurationNvM_NvM_RpNotifyJobEnd_DidDataProcessNvBlockNeed_: upstream-reference=COMPOSITIONTYPE.DidDataProcess.NvBlockNeed_ClusterInternalConfiguration, ecu-extract-reference=DidDataProcessNvMNotifyJobFinished_NvBlockNeed_ClusterInternalConfigurationNvM_NvM_RpNotifyJobEnd_DidDataProcessNvBlockNeed_
      DidDataProcessNvMService_AC2_SRBS_NvBlockNeed_ClusterInternalConfigurationNvM_PS_DidDataProcessNvBlockNeed_ClusterInternalCo: upstream-reference=COMPOSITIONTYPE.DidDataProcess.NvBlockNeed_ClusterInternalConfiguration, ecu-extract-reference=DidDataProcessNvMService_AC2_SRBS_NvBlockNeed_ClusterInternalConfigurationNvM_PS_DidDataProcessNvBlockNeed_ClusterInternalCo
      DidDataProcessNvBlockNeed_ClusterInternalConfiguration: upstream-reference=COMPOSITIONTYPE.DidDataProcess.NvBlockNeed_ClusterInternalConfiguration
      IP_LagueSet: upstream-reference=EcuSwComposition.IP_LagueSet, ecu-extract-reference=COMPOSITIONTYPE.IP_LagueSet
      IP_VelSpdDisp_Mile: upstream-reference=EcuSwComposition.IP_VelSpdDisp_Mile, ecu-extract-reference=COMPOSITIONTYPE.IP_VelSpdDisp_Mile
      IP_VehSpdDisp: upstream-reference=EcuSwComposition.IP_VehSpdDisp, ecu-extract-reference=COMPOSITIONTYPE.IP_VehSpdDisp
      IP_FuelAuxTankR: upstream-reference=EcuSwComposition.IP_FuelAuxTankR, ecu-extract-reference=COMPOSITIONTYPE.IP_FuelAuxTankR
      IP_FuelMainTankR: upstream-reference=EcuSwComposition.IP_FuelMainTankR, ecu-extract-reference=COMPOSITIONTYPE.IP_FuelMainTankR
      IP_CurrTheme: upstream-reference=EcuSwComposition.IP_CurrTheme, ecu-extract-reference=COMPOSITIONTYPE.IP_CurrTheme
      IP_InstFuelCons: upstream-reference=EcuSwComposition.IP_InstFuelCons, ecu-extract-reference=COMPOSITIONTYPE.IP_InstFuelCons
      IP_AvgFuelCons: upstream-reference=EcuSwComposition.IP_AvgFuelCons, ecu-extract-reference=COMPOSITIONTYPE.IP_AvgFuelCons
      IP_InstFuelConsUnit: upstream-reference=EcuSwComposition.IP_InstFuelConsUnit, ecu-extract-reference=COMPOSITIONTYPE.IP_InstFuelConsUnit
      IP_RemainDistance: upstream-reference=EcuSwComposition.IP_RemainDistance, ecu-extract-reference=COMPOSITIONTYPE.IP_RemainDistance
      ACC_FD3_0x2B4: upstream-reference=EcuSwComposition.ACC_FD3_0x2B4, ecu-extract-reference=COMPOSITIONTYPE.ACC_FD3_0x2B4
      ABS1_0x231: upstream-reference=EcuSwComposition.ABS1_0x231, ecu-extract-reference=COMPOSITIONTYPE.ABS1_0x231
      ABS2_0x246: upstream-reference=EcuSwComposition.ABS2_0x246, ecu-extract-reference=COMPOSITIONTYPE.ABS2_0x246
      CConfig: upstream-reference=EcuSwComposition.Manager_Swc.CConfig, ecu-extract-reference=COMPOSITIONTYPE.CConfig
      BCM6_0x28C: upstream-reference=EcuSwComposition.BCM6_0x28C, ecu-extract-reference=COMPOSITIONTYPE.BCM6_0x28C
      PLG_1_0x2FE: upstream-reference=EcuSwComposition.PLG_1_0x2FE, ecu-extract-reference=COMPOSITIONTYPE.PLG_1_0x2FE
      HUT16_0x348: upstream-reference=EcuSwComposition.HUT16_0x348, ecu-extract-reference=COMPOSITIONTYPE.HUT16_0x348
      HUT3_0x36B: upstream-reference=EcuSwComposition.HUT3_0x36B, ecu-extract-reference=COMPOSITIONTYPE.HUT3_0x36B
      HUT34_0x370: upstream-reference=EcuSwComposition.HUT34_0x370, ecu-extract-reference=COMPOSITIONTYPE.HUT34_0x370
      AMP_NvBlockNeed_LC_Calibration: upstream-reference=COMPOSITIONTYPE.AMP.NvBlockNeed_LC_Calibration
      AMP_NvMNotifyJobFinished_NvBlockNeed_LC_CalibrationNvM_NvM_RpNotifyJobEnd_AMP_NvBlockNeed_LC_Calibration: upstream-reference=COMPOSITIONTYPE.AMP.NvBlockNeed_LC_Calibration, ecu-extract-reference=AMP_NvMNotifyJobFinished_NvBlockNeed_LC_CalibrationNvM_NvM_RpNotifyJobEnd_AMP_NvBlockNeed_LC_Calibration
      AMP_NvMService_AC2_SRBS_Defs_NvBlockNeed_LC_CalibrationNvM_PS_AMP_NvBlockNeed_LC_Calibration: upstream-reference=COMPOSITIONTYPE.AMP.NvBlockNeed_LC_Calibration, ecu-extract-reference=AMP_NvMService_AC2_SRBS_Defs_NvBlockNeed_LC_CalibrationNvM_PS_AMP_NvBlockNeed_LC_Calibration
      SG_ABS3: upstream-reference=EcuSwComposition.SG_ABS3, ecu-extract-reference=COMPOSITIONTYPE.SG_ABS3
      SG_ESP1: upstream-reference=EcuSwComposition.SG_ESP1, ecu-extract-reference=COMPOSITIONTYPE.SG_ESP1
      HUT_IP1_0x293: upstream-reference=EcuSwComposition.HUT_IP1_0x293, ecu-extract-reference=COMPOSITIONTYPE.HUT_IP1_0x293
      HUT_IP3_0x34A: upstream-reference=EcuSwComposition.HUT_IP3_0x34A, ecu-extract-reference=COMPOSITIONTYPE.HUT_IP3_0x34A
      DidDataProcessNvMNotifyJobFinished_NvBlockNeed_E2ESwitchNvM_NvM_RpNotifyJobEnd_DidDataProcessNvBlockNeed_E2ESwitch: upstream-reference=COMPOSITIONTYPE.DidDataProcess.NvBlockNeed_E2ESwitch, ecu-extract-reference=DidDataProcessNvMNotifyJobFinished_NvBlockNeed_E2ESwitchNvM_NvM_RpNotifyJobEnd_DidDataProcessNvBlockNeed_E2ESwitch
      DidDataProcessNvMService_AC2_SRBS_NvBlockNeed_E2ESwitchNvM_PS_DidDataProcessNvBlockNeed_E2ESwitch: upstream-reference=COMPOSITIONTYPE.DidDataProcess.NvBlockNeed_E2ESwitch, ecu-extract-reference=DidDataProcessNvMService_AC2_SRBS_NvBlockNeed_E2ESwitchNvM_PS_DidDataProcessNvBlockNeed_E2ESwitch
      DidDataProcessNvBlockNeed_E2ESwitch: upstream-reference=COMPOSITIONTYPE.DidDataProcess.NvBlockNeed_E2ESwitch
      DidDataProcessNvMNotifyJobFinished_NvBlockNeed_SecOcSwitchNvM_NvM_RpNotifyJobEnd_DidDataProcessNvBlockNeed_SecOcSwitch: upstream-reference=COMPOSITIONTYPE.DidDataProcess.NvBlockNeed_SecOcSwitch, ecu-extract-reference=DidDataProcessNvMNotifyJobFinished_NvBlockNeed_SecOcSwitchNvM_NvM_RpNotifyJobEnd_DidDataProcessNvBlockNeed_SecOcSwitch
      DidDataProcessNvMService_AC2_SRBS_NvBlockNeed_SecOcSwitchNvM_PS_DidDataProcessNvBlockNeed_SecOcSwitch: upstream-reference=COMPOSITIONTYPE.DidDataProcess.NvBlockNeed_SecOcSwitch, ecu-extract-reference=DidDataProcessNvMService_AC2_SRBS_NvBlockNeed_SecOcSwitchNvM_PS_DidDataProcessNvBlockNeed_SecOcSwitch
      DidDataProcessNvBlockNeed_SecOcSwitch: upstream-reference=COMPOSITIONTYPE.DidDataProcess.NvBlockNeed_SecOcSwitch
      T_Box_SysErrSts: upstream-reference=EcuSwComposition.T_Box_SysErrSts, ecu-extract-reference=COMPOSITIONTYPE.T_Box_SysErrSts
      NvBlockNeed_UpgradeResetFlag: upstream-reference=COMPOSITIONTYPE.Upgrade.NvBlockNeed_UpgradeResetFlag
      UpgradeNvMService_AC2_SRBS_Defs_NvBlockNeed_UpgradeResetFlagNvM_PS_NvBlockNeed_UpgradeResetFlag: upstream-reference=COMPOSITIONTYPE.Upgrade.NvBlockNeed_UpgradeResetFlag, ecu-extract-reference=UpgradeNvMService_AC2_SRBS_Defs_NvBlockNeed_UpgradeResetFlagNvM_PS_NvBlockNeed_UpgradeResetFlag
      BSD_LCA_warningReqleft: upstream-reference=EcuSwComposition.BSD_LCA_warningReqleft, ecu-extract-reference=COMPOSITIONTYPE.BSD_LCA_warningReqleft
      BSD_LCA_warningReqRight: upstream-reference=EcuSwComposition.BSD_LCA_warningReqRight, ecu-extract-reference=COMPOSITIONTYPE.BSD_LCA_warningReqRight
      RCTA_warningReqLeft: upstream-reference=EcuSwComposition.RCTA_warningReqLeft, ecu-extract-reference=COMPOSITIONTYPE.RCTA_warningReqLeft
      RCTA_warningReqRight: upstream-reference=EcuSwComposition.RCTA_warningReqRight, ecu-extract-reference=COMPOSITIONTYPE.RCTA_warningReqRight
      DOW_warningReqleft: upstream-reference=EcuSwComposition.DOW_warningReqleft, ecu-extract-reference=COMPOSITIONTYPE.DOW_warningReqleft
      DOW_warningReqRight: upstream-reference=EcuSwComposition.DOW_warningReqRight, ecu-extract-reference=COMPOSITIONTYPE.DOW_warningReqRight
      HSM: upstream-reference=EcuSwComposition.BSW_CDD.HSM, ecu-extract-reference=COMPOSITIONTYPE.HSM
      SwToFieldCalRstCmd: upstream-reference=EcuSwComposition.SwToFieldCalRstCmd, ecu-extract-reference=COMPOSITIONTYPE.SwToFieldCalRstCmd
      SyncRequestMessageId: upstream-reference=EcuSwComposition.SyncRequestMessageId, ecu-extract-reference=COMPOSITIONTYPE.SyncRequestMessageId
      SyncRequstReseverData1: upstream-reference=EcuSwComposition.SyncRequstReseverData1, ecu-extract-reference=COMPOSITIONTYPE.SyncRequstReseverData1
      SecOc_Server: upstream-reference=EcuSwComposition.Manager_Swc.SecOc_Server, ecu-extract-reference=COMPOSITIONTYPE.SecOc_Server
      Common_NormalNvBlockNeed_Menu: upstream-reference=COMPOSITIONTYPE.Common_Normal.NvBlockNeed_Menu
      Common_NormalNvMService_AC3_SRBS_NvBlockNeed_MenuNvM_PS_Common_NormalNvBlockNeed_Menu: upstream-reference=COMPOSITIONTYPE.Common_Normal.NvBlockNeed_Menu, ecu-extract-reference=Common_NormalNvMService_AC3_SRBS_NvBlockNeed_MenuNvM_PS_Common_NormalNvBlockNeed_Menu
      Common_NormalNvMNotifyJobFinished_NvBlockNeed_MenuNvM_NvM_RpNotifyJobEnd_Common_NormalNvBlockNeed_Menu: upstream-reference=COMPOSITIONTYPE.Common_Normal.NvBlockNeed_Menu, ecu-extract-reference=Common_NormalNvMNotifyJobFinished_NvBlockNeed_MenuNvM_NvM_RpNotifyJobEnd_Common_NormalNvBlockNeed_Menu
      ADAU1978: upstream-reference=EcuSwComposition.BSW_CDD.ADAU1978, ecu-extract-reference=COMPOSITIONTYPE.ADAU1978
      SG_HUT32: upstream-reference=EcuSwComposition.SG_HUT32, ecu-extract-reference=COMPOSITIONTYPE.SG_HUT32
      AdjVolUpSwtSts: upstream-reference=EcuSwComposition.AdjVolUpSwtSts, ecu-extract-reference=COMPOSITIONTYPE.AdjVolUpSwtSts
      PageUpSwtSts: upstream-reference=EcuSwComposition.PageUpSwtSts, ecu-extract-reference=COMPOSITIONTYPE.PageUpSwtSts
      ACC_FD4_0x2B8: upstream-reference=EcuSwComposition.ACC_FD4_0x2B8, ecu-extract-reference=COMPOSITIONTYPE.ACC_FD4_0x2B8
      SG_ACC6_ACC_FD2: upstream-reference=EcuSwComposition.SG_ACC6_ACC_FD2, ecu-extract-reference=COMPOSITIONTYPE.SG_ACC6_ACC_FD2
      SG_BMS4: upstream-reference=EcuSwComposition.SG_BMS4, ecu-extract-reference=COMPOSITIONTYPE.SG_BMS4
      SG_HCU_HP5: upstream-reference=EcuSwComposition.SG_HCU_HP5, ecu-extract-reference=COMPOSITIONTYPE.SG_HCU_HP5
      SG_HCU_PT4: upstream-reference=EcuSwComposition.SG_HCU_PT4, ecu-extract-reference=COMPOSITIONTYPE.SG_HCU_PT4
      SG_HCU_PT7: upstream-reference=EcuSwComposition.SG_HCU_PT7, ecu-extract-reference=COMPOSITIONTYPE.SG_HCU_PT7
      SG_DHT_FD1: upstream-reference=EcuSwComposition.SG_DHT_FD1, ecu-extract-reference=COMPOSITIONTYPE.SG_DHT_FD1
      SG_IFC6_IFC_FD2: upstream-reference=EcuSwComposition.SG_IFC6_IFC_FD2, ecu-extract-reference=COMPOSITIONTYPE.SG_IFC6_IFC_FD2
      HUT35_0x1E5: upstream-reference=EcuSwComposition.HUT35_0x1E5, ecu-extract-reference=COMPOSITIONTYPE.HUT35_0x1E5
      HUT_FD4_0x1DA: upstream-reference=EcuSwComposition.HUT_FD4_0x1DA, ecu-extract-reference=COMPOSITIONTYPE.HUT_FD4_0x1DA
      HAP_FD6_0x289: upstream-reference=EcuSwComposition.HAP_FD6_0x289, ecu-extract-reference=COMPOSITIONTYPE.HAP_FD6_0x289
      HAP_FD7_0x29B: upstream-reference=EcuSwComposition.HAP_FD7_0x29B, ecu-extract-reference=COMPOSITIONTYPE.HAP_FD7_0x29B
      HUT40_0x2CE: upstream-reference=EcuSwComposition.HUT40_0x2CE, ecu-extract-reference=COMPOSITIONTYPE.HUT40_0x2CE
      HCM_L1_0x308: upstream-reference=EcuSwComposition.HCM_L1_0x308, ecu-extract-reference=COMPOSITIONTYPE.HCM_L1_0x308
      HCM_R1_0x30D: upstream-reference=EcuSwComposition.HCM_R1_0x30D, ecu-extract-reference=COMPOSITIONTYPE.HCM_R1_0x30D
      BMS22_0x3BF: upstream-reference=EcuSwComposition.BMS22_0x3BF, ecu-extract-reference=COMPOSITIONTYPE.BMS22_0x3BF
      BMS8_0x285: upstream-reference=EcuSwComposition.BMS8_0x285, ecu-extract-reference=COMPOSITIONTYPE.BMS8_0x285
      BMS_FD14_0x1E3: upstream-reference=EcuSwComposition.BMS_FD14_0x1E3, ecu-extract-reference=COMPOSITIONTYPE.BMS_FD14_0x1E3
      HCU_FD1_0x60: upstream-reference=EcuSwComposition.HCU_FD1_0x60, ecu-extract-reference=COMPOSITIONTYPE.HCU_FD1_0x60
      HCU_HC3_0x268: upstream-reference=EcuSwComposition.HCU_HC3_0x268, ecu-extract-reference=COMPOSITIONTYPE.HCU_HC3_0x268
      HCU_HC8_0x1E2: upstream-reference=EcuSwComposition.HCU_HC8_0x1E2, ecu-extract-reference=COMPOSITIONTYPE.HCU_HC8_0x1E2
      HCU_HP5_0x201: upstream-reference=EcuSwComposition.HCU_HP5_0x201, ecu-extract-reference=COMPOSITIONTYPE.HCU_HP5_0x201
      HCU_HP6_0x11A: upstream-reference=EcuSwComposition.HCU_HP6_0x11A, ecu-extract-reference=COMPOSITIONTYPE.HCU_HP6_0x11A
      LADBstatus: upstream-reference=EcuSwComposition.LADBstatus, ecu-extract-reference=COMPOSITIONTYPE.LADBstatus
      RADBstatus: upstream-reference=EcuSwComposition.RADBstatus, ecu-extract-reference=COMPOSITIONTYPE.RADBstatus
      LHiBeamSts: upstream-reference=EcuSwComposition.LHiBeamSts, ecu-extract-reference=COMPOSITIONTYPE.LHiBeamSts
      RHiBeamSts: upstream-reference=EcuSwComposition.RHiBeamSts, ecu-extract-reference=COMPOSITIONTYPE.RHiBeamSts
      SysSafety: upstream-reference=EcuSwComposition.BSW_CDD.SysSafety, ecu-extract-reference=COMPOSITIONTYPE.SysSafety
      DidDataProcessNvMNotifyJobFinished_NvBlockNeed_VehicleSoftwareVersionNvM_NvM_RpNotifyJobEnd_DidDataProcessNvBlockNeed_Vehicl: upstream-reference=COMPOSITIONTYPE.DidDataProcess.NvBlockNeed_VehicleSoftwareVersion, ecu-extract-reference=DidDataProcessNvMNotifyJobFinished_NvBlockNeed_VehicleSoftwareVersionNvM_NvM_RpNotifyJobEnd_DidDataProcessNvBlockNeed_Vehicl
      DidDataProcessNvMService_AC2_SRBS_NvBlockNeed_VehicleSoftwareVersionNvM_PS_DidDataProcessNvBlockNeed_VehicleSoftwareVersion: upstream-reference=COMPOSITIONTYPE.DidDataProcess.NvBlockNeed_VehicleSoftwareVersion, ecu-extract-reference=DidDataProcessNvMService_AC2_SRBS_NvBlockNeed_VehicleSoftwareVersionNvM_PS_DidDataProcessNvBlockNeed_VehicleSoftwareVersion
      DidDataProcessNvBlockNeed_VehicleSoftwareVersion: upstream-reference=COMPOSITIONTYPE.DidDataProcess.NvBlockNeed_VehicleSoftwareVersion
      ComEx: upstream-reference=EcuSwComposition.BSW_CDD.ComEx, ecu-extract-reference=COMPOSITIONTYPE.ComEx
      KeyReturn: upstream-reference=EcuSwComposition.BSW_CDD.KeyReturn, ecu-extract-reference=COMPOSITIONTYPE.KeyReturn
      GNSS: upstream-reference=EcuSwComposition.BSW_CDD.GNSS, ecu-extract-reference=COMPOSITIONTYPE.GNSS
      AMP_NvMNotifyJobFinished_NvBlockNeed_LC_Calibration2NvM_NvM_RpNotifyJobEnd_AMP_NvBlockNeed_LC_Calibration2: upstream-reference=COMPOSITIONTYPE.AMP.NvBlockNeed_LC_Calibration2, ecu-extract-reference=AMP_NvMNotifyJobFinished_NvBlockNeed_LC_Calibration2NvM_NvM_RpNotifyJobEnd_AMP_NvBlockNeed_LC_Calibration2
      AMP_NvMService_AC2_SRBS_Defs_NvBlockNeed_LC_Calibration2NvM_PS_AMP_NvBlockNeed_LC_Calibration2: upstream-reference=COMPOSITIONTYPE.AMP.NvBlockNeed_LC_Calibration2, ecu-extract-reference=AMP_NvMService_AC2_SRBS_Defs_NvBlockNeed_LC_Calibration2NvM_PS_AMP_NvBlockNeed_LC_Calibration2
      AMP_NvBlockNeed_LC_Calibration2: upstream-reference=COMPOSITIONTYPE.AMP.NvBlockNeed_LC_Calibration2
      SOCManagerNvMNotifyJobFinished_NvBlockNeed_HealthSwitchNvM_NvM_RpNotifyJobEnd_SOCManagerNvBlockNeed_HealthSwitch: upstream-reference=COMPOSITIONTYPE.SOCManager.NvBlockNeed_HealthSwitch, ecu-extract-reference=SOCManagerNvMNotifyJobFinished_NvBlockNeed_HealthSwitchNvM_NvM_RpNotifyJobEnd_SOCManagerNvBlockNeed_HealthSwitch
      SOCManagerNvMService_AC3_Defs_NvBlockNeed_HealthSwitchNvM_PS_SOCManagerNvBlockNeed_HealthSwitch: upstream-reference=COMPOSITIONTYPE.SOCManager.NvBlockNeed_HealthSwitch, ecu-extract-reference=SOCManagerNvMService_AC3_Defs_NvBlockNeed_HealthSwitchNvM_PS_SOCManagerNvBlockNeed_HealthSwitch
      SOCManagerNvBlockNeed_HealthSwitch: upstream-reference=COMPOSITIONTYPE.SOCManager.NvBlockNeed_HealthSwitch
      DidDataProcessNvMNotifyJobFinished_NvBlockNeed_ClusterDisplayHMIAdjustmentOffsetNvM_NvM_RpNotifyJobEnd_DidDataProcessNvBlock: upstream-reference=COMPOSITIONTYPE.DidDataProcess.NvBlockNeed_ClusterDisplayHMIAdjustmentOffset, ecu-extract-reference=DidDataProcessNvMNotifyJobFinished_NvBlockNeed_ClusterDisplayHMIAdjustmentOffsetNvM_NvM_RpNotifyJobEnd_DidDataProcessNvBlock
      DidDataProcessNvMService_AC2_SRBS_NvBlockNeed_ClusterDisplayHMIAdjustmentOffsetNvM_PS_DidDataProcessNvBlockNeed_ClusterDispl: upstream-reference=COMPOSITIONTYPE.DidDataProcess.NvBlockNeed_ClusterDisplayHMIAdjustmentOffset, ecu-extract-reference=DidDataProcessNvMService_AC2_SRBS_NvBlockNeed_ClusterDisplayHMIAdjustmentOffsetNvM_PS_DidDataProcessNvBlockNeed_ClusterDispl
      DidDataProcessNvBlockNeed_ClusterDisplayHMIAdjustmentOffset: upstream-reference=COMPOSITIONTYPE.DidDataProcess.NvBlockNeed_ClusterDisplayHMIAdjustmentOffset
      Can_ServerNvMNotifyJobFinished_NvBlockNeed_AbnormalWakeupSleepRecordsNvM_NvM_RpNotifyJobEnd_Can_ServerNvBlockNeed_AbnormalWa: upstream-reference=COMPOSITIONTYPE.Can_Server.NvBlockNeed_AbnormalWakeupSleepRecords, ecu-extract-reference=Can_ServerNvMNotifyJobFinished_NvBlockNeed_AbnormalWakeupSleepRecordsNvM_NvM_RpNotifyJobEnd_Can_ServerNvBlockNeed_AbnormalWa
      Can_ServerNvMService_AC2_SRBS_NvBlockNeed_AbnormalWakeupSleepRecordsNvM_PS_Can_ServerNvBlockNeed_AbnormalWakeupSleepRecords: upstream-reference=COMPOSITIONTYPE.Can_Server.NvBlockNeed_AbnormalWakeupSleepRecords, ecu-extract-reference=Can_ServerNvMService_AC2_SRBS_NvBlockNeed_AbnormalWakeupSleepRecordsNvM_PS_Can_ServerNvBlockNeed_AbnormalWakeupSleepRecords
      Can_ServerNvBlockNeed_AbnormalWakeupSleepRecords: upstream-reference=COMPOSITIONTYPE.Can_Server.NvBlockNeed_AbnormalWakeupSleepRecords
      Can_ServerNvMNotifyJobFinished_NvBlockNeed_ActiveWUCounterNvM_NvM_RpNotifyJobEnd_Can_ServerNvBlockNeed_ActiveWUCounter: upstream-reference=COMPOSITIONTYPE.Can_Server.NvBlockNeed_ActiveWUCounter, ecu-extract-reference=Can_ServerNvMNotifyJobFinished_NvBlockNeed_ActiveWUCounterNvM_NvM_RpNotifyJobEnd_Can_ServerNvBlockNeed_ActiveWUCounter
      Can_ServerNvMService_AC2_SRBS_NvBlockNeed_ActiveWUCounterNvM_PS_Can_ServerNvBlockNeed_ActiveWUCounter: upstream-reference=COMPOSITIONTYPE.Can_Server.NvBlockNeed_ActiveWUCounter, ecu-extract-reference=Can_ServerNvMService_AC2_SRBS_NvBlockNeed_ActiveWUCounterNvM_PS_Can_ServerNvBlockNeed_ActiveWUCounter
      Can_ServerNvBlockNeed_ActiveWUCounter: upstream-reference=COMPOSITIONTYPE.Can_Server.NvBlockNeed_ActiveWUCounter
