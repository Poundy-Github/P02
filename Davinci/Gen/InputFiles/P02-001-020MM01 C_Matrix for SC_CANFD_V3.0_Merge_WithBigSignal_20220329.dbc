VERSION "created by canmatrix"

NS_ :

BS_:

BU_: CEM HUT GW T_BOX XBOX_D DVR Tester

BO_ 628 HAP_FD2: 64 GW
 SG_ AutoAVMSwtSet_Sts : 83|1@0+ (1,0) [0|1] ""  HUT
 SG_ AVM_CurrSts : 79|2@0+ (1,0) [0|3] ""  HUT
 SG_ GuidOvlSts : 95|2@0+ (1,0) [0|3] ""  HUT
 SG_ FrntCamInpFailSts : 108|1@0+ (1,0) [0|1] ""  HUT
 SG_ RearCamInpFailSts : 109|1@0+ (1,0) [0|1] ""  HUT
 SG_ LeCamInpFailSts : 110|1@0+ (1,0) [0|1] ""  HUT
 SG_ RiCamInpFailSts : 111|1@0+ (1,0) [0|1] ""  HUT
 SG_ EolNotCmpltd : 107|1@0+ (1,0) [0|1] ""  HUT
 SG_ OvlOpFailSts : 105|1@0+ (1,0) [0|1] ""  HUT
 SG_ LaneCalSts : 101|2@0+ (1,0) [0|3] ""  HUT
 SG_ RadarDispSts : 93|2@0+ (1,0) [0|3] ""  HUT
 SG_ LaneCalFltSts : 99|3@0+ (1,0) [0|7] ""  HUT
 SG_ AutoViewChgFuncSts : 84|1@0+ (1,0) [0|1] ""  HUT
 SG_ CarMdlTrsprcySts : 103|2@0+ (1,0) [0|3] ""  HUT
 SG_ CarMdlDispSts : 85|1@0+ (1,0) [0|1] ""  HUT
 SG_ CurrCalResultSts : 96|1@0+ (1,0) [0|1] ""  HUT
 SG_ MdlColrSts : 91|4@0+ (1,0) [0|15] ""  HUT
 SG_ SigViewIndcn : 77|6@0+ (1,0) [0|63] ""  HUT
 SG_ HAP_DispCmd : 127|1@0+ (1,0) [0|1] ""  HUT
 SG_ AVM_3DAngSts : 104|9@0+ (1,0) [0|360] "deg"  HUT
 SG_ MOD_WorkSts : 87|1@0+ (1,0) [0|1] ""  HUT
 SG_ MOD_AlarmSts : 86|1@0+ (1,0) [0|1] ""  HUT
 SG_ DVRWorkSts : 126|2@0+ (1,0) [0|3] ""  HUT
 SG_ HAP_Hmi_Index : 143|4@0+ (1,0) [0|15] ""  HUT
 SG_ HAP_FD2_0x274 : 0|512@1+ (1,0) [0|0] ""  HUT

BO_ 636 AC8: 8 GW
 SG_ RearInCarTemp : 47|8@0+ (0.5,-40) [-40|86.5] "Ã‚Â°C"  HUT,T_BOX
 SG_ ACRLTemp_ATC : 31|6@0+ (0.5,16) [16|32] "Ã‚Â°C"  HUT,T_BOX
 SG_ AC8_0x27C : 0|64@1+ (1,0) [0|0] ""  HUT

BO_ 639 IP2: 16 HUT
 SG_ CheckSum_IP2 : 7|8@0+ (1,0) [0|255] ""  GW
 SG_ IP_DrvSeatBeltWarnLmpFailSts : 51|2@0+ (1,0) [0|3] ""  GW
 SG_ IP_PassSeatBeltWarnLmpFailSts : 49|2@0+ (1,0) [0|3] ""  GW
 SG_ IP_VehTotDistance : 15|24@0+ (0.1,0) [0|999999.9] "Km"  GW,CEM,T_BOX
 SG_ IP_VehTotDistanceValid : 46|1@0+ (1,0) [0|1] ""  GW,CEM,T_BOX
 SG_ IP_FuelLvlInfo : 39|8@0+ (1,0) [0|200] "L"  GW,T_BOX
 SG_ IP_FuelLvlLowLmpSts : 45|2@0+ (1,0) [0|3] ""  T_BOX
 SG_ IP_BattChrgLmpSts : 43|2@0+ (1,0) [0|3] "" Vector__XXX
 SG_ IP_EngOilPressLowLmpSts : 41|2@0+ (1,0) [0|3] "" Vector__XXX
 SG_ IP_ABMWarnLmpFailrSts : 55|2@0+ (1,0) [0|3] ""  GW
 SG_ IP_Err : 52|1@0+ (1,0) [0|1] ""  GW
 SG_ IP_ACCErr : 47|1@0+ (1,0) [0|1] ""  GW
 SG_ IP_VehSpdUnit : 53|1@0+ (1,0) [0|1] ""  GW,T_BOX
 SG_ IP_VINcompr : 63|1@0+ (1,0) [0|1] ""  GW
 SG_ RollingCounter_IP2 : 59|4@0+ (1,0) [0|15] ""  GW
 SG_ FreshnessValue_IP2 : 71|16@0+ (1,0) [0|65535] ""  GW,T_BOX
 SG_ MAC_Check_IP2 : 87|48@0+ (1,0) [0|281474976710655] ""  GW,T_BOX
 SG_ IP2_0x27F : 0|64@1+ (1,0) [0|0] "" Vector__XXX

BO_ 647 ALS1: 16 GW
 SG_ CheckSum_HC1 : 7|8@0+ (1,0) [0|255] ""  HUT
 SG_ ALS_FailSts : 8|1@0+ (1,0) [0|1] ""  HUT
 SG_ RollingCounter_HC1 : 59|4@0+ (1,0) [0|15] ""  HUT
 SG_ ALS1_0x287 : 0|128@1+ (1,0) [0|0] ""  HUT

BO_ 649 HAP_FD6: 64 GW
 SG_ HAP_RtCam_WorkSts : 61|2@0+ (1,0) [0|3] ""  HUT
 SG_ HAP_RtSide_Obj1_ID : 15|4@0+ (1,0) [0|3] ""  HUT
 SG_ HAP_RtSide_Obj1_type : 11|3@0+ (1,0) [0|7] ""  HUT
 SG_ HAP_RtSide_Obj1_Confidence : 27|4@0+ (0.1,0) [0|1] ""  HUT
 SG_ HAP_RtSide_Obj1_Ground_Pos_X : 23|12@0+ (0.01,0) [0|40] "m"  HUT
 SG_ HAP_RtSide_Obj1_Ground_Pos_Y : 39|12@0+ (0.01,-20) [-20|20] "m"  HUT
 SG_ HAP_RtSide_Obj2_ID : 79|4@0+ (1,0) [0|3] ""  HUT
 SG_ HAP_RtSide_Obj2_type : 75|3@0+ (1,0) [0|7] ""  HUT
 SG_ HAP_RtSide_Obj2_Confidence : 91|4@0+ (0.1,0) [0|1] ""  HUT
 SG_ HAP_RtSide_Obj2_Ground_Pos_X : 87|12@0+ (0.01,0) [0|40] "m"  HUT
 SG_ HAP_RtSide_Obj2_Ground_Pos_Y : 103|12@0+ (0.01,-20) [-20|20] "m"  HUT
 SG_ HAP_RtSide_Obj3_ID : 143|4@0+ (1,0) [0|3] ""  HUT
 SG_ HAP_RtSide_Obj3_type : 139|3@0+ (1,0) [0|7] ""  HUT
 SG_ HAP_RtSide_Obj3_Confidence : 155|4@0+ (0.1,0) [0|1] ""  HUT
 SG_ HAP_RtSide_Obj3_Ground_Pos_X : 151|12@0+ (0.01,0) [0|40] "m"  HUT
 SG_ HAP_RtSide_Obj3_Ground_Pos_Y : 167|12@0+ (0.01,-20) [-20|20] "m"  HUT
 SG_ HAP_RtSide_Obj4_ID : 207|4@0+ (1,0) [0|3] ""  HUT
 SG_ HAP_RtSide_Obj4_type : 203|3@0+ (1,0) [0|7] ""  HUT
 SG_ HAP_RtSide_Obj4_Confidence : 219|4@0+ (0.1,0) [0|1] ""  HUT
 SG_ HAP_RtSide_Obj4_Ground_Pos_X : 215|12@0+ (0.01,0) [0|40] "m"  HUT
 SG_ HAP_RtSide_Obj4_Ground_Pos_Y : 231|12@0+ (0.01,-20) [-20|20] "m"  HUT
 SG_ USS_FLSide1_Status : 271|2@0+ (1,0) [0|3] ""  HUT
 SG_ USS_FLSide1_Dist : 279|7@0+ (0.1,0) [0|12.6] "m"  HUT
 SG_ USS_RLSide2_Status : 269|2@0+ (1,0) [0|3] ""  HUT
 SG_ USS_RLSide2_Dist : 287|7@0+ (0.1,0) [0|12.6] "m"  HUT
 SG_ USS_FRSide1_Status : 267|2@0+ (1,0) [0|3] ""  HUT
 SG_ USS_FRSide1_Dist : 295|7@0+ (0.1,0) [0|12.6] "m"  HUT
 SG_ USS_RRSide2_Status : 265|2@0+ (1,0) [0|3] ""  HUT
 SG_ USS_RRSide2_Dist : 303|7@0+ (0.1,0) [0|12.6] "m"  HUT
 SG_ HAP_FD6_0x289 : 0|512@1+ (1,0) [0|0] ""  HUT

BO_ 653 BCM7: 8 CEM
 SG_ SecRowLeSeatVentSts : 15|2@0+ (1,0) [0|3] ""  HUT,T_BOX
 SG_ SecRowRiSeatVentSts : 13|2@0+ (1,0) [0|3] ""  HUT,T_BOX
 SG_ BCM7_0x28D : 0|64@1+ (1,0) [0|0] ""  HUT

BO_ 656 ECM_PT6: 8 GW
 SG_ EngOilLvl : 63|4@0+ (1,0) [0|15] ""  HUT
 SG_ FTIVFault : 16|1@0+ (1,0) [0|1] ""  HUT
 SG_ FuelTankCapWarning : 50|2@0+ (1,0) [0|3] ""  HUT
 SG_ PressReliProgs : 23|7@0+ (1,0) [0|100] "%"  HUT
 SG_ ECM_PT6_0x290 : 0|64@1+ (1,0) [0|0] ""  HUT

BO_ 659 IP1: 8 HUT
 SG_ IP_CurrTheme : 20|3@0+ (1,0) [0|7] ""  T_BOX
 SG_ IP_VehSpdDisp : 15|9@0+ (0.5,0) [0|255] "kmh"  GW
 SG_ IP_VelSpdDisp_Mile : 51|8@0+ (1,0) [0|255] "Mile per hour"  GW
 SG_ IP_FuelMainTankR : 17|10@0+ (1,0) [10|1000] "Ohm"  GW
 SG_ IP_FuelAuxTankR : 39|10@0+ (1,0) [10|1000] "Ohm"  GW
 SG_ IP_LagueSet : 45|4@0+ (1,0) [0|15] "" Vector__XXX
 SG_ IP1_0x293 : 0|64@1+ (1,0) [0|0] "" Vector__XXX

BO_ 661 PEPS2: 8 CEM
 SG_ SysPowerMod : 15|2@0+ (1,0) [0|3] ""  HUT,XBOX_D,T_BOX
 SG_ SysPowerModVld : 13|1@0+ (1,0) [0|1] ""  HUT,XBOX_D,T_BOX
 SG_ PEPS_PowerRlyOutpSts : 31|3@0+ (1,0) [0|7] ""  HUT
 SG_ RemPowerFailureSts : 37|2@0+ (1,0) [0|3] ""  HUT,T_BOX
 SG_ RemUpgrdModSysPower : 39|2@0+ (1,0) [0|3] ""  HUT,T_BOX
 SG_ PEPS2_0x295 : 0|64@1+ (1,0) [0|0] ""  HUT

BO_ 664 HAP_FD3: 64 GW
 SG_ RPAS_NearBrrdstn : 15|8@0+ (1,0) [0|150] ""  HUT
 SG_ HAVP_ProcRa : 23|7@0+ (1,0) [0|127] ""  HUT
 SG_ P2P_ProcBar : 31|7@0+ (1,0) [0|127] ""  HUT
 SG_ APS_ObjRiSideAr1 : 79|4@0+ (1,0) [0|15] ""  HUT
 SG_ APS_ObjRiSideAr2 : 75|4@0+ (1,0) [0|15] ""  HUT
 SG_ APS_ObjRiSideAr3 : 87|4@0+ (1,0) [0|15] ""  HUT
 SG_ APS_ObjRiSideAr4 : 83|4@0+ (1,0) [0|15] ""  HUT
 SG_ APS_ObjRiSideAr5 : 95|4@0+ (1,0) [0|15] ""  HUT
 SG_ APS_ObjLeSideAr1 : 91|4@0+ (1,0) [0|15] ""  HUT
 SG_ APS_ObjLeSideAr2 : 103|4@0+ (1,0) [0|15] ""  HUT
 SG_ APS_ObjLeSideAr3 : 99|4@0+ (1,0) [0|15] ""  HUT
 SG_ APS_ObjLeSideAr4 : 111|4@0+ (1,0) [0|15] ""  HUT
 SG_ APS_ObjLeSideAr5 : 107|4@0+ (1,0) [0|15] ""  HUT
 SG_ APS_FRSideSnsrFailSts : 119|1@0+ (1,0) [0|1] ""  HUT
 SG_ APS_FLSideSnsrFailSts : 118|1@0+ (1,0) [0|1] ""  HUT
 SG_ APS_RRSideSnsrFailSts : 117|1@0+ (1,0) [0|1] ""  HUT
 SG_ APS_RLSideSnsrFailSts : 116|1@0+ (1,0) [0|1] ""  HUT
 SG_ SDW_SoundIndcn : 115|2@0+ (1,0) [0|3] ""  HUT
 SG_ SDWActiveSts : 112|1@0+ (1,0) [0|1] ""  HUT
 SG_ RPAS_ObjRRCornrAr1 : 143|4@0+ (1,0) [0|15] ""  HUT
 SG_ RPAS_ObjRRCornrAr2 : 139|4@0+ (1,0) [0|15] ""  HUT
 SG_ RPAS_ObjRRMidlAr1 : 151|4@0+ (1,0) [0|15] ""  HUT
 SG_ RPAS_ObjRRMidlAr2 : 147|4@0+ (1,0) [0|15] ""  HUT
 SG_ RPAS_ObjRLMidlAr1 : 159|4@0+ (1,0) [0|15] ""  HUT
 SG_ RPAS_ObjRLMidlAr2 : 155|4@0+ (1,0) [0|15] ""  HUT
 SG_ RPAS_ObjRLCornrAr1 : 167|4@0+ (1,0) [0|15] ""  HUT
 SG_ RPAS_ObjRLCornrAr2 : 163|4@0+ (1,0) [0|15] ""  HUT
 SG_ RPAS_RLCornrSnsrFailSts : 175|1@0+ (1,0) [0|1] ""  HUT
 SG_ RPAS_RLMiddlSnsrFailSts : 174|1@0+ (1,0) [0|1] ""  HUT
 SG_ RPAS_RRMiddlSnsrFailSts : 173|1@0+ (1,0) [0|1] ""  HUT
 SG_ RPAS_RRCornrSnsrFailSts : 172|1@0+ (1,0) [0|1] ""  HUT
 SG_ RPAS_WorkSts : 171|2@0+ (1,0) [0|3] ""  HUT
 SG_ RPAS_SoundIndcn : 183|2@0+ (1,0) [0|3] ""  HUT
 SG_ MEBWorkSts : 180|2@0+ (1,0) [0|3] ""  HUT
 SG_ MEB_EnableSts : 178|1@0+ (1,0) [0|1] ""  HUT
 SG_ FPAS_ObjFLCornrAr1 : 207|4@0+ (1,0) [0|15] ""  HUT
 SG_ FPAS_ObjFLCornrAr2 : 203|4@0+ (1,0) [0|15] ""  HUT
 SG_ FPAS_ObjFLMidlAr1 : 215|4@0+ (1,0) [0|15] ""  HUT
 SG_ FPAS_ObjFLMidlAr2 : 211|4@0+ (1,0) [0|15] ""  HUT
 SG_ FPAS_ObjFRMidlAr1 : 223|4@0+ (1,0) [0|15] ""  HUT
 SG_ FPAS_ObjFRMidlAr2 : 219|4@0+ (1,0) [0|15] ""  HUT
 SG_ FPAS_ObjFRCornrAr1 : 231|4@0+ (1,0) [0|15] ""  HUT
 SG_ FPAS_ObjFRCornrAr2 : 227|4@0+ (1,0) [0|15] ""  HUT
 SG_ FPAS_FLCornrSnsrFailSts : 239|1@0+ (1,0) [0|1] ""  HUT
 SG_ FPAS_FLMiddlSnsrFailSts : 238|1@0+ (1,0) [0|1] ""  HUT
 SG_ FPAS_FRMiddlSnsrFailSts : 237|1@0+ (1,0) [0|1] ""  HUT
 SG_ FPAS_FRCornrSnsrFailSts : 236|1@0+ (1,0) [0|1] ""  HUT
 SG_ FPAS_WorkSts : 235|2@0+ (1,0) [0|3] ""  HUT
 SG_ FPAS_AutoModSts : 232|1@0+ (1,0) [0|1] ""  HUT
 SG_ FPAS_SoundIndcn : 247|2@0+ (1,0) [0|3] ""  HUT
 SG_ FPAS_NearBrrdstn : 242|7@0+ (1,0) [0|100] ""  HUT
 SG_ APA_MenuDispCtrlCmd : 279|4@0+ (1,0) [0|15] ""  HUT
 SG_ APA_FuncSts : 271|2@0+ (1,0) [0|3] ""  HUT
 SG_ RADS_FuncSts : 267|2@0+ (1,0) [0|3] ""  HUT
 SG_ FADS_FuncSts : 265|2@0+ (1,0) [0|3] ""  HUT
 SG_ HAP_TextIconDispCtrl : 275|2@0+ (1,0) [0|3] ""  HUT
 SG_ P2P_FuncSts : 269|2@0+ (1,0) [0|3] ""  HUT
 SG_ FrntCamDirtySts : 447|1@0+ (1,0) [0|1] ""  HUT
 SG_ RearCamDirtySts : 446|1@0+ (1,0) [0|1] ""  HUT
 SG_ LeCamDirtySts : 445|1@0+ (1,0) [0|1] ""  HUT
 SG_ RiCamDirtySts : 444|1@0+ (1,0) [0|1] ""  HUT
 SG_ DVRCamDirtySts : 432|1@0+ (1,0) [0|1] ""  HUT
 SG_ HAP_FD3_0x298 : 0|512@1+ (1,0) [0|0] ""  HUT

BO_ 665 AC14: 8 GW
 SG_ FGA_Chan1LongTyp : 31|11@0+ (1,0) [0|2047] ""  HUT
 SG_ FGA_Chan2LongTyp : 36|11@0+ (1,0) [0|2047] ""  HUT
 SG_ FGA_Chan3LongTyp : 55|11@0+ (1,0) [0|2047] ""  HUT
 SG_ AC14_0x299 : 0|64@1+ (1,0) [0|0] ""  HUT

BO_ 667 HAP_FD7: 64 GW
 SG_ HAVP_LrngDst : 375|10@0+ (1,0) [0|1023] "m"  HUT
 SG_ HAVP_HUT_TextDisp : 343|6@0+ (1,0) [0|63] ""  HUT
 SG_ HAVP_ScFail_info : 351|5@0+ (1,0) [0|31] ""  HUT
 SG_ PAVP_ScFail_info : 367|5@0+ (1,0) [0|31] ""  HUT
 SG_ HAP_FD7_0x29B : 0|512@1+ (1,0) [0|0] ""  HUT

BO_ 669 AC1: 8 GW
 SG_ InCarTemp : 15|8@0+ (0.5,-40) [-40|86.5] "Ã‚Â°C"  HUT,T_BOX
 SG_ ACAQSEnaSts : 16|1@0+ (1,0) [0|1] ""  HUT
 SG_ ACOperMod : 39|3@0+ (1,0) [0|7] ""  HUT
 SG_ ACAIUEnaSts : 36|1@0+ (1,0) [0|1] ""  HUT,T_BOX
 SG_ ACDrvAirDistriMod : 23|3@0+ (1,0) [0|7] ""  HUT
 SG_ ACSteplessSpdSetEnaSts : 19|1@0+ (1,0) [0|1] ""  HUT
 SG_ ACFrntPassTempSteplessSetEnaSts : 24|1@0+ (1,0) [0|1] ""  HUT
 SG_ ACDrvTempSteplessSetEnaSts : 25|1@0+ (1,0) [0|1] ""  HUT
 SG_ ACEEMSts : 63|4@0+ (1,0) [0|15] ""  HUT
 SG_ ACCbnClnEnasts : 47|1@0+ (1,0) [0|1] ""  T_BOX
 SG_ ACCbnClnOffCode : 46|4@0+ (1,0) [0|15] ""  T_BOX
 SG_ AC1_0x29D : 0|64@1+ (1,0) [0|0] ""  HUT

BO_ 671 BCM8: 8 CEM
 SG_ RemoteModSts : 9|1@0+ (1,0) [0|1] "1.0"  HUT,T_BOX
 SG_ PASWorkCmd : 8|1@0+ (1,0) [0|1] ""  HUT
 SG_ KL30BRelaySts : 61|1@0+ (1,0) [0|1] ""  HUT
 SG_ RViewMirrorSts : 44|1@0+ (1,0) [0|1] ""  HUT
 SG_ WiprReq_F_PBox : 51|3@0+ (1,0) [0|7] ""  HUT
 SG_ DrivingModReq : 19|4@0+ (1,0) [0|15] ""  HUT
 SG_ WhistleSts : 45|1@0+ (1,0) [0|1] ""  T_BOX
 SG_ BCM8_0x29F : 0|64@1+ (1,0) [0|0] ""  HUT

BO_ 675 BCM14: 8 CEM
 SG_ DrvSeatHeatSts_Nine : 39|4@0+ (1,0) [0|15] ""  HUT,T_BOX
 SG_ PassSeatHeatSts_Nine : 35|4@0+ (1,0) [0|15] ""  HUT,T_BOX
 SG_ SecRowLeSeatHeatSts_Nine : 47|4@0+ (1,0) [0|15] ""  HUT,T_BOX
 SG_ SecRowRiSeatHeatSts_Nine : 43|4@0+ (1,0) [0|15] ""  HUT,T_BOX
 SG_ BCM14_0x2A3 : 0|64@1+ (1,0) [0|0] ""  HUT

BO_ 680 EEM1: 8 CEM
 SG_ TranPMode_Sts : 7|1@0+ (1,0) [0|1] ""  HUT,T_BOX
 SG_ Stat_PwrSv_Lvl : 6|3@0+ (1,0) [0|7] ""  HUT
 SG_ Dyn_PwrSv_Lvl : 23|3@0+ (1,0) [0|7] ""  HUT
 SG_ LvPwrSysErr : 25|2@0+ (1,0) [0|3] ""  HUT
 SG_ DeepSlpCmd : 3|2@0+ (1,0) [0|3] ""  T_BOX
 SG_ EEM1_0x2A8 : 0|64@1+ (1,0) [0|0] ""  HUT

BO_ 683 ACC_FD2: 64 GW
 SG_ ACC_LeTgt_02_Dy : 15|7@0+ (0.1,-8) [-8|0] "m"  HUT
 SG_ ACC_LeTgt_02_Dx : 8|9@0+ (0.5,0) [0|150] "m"  HUT
 SG_ ACC_LeTgt_02_Typ : 31|3@0+ (1,0) [0|7] ""  HUT
 SG_ ACC_LeTargrt_02_Detn : 28|2@0+ (1,0) [0|3] ""  HUT
 SG_ ACC_RiTargrt_02_Detn : 26|2@0+ (1,0) [0|3] ""  HUT
 SG_ ACC_RiTgt_02_Dy : 55|7@0+ (0.1,0) [0|8] "m"  HUT
 SG_ ACC_RiTgt_02_Dx : 24|9@0+ (0.5,0) [0|150] "m"  HUT
 SG_ ACC_RiTgt_02_Typ : 63|3@0+ (1,0) [0|7] ""  HUT
 SG_ ACC_LeTgtObjBarDisp : 47|3@0+ (1,0) [0|7] ""  HUT
 SG_ ACC_RiTgtObjBarDisp : 44|3@0+ (1,0) [0|7] ""  HUT
 SG_ Checksum_ACC3 : 71|8@0+ (1,0) [0|255] ""  HUT
 SG_ ICA_HandsOffResp : 78|1@0+ (1,0) [0|1] ""  HUT
 SG_ ALC_Resp : 73|1@0+ (1,0) [0|1] ""  HUT
 SG_ HWA_Resp : 77|1@0+ (1,0) [0|1] ""  HUT
 SG_ ISL_Resp : 79|1@0+ (1,0) [0|1] ""  HUT
 SG_ HWA_SnvtySet_Resp : 76|2@0+ (1,0) [0|3] ""  HUT
 SG_ Longctrl_VehHldReq_DVR : 87|1@0+ (1,0) [0|1] ""  HUT
 SG_ Longctrl_DrvOFF_Req_DVR : 86|1@0+ (1,0) [0|1] ""  HUT
 SG_ Longctrl_ModSts_DVR : 85|4@0+ (1,0) [0|15] ""  HUT
 SG_ Longctrl_Decel_Req_DVR : 81|1@0+ (1,0) [0|1] ""  HUT
 SG_ Longctrl_EngTrqReq_DVR : 95|16@0+ (0.0030518,-100) [-100|99.999713] "%"  HUT
 SG_ Longctrl_EngTrqReqActive_DVR : 80|1@0+ (1,0) [0|1] ""  HUT
 SG_ Longctrl_DecelToStopReq_DVR : 119|1@0+ (1,0) [0|1] ""  HUT
 SG_ Longctrl_ParkShiftReq_DVR : 118|2@0+ (1,0) [0|3] ""  HUT
 SG_ Longctrl_Decel_ReqValue_DVR : 111|8@0+ (0.05,-7) [-7|5.75] "ms^2"  HUT
 SG_ ALC_InterSysInfoDisp : 127|2@0+ (1,0) [0|3] ""  HUT
 SG_ RollingCounter_ACC3 : 123|4@0+ (1,0) [0|15] ""  HUT
 SG_ Checksum_ACC4 : 135|8@0+ (1,0) [0|255] ""  HUT
 SG_ ACC_ObjDetecte : 143|1@0+ (1,0) [0|1] ""  HUT
 SG_ ACC_TakeOverReq : 142|1@0+ (1,0) [0|1] ""  HUT
 SG_ ACC_InterSysInfoDisp : 141|5@0+ (1,0) [0|31] ""  HUT
 SG_ ACC_ModDisp : 151|5@0+ (1,0) [0|31] ""  HUT
 SG_ ACC_FctSts : 146|2@0+ (1,0) [0|3] ""  HUT
 SG_ ACC_TgtObjBarDisp : 159|3@0+ (1,0) [0|7] ""  HUT
 SG_ Longctrl_HazActv : 156|2@0+ (1,0) [0|3] ""  HUT
 SG_ TJA_ACC_SelSts : 154|3@0+ (1,0) [0|7] ""  HUT
 SG_ CruCha_ModDisp : 167|4@0+ (1,0) [0|15] ""  HUT
 SG_ TJA_ICA_InterSysInfoDisp : 163|3@0+ (1,0) [0|7] ""  HUT
 SG_ TJA_ICA_ModDisp : 175|3@0+ (1,0) [0|7] ""  HUT
 SG_ ISL_InterSysInfoDisp : 172|2@0+ (1,0) [0|3] ""  HUT
 SG_ ACC_TimeGapSet : 170|3@0+ (1,0) [0|7] ""  HUT
 SG_ ACC_SpdSetValue : 183|8@0+ (1,0) [0|255] "kphmph"  HUT
 SG_ CruChar_InterSysInfoDisp : 191|4@0+ (1,0) [0|15] ""  HUT
 SG_ RollingCounter_ACC4 : 187|4@0+ (1,0) [0|15] ""  HUT
 SG_ Checksum_ACC8 : 199|8@0+ (1,0) [0|255] ""  HUT
 SG_ HWA_ModDisp : 207|4@0+ (1,0) [0|15] ""  HUT
 SG_ HWA_InterSysInfoDisp : 203|4@0+ (1,0) [0|15] ""  HUT
 SG_ HWA_LaneChange : 213|2@0+ (1,0) [0|3] ""  HUT
 SG_ HWA_LaneChangeReq : 223|3@0+ (1,0) [0|7] ""  HUT
 SG_ HWA_Warning : 217|2@0+ (1,0) [0|3] ""  HUT
 SG_ RollingCounter_ACC8 : 251|4@0+ (1,0) [0|15] ""  HUT
 SG_ Checksum_ACC6 : 263|8@0+ (1,0) [0|255] ""  HUT
 SG_ ACC_PotentialTgtDy : 271|8@0+ (0.1,-8) [-8|8] "m"  HUT
 SG_ ACC_PotentialTgtDx : 279|9@0+ (0.5,0) [0|150] "m"  HUT
 SG_ ACC_RlvTgtDetn : 286|2@0+ (1,0) [0|3] ""  HUT
 SG_ ACC_EgoStatus : 284|2@0+ (1,0) [0|3] ""  HUT
 SG_ ACC_RlvTgtTyp : 282|3@0+ (1,0) [0|7] ""  HUT
 SG_ ACC_RlvTgtDy : 295|8@0+ (0.1,-8) [-8|8] "m"  HUT
 SG_ ACC_RlvTgtDx : 303|9@0+ (0.5,0) [0|150] "m"  HUT
 SG_ ACC_PotentialTgtDetn : 309|2@0+ (1,0) [0|3] ""  HUT
 SG_ ACC_PotentialTgtTyp : 307|3@0+ (1,0) [0|7] ""  HUT
 SG_ RollingCounter_ACC6 : 315|4@0+ (1,0) [0|15] ""  HUT
 SG_ Checksum_ACC7 : 327|8@0+ (1,0) [0|255] ""  HUT
 SG_ Request_driveoff : 383|3@0+ (1,0) [0|7] ""  HUT
 SG_ ACCSts : 380|1@0+ (1,0) [0|1] ""  HUT
 SG_ ACC_LeTgtDy : 335|8@0+ (0.1,-8) [-8|8] "m"  HUT
 SG_ ACC_LeTgtDx : 343|9@0+ (0.5,0) [0|150] "m"  HUT
 SG_ ACC_LeTgtTyp : 350|3@0+ (1,0) [0|7] ""  HUT
 SG_ ACC_LeTargrtDection : 347|2@0+ (1,0) [0|3] ""  HUT
 SG_ ACC_RiTargrtDetn : 345|2@0+ (1,0) [0|3] ""  HUT
 SG_ ACC_RiTgtDy : 359|8@0+ (0.1,-8) [-8|8] "m"  HUT
 SG_ ACC_RiTgtDx : 367|9@0+ (0.5,0) [0|150] "m"  HUT
 SG_ ACC_RiTgtTyp : 374|3@0+ (1,0) [0|7] ""  HUT
 SG_ RollingCounter_ACC7 : 379|4@0+ (1,0) [0|15] ""  HUT
 SG_ FreshnessValue_ACC_FD2 : 455|16@0+ (1,0) [0|65535] ""  HUT
 SG_ MAC_Check_ACC_FD2 : 471|48@0+ (1,0) [0|281474976710655] ""  HUT
 SG_ ACC_RlvTgtfusion : 399|1@0+ (1,0) [0|1] ""  HUT
 SG_ ACC_RlvTgtHeading : 398|6@0+ (0.05,-1.5) [-1.5|1.5] "rad"  HUT
 SG_ ACC_LeTgtfusion : 392|1@0+ (1,0) [0|1] ""  HUT
 SG_ ACC_LeTgtHeading : 407|6@0+ (0.05,-1.5) [-1.5|1.5] "rad"  HUT
 SG_ ACC_RiTgtfusion : 401|1@0+ (1,0) [0|1] ""  HUT
 SG_ ACC_RiTgtHeading : 415|6@0+ (0.05,-1.5) [-1.5|1.5] "rad"  HUT
 SG_ ACC_PotentialTgtfusion : 400|1@0+ (1,0) [0|1] ""  HUT
 SG_ ACC_PotentialTgtHeading : 409|6@0+ (0.05,-1.5) [-1.5|1.5] "rad"  HUT
 SG_ TargetCutinPro : 419|6@0+ (0.02,0) [0|1] ""  HUT
 SG_ TargetCutoutPro : 429|6@0+ (0.02,0) [0|1] ""  HUT
 SG_ Longctrl_WheelTrqReqActive_DVR : 116|1@0+ (1,0) [0|1] ""  HUT
 SG_ Longctrl_WheelTrqReq_DVR : 231|16@0+ (0.5,-16384) [-16384|16383.5] "NM"  HUT
 SG_ ACC_FD2_0x2AB : 0|448@1+ (1,0) [0|0] ""  HUT

BO_ 692 ACC_FD3: 64 GW
 SG_ JAPedObjExist : 47|6@0+ (0.015625,0) [0|0.984375] "%"  HUT
 SG_ AEBJAObjID : 79|8@0+ (1,0) [0|255] ""  HUT
 SG_ AEBJAObjExist : 87|6@0+ (0.015625,0) [0|0.984375] "%"  HUT
 SG_ JAPedObjID : 119|8@0+ (1,0) [0|255] ""  HUT
 SG_ AEBJAObjVideoCfmd : 81|1@0+ (1,0) [0|1] ""  HUT
 SG_ AEBJAObjVx : 95|12@0+ (0.0625,-128) [-128|127] "ms"  HUT
 SG_ AEBJAObjDx : 99|12@0+ (0.0625,0) [0|255.9375] "m"  HUT
 SG_ JAPedObjVideoCfmd : 80|1@0+ (1,0) [0|1] ""  HUT
 SG_ AEBJAObjState : 127|3@0+ (1,0) [0|7] ""  HUT
 SG_ AEBJAObjCntAlive : 143|12@0+ (17,0) [0|65535] ""  HUT
 SG_ AEBJAObjDy : 147|11@0+ (0.125,-128) [-128|127.875] "m"  HUT
 SG_ JAPedObjState : 191|3@0+ (1,0) [0|7] ""  HUT
 SG_ AEBJAObjObstcl : 152|5@0+ (0.03125,0) [0|0.96875] "%"  HUT
 SG_ AEBJAObjVy : 163|10@0+ (0.125,-64) [-64|63.875] "ms"  HUT
 SG_ AEBJAObjAx : 169|10@0+ (0.03125,-16) [-16|15.96875] "ms2"  HUT
 SG_ AEBJAObjAy : 207|10@0+ (0.03125,-16) [-16|15.96875] "ms2"  HUT
 SG_ JAPedObjObstcl : 213|5@0+ (0.03125,0) [0|0.96875] "%"  HUT
 SG_ JAPedObjDy : 223|11@0+ (0.125,-128) [-128|127.875] "m"  HUT
 SG_ JAPedObjDx : 228|12@0+ (0.0625,0) [0|255.9375] "m"  HUT
 SG_ FCWAEB_JATTC : 247|6@0+ (0.1,0) [0|6.3] "s"  HUT
 SG_ JAPedObjVx : 271|12@0+ (0.0625,-128) [-128|127] "ms"  HUT
 SG_ JAPedObjVy : 295|10@0+ (0.125,-64) [-64|63.875] "ms"  HUT
 SG_ JAPedObjAy : 301|10@0+ (0.03125,-16) [-16|15.96875] "ms2"  HUT
 SG_ JAPedObjCntAlive : 275|12@0+ (17,0) [0|65535] ""  HUT
 SG_ FCWAEB_longTTC : 365|6@0+ (0.1,0) [0|6.3] "s"  HUT
 SG_ FCWAEB_crossingTTC : 375|6@0+ (0.1,0) [0|6.3] "s"  HUT
 SG_ JAPedObjAx : 335|10@0+ (0.03125,-16) [-16|15.96875] "ms2"  HUT
 SG_ NOH_Sts : 355|4@0+ (1,0) [0|15] ""  HUT
 SG_ NOH_Swt_Resp : 368|1@0+ (1,0) [0|1] ""  HUT
 SG_ NOH_Act_Resp : 369|1@0+ (1,0) [0|1] ""  HUT
 SG_ NOH_SysInfoDisplay : 383|4@0+ (1,0) [0|15] ""  HUT
 SG_ NOH_DistToExit : 351|12@0+ (1,0) [0|4095] "m"  HUT
 SG_ ACC_FD3_0x2B4 : 0|512@1+ (1,0) [0|0] ""  HUT

BO_ 694 HUT26: 8 HUT
 SG_ PassSeatAdjmtSwt_HUT : 39|4@0+ (1,0) [0|15] ""  CEM
 SG_ SeatFlankAdjmtSwt_HUT : 55|3@0+ (1,0) [0|7] ""  CEM
 SG_ AVM_dispsts : 16|1@0+ (1,0) [0|1] ""  GW
 SG_ HUT26_0x2B6 : 0|64@1+ (1,0) [0|0] "" Vector__XXX

BO_ 696 ACC_FD4: 64 GW
 SG_ AEBObjID : 7|8@0+ (1,0) [0|255] ""  HUT
 SG_ AEBObjExist : 15|6@0+ (0.015625,0) [0|0.984375] "%"  HUT
 SG_ AEBObjVideoCfmd : 9|1@0+ (1,0) [0|1] ""  HUT
 SG_ AEBObjVx : 23|12@0+ (0.0625,-128) [-128|127] "ms"  HUT
 SG_ AEBObjDx : 27|12@0+ (0.0625,0) [0|255.9375] "m"  HUT
 SG_ AEBObjCntAlive : 47|12@0+ (1,0) [0|3855] ""  HUT
 SG_ AEBObjDy : 50|11@0+ (0.125,-128) [-128|127.875] "m"  HUT
 SG_ AEBObjState : 71|3@0+ (1,0) [0|7] ""  HUT
 SG_ AEBObjObstcl : 68|5@0+ (0.03125,0) [0|0.96875] "%"  HUT
 SG_ AEBObjVy : 79|10@0+ (0.125,-64) [-64|63.875] "ms"  HUT
 SG_ CyclistObjExist : 85|6@0+ (0.015625,0) [0|0.984375] "%"  HUT
 SG_ AEBObjAx : 95|10@0+ (0.03125,-16) [-16|15.96875] "ms2"  HUT
 SG_ AEBObjAy : 101|10@0+ (0.03125,-16) [-16|15.96875] "ms2"  HUT
 SG_ CyclistObjDx : 107|12@0+ (0.0625,0) [0|255.9375] "m"  HUT
 SG_ CyclistObjID : 127|8@0+ (1,0) [0|255] ""  HUT
 SG_ CyclistObjObstcl : 135|5@0+ (0.03125,0) [0|0.96875] "%"  HUT
 SG_ CyclistObjDy : 130|11@0+ (0.125,-128) [-128|127.875] "m"  HUT
 SG_ CyclistObjVx : 151|12@0+ (0.0625,-128) [-128|127] "ms"  HUT
 SG_ CyclistObjCntAlive : 155|12@0+ (1,0) [0|3855] ""  HUT
 SG_ CyclistObjVy : 175|10@0+ (0.125,-64) [-64|63.875] "ms"  HUT
 SG_ CyclistObjState : 181|3@0+ (1,0) [0|7] ""  HUT
 SG_ CyclistObjVideoCfmd : 178|1@0+ (1,0) [0|1] ""  HUT
 SG_ CyclistObjAx : 177|10@0+ (0.03125,-16) [-16|15.96875] "ms2"  HUT
 SG_ CyclistObjAy : 199|10@0+ (0.03125,-16) [-16|15.96875] "ms2"  HUT
 SG_ PedObjExist : 205|6@0+ (0.015625,0) [0|0.984375] "%"  HUT
 SG_ PedObjID : 215|8@0+ (1,0) [0|255] ""  HUT
 SG_ PedObjObstcl : 223|5@0+ (0.03125,0) [0|0.96875] "%"  HUT
 SG_ PedObjDy : 218|11@0+ (0.125,-128) [-128|127.875] "m"  HUT
 SG_ PedObjDx : 239|12@0+ (0.0625,0) [0|255.9375] "m"  HUT
 SG_ PedObjVx : 243|12@0+ (0.0625,-128) [-128|127] "ms"  HUT
 SG_ PedObjVy : 263|10@0+ (0.125,-64) [-64|63.875] "ms"  HUT
 SG_ PedObjVideoCfmd : 269|1@0+ (1,0) [0|1] ""  HUT
 SG_ ACCTgtObjDx : 267|12@0+ (0.0625,0) [0|255.9375] "m"  HUT
 SG_ PedObjAy : 287|10@0+ (0.03125,-16) [-16|15.96875] "ms2"  HUT
 SG_ PedObjCntAlive : 293|12@0+ (1,0) [0|3855] ""  HUT
 SG_ PedObjAx : 297|10@0+ (0.03125,-16) [-16|15.96875] "ms2"  HUT
 SG_ ACCTgtObjID : 319|8@0+ (1,0) [0|255] ""  HUT
 SG_ ACCTgtObjObstcl : 327|5@0+ (0.03125,0) [0|0.96875] "%"  HUT
 SG_ ACCTgtObjDy : 322|11@0+ (0.125,-128) [-128|127.875] "m"  HUT
 SG_ ACCTgtObjExist : 343|6@0+ (0.015625,0) [0|0.984375] "%"  HUT
 SG_ ACCTgtObjVy : 337|10@0+ (0.125,-64) [-64|63.875] "ms"  HUT
 SG_ ACCTgtObjVx : 359|12@0+ (0.0625,-128) [-128|127] "ms"  HUT
 SG_ ACCTgtObjAx : 363|10@0+ (0.03125,-16) [-16|15.96875] "ms2"  HUT
 SG_ ACCTgtObjAy : 369|10@0+ (0.03125,-16) [-16|15.96875] "ms2"  HUT
 SG_ ACCTgtObjState : 391|3@0+ (1,0) [0|7] ""  HUT
 SG_ ACCTgtObjVideoCfmd : 388|1@0+ (1,0) [0|1] ""  HUT
 SG_ ACCTgtObjCntAlive : 387|12@0+ (1,0) [0|3855] ""  HUT
 SG_ RadarHorMisalign : 407|12@0+ (0.0001,-0.2048) [-0.2048|0.2047] "rad"  HUT
 SG_ HandsoffDetd : 411|2@0+ (1,0) [0|3] ""  HUT
 SG_ DrvgOnHiWay : 409|2@0+ (1,0) [0|3] ""  HUT
 SG_ RoadCrvt : 423|10@0+ (0.00032,-0.16352) [-0.16352|0.16352] ""  HUT
 SG_ SpdLimitDst : 429|6@0+ (10,0) [0|600] "m"  HUT
 SG_ RoadCrvtFar : 439|10@0+ (0.00032,-0.16352) [-0.16352|0.16352] ""  HUT
 SG_ RampDst : 445|6@0+ (10,0) [0|600] "m"  HUT
 SG_ SpdLimit : 455|8@0+ (1,0) [0|255] ""  HUT
 SG_ CurveDst : 463|6@0+ (10,0) [0|600] "m"  HUT
 SG_ NavSpdLimUnit : 457|2@0+ (1,0) [0|3] ""  HUT
 SG_ TunnelDst : 471|6@0+ (10,0) [0|600] "m"  HUT
 SG_ DrvgOnRiLane : 465|2@0+ (1,0) [0|3] ""  HUT
 SG_ BrdgDst : 479|6@0+ (10,0) [0|600] "m"  HUT
 SG_ RadarDrvrAttentive : 473|1@0+ (1,0) [0|1] ""  HUT
 SG_ ACC_DataRecReq : 511|8@0+ (1,0) [0|255] ""  HUT
 SG_ ACC_SOSReq : 484|2@0+ (1,0) [0|3] ""  HUT,T_BOX
 SG_ PedObjState : 482|3@0+ (1,0) [0|7] ""  HUT
 SG_ MapDataValid : 495|1@0+ (1,0) [0|1] ""  HUT
 SG_ DrvrSts : 494|3@0+ (1,0) [0|7] ""  HUT
 SG_ AEBObjOverlap : 491|5@0+ (1,0) [0|31] ""  HUT
 SG_ AEBObjDrvby : 502|5@0+ (1,0) [0|31] ""  HUT
 SG_ ACC_FD4_0x2B8 : 0|512@1+ (1,0) [0|0] ""  HUT

BO_ 697 DWD1: 8 GW
 SG_ DWD_WorkSts : 15|2@0+ (1,0) [0|3] ""  HUT
 SG_ DWD_TextDisp : 13|5@0+ (1,0) [0|31] ""  HUT
 SG_ DWD_Dis : 23|4@0+ (1,0) [0|15] ""  HUT
 SG_ DWD_SoundIndcn : 19|2@0+ (1,0) [0|3] ""  HUT
 SG_ RSnsrFailSts : 8|1@0+ (1,0) [0|1] ""  HUT
 SG_ LSnsrFailSts : 17|1@0+ (1,0) [0|1] ""  HUT
 SG_ DWD1_0x2B9 : 0|64@1+ (1,0) [0|0] ""  HUT

BO_ 698 WPC1: 8 GW
 SG_ WPC_ChrgSts : 13|2@0+ (1,0) [0|3] ""  HUT
 SG_ WPC_SwtSts : 15|2@0+ (1,0) [0|3] ""  HUT
 SG_ WPC_FaultSts : 11|3@0+ (1,0) [0|7] ""  HUT
 SG_ WPC_PhoneReminder : 8|1@0+ (1,0) [0|1] ""  HUT
 SG_ WPC1_0x2BA : 0|64@1+ (1,0) [0|0] ""  HUT

CM_ SG_ 628 AutoAVMSwtSet_Sts "Auto Around view swtich set status,to HUT.";
CM_ SG_ 628 AVM_CurrSts "Used to indicate the current state of AVM.";
CM_ SG_ 628 GuidOvlSts "Show the current status of guidance overlay";
CM_ SG_ 628 FrntCamInpFailSts "Controller is failed to receive front camera video input.";
CM_ SG_ 628 RearCamInpFailSts "Controller is failed to receive rear camera video input.";
CM_ SG_ 628 LeCamInpFailSts "Controller is failed to receive left camera video input.";
CM_ SG_ 628 RiCamInpFailSts "Controller is failed to receive right camera video input.";
CM_ SG_ 628 EolNotCmpltd "Used to check whether EOL is completed.";
CM_ SG_ 628 OvlOpFailSts "Overlay could not operate normally. The corresponding buttons shall be shown as grey.";
CM_ SG_ 628 LaneCalSts "Used to indicate the current state of
Calibration.";
CM_ SG_ 628 RadarDispSts "Show the current Display status of Radar";
CM_ SG_ 628 LaneCalFltSts "Used to indicate the Fault-code of Lane
Calibration";
CM_ SG_ 628 AutoViewChgFuncSts "Used to indicate the function state of AutoChangeView";
CM_ SG_ 628 CarMdlTrsprcySts "Car Model Transparency Status";
CM_ SG_ 628 CarMdlDispSts "Indicate the 2D3D display mode status";
CM_ SG_ 628 CurrCalResultSts "Used to indicate  the current Calbrtion Result AVM Using";
CM_ SG_ 628 MdlColrSts "Used to indicate the model color";
CM_ SG_ 628 SigViewIndcn "Single View Indication, used to indicate the current single view.";
CM_ SG_ 628 HAP_DispCmd "HAP display command";
CM_ SG_ 628 AVM_3DAngSts "Horizontal angle state of 3D view";
CM_ SG_ 628 MOD_WorkSts "MOD function work status";
CM_ SG_ 628 MOD_AlarmSts "MOD function alarm status";
CM_ SG_ 628 DVRWorkSts "DVR work status";
CM_ SG_ 628 HAP_Hmi_Index "Indicate the current HMI index of AVM.";
CM_ SG_ 636 RearInCarTemp "Rear Air Conditioning Cabin TemperatureÃ¯Â¼ÂˆDriver sideÃ¯Â¼Â‰";
CM_ SG_ 636 ACRLTemp_ATC "AC Rear Left Temperature";
CM_ SG_ 639 CheckSum_IP2 "Use the checksum strategy from document Ã¢Â€ÂœEnd-to-End Communication Protection SpecificationÃ¢Â€Â";
CM_ SG_ 639 IP_DrvSeatBeltWarnLmpFailSts "Driver Seat Belt  warning lamp failure statusBD2-CAN To:ABM";
CM_ SG_ 639 IP_PassSeatBeltWarnLmpFailSts "Passenger  Seat Belt warning lamp failure statusBD2-CAN To:ABM";
CM_ SG_ 639 IP_VehTotDistance "Vehicle total distanceBD1-CAN To:CSA,ESCL,WPC,AC,BLE
BD2-CAN To:ABM,HUD,AMP,PPMI_D,PPMI_P,SBWM,SVM,ELD,TOD
PT_CAN To:ESP,TCU,Ibooster,EDC,EPS,ECM
ADAS-CANFD To:IFC,RSDS_R,RSDS_L,HAP,PAS,RPAS,CR_L,CR_R,ALS,IDC_L2
HC_CAN:To DCDC,BSG,BMS
BD_Sub_CAN:To DDCM,PDCM,DSC,HVSM,CP,RHVSM";
CM_ SG_ 639 IP_VehTotDistanceValid "Vaild information to current Vehicle travelled total distanceBD1-CAN To:CSA,ESCL,WPC,AC,BLE
BD2-CAN To:HUD,AMP,SBWM,SVM,TOD
PT_CAN To:ESP,TCU,Ibooster,EDC,EPS,ECM
ADAS-CANFD To:IFC,RSDS_R,RSDS_L,HAP,PAS,RPAS,CR_L,CR_R,ALS,IDC_L2
HC_CAN:To DCDC,BSG,BMS
BD_Sub_CAN:To DDCM,PDCM,DSC,HVSM,CP,RHVSM";
CM_ SG_ 639 IP_FuelLvlInfo "Fuel Level Information.PT_CAN:To ECM";
CM_ SG_ 639 IP_FuelLvlLowLmpSts "Fuel Level Low indication lamp ON or OFF status.";
CM_ SG_ 639 IP_BattChrgLmpSts "Indicate Battery charging  lamp ON or OFF status.";
CM_ SG_ 639 IP_EngOilPressLowLmpSts "Engine Oil pressure Low indication lamp status..";
CM_ SG_ 639 IP_ABMWarnLmpFailrSts "Airbag warning lamp failure statusBD2-CAN To:ABM";
CM_ SG_ 639 IP_Err "Error in the IP control unit or the dashboardADAS-CANFD To:IFC,IDC_L2";
CM_ SG_ 639 IP_ACCErr "IP Check ACC error(Checksum,RollingCounter,Missing message)status,if any error were detected by IP will send this signalADAS-CANFD To:IFC,IDC_L2";
CM_ SG_ 639 IP_VehSpdUnit "Indicate the vehicle speed unit used by IP.PT_CAN To:ECM,TCU
ADAS-CANFD To:IFC,IDC_L2";
CM_ SG_ 639 IP_VINcompr "IP compare inner VIN with VIN ECM sendPT_CAN To:ECM";
CM_ SG_ 639 RollingCounter_IP2 "Rolling counter_IP2PT_CAN To:TCU,Ibooster";
CM_ SG_ 639 FreshnessValue_IP2 "ADAS-CANFD To:IDC_L2
PT_CAN:To TCU,EPS";
CM_ SG_ 639 MAC_Check_IP2 "MAC protection mechanism should comply with the GWM MAC SpecificatioADAS-CANFD To:IDC_L2
PT_CAN:To TCU,EPS";
CM_ SG_ 647 CheckSum_HC1 "Use the checksum strategy from document Ã¢Â€ÂœEnd-to-End Communication Protection SpecificationÃ¢Â€Â";
CM_ SG_ 647 ALS_FailSts "ALS failure status";
CM_ SG_ 647 RollingCounter_HC1 "Rolling counter_HC1";
CM_ SG_ 649 HAP_RtCam_WorkSts "Current work status of  HAP right camera";
CM_ SG_ 649 HAP_RtSide_Obj1_ID "ID of the Target obstacle on the right side of vehicle";
CM_ SG_ 649 HAP_RtSide_Obj1_type "OD_type";
CM_ SG_ 649 HAP_RtSide_Obj1_Confidence "Confidence of the Target obstacle";
CM_ SG_ 649 HAP_RtSide_Obj1_Ground_Pos_X "X-Axis Position of the Target obstacle";
CM_ SG_ 649 HAP_RtSide_Obj1_Ground_Pos_Y "Y-Axis Position of the Target obstacle";
CM_ SG_ 649 HAP_RtSide_Obj2_ID "ID of theTarget obstacle on the right side of vehicle";
CM_ SG_ 649 HAP_RtSide_Obj2_type "OD_type";
CM_ SG_ 649 HAP_RtSide_Obj2_Confidence "Confidence of the Target obstacle";
CM_ SG_ 649 HAP_RtSide_Obj2_Ground_Pos_X "X-Axis Position of the Target obstacle";
CM_ SG_ 649 HAP_RtSide_Obj2_Ground_Pos_Y "Y-Axis Position of the Target obstacle";
CM_ SG_ 649 HAP_RtSide_Obj3_ID "ID of theTarget obstacle on the right side of vehicle";
CM_ SG_ 649 HAP_RtSide_Obj3_type "OD_type";
CM_ SG_ 649 HAP_RtSide_Obj3_Confidence "Confidence of the Target obstacle";
CM_ SG_ 649 HAP_RtSide_Obj3_Ground_Pos_X "X-Axis Position of the Target obstacle";
CM_ SG_ 649 HAP_RtSide_Obj3_Ground_Pos_Y "Y-Axis Position of the Target obstacle";
CM_ SG_ 649 HAP_RtSide_Obj4_ID "ID of theTarget obstacle on the right side of vehicle";
CM_ SG_ 649 HAP_RtSide_Obj4_type "OD_type";
CM_ SG_ 649 HAP_RtSide_Obj4_Confidence "Confidence of the Target obstacle";
CM_ SG_ 649 HAP_RtSide_Obj4_Ground_Pos_X "X-Axis Position of the Target obstacle";
CM_ SG_ 649 HAP_RtSide_Obj4_Ground_Pos_Y "Y-Axis Position of the Target obstacle";
CM_ SG_ 649 USS_FLSide1_Status "USS(on the front left side) Working Status";
CM_ SG_ 649 USS_FLSide1_Dist "Distance of detecting the target on the front left side";
CM_ SG_ 649 USS_RLSide2_Status "USS(on the rear left side) Working Status";
CM_ SG_ 649 USS_RLSide2_Dist "Distance of detecting the target on the rear left side";
CM_ SG_ 649 USS_FRSide1_Status "USS(on the front right side) Working Status";
CM_ SG_ 649 USS_FRSide1_Dist "Distance of detecting the target on the front right side";
CM_ SG_ 649 USS_RRSide2_Status "USS(on the rear right side) Working Status";
CM_ SG_ 649 USS_RRSide2_Dist "Distance of detecting the target on the rear right side";
CM_ SG_ 653 SecRowLeSeatVentSts "Left ventilation status of the second row";
CM_ SG_ 653 SecRowRiSeatVentSts "Right ventilation status of the second row";
CM_ SG_ 656 EngOilLvl "Engine oil level";
CM_ SG_ 656 FTIVFault "Fuel Tank Isolation Valve Fault.IP";
CM_ SG_ 656 FuelTankCapWarning "Fuel tank cap do not colse warning.IP";
CM_ SG_ 656 PressReliProgs "PressReliProgsIP";
CM_ SG_ 659 IP_CurrTheme "Indicate the current theme by IP.The coding detailed definition IFCACCording to specific project";
CM_ SG_ 659 IP_VehSpdDisp "The vehilce speed display by IPADAS_CAN:To IFC,IDC_L2";
CM_ SG_ 659 IP_VelSpdDisp_Mile "The vehicle speed display by IP(Mile)ADAS_CAN:To IFC,IDC_L2";
CM_ SG_ 659 IP_FuelMainTankR "IP external main fuel tank resistance valuePT_CAN To:ECM";
CM_ SG_ 659 IP_FuelAuxTankR "IP external auxiliary fuel tank resistance valuePT_CAN To:ECM";
CM_ SG_ 659 IP_LagueSet "Language set";
CM_ SG_ 661 SysPowerMod "System power modeIP Received";
CM_ SG_ 661 SysPowerModVld "System power mode valid";
CM_ SG_ 661 PEPS_PowerRlyOutpSts "PEPS Power Relay Output status, 3 bits indicate 3 PEPS Power Relay Output Status, 0 means the output enable, 1 means no output. Bit0 for ACC, Bit1 for IGN2, Bit2 For IGN1.
Ã§Â³Â»Ã§Â»ÂŸÃ§Â”ÂµÃ¦ÂºÂÃ§Â»Â§Ã§Â”ÂµÃ¥Â™Â¨Ã¥ÂÂÃ©Â¦ÂˆÃ§ÂŠÂ¶Ã¦Â€ÂÃ¤Â¿Â¡Ã¥ÂÂ·Sub_CAN:To HUD";
CM_ SG_ 661 RemPowerFailureSts "Remote power failure status";
CM_ SG_ 661 RemUpgrdModSysPower "Remote upgrade system power mode";
CM_ SG_ 664 RPAS_NearBrrdstn "RPAS nearest barrier distance";
CM_ SG_ 664 HAVP_ProcRa "Vehicle B area display route Generation Progress Bar";
CM_ SG_ 664 P2P_ProcBar "P2P Process bar";
CM_ SG_ 664 APS_ObjRiSideAr1 "Right side sensor detect area1";
CM_ SG_ 664 APS_ObjRiSideAr2 "Right side sensor detect area2";
CM_ SG_ 664 APS_ObjRiSideAr3 "Right side sensor detect area3";
CM_ SG_ 664 APS_ObjRiSideAr4 "Right side sensor detect area4";
CM_ SG_ 664 APS_ObjRiSideAr5 "Right side sensor detect area5";
CM_ SG_ 664 APS_ObjLeSideAr1 "Left side sensor detect area1";
CM_ SG_ 664 APS_ObjLeSideAr2 "Left side sensor detect area2";
CM_ SG_ 664 APS_ObjLeSideAr3 "Left side sensor detect area3";
CM_ SG_ 664 APS_ObjLeSideAr4 "Left side sensor detect area4";
CM_ SG_ 664 APS_ObjLeSideAr5 "Left side sensor detect area5";
CM_ SG_ 664 APS_FRSideSnsrFailSts "Fail status of the Front Right Side sensorIP Received";
CM_ SG_ 664 APS_FLSideSnsrFailSts "Fail status of the Front Left Sid sensorIP Received";
CM_ SG_ 664 APS_RRSideSnsrFailSts "Fail status of the Rear Right Side sensorIP Received";
CM_ SG_ 664 APS_RLSideSnsrFailSts "Fault status of the Rear Left Side sensorIP Received";
CM_ SG_ 664 SDW_SoundIndcn "Side Distance Warning Sound IndicationIP Received";
CM_ SG_ 664 SDWActiveSts "Side Distance Warning Function Active StatusIP Received";
CM_ SG_ 664 RPAS_ObjRRCornrAr1 "Rear right Corner sensor detect area1";
CM_ SG_ 664 RPAS_ObjRRCornrAr2 "Rear right Corner sensor detect area2";
CM_ SG_ 664 RPAS_ObjRRMidlAr1 "Rear right middle sensor detect area1";
CM_ SG_ 664 RPAS_ObjRRMidlAr2 "Rear right middle sensor detect area2";
CM_ SG_ 664 RPAS_ObjRLMidlAr1 "Rear left middle sensor detect area1";
CM_ SG_ 664 RPAS_ObjRLMidlAr2 "Rear left middle sensor detect area2";
CM_ SG_ 664 RPAS_ObjRLCornrAr1 "Rear left Corner sensor detect area1";
CM_ SG_ 664 RPAS_ObjRLCornrAr2 "Rear left Corner sensor detect area2";
CM_ SG_ 664 RPAS_RLCornrSnsrFailSts "fail status of the Rear Left Corner sensor";
CM_ SG_ 664 RPAS_RLMiddlSnsrFailSts "fail status of the Rear Left Middle  sensor";
CM_ SG_ 664 RPAS_RRMiddlSnsrFailSts "fail status of the Rear Right Middle sensor";
CM_ SG_ 664 RPAS_RRCornrSnsrFailSts "fail status of the Rear Right Corner sensor";
CM_ SG_ 664 RPAS_WorkSts "Rear Park Assistant System work StatusIP Received";
CM_ SG_ 664 RPAS_SoundIndcn "Rear Park Assistant System Sound IndicationIP Received";
CM_ SG_ 664 MEBWorkSts "RPAS MEB Work Status";
CM_ SG_ 664 MEB_EnableSts "MEB Enable Status";
CM_ SG_ 664 FPAS_ObjFLCornrAr1 "Front left Corner sensor detect area1";
CM_ SG_ 664 FPAS_ObjFLCornrAr2 "Front left Corner sensor detect area2";
CM_ SG_ 664 FPAS_ObjFLMidlAr1 "Front left middle sensor detect area1";
CM_ SG_ 664 FPAS_ObjFLMidlAr2 "Front left middle sensor detect area2";
CM_ SG_ 664 FPAS_ObjFRMidlAr1 "Front right middle sensor detect area1";
CM_ SG_ 664 FPAS_ObjFRMidlAr2 "Front right middle area2";
CM_ SG_ 664 FPAS_ObjFRCornrAr1 "Front right Corner sensor detect area1";
CM_ SG_ 664 FPAS_ObjFRCornrAr2 "Front right Corner sensor detect area2";
CM_ SG_ 664 FPAS_FLCornrSnsrFailSts "Fail status of the Front Left Corner sensor";
CM_ SG_ 664 FPAS_FLMiddlSnsrFailSts "Fail status of the Front Left Middle  sensor";
CM_ SG_ 664 FPAS_FRMiddlSnsrFailSts "Fail status of the Front Right Middle sensor";
CM_ SG_ 664 FPAS_FRCornrSnsrFailSts "Fail status of the Front Right Corner sensor";
CM_ SG_ 664 FPAS_WorkSts "Park Assistant Front System StatusIP Received";
CM_ SG_ 664 FPAS_AutoModSts "Park Assistant Front System AutoStategy Status";
CM_ SG_ 664 FPAS_SoundIndcn "Front Park Assistant System Sound IndicationIP Received";
CM_ SG_ 664 FPAS_NearBrrdstn "FPAS nearest barrier distance";
CM_ SG_ 664 APA_MenuDispCtrlCmd "APA menu display mode control command (area A)";
CM_ SG_ 664 APA_FuncSts "APA Function status";
CM_ SG_ 664 RADS_FuncSts "Reverse Asist Function status";
CM_ SG_ 664 FADS_FuncSts "Front Asist Function status";
CM_ SG_ 664 HAP_TextIconDispCtrl "Control display method of small icon beside text box";
CM_ SG_ 664 P2P_FuncSts "P2P Function status";
CM_ SG_ 664 FrntCamDirtySts "Ã¥Â‰ÂÃ§ÂŽÂ¯Ã¨Â§Â†Ã¦Â‘Â„Ã¥ÂƒÂÃ¥Â¤Â´Ã¨Â„ÂÃ¦Â±Â¡Ã§ÂŠÂ¶Ã¦Â€Â";
CM_ SG_ 664 RearCamDirtySts "Ã¥ÂÂŽÃ§ÂŽÂ¯Ã¨Â§Â†Ã¦Â‘Â„Ã¥ÂƒÂÃ¥Â¤Â´Ã¨Â„ÂÃ¦Â±Â¡Ã§ÂŠÂ¶Ã¦Â€Â";
CM_ SG_ 664 LeCamDirtySts "Ã¥Â·Â¦Ã§ÂŽÂ¯Ã¨Â§Â†Ã¦Â‘Â„Ã¥ÂƒÂÃ¥Â¤Â´Ã¨Â„ÂÃ¦Â±Â¡Ã§ÂŠÂ¶Ã¦Â€Â";
CM_ SG_ 664 RiCamDirtySts "Ã¥ÂÂ³Ã§ÂŽÂ¯Ã¨Â§Â†Ã¦Â‘Â„Ã¥ÂƒÂÃ¥Â¤Â´Ã¨Â„ÂÃ¦Â±Â¡Ã§ÂŠÂ¶Ã¦Â€Â";
CM_ SG_ 664 DVRCamDirtySts "DVRÃ¦Â‘Â„Ã¥ÂƒÂÃ¥Â¤Â´Ã¨Â„ÂÃ¦Â±Â¡Ã§ÂŠÂ¶Ã¦Â€Â";
CM_ SG_ 665 FGA_Chan1LongTyp "Fragrance channel 1 Long spice type";
CM_ SG_ 665 FGA_Chan2LongTyp "Fragrance channel 2 Long spice type";
CM_ SG_ 665 FGA_Chan3LongTyp "Fragrance channel 3 Long spice type";
CM_ SG_ 667 HAVP_LrngDst "Learning distance calculated by HAVP controllerÃ¦Â­Â£Ã¥ÂœÂ¨Ã¥Â­Â¦Ã¤Â¹Â Ã§ÂšÂ„Ã¨Â·Â¯Ã§ÂºÂ¿Ã¨Â·ÂÃ§Â¦Â»";
CM_ SG_ 667 HAVP_HUT_TextDisp "HAVP text display on HUTÃ¨Â®Â°Ã¥Â¿Â†Ã¦Â³ÂŠÃ¨Â½Â¦Ã¨Â½Â¦Ã¦ÂœÂºÃ§Â«Â¯Ã¦Â–Â‡Ã¥Â­Â—Ã¦ÂÂÃ§Â¤Âº";
CM_ SG_ 667 HAVP_ScFail_info "HAVP selfcheck failed reason
Ã¨Â‡ÂªÃ¦Â£Â€Ã¥Â¤Â±Ã¨Â´Â¥Ã¥Â…Â·Ã¤Â½Â“Ã¥ÂŽÂŸÃ¥Â›Â Ã¯Â¼ÂˆÃ¨Â‡ÂªÃ¥Â·Â±Ã¨Â°ÂƒÃ¨Â¯Â•Ã§Â”Â¨Ã¯Â¼ÂŒÃ¥Â…Â³Ã¨ÂÂ”Ã¤Â»Â¶Ã¤Â¸ÂÃ¦ÂŽÂ¥Ã¦Â”Â¶Ã¯Â¼Â‰";
CM_ SG_ 667 PAVP_ScFail_info "PAVP Selfcheck signal PAVPÃ¨Â‡ÂªÃ¦Â£Â€Ã§ÂŠÂ¶Ã¦Â€ÂÃ¯Â¼Â›";
CM_ SG_ 669 InCarTemp "Air Conditioning Cabin TemperatureÃ¯Â¼ÂˆDriver sideÃ¯Â¼Â‰";
CM_ SG_ 669 ACAQSEnaSts "AQS(air quality sensorÃ¯Â¼Â‰enable Status";
CM_ SG_ 669 ACOperMod "AC operation mode";
CM_ SG_ 669 ACAIUEnaSts "Air Ionizer Unit enable Status";
CM_ SG_ 669 ACDrvAirDistriMod "Driver Air Distribution Mode";
CM_ SG_ 669 ACSteplessSpdSetEnaSts "Blower Stepless Speed Set enable status";
CM_ SG_ 669 ACFrntPassTempSteplessSetEnaSts "Front passenger side Temperature Stepless Set enable status";
CM_ SG_ 669 ACDrvTempSteplessSetEnaSts "Drive side Temperature Stepless Set enable status";
CM_ SG_ 669 ACEEMSts "AC EEM status";
CM_ SG_ 669 ACCbnClnEnasts "Cabin(incar) clean enable status";
CM_ SG_ 669 ACCbnClnOffCode "Cabin(incar) clean off code";
CM_ SG_ 671 RemoteModSts "Remote mode status.IP Received";
CM_ SG_ 671 PASWorkCmd "PAS Work commandIP Received";
CM_ SG_ 671 KL30BRelaySts "KL30B Relay status.IP Received";
CM_ SG_ 671 RViewMirrorSts "Rear View Mirror FoldUnfold Status";
CM_ SG_ 671 WiprReq_F_PBox "Front windshield wiper operation request.";
CM_ SG_ 671 DrivingModReq "Driving mode request";
CM_ SG_ 671 WhistleSts "The state of the whistle signal.";
CM_ SG_ 675 DrvSeatHeatSts_Nine "The driver side seat heating statusSC-CANFD:To HUT,T_Box";
CM_ SG_ 675 PassSeatHeatSts_Nine "The passenger side seat heating statusSC-CANFD:To HUT,T_Box";
CM_ SG_ 675 SecRowLeSeatHeatSts_Nine "Rear Left Passenger Seat Heating Status9 levelSC-CANFD:To HUT,T_Box";
CM_ SG_ 675 SecRowRiSeatHeatSts_Nine "Rear Right Passenger Seat Heating Status9 levelSC-CANFD:To HUT,T_Box";
CM_ SG_ 680 TranPMode_Sts "Transport Mode statusIP Received
IFCom message EEM1";
CM_ SG_ 680 Stat_PwrSv_Lvl "Static Power save levelIP Received
IFCom message EEM1";
CM_ SG_ 680 Dyn_PwrSv_Lvl "dynamic Power save levelIP Received
IFCom message EEM1";
CM_ SG_ 680 LvPwrSysErr "LV power system errorIP Received
IFCom message EEM1";
CM_ SG_ 680 DeepSlpCmd "Deep sleep commendIFCom message EEM1";
CM_ SG_ 683 ACC_LeTgt_02_Dy "Lateral distance of the second target in left lane";
CM_ SG_ 683 ACC_LeTgt_02_Dx "Longitudinal distance of the second target in left lane";
CM_ SG_ 683 ACC_LeTgt_02_Typ "Type of the second target in left lane";
CM_ SG_ 683 ACC_LeTargrt_02_Detn "Detection of the second target in left lane";
CM_ SG_ 683 ACC_RiTargrt_02_Detn "Detection of the second target in rignt lane";
CM_ SG_ 683 ACC_RiTgt_02_Dy "Lateral distance of the second target in rignt lane";
CM_ SG_ 683 ACC_RiTgt_02_Dx "Longitudinal distance of the second target in right lane";
CM_ SG_ 683 ACC_RiTgt_02_Typ "Type of the second target in right lane";
CM_ SG_ 683 ACC_LeTgtObjBarDisp "Disply distance to the left target object in AR_HUD";
CM_ SG_ 683 ACC_RiTgtObjBarDisp "Disply distance to the right target object in AR_HUD";
CM_ SG_ 683 Checksum_ACC3 "Use the checksum strategy from document Ã¢Â€ÂœEnd-to-End Communication Protection SpecificationÃ¢Â€Â";
CM_ SG_ 683 ICA_HandsOffResp "Indicate ICA HandsOff Function switch status";
CM_ SG_ 683 ALC_Resp "Indicate Switch  of ALCÃ¯Â¼ÂˆAutomatic lane change assistanceÃ¯Â¼Â‰ switch statusIP Received";
CM_ SG_ 683 HWA_Resp "Indicate Switch  of HWA switch statusIP Received";
CM_ SG_ 683 ISL_Resp "Indicate ISL(Intelligent Speed Limit) switch status";
CM_ SG_ 683 HWA_SnvtySet_Resp "Indicate HWA Change track remind sensibility";
CM_ SG_ 683 Longctrl_VehHldReq_DVR "ACC request ESPÃ‚Â Ã‚Â hold vehicle";
CM_ SG_ 683 Longctrl_DrvOFF_Req_DVR "ACC request ESP(CDD-S) drive off";
CM_ SG_ 683 Longctrl_ModSts_DVR "The status of the Longctrl control unit.
The Longctrl mode should be contained in every message sent by Longctrl.";
CM_ SG_ 683 Longctrl_Decel_Req_DVR "Status of the deceleration request from ACC";
CM_ SG_ 683 Longctrl_EngTrqReq_DVR "Vehilce longitudinal control function Engine torque request";
CM_ SG_ 683 Longctrl_EngTrqReqActive_DVR "Vehilce longitudinal control function Engine torque request active";
CM_ SG_ 683 Longctrl_DecelToStopReq_DVR "The ACC request ESPVLC to decelerate untill standstill.";
CM_ SG_ 683 Longctrl_ParkShiftReq_DVR "ACC Request Park Shift";
CM_ SG_ 683 Longctrl_Decel_ReqValue_DVR "ACC deceleration request from ACC";
CM_ SG_ 683 ALC_InterSysInfoDisp "Automatic Lane Change";
CM_ SG_ 683 RollingCounter_ACC3 "RollingCounter_ACC3";
CM_ SG_ 683 Checksum_ACC4 "Use the checksum strategy from document Ã¢Â€ÂœEnd-to-End Communication Protection SpecificationÃ¢Â€Â";
CM_ SG_ 683 ACC_ObjDetecte "An ahead target object detected by ACC, to inform the driver.IP Received";
CM_ SG_ 683 ACC_TakeOverReq "The limits of the ACC control reaches, driver should take over.IP Received";
CM_ SG_ 683 ACC_InterSysInfoDisp "Provides driver for  text reminder informations of ACC functionIP Received";
CM_ SG_ 683 ACC_ModDisp "The status of the ACC control unit.IP Received";
CM_ SG_ 683 ACC_FctSts "Indicate ACC fuction system working statusIP Received";
CM_ SG_ 683 ACC_TgtObjBarDisp "Disply distance to the ahead target object in case of \"mid-end\" HMI.IP Received";
CM_ SG_ 683 Longctrl_HazActv "Indicate the hazard brake will be actived";
CM_ SG_ 683 TJA_ACC_SelSts "Indicate select status of TJAACC function swicthIP Received";
CM_ SG_ 683 CruCha_ModDisp "Cruise Chauffer StatusIP Received";
CM_ SG_ 683 TJA_ICA_InterSysInfoDisp "Provides driver for  text reminder informations of TJAICA functionIP Received";
CM_ SG_ 683 TJA_ICA_ModDisp "provides driver for  text reminder informations of TJAICA functionIP Received";
CM_ SG_ 683 ISL_InterSysInfoDisp "Provides driver for  text reminder informations of ISL(Intelligent Speed limit) functionIP Received";
CM_ SG_ 683 ACC_TimeGapSet "The set timeGap from driver, should be displayed to driver and if the set value changes.IP Received";
CM_ SG_ 683 ACC_SpdSetValue "The set speed from driver, should be available as long as ACC is active.IP Received";
CM_ SG_ 683 CruChar_InterSysInfoDisp "Provides driver for  text reminder informations of Cruise Chauffer functionIP Received";
CM_ SG_ 683 RollingCounter_ACC4 "RollingCounter_ACC4";
CM_ SG_ 683 Checksum_ACC8 "Use the checksum strategy from document Ã¢Â€ÂœEnd-to-End Communication Protection SpecificationÃ¢Â€Â";
CM_ SG_ 683 HWA_ModDisp "show the status of HWAIP Received";
CM_ SG_ 683 HWA_InterSysInfoDisp "Provides driver for  text reminder informations of HWA functionIP Received";
CM_ SG_ 683 HWA_LaneChange "Lane changingIP Received";
CM_ SG_ 683 HWA_LaneChangeReq "Lane change is availableIP Received";
CM_ SG_ 683 HWA_Warning "HWA  different level warningIP Received";
CM_ SG_ 683 RollingCounter_ACC8 "RollingCounter_ACC8";
CM_ SG_ 683 Checksum_ACC6 "Use the checksum strategy from document Ã¢Â€ÂœEnd-to-End Communication Protection SpecificationÃ¢Â€Â";
CM_ SG_ 683 ACC_PotentialTgtDy "Lateral distance of potential target in this laneIP Received";
CM_ SG_ 683 ACC_PotentialTgtDx "Longitudinal distance of potential target in this laneIP Received";
CM_ SG_ 683 ACC_RlvTgtDetn "Effective target detection.IP Received";
CM_ SG_ 683 ACC_EgoStatus "Status of ego vehicleIP Received";
CM_ SG_ 683 ACC_RlvTgtTyp "Types of effective targets in this laneIP Received";
CM_ SG_ 683 ACC_RlvTgtDy "Lateral distance of effective target in this laneIP Received";
CM_ SG_ 683 ACC_RlvTgtDx "Longitudinal distance of effective target in this laneIP Received";
CM_ SG_ 683 ACC_PotentialTgtDetn "Detection of potential targets in this laneIP Received";
CM_ SG_ 683 ACC_PotentialTgtTyp "Types of potential targets in this laneIP Received";
CM_ SG_ 683 RollingCounter_ACC6 "RollingCounter_ACC6";
CM_ SG_ 683 Checksum_ACC7 "Use the checksum strategy from document Ã¢Â€ÂœEnd-to-End Communication Protection SpecificationÃ¢Â€Â";
CM_ SG_ 683 Request_driveoff "Request driver drive off";
CM_ SG_ 683 ACCSts "show the status of ACC";
CM_ SG_ 683 ACC_LeTgtDy "Lateral distance of the nearest target in left laneIP Received";
CM_ SG_ 683 ACC_LeTgtDx "Longitudinal distance of the nearest target in left laneIP Received";
CM_ SG_ 683 ACC_LeTgtTyp "Type of the nearest target in left laneIP Received";
CM_ SG_ 683 ACC_LeTargrtDection "Detection of the nearest target in left laneIP Received";
CM_ SG_ 683 ACC_RiTargrtDetn "Detection of the nearest target in rignt laneIP Received";
CM_ SG_ 683 ACC_RiTgtDy "Lateral distance of the nearest target in rignt laneIP Received";
CM_ SG_ 683 ACC_RiTgtDx "Longitudinal distance of the nearest target in right laneIP Received";
CM_ SG_ 683 ACC_RiTgtTyp "Type of the nearest target in right laneIP Received";
CM_ SG_ 683 RollingCounter_ACC7 "RollingCounter_ACC7";
CM_ SG_ 683 MAC_Check_ACC_FD2 "MAC protection mechanism should comply with the GWM MAC Specificatio";
CM_ SG_ 683 ACC_RlvTgtfusion "fusion flag of  effective target in this lane";
CM_ SG_ 683 ACC_RlvTgtHeading "the heading angle of effective target in this lane";
CM_ SG_ 683 ACC_LeTgtfusion "fusion flag of the nearest target in left lane";
CM_ SG_ 683 ACC_LeTgtHeading "the heading angle of the nearest target in left lane";
CM_ SG_ 683 ACC_RiTgtfusion "fusion flag of the nearest target in right lane";
CM_ SG_ 683 ACC_RiTgtHeading "the heading angle of the nearest target in right lane";
CM_ SG_ 683 ACC_PotentialTgtfusion "fusion flag of potential target in this lane";
CM_ SG_ 683 ACC_PotentialTgtHeading "the heading angle of potential target in this lane";
CM_ SG_ 683 TargetCutinPro "Possibility of target cutting in";
CM_ SG_ 683 TargetCutoutPro "Possibility of target cutting out";
CM_ SG_ 683 Longctrl_WheelTrqReqActive_DVR "Vehilce longitudinal control function HCU torque request active";
CM_ SG_ 683 Longctrl_WheelTrqReq_DVR "Vehilce longitudinal control function HCU torque request at wheel level.";
CM_ SG_ 692 JAPedObjExist "The possibility of Pedestrian objecttive existence";
CM_ SG_ 692 AEBJAObjID "AEBJA objecttive ID";
CM_ SG_ 692 AEBJAObjExist "The possibility of AEBJA objecttive existence";
CM_ SG_ 692 JAPedObjID "Pedestrian objective ID";
CM_ SG_ 692 AEBJAObjVideoCfmd "AEBJA objective and Video Camera Fusion";
CM_ SG_ 692 AEBJAObjVx "Longitudinal relative speed of the AEBJA objecttive with the ego vehicle";
CM_ SG_ 692 AEBJAObjDx "Longitudinal distance of the AEBJA objecttive with the ego vehicle";
CM_ SG_ 692 JAPedObjVideoCfmd "Pedestrian objective and Video Camera Fusion";
CM_ SG_ 692 AEBJAObjState "Indicate AEBJA objective Status";
CM_ SG_ 692 AEBJAObjCntAlive "Indicate the duration of the AEBJA objecttive";
CM_ SG_ 692 AEBJAObjDy "Lateral distance of the AEBJA objecttive with the ego vehicle";
CM_ SG_ 692 JAPedObjState "Pedestrian objective Status";
CM_ SG_ 692 AEBJAObjObstcl "AEBJA Target are the possibility of obstacles";
CM_ SG_ 692 AEBJAObjVy "Lateral relative speed of the AEBJA target vehicle with the ego vehicle";
CM_ SG_ 692 AEBJAObjAx "Longitudinal relative speed of the AEBJA target with the ego vehicle";
CM_ SG_ 692 AEBJAObjAy "Lateral ACCeleration of the AEBJA target with the ego vehicle";
CM_ SG_ 692 JAPedObjObstcl "Target Pedestrian are the possibility of obstacles";
CM_ SG_ 692 JAPedObjDy "Lateral distance of the target Pedestrian with the ego vehicle";
CM_ SG_ 692 JAPedObjDx "Longitudinal distance of the target Pedestrian with the ego vehicle";
CM_ SG_ 692 FCWAEB_JATTC "FCWAEB JA turn across TTC";
CM_ SG_ 692 JAPedObjVx "Longitudinal relative speed of the target Pedestrian with the ego vehicle";
CM_ SG_ 692 JAPedObjVy "Lateral relative speed of the Pedestrian objective with the ego vehicle";
CM_ SG_ 692 JAPedObjAy "Lateral ACCeleration of Pedestrian objective with ego vehicle";
CM_ SG_ 692 JAPedObjCntAlive "Indicate the duration of the Pedestrian objective's existence";
CM_ SG_ 692 FCWAEB_longTTC "FCWAEB longitude TTC(Time to collision)";
CM_ SG_ 692 FCWAEB_crossingTTC "FCWAEB crossing TTC";
CM_ SG_ 692 JAPedObjAx "Longitudinal ACCeleration of Pedestrian objective with ego vehicle";
CM_ SG_ 692 NOH_Sts "show the status of NOH";
CM_ SG_ 692 NOH_Swt_Resp "Indicate Switch  of NOH switch status";
CM_ SG_ 692 NOH_Act_Resp "Indicate Switch  of NOH activate status";
CM_ SG_ 692 NOH_SysInfoDisplay "Provides driver for  text reminder informations of NOH function";
CM_ SG_ 692 NOH_DistToExit "Distance to NOH Geo-Fence exit";
CM_ SG_ 694 PassSeatAdjmtSwt_HUT "Passenger seat adjustment switch by HUT";
CM_ SG_ 694 SeatFlankAdjmtSwt_HUT "Seat flank adjustment switch by HUT";
CM_ SG_ 694 AVM_dispsts "AVM Display StatusBD1_CAN:To DWD";
CM_ SG_ 696 AEBObjID "AEB objecttive ID";
CM_ SG_ 696 AEBObjExist "The possibility of AEB objecttive existence";
CM_ SG_ 696 AEBObjVideoCfmd "AEB objective and Video Camera Fusion";
CM_ SG_ 696 AEBObjVx "Longitudinal relative speed of the AEB objecttive with the ego vehicle";
CM_ SG_ 696 AEBObjDx "Longitudinal distance of the AEB objecttive with the ego vehicle";
CM_ SG_ 696 AEBObjCntAlive "Indicate the duration of the AEB objecttive";
CM_ SG_ 696 AEBObjDy "Lateral distance of the AEB objecttive with the ego vehicle";
CM_ SG_ 696 AEBObjState "Indicate AEB objective Status";
CM_ SG_ 696 AEBObjObstcl "AEB Target are the possibility of obstacles";
CM_ SG_ 696 AEBObjVy "Lateral relative speed of the AEB target vehicle with the ego vehicle";
CM_ SG_ 696 CyclistObjExist "The possibility of Cyclist objecttive existence";
CM_ SG_ 696 AEBObjAx "Longitudinal relative speed of the AEB target with the ego vehicle";
CM_ SG_ 696 AEBObjAy "Lateral ACCeleration of the AEB target with the ego vehicle";
CM_ SG_ 696 CyclistObjDx "Longitudinal distance of the target Cyclist with the ego vehicle";
CM_ SG_ 696 CyclistObjID "Cyclist objecttive ID";
CM_ SG_ 696 CyclistObjObstcl "Target Cyclist are the possibility of obstacles";
CM_ SG_ 696 CyclistObjDy "Lateral distance of the Cyclist objective with the ego vehicle";
CM_ SG_ 696 CyclistObjVx "Longitudinal relative speed of the Cyclist objective with the ego vehicle";
CM_ SG_ 696 CyclistObjCntAlive "Indicate the duration of the target Cyclist's existence";
CM_ SG_ 696 CyclistObjVy "Lateral relative speed of the target Cyclist  with the ego vehicle";
CM_ SG_ 696 CyclistObjState "Cyclist objective Status";
CM_ SG_ 696 CyclistObjVideoCfmd "Cyclist objective and Video Camera Fusion";
CM_ SG_ 696 CyclistObjAx "Longitudinal ACCeleration of Cyclist objective with ego vehicle";
CM_ SG_ 696 CyclistObjAy "Lateral ACCeleration of Cyclist objective with ego vehicle";
CM_ SG_ 696 PedObjExist "The possibility of Pedestrian objecttive existence";
CM_ SG_ 696 PedObjID "Pedestrian objective ID";
CM_ SG_ 696 PedObjObstcl "Target Pedestrian are the possibility of obstacles";
CM_ SG_ 696 PedObjDy "Lateral distance of the target Pedestrian with the ego vehicle";
CM_ SG_ 696 PedObjDx "Longitudinal distance of the target Pedestrian with the ego vehicle";
CM_ SG_ 696 PedObjVx "Longitudinal relative speed of the target Pedestrian with the ego vehicle";
CM_ SG_ 696 PedObjVy "Lateral relative speed of the Pedestrian objective with the ego vehicle";
CM_ SG_ 696 PedObjVideoCfmd "Pedestrian objective and Video Camera Fusion";
CM_ SG_ 696 ACCTgtObjDx "Longitudinal distance of the ACCTarget objective with the ego vehicle";
CM_ SG_ 696 PedObjAy "Lateral ACCeleration of Pedestrian objective with ego vehicle";
CM_ SG_ 696 PedObjCntAlive "Indicate the duration of the Pedestrian objective's existence";
CM_ SG_ 696 PedObjAx "Longitudinal ACCeleration of Pedestrian objective with ego vehicle";
CM_ SG_ 696 ACCTgtObjID "ACCTarget objecttive ID";
CM_ SG_ 696 ACCTgtObjObstcl "ACCTarget objective are the possibility of obstacles";
CM_ SG_ 696 ACCTgtObjDy "Lateral distance of the ACCTarget objective with the ego vehicle";
CM_ SG_ 696 ACCTgtObjExist "The possibility of ACCTarget objecttive existence";
CM_ SG_ 696 ACCTgtObjVy "Lateral relative speed of the ACCTarget objective with the ego vehicle";
CM_ SG_ 696 ACCTgtObjVx "Longitudinal relative speed of the ACCTarget objective with the ego vehicle";
CM_ SG_ 696 ACCTgtObjAx "Longitudinal ACCeleration of ACCTarget objective with ego vehicle";
CM_ SG_ 696 ACCTgtObjAy "Lateral ACCeleration of ACCTarget objective with ego vehicle";
CM_ SG_ 696 ACCTgtObjState "ACCTarget objecttive Status";
CM_ SG_ 696 ACCTgtObjVideoCfmd "ACCTarget objective and Video Camera Fusion";
CM_ SG_ 696 ACCTgtObjCntAlive "Indicate the duration of the ACCTarget objective's existence";
CM_ SG_ 696 RadarHorMisalign "Horizontal Deviation Angle of Radar Installation for Radar Detection";
CM_ SG_ 696 HandsoffDetd "Hands off Detected";
CM_ SG_ 696 DrvgOnHiWay "Drive on Highway";
CM_ SG_ 696 RoadCrvt "Current position curvature";
CM_ SG_ 696 SpdLimitDst "Distance between Current location and speed limit point";
CM_ SG_ 696 RoadCrvtFar "200 m (tentative) road curvature ahead";
CM_ SG_ 696 RampDst "Current location and ramp distance";
CM_ SG_ 696 SpdLimit "Speed limit value";
CM_ SG_ 696 CurveDst "Distance between Current location and curve";
CM_ SG_ 696 NavSpdLimUnit "Speed limit unit";
CM_ SG_ 696 TunnelDst "Distance between Current location and tunnel";
CM_ SG_ 696 DrvgOnRiLane "Drive in the rightmost Lane";
CM_ SG_ 696 BrdgDst "Distance between Current location and bridge";
CM_ SG_ 696 RadarDrvrAttentive "Radar Detect driver's attention";
CM_ SG_ 696 ACC_DataRecReq "Rquest DVR Record Data";
CM_ SG_ 696 ACC_SOSReq "Indicate T-BOX will activative the e-call mode";
CM_ SG_ 696 PedObjState "Pedestrian objective Status";
CM_ SG_ 696 MapDataValid "Map Data is valid or invalid";
CM_ SG_ 696 DrvrSts "Driver State";
CM_ SG_ 696 AEBObjOverlap "Condition of AEB objecttive overlap";
CM_ SG_ 696 AEBObjDrvby "Condition of AEB objecttive driveby";
CM_ SG_ 697 DWD_WorkSts "DWD work status";
CM_ SG_ 697 DWD_TextDisp "DWD Text Display";
CM_ SG_ 697 DWD_Dis "DWD Distance";
CM_ SG_ 697 DWD_SoundIndcn "DWD Sound Indication";
CM_ SG_ 697 RSnsrFailSts "Sensor fault status of the Right sensor";
CM_ SG_ 697 LSnsrFailSts "Sensor fault status of the Left sensor";
CM_ SG_ 698 WPC_ChrgSts "Describe the status of charge of the WPC:standby,charging,charging completed,WPC failure.";
CM_ SG_ 698 WPC_SwtSts "WPC Switch Status";
CM_ SG_ 698 WPC_FaultSts "Describe the current failure status of WPC.";
CM_ SG_ 698 WPC_PhoneReminder "Describe whether there is a phone forgotten in the car.";
BA_DEF_ BO_  "DiagRequest" ENUM  "No","Yes";
BA_DEF_ BO_  "DiagResponse" ENUM  "No","Yes";
BA_DEF_ BO_  "DiagState" ENUM  "No","Yes";
BA_DEF_ BO_  "GenMsgCycleTime" INT 0 65535;
BA_DEF_ BO_  "GenMsgCycleTimeFast" INT 0 65535;
BA_DEF_ BO_  "GenMsgILSupport" ENUM  "No","Yes";
BA_DEF_ BO_  "GenMsgNrOfRepetition" INT 0 65535;
BA_DEF_ BO_  "GenMsgSendType" ENUM  "Cyclic","CyclicAndSpontanX","Event";
BA_DEF_ BO_  "NmAsrMessage" ENUM  "No","Yes";
BA_DEF_ BO_  "OriginFrame" STRING ;
BA_DEF_ BO_  "SCP_AuthInfoTxLength" INT 0 512;
BA_DEF_ BO_  "SCP_DataId" INT 0 65535;
BA_DEF_ BO_  "SCP_FreshnessValueLength" INT 0 512;
BA_DEF_ BO_  "SCP_FreshnessValueTxLength" INT 0 512;
BA_DEF_ BO_  "SC_Message" ENUM  "NO","YES";
BA_DEF_ BO_  "VFrameFormat" ENUM  "StandardCAN","ExtendedCAN","reserved","reserved","reserved","reserved","reserved","reserved","reserved","reserved","reserved","reserved","reserved","reserved","StandardCAN_FD","ExtendedCAN_FD";
BA_DEF_ SG_  "GenSigCycleTime" INT 0 65535;
BA_DEF_ SG_  "GenSigSendType" ENUM  "Cyclic","OnWrite","OnWriteWithRepetition","OnChange","OnChangeWithRepetition","NotUsed","NotUsed","NoSigSendType";
BA_DEF_ SG_  "GenSigStartValue" FLOAT 0 100000000000;
BA_DEF_ SG_  "Match" STRING ;
BA_DEF_ SG_  "Origin" STRING ;
BA_DEF_ SG_  "TransparentInitValue" STRING ;
BA_DEF_ SG_  "SystemSignalLongSymbol" STRING ;
BA_DEF_DEF_  "DiagRequest" "No";
BA_DEF_DEF_  "DiagResponse" "No";
BA_DEF_DEF_  "DiagState" "No";
BA_DEF_DEF_  "GenMsgCycleTime" 0;
BA_DEF_DEF_  "GenMsgCycleTimeFast" 0;
BA_DEF_DEF_  "GenMsgILSupport" "No";
BA_DEF_DEF_  "GenMsgNrOfRepetition" 0;
BA_DEF_DEF_  "GenMsgSendType" "Cyclic";
BA_DEF_DEF_  "NmAsrMessage" "No";
BA_DEF_DEF_  "OriginFrame" "";
BA_DEF_DEF_  "SCP_AuthInfoTxLength" 0;
BA_DEF_DEF_  "SCP_DataId" 0;
BA_DEF_DEF_  "SCP_FreshnessValueLength" 0;
BA_DEF_DEF_  "SCP_FreshnessValueTxLength" 0;
BA_DEF_DEF_  "SC_Message" "NO";
BA_DEF_DEF_  "VFrameFormat" "";
BA_DEF_DEF_  "GenSigCycleTime" 0;
BA_DEF_DEF_  "GenSigSendType" "Cyclic";
BA_DEF_DEF_  "GenSigStartValue" 0;
BA_DEF_DEF_  "Match" "";
BA_DEF_DEF_  "Origin" "";
BA_DEF_DEF_  "TransparentInitValue" "";
BA_DEF_DEF_  "SystemSignalLongSymbol" "";
BA_ "OriginFrame" BO_ 628 "fuel,ev";
BA_ "GenMsgILSupport" BO_ 628 1;
BA_ "GenMsgCycleTime" BO_ 628 50;
BA_ "VFrameFormat" BO_ 628 14;
BA_ "OriginFrame" BO_ 636 "fuel,ev";
BA_ "GenMsgILSupport" BO_ 636 1;
BA_ "GenMsgCycleTime" BO_ 636 50;
BA_ "VFrameFormat" BO_ 636 14;
BA_ "SC_Message" BO_ 639 1;
BA_ "SCP_FreshnessValueTxLength" BO_ 639 16;
BA_ "SCP_FreshnessValueLength" BO_ 639 64;
BA_ "SCP_DataId" BO_ 639 639;
BA_ "SCP_AuthInfoTxLength" BO_ 639 48;
BA_ "OriginFrame" BO_ 639 "fuel,ev";
BA_ "GenMsgILSupport" BO_ 639 1;
BA_ "GenMsgCycleTime" BO_ 639 50;
BA_ "VFrameFormat" BO_ 639 14;
BA_ "OriginFrame" BO_ 647 "fuel,ev";
BA_ "GenMsgILSupport" BO_ 647 1;
BA_ "GenMsgCycleTime" BO_ 647 100;
BA_ "VFrameFormat" BO_ 647 14;
BA_ "OriginFrame" BO_ 649 "fuel,ev";
BA_ "GenMsgILSupport" BO_ 649 1;
BA_ "GenMsgCycleTime" BO_ 649 100;
BA_ "VFrameFormat" BO_ 649 14;
BA_ "OriginFrame" BO_ 653 "fuel,ev";
BA_ "GenMsgILSupport" BO_ 653 1;
BA_ "GenMsgCycleTime" BO_ 653 100;
BA_ "VFrameFormat" BO_ 653 14;
BA_ "OriginFrame" BO_ 656 "fuel,ev";
BA_ "GenMsgILSupport" BO_ 656 1;
BA_ "GenMsgCycleTime" BO_ 656 100;
BA_ "VFrameFormat" BO_ 656 14;
BA_ "OriginFrame" BO_ 659 "fuel,ev";
BA_ "GenMsgILSupport" BO_ 659 1;
BA_ "GenMsgCycleTime" BO_ 659 100;
BA_ "VFrameFormat" BO_ 659 14;
BA_ "OriginFrame" BO_ 661 "fuel,ev";
BA_ "GenMsgILSupport" BO_ 661 1;
BA_ "GenMsgCycleTime" BO_ 661 50;
BA_ "VFrameFormat" BO_ 661 14;
BA_ "OriginFrame" BO_ 664 "fuel,ev";
BA_ "GenMsgILSupport" BO_ 664 1;
BA_ "GenMsgCycleTime" BO_ 664 100;
BA_ "VFrameFormat" BO_ 664 14;
BA_ "OriginFrame" BO_ 665 "fuel,ev";
BA_ "GenMsgILSupport" BO_ 665 1;
BA_ "GenMsgCycleTime" BO_ 665 100;
BA_ "VFrameFormat" BO_ 665 14;
BA_ "OriginFrame" BO_ 667 "fuel,ev";
BA_ "GenMsgILSupport" BO_ 667 1;
BA_ "GenMsgCycleTime" BO_ 667 100;
BA_ "VFrameFormat" BO_ 667 14;
BA_ "OriginFrame" BO_ 669 "fuel,ev";
BA_ "GenMsgILSupport" BO_ 669 1;
BA_ "GenMsgCycleTime" BO_ 669 100;
BA_ "VFrameFormat" BO_ 669 14;
BA_ "OriginFrame" BO_ 671 "fuel,ev";
BA_ "GenMsgILSupport" BO_ 671 1;
BA_ "GenMsgCycleTime" BO_ 671 100;
BA_ "VFrameFormat" BO_ 671 14;
BA_ "OriginFrame" BO_ 675 "fuel,ev";
BA_ "GenMsgILSupport" BO_ 675 1;
BA_ "GenMsgCycleTime" BO_ 675 100;
BA_ "VFrameFormat" BO_ 675 14;
BA_ "OriginFrame" BO_ 680 "fuel,ev";
BA_ "GenMsgILSupport" BO_ 680 1;
BA_ "GenMsgCycleTime" BO_ 680 100;
BA_ "VFrameFormat" BO_ 680 14;
BA_ "SC_Message" BO_ 683 1;
BA_ "SCP_FreshnessValueTxLength" BO_ 683 16;
BA_ "SCP_FreshnessValueLength" BO_ 683 64;
BA_ "SCP_DataId" BO_ 683 683;
BA_ "SCP_AuthInfoTxLength" BO_ 683 48;
BA_ "OriginFrame" BO_ 683 "fuel,ev";
BA_ "GenMsgILSupport" BO_ 683 1;
BA_ "GenMsgCycleTime" BO_ 683 100;
BA_ "VFrameFormat" BO_ 683 14;
BA_ "OriginFrame" BO_ 692 "fuel,ev";
BA_ "GenMsgILSupport" BO_ 692 1;
BA_ "GenMsgCycleTime" BO_ 692 100;
BA_ "VFrameFormat" BO_ 692 14;
BA_ "OriginFrame" BO_ 694 "fuel,ev";
BA_ "GenMsgILSupport" BO_ 694 1;
BA_ "GenMsgCycleTime" BO_ 694 100;
BA_ "VFrameFormat" BO_ 694 14;
BA_ "OriginFrame" BO_ 696 "fuel,ev";
BA_ "GenMsgILSupport" BO_ 696 1;
BA_ "GenMsgCycleTime" BO_ 696 100;
BA_ "VFrameFormat" BO_ 696 14;
BA_ "OriginFrame" BO_ 697 "fuel,ev";
BA_ "GenMsgILSupport" BO_ 697 1;
BA_ "GenMsgCycleTime" BO_ 697 100;
BA_ "VFrameFormat" BO_ 697 14;
BA_ "OriginFrame" BO_ 698 "fuel,ev";
BA_ "GenMsgILSupport" BO_ 698 1;
BA_ "GenMsgCycleTime" BO_ 698 100;
BA_ "VFrameFormat" BO_ 698 14;
BA_ "Origin" SG_ 628 AutoAVMSwtSet_Sts "fuel,ev";
BA_ "Match" SG_ 628 AutoAVMSwtSet_Sts "AutoAVMSwtSet_Sts";
BA_ "GenSigCycleTime" SG_ 628 AutoAVMSwtSet_Sts 50;
BA_ "Origin" SG_ 628 AVM_CurrSts "fuel,ev";
BA_ "Match" SG_ 628 AVM_CurrSts "AVM_CurrSts";
BA_ "GenSigCycleTime" SG_ 628 AVM_CurrSts 50;
BA_ "Origin" SG_ 628 GuidOvlSts "fuel,ev";
BA_ "Match" SG_ 628 GuidOvlSts "GuidOvlSts";
BA_ "GenSigCycleTime" SG_ 628 GuidOvlSts 50;
BA_ "Origin" SG_ 628 FrntCamInpFailSts "fuel,ev";
BA_ "Match" SG_ 628 FrntCamInpFailSts "FrntCamInpFailSts";
BA_ "GenSigCycleTime" SG_ 628 FrntCamInpFailSts 50;
BA_ "Origin" SG_ 628 RearCamInpFailSts "fuel,ev";
BA_ "Match" SG_ 628 RearCamInpFailSts "RearCamInpFailSts";
BA_ "GenSigCycleTime" SG_ 628 RearCamInpFailSts 50;
BA_ "Origin" SG_ 628 LeCamInpFailSts "fuel,ev";
BA_ "Match" SG_ 628 LeCamInpFailSts "LeCamInpFailSts";
BA_ "GenSigCycleTime" SG_ 628 LeCamInpFailSts 50;
BA_ "Origin" SG_ 628 RiCamInpFailSts "fuel,ev";
BA_ "Match" SG_ 628 RiCamInpFailSts "RiCamInpFailSts";
BA_ "GenSigCycleTime" SG_ 628 RiCamInpFailSts 50;
BA_ "Origin" SG_ 628 EolNotCmpltd "fuel,ev";
BA_ "Match" SG_ 628 EolNotCmpltd "EolNotCmpltd";
BA_ "GenSigCycleTime" SG_ 628 EolNotCmpltd 50;
BA_ "Origin" SG_ 628 OvlOpFailSts "fuel,ev";
BA_ "Match" SG_ 628 OvlOpFailSts "OvlOpFailSts";
BA_ "GenSigCycleTime" SG_ 628 OvlOpFailSts 50;
BA_ "Origin" SG_ 628 LaneCalSts "fuel,ev";
BA_ "Match" SG_ 628 LaneCalSts "LaneCalSts";
BA_ "GenSigCycleTime" SG_ 628 LaneCalSts 50;
BA_ "Origin" SG_ 628 RadarDispSts "fuel,ev";
BA_ "Match" SG_ 628 RadarDispSts "RadarDispSts";
BA_ "GenSigCycleTime" SG_ 628 RadarDispSts 50;
BA_ "Origin" SG_ 628 LaneCalFltSts "fuel,ev";
BA_ "Match" SG_ 628 LaneCalFltSts "LaneCalFltSts";
BA_ "GenSigCycleTime" SG_ 628 LaneCalFltSts 50;
BA_ "Origin" SG_ 628 AutoViewChgFuncSts "fuel,ev";
BA_ "Match" SG_ 628 AutoViewChgFuncSts "AutoViewChgFuncSts";
BA_ "GenSigCycleTime" SG_ 628 AutoViewChgFuncSts 50;
BA_ "Origin" SG_ 628 CarMdlTrsprcySts "fuel,ev";
BA_ "Match" SG_ 628 CarMdlTrsprcySts "CarMdlTrsprcySts";
BA_ "GenSigCycleTime" SG_ 628 CarMdlTrsprcySts 50;
BA_ "Origin" SG_ 628 CarMdlDispSts "fuel,ev";
BA_ "Match" SG_ 628 CarMdlDispSts "CarMdlDispSts";
BA_ "GenSigCycleTime" SG_ 628 CarMdlDispSts 50;
BA_ "Origin" SG_ 628 CurrCalResultSts "fuel,ev";
BA_ "Match" SG_ 628 CurrCalResultSts "CurrCalResultSts";
BA_ "GenSigCycleTime" SG_ 628 CurrCalResultSts 50;
BA_ "Origin" SG_ 628 MdlColrSts "fuel,ev";
BA_ "Match" SG_ 628 MdlColrSts "MdlColrSts";
BA_ "GenSigCycleTime" SG_ 628 MdlColrSts 50;
BA_ "Origin" SG_ 628 SigViewIndcn "fuel,ev";
BA_ "Match" SG_ 628 SigViewIndcn "SigViewIndcn";
BA_ "GenSigCycleTime" SG_ 628 SigViewIndcn 50;
BA_ "Origin" SG_ 628 HAP_DispCmd "fuel,ev";
BA_ "Match" SG_ 628 HAP_DispCmd "HAP_DispCmd";
BA_ "GenSigCycleTime" SG_ 628 HAP_DispCmd 50;
BA_ "Origin" SG_ 628 AVM_3DAngSts "fuel,ev";
BA_ "Match" SG_ 628 AVM_3DAngSts "AVM_3DAngSts";
BA_ "GenSigCycleTime" SG_ 628 AVM_3DAngSts 50;
BA_ "Origin" SG_ 628 MOD_WorkSts "fuel,ev";
BA_ "Match" SG_ 628 MOD_WorkSts "MOD_WorkSts";
BA_ "GenSigCycleTime" SG_ 628 MOD_WorkSts 50;
BA_ "Origin" SG_ 628 MOD_AlarmSts "fuel,ev";
BA_ "Match" SG_ 628 MOD_AlarmSts "MOD_AlarmSts";
BA_ "GenSigCycleTime" SG_ 628 MOD_AlarmSts 50;
BA_ "Origin" SG_ 628 DVRWorkSts "fuel,ev";
BA_ "Match" SG_ 628 DVRWorkSts "DVRWorkSts";
BA_ "GenSigCycleTime" SG_ 628 DVRWorkSts 50;
BA_ "Origin" SG_ 628 HAP_Hmi_Index "fuel,ev";
BA_ "Match" SG_ 628 HAP_Hmi_Index "HAP_Hmi_Index";
BA_ "GenSigCycleTime" SG_ 628 HAP_Hmi_Index 50;
BA_ "TransparentInitValue" SG_ 628 HAP_FD2_0x274 "0 0 0 0 0 0 0 0 0 0 0 0 0 0 0 0 0 0 0 0 0 0 0 0 0 0 0 0 0 0 0 0 0 0 0 0 0 0 0 0 0 0 0 0 0 0 0 0 0 0 0 0 0 0 0 0 0 0 0 0 0 0 0 0 ";
BA_ "GenSigCycleTime" SG_ 628 HAP_FD2_0x274 50;
BA_ "Origin" SG_ 636 RearInCarTemp "fuel,ev";
BA_ "Match" SG_ 636 RearInCarTemp "RearInCarTemp";
BA_ "GenSigStartValue" SG_ 636 RearInCarTemp 254;
BA_ "GenSigCycleTime" SG_ 636 RearInCarTemp 50;
BA_ "Origin" SG_ 636 ACRLTemp_ATC "fuel,ev";
BA_ "Match" SG_ 636 ACRLTemp_ATC "ACRLTemp_ATC";
BA_ "GenSigStartValue" SG_ 636 ACRLTemp_ATC 33;
BA_ "GenSigCycleTime" SG_ 636 ACRLTemp_ATC 50;
BA_ "TransparentInitValue" SG_ 636 AC8_0x27C "0 0 0 132 0 254 0 0 ";
BA_ "GenSigCycleTime" SG_ 636 AC8_0x27C 50;
BA_ "Origin" SG_ 639 CheckSum_IP2 "fuel,ev";
BA_ "Match" SG_ 639 CheckSum_IP2 "CheckSum_IP2";
BA_ "GenSigCycleTime" SG_ 639 CheckSum_IP2 50;
BA_ "Origin" SG_ 639 IP_DrvSeatBeltWarnLmpFailSts "fuel,ev";
BA_ "Match" SG_ 639 IP_DrvSeatBeltWarnLmpFailSts "IP_DrvSeatBeltWarnLmpFailSts";
BA_ "GenSigCycleTime" SG_ 639 IP_DrvSeatBeltWarnLmpFailSts 50;
BA_ "Origin" SG_ 639 IP_PassSeatBeltWarnLmpFailSts "fuel,ev";
BA_ "Match" SG_ 639 IP_PassSeatBeltWarnLmpFailSts "IP_PassSeatBeltWarnLmpFailSts";
BA_ "GenSigCycleTime" SG_ 639 IP_PassSeatBeltWarnLmpFailSts 50;
BA_ "Origin" SG_ 639 IP_VehTotDistance "fuel,ev";
BA_ "Match" SG_ 639 IP_VehTotDistance "IP_VehTotDistance";
BA_ "GenSigCycleTime" SG_ 639 IP_VehTotDistance 50;
BA_ "Origin" SG_ 639 IP_VehTotDistanceValid "fuel,ev";
BA_ "Match" SG_ 639 IP_VehTotDistanceValid "IP_VehTotDistanceValid";
BA_ "GenSigCycleTime" SG_ 639 IP_VehTotDistanceValid 50;
BA_ "Origin" SG_ 639 IP_FuelLvlInfo "fuel,ev";
BA_ "Match" SG_ 639 IP_FuelLvlInfo "IP_FuelLvlInfo";
BA_ "GenSigCycleTime" SG_ 639 IP_FuelLvlInfo 50;
BA_ "Origin" SG_ 639 IP_FuelLvlLowLmpSts "fuel,ev";
BA_ "Match" SG_ 639 IP_FuelLvlLowLmpSts "IP_FuelLvlLowLmpSts";
BA_ "GenSigCycleTime" SG_ 639 IP_FuelLvlLowLmpSts 50;
BA_ "Origin" SG_ 639 IP_BattChrgLmpSts "fuel,ev";
BA_ "Match" SG_ 639 IP_BattChrgLmpSts "IP_BattChrgLmpSts";
BA_ "GenSigCycleTime" SG_ 639 IP_BattChrgLmpSts 50;
BA_ "Origin" SG_ 639 IP_EngOilPressLowLmpSts "fuel,ev";
BA_ "Match" SG_ 639 IP_EngOilPressLowLmpSts "IP_EngOilPressLowLmpSts";
BA_ "GenSigCycleTime" SG_ 639 IP_EngOilPressLowLmpSts 50;
BA_ "Origin" SG_ 639 IP_ABMWarnLmpFailrSts "fuel,ev";
BA_ "Match" SG_ 639 IP_ABMWarnLmpFailrSts "IP_ABMWarnLmpFailrSts";
BA_ "GenSigCycleTime" SG_ 639 IP_ABMWarnLmpFailrSts 50;
BA_ "Origin" SG_ 639 IP_Err "fuel,ev";
BA_ "Match" SG_ 639 IP_Err "IP_Err";
BA_ "GenSigCycleTime" SG_ 639 IP_Err 50;
BA_ "Origin" SG_ 639 IP_ACCErr "fuel,ev";
BA_ "Match" SG_ 639 IP_ACCErr "IP_ACCErr";
BA_ "GenSigCycleTime" SG_ 639 IP_ACCErr 50;
BA_ "Origin" SG_ 639 IP_VehSpdUnit "fuel,ev";
BA_ "Match" SG_ 639 IP_VehSpdUnit "IP_VehSpdUnit";
BA_ "GenSigCycleTime" SG_ 639 IP_VehSpdUnit 50;
BA_ "Origin" SG_ 639 IP_VINcompr "fuel,ev";
BA_ "Match" SG_ 639 IP_VINcompr "IP_VINcompr";
BA_ "GenSigCycleTime" SG_ 639 IP_VINcompr 50;
BA_ "Origin" SG_ 639 RollingCounter_IP2 "fuel,ev";
BA_ "Match" SG_ 639 RollingCounter_IP2 "RollingCounter_IP2";
BA_ "GenSigCycleTime" SG_ 639 RollingCounter_IP2 50;
BA_ "Origin" SG_ 639 FreshnessValue_IP2 "fuel,ev";
BA_ "Match" SG_ 639 FreshnessValue_IP2 "FreshnessValue_IP2";
BA_ "GenSigCycleTime" SG_ 639 FreshnessValue_IP2 50;
BA_ "Origin" SG_ 639 MAC_Check_IP2 "fuel,ev";
BA_ "Match" SG_ 639 MAC_Check_IP2 "MAC_Check_IP2";
BA_ "GenSigCycleTime" SG_ 639 MAC_Check_IP2 50;
BA_ "TransparentInitValue" SG_ 639 IP2_0x27F "0 0 0 0 0 0 0 0 0 0 0 0 0 0 0 0 ";
BA_ "GenSigCycleTime" SG_ 639 IP2_0x27F 50;
BA_ "Origin" SG_ 647 CheckSum_HC1 "fuel,ev";
BA_ "Match" SG_ 647 CheckSum_HC1 "CheckSum_HC1";
BA_ "GenSigCycleTime" SG_ 647 CheckSum_HC1 100;
BA_ "Origin" SG_ 647 ALS_FailSts "fuel,ev";
BA_ "Match" SG_ 647 ALS_FailSts "ALS_FailSts";
BA_ "GenSigCycleTime" SG_ 647 ALS_FailSts 100;
BA_ "Origin" SG_ 647 RollingCounter_HC1 "fuel,ev";
BA_ "Match" SG_ 647 RollingCounter_HC1 "RollingCounter_HC1";
BA_ "GenSigCycleTime" SG_ 647 RollingCounter_HC1 100;
BA_ "TransparentInitValue" SG_ 647 ALS1_0x287 "0 0 0 0 0 0 0 0 0 0 0 0 0 0 0 0 ";
BA_ "GenSigCycleTime" SG_ 647 ALS1_0x287 100;
BA_ "Origin" SG_ 649 HAP_RtCam_WorkSts "fuel,ev";
BA_ "Match" SG_ 649 HAP_RtCam_WorkSts "HAP_RtCam_WorkSts";
BA_ "GenSigStartValue" SG_ 649 HAP_RtCam_WorkSts 1;
BA_ "GenSigCycleTime" SG_ 649 HAP_RtCam_WorkSts 100;
BA_ "Origin" SG_ 649 HAP_RtSide_Obj1_ID "fuel,ev";
BA_ "Match" SG_ 649 HAP_RtSide_Obj1_ID "HAP_RtSide_Obj1_ID";
BA_ "GenSigCycleTime" SG_ 649 HAP_RtSide_Obj1_ID 100;
BA_ "Origin" SG_ 649 HAP_RtSide_Obj1_type "fuel,ev";
BA_ "Match" SG_ 649 HAP_RtSide_Obj1_type "HAP_RtSide_Obj1_type";
BA_ "GenSigCycleTime" SG_ 649 HAP_RtSide_Obj1_type 100;
BA_ "Origin" SG_ 649 HAP_RtSide_Obj1_Confidence "fuel,ev";
BA_ "Match" SG_ 649 HAP_RtSide_Obj1_Confidence "HAP_RtSide_Obj1_Confidence";
BA_ "GenSigCycleTime" SG_ 649 HAP_RtSide_Obj1_Confidence 100;
BA_ "Origin" SG_ 649 HAP_RtSide_Obj1_Ground_Pos_X "fuel,ev";
BA_ "Match" SG_ 649 HAP_RtSide_Obj1_Ground_Pos_X "HAP_RtSide_Obj1_Ground_Pos_X";
BA_ "GenSigCycleTime" SG_ 649 HAP_RtSide_Obj1_Ground_Pos_X 100;
BA_ "Origin" SG_ 649 HAP_RtSide_Obj1_Ground_Pos_Y "fuel,ev";
BA_ "Match" SG_ 649 HAP_RtSide_Obj1_Ground_Pos_Y "HAP_RtSide_Obj1_Ground_Pos_Y";
BA_ "GenSigCycleTime" SG_ 649 HAP_RtSide_Obj1_Ground_Pos_Y 100;
BA_ "Origin" SG_ 649 HAP_RtSide_Obj2_ID "fuel,ev";
BA_ "Match" SG_ 649 HAP_RtSide_Obj2_ID "HAP_RtSide_Obj2_ID";
BA_ "GenSigCycleTime" SG_ 649 HAP_RtSide_Obj2_ID 100;
BA_ "Origin" SG_ 649 HAP_RtSide_Obj2_type "fuel,ev";
BA_ "Match" SG_ 649 HAP_RtSide_Obj2_type "HAP_RtSide_Obj2_type";
BA_ "GenSigCycleTime" SG_ 649 HAP_RtSide_Obj2_type 100;
BA_ "Origin" SG_ 649 HAP_RtSide_Obj2_Confidence "fuel,ev";
BA_ "Match" SG_ 649 HAP_RtSide_Obj2_Confidence "HAP_RtSide_Obj2_Confidence";
BA_ "GenSigCycleTime" SG_ 649 HAP_RtSide_Obj2_Confidence 100;
BA_ "Origin" SG_ 649 HAP_RtSide_Obj2_Ground_Pos_X "fuel,ev";
BA_ "Match" SG_ 649 HAP_RtSide_Obj2_Ground_Pos_X "HAP_RtSide_Obj2_Ground_Pos_X";
BA_ "GenSigCycleTime" SG_ 649 HAP_RtSide_Obj2_Ground_Pos_X 100;
BA_ "Origin" SG_ 649 HAP_RtSide_Obj2_Ground_Pos_Y "fuel,ev";
BA_ "Match" SG_ 649 HAP_RtSide_Obj2_Ground_Pos_Y "HAP_RtSide_Obj2_Ground_Pos_Y";
BA_ "GenSigCycleTime" SG_ 649 HAP_RtSide_Obj2_Ground_Pos_Y 100;
BA_ "Origin" SG_ 649 HAP_RtSide_Obj3_ID "fuel,ev";
BA_ "Match" SG_ 649 HAP_RtSide_Obj3_ID "HAP_RtSide_Obj3_ID";
BA_ "GenSigCycleTime" SG_ 649 HAP_RtSide_Obj3_ID 100;
BA_ "Origin" SG_ 649 HAP_RtSide_Obj3_type "fuel,ev";
BA_ "Match" SG_ 649 HAP_RtSide_Obj3_type "HAP_RtSide_Obj3_type";
BA_ "GenSigCycleTime" SG_ 649 HAP_RtSide_Obj3_type 100;
BA_ "Origin" SG_ 649 HAP_RtSide_Obj3_Confidence "fuel,ev";
BA_ "Match" SG_ 649 HAP_RtSide_Obj3_Confidence "HAP_RtSide_Obj3_Confidence";
BA_ "GenSigCycleTime" SG_ 649 HAP_RtSide_Obj3_Confidence 100;
BA_ "Origin" SG_ 649 HAP_RtSide_Obj3_Ground_Pos_X "fuel,ev";
BA_ "Match" SG_ 649 HAP_RtSide_Obj3_Ground_Pos_X "HAP_RtSide_Obj3_Ground_Pos_X";
BA_ "GenSigCycleTime" SG_ 649 HAP_RtSide_Obj3_Ground_Pos_X 100;
BA_ "Origin" SG_ 649 HAP_RtSide_Obj3_Ground_Pos_Y "fuel,ev";
BA_ "Match" SG_ 649 HAP_RtSide_Obj3_Ground_Pos_Y "HAP_RtSide_Obj3_Ground_Pos_Y";
BA_ "GenSigCycleTime" SG_ 649 HAP_RtSide_Obj3_Ground_Pos_Y 100;
BA_ "Origin" SG_ 649 HAP_RtSide_Obj4_ID "fuel,ev";
BA_ "Match" SG_ 649 HAP_RtSide_Obj4_ID "HAP_RtSide_Obj4_ID";
BA_ "GenSigCycleTime" SG_ 649 HAP_RtSide_Obj4_ID 100;
BA_ "Origin" SG_ 649 HAP_RtSide_Obj4_type "fuel,ev";
BA_ "Match" SG_ 649 HAP_RtSide_Obj4_type "HAP_RtSide_Obj4_type";
BA_ "GenSigCycleTime" SG_ 649 HAP_RtSide_Obj4_type 100;
BA_ "Origin" SG_ 649 HAP_RtSide_Obj4_Confidence "fuel,ev";
BA_ "Match" SG_ 649 HAP_RtSide_Obj4_Confidence "HAP_RtSide_Obj4_Confidence";
BA_ "GenSigCycleTime" SG_ 649 HAP_RtSide_Obj4_Confidence 100;
BA_ "Origin" SG_ 649 HAP_RtSide_Obj4_Ground_Pos_X "fuel,ev";
BA_ "Match" SG_ 649 HAP_RtSide_Obj4_Ground_Pos_X "HAP_RtSide_Obj4_Ground_Pos_X";
BA_ "GenSigCycleTime" SG_ 649 HAP_RtSide_Obj4_Ground_Pos_X 100;
BA_ "Origin" SG_ 649 HAP_RtSide_Obj4_Ground_Pos_Y "fuel,ev";
BA_ "Match" SG_ 649 HAP_RtSide_Obj4_Ground_Pos_Y "HAP_RtSide_Obj4_Ground_Pos_Y";
BA_ "GenSigCycleTime" SG_ 649 HAP_RtSide_Obj4_Ground_Pos_Y 100;
BA_ "Origin" SG_ 649 USS_FLSide1_Status "fuel,ev";
BA_ "Match" SG_ 649 USS_FLSide1_Status "USS_FLSide1_Status";
BA_ "GenSigStartValue" SG_ 649 USS_FLSide1_Status 1;
BA_ "GenSigCycleTime" SG_ 649 USS_FLSide1_Status 100;
BA_ "Origin" SG_ 649 USS_FLSide1_Dist "fuel,ev";
BA_ "Match" SG_ 649 USS_FLSide1_Dist "USS_FLSide1_Dist";
BA_ "GenSigCycleTime" SG_ 649 USS_FLSide1_Dist 100;
BA_ "Origin" SG_ 649 USS_RLSide2_Status "fuel,ev";
BA_ "Match" SG_ 649 USS_RLSide2_Status "USS_RLSide2_Status";
BA_ "GenSigStartValue" SG_ 649 USS_RLSide2_Status 1;
BA_ "GenSigCycleTime" SG_ 649 USS_RLSide2_Status 100;
BA_ "Origin" SG_ 649 USS_RLSide2_Dist "fuel,ev";
BA_ "Match" SG_ 649 USS_RLSide2_Dist "USS_RLSide2_Dist";
BA_ "GenSigCycleTime" SG_ 649 USS_RLSide2_Dist 100;
BA_ "Origin" SG_ 649 USS_FRSide1_Status "fuel,ev";
BA_ "Match" SG_ 649 USS_FRSide1_Status "USS_FRSide1_Status";
BA_ "GenSigStartValue" SG_ 649 USS_FRSide1_Status 1;
BA_ "GenSigCycleTime" SG_ 649 USS_FRSide1_Status 100;
BA_ "Origin" SG_ 649 USS_FRSide1_Dist "fuel,ev";
BA_ "Match" SG_ 649 USS_FRSide1_Dist "USS_FRSide1_Dist";
BA_ "GenSigCycleTime" SG_ 649 USS_FRSide1_Dist 100;
BA_ "Origin" SG_ 649 USS_RRSide2_Status "fuel,ev";
BA_ "Match" SG_ 649 USS_RRSide2_Status "USS_RRSide2_Status";
BA_ "GenSigStartValue" SG_ 649 USS_RRSide2_Status 1;
BA_ "GenSigCycleTime" SG_ 649 USS_RRSide2_Status 100;
BA_ "Origin" SG_ 649 USS_RRSide2_Dist "fuel,ev";
BA_ "Match" SG_ 649 USS_RRSide2_Dist "USS_RRSide2_Dist";
BA_ "GenSigCycleTime" SG_ 649 USS_RRSide2_Dist 100;
BA_ "TransparentInitValue" SG_ 649 HAP_FD6_0x289 "0 0 0 0 0 0 0 16 0 0 0 0 0 0 0 0 0 0 0 0 0 0 0 0 0 0 0 0 0 0 0 0 0 85 0 0 0 0 0 0 0 0 0 0 0 0 0 0 0 0 0 0 0 0 0 0 0 0 0 0 0 0 0 0 ";
BA_ "GenSigCycleTime" SG_ 649 HAP_FD6_0x289 100;
BA_ "Origin" SG_ 653 SecRowLeSeatVentSts "fuel,ev";
BA_ "Match" SG_ 653 SecRowLeSeatVentSts "SecRowLeSeatVentSts";
BA_ "GenSigCycleTime" SG_ 653 SecRowLeSeatVentSts 100;
BA_ "Origin" SG_ 653 SecRowRiSeatVentSts "fuel,ev";
BA_ "Match" SG_ 653 SecRowRiSeatVentSts "SecRowRiSeatVentSts";
BA_ "GenSigCycleTime" SG_ 653 SecRowRiSeatVentSts 100;
BA_ "TransparentInitValue" SG_ 653 BCM7_0x28D "0 0 0 0 0 0 0 0 ";
BA_ "GenSigCycleTime" SG_ 653 BCM7_0x28D 100;
BA_ "Origin" SG_ 656 EngOilLvl "fuel";
BA_ "Match" SG_ 656 EngOilLvl "EngOilLvl";
BA_ "GenSigCycleTime" SG_ 656 EngOilLvl 100;
BA_ "Origin" SG_ 656 FTIVFault "ev";
BA_ "Match" SG_ 656 FTIVFault "FTIVFault";
BA_ "GenSigCycleTime" SG_ 656 FTIVFault 100;
BA_ "Origin" SG_ 656 FuelTankCapWarning "ev";
BA_ "Match" SG_ 656 FuelTankCapWarning "FuelTankCapWarning";
BA_ "GenSigCycleTime" SG_ 656 FuelTankCapWarning 100;
BA_ "Origin" SG_ 656 PressReliProgs "ev";
BA_ "Match" SG_ 656 PressReliProgs "PressReliProgs";
BA_ "GenSigCycleTime" SG_ 656 PressReliProgs 100;
BA_ "TransparentInitValue" SG_ 656 ECM_PT6_0x290 "0 0 0 0 0 0 0 0 ";
BA_ "GenSigCycleTime" SG_ 656 ECM_PT6_0x290 100;
BA_ "Origin" SG_ 659 IP_CurrTheme "fuel,ev";
BA_ "Match" SG_ 659 IP_CurrTheme "IP_CurrTheme";
BA_ "GenSigStartValue" SG_ 659 IP_CurrTheme 4;
BA_ "GenSigCycleTime" SG_ 659 IP_CurrTheme 100;
BA_ "Origin" SG_ 659 IP_VehSpdDisp "fuel,ev";
BA_ "Match" SG_ 659 IP_VehSpdDisp "IP_VehSpdDisp";
BA_ "GenSigCycleTime" SG_ 659 IP_VehSpdDisp 100;
BA_ "Origin" SG_ 659 IP_VelSpdDisp_Mile "fuel,ev";
BA_ "Match" SG_ 659 IP_VelSpdDisp_Mile "IP_VelSpdDisp_Mile";
BA_ "GenSigCycleTime" SG_ 659 IP_VelSpdDisp_Mile 100;
BA_ "Origin" SG_ 659 IP_FuelMainTankR "fuel,ev";
BA_ "Match" SG_ 659 IP_FuelMainTankR "IP_FuelMainTankR";
BA_ "GenSigStartValue" SG_ 659 IP_FuelMainTankR 10;
BA_ "GenSigCycleTime" SG_ 659 IP_FuelMainTankR 100;
BA_ "Origin" SG_ 659 IP_FuelAuxTankR "fuel,ev";
BA_ "Match" SG_ 659 IP_FuelAuxTankR "IP_FuelAuxTankR";
BA_ "GenSigStartValue" SG_ 659 IP_FuelAuxTankR 10;
BA_ "GenSigCycleTime" SG_ 659 IP_FuelAuxTankR 100;
BA_ "Origin" SG_ 659 IP_LagueSet "fuel,ev";
BA_ "Match" SG_ 659 IP_LagueSet "IP_LagueSet";
BA_ "GenSigStartValue" SG_ 659 IP_LagueSet 15;
BA_ "GenSigCycleTime" SG_ 659 IP_LagueSet 100;
BA_ "TransparentInitValue" SG_ 659 IP1_0x293 "0 0 16 10 2 188 0 0 ";
BA_ "GenSigCycleTime" SG_ 659 IP1_0x293 100;
BA_ "Origin" SG_ 661 SysPowerMod "fuel,ev";
BA_ "Match" SG_ 661 SysPowerMod "SysPowerMod";
BA_ "GenSigCycleTime" SG_ 661 SysPowerMod 50;
BA_ "Origin" SG_ 661 SysPowerModVld "fuel,ev";
BA_ "Match" SG_ 661 SysPowerModVld "SysPowerModVld";
BA_ "GenSigCycleTime" SG_ 661 SysPowerModVld 50;
BA_ "Origin" SG_ 661 PEPS_PowerRlyOutpSts "fuel,ev";
BA_ "Match" SG_ 661 PEPS_PowerRlyOutpSts "PEPS_PowerRlyOutpSts";
BA_ "GenSigCycleTime" SG_ 661 PEPS_PowerRlyOutpSts 50;
BA_ "Origin" SG_ 661 RemPowerFailureSts "fuel,ev";
BA_ "Match" SG_ 661 RemPowerFailureSts "RemPowerFailureSts";
BA_ "GenSigCycleTime" SG_ 661 RemPowerFailureSts 50;
BA_ "Origin" SG_ 661 RemUpgrdModSysPower "fuel,ev";
BA_ "Match" SG_ 661 RemUpgrdModSysPower "RemUpgrdModSysPower";
BA_ "GenSigCycleTime" SG_ 661 RemUpgrdModSysPower 50;
BA_ "TransparentInitValue" SG_ 661 PEPS2_0x295 "0 0 0 0 0 0 0 0 ";
BA_ "GenSigCycleTime" SG_ 661 PEPS2_0x295 50;
BA_ "Origin" SG_ 664 RPAS_NearBrrdstn "fuel,ev";
BA_ "Match" SG_ 664 RPAS_NearBrrdstn "RPAS_NearBrrdstn";
BA_ "GenSigStartValue" SG_ 664 RPAS_NearBrrdstn 255;
BA_ "GenSigCycleTime" SG_ 664 RPAS_NearBrrdstn 100;
BA_ "Origin" SG_ 664 HAVP_ProcRa "fuel,ev";
BA_ "Match" SG_ 664 HAVP_ProcRa "HAVP_ProcRa";
BA_ "GenSigStartValue" SG_ 664 HAVP_ProcRa 127;
BA_ "GenSigCycleTime" SG_ 664 HAVP_ProcRa 100;
BA_ "Origin" SG_ 664 P2P_ProcBar "fuel,ev";
BA_ "Match" SG_ 664 P2P_ProcBar "P2P_ProcBar";
BA_ "GenSigStartValue" SG_ 664 P2P_ProcBar 127;
BA_ "GenSigCycleTime" SG_ 664 P2P_ProcBar 100;
BA_ "Origin" SG_ 664 APS_ObjRiSideAr1 "fuel,ev";
BA_ "Match" SG_ 664 APS_ObjRiSideAr1 "APS_ObjRiSideAr1";
BA_ "GenSigCycleTime" SG_ 664 APS_ObjRiSideAr1 100;
BA_ "Origin" SG_ 664 APS_ObjRiSideAr2 "fuel,ev";
BA_ "Match" SG_ 664 APS_ObjRiSideAr2 "APS_ObjRiSideAr2";
BA_ "GenSigCycleTime" SG_ 664 APS_ObjRiSideAr2 100;
BA_ "Origin" SG_ 664 APS_ObjRiSideAr3 "fuel,ev";
BA_ "Match" SG_ 664 APS_ObjRiSideAr3 "APS_ObjRiSideAr3";
BA_ "GenSigCycleTime" SG_ 664 APS_ObjRiSideAr3 100;
BA_ "Origin" SG_ 664 APS_ObjRiSideAr4 "fuel,ev";
BA_ "Match" SG_ 664 APS_ObjRiSideAr4 "APS_ObjRiSideAr4";
BA_ "GenSigCycleTime" SG_ 664 APS_ObjRiSideAr4 100;
BA_ "Origin" SG_ 664 APS_ObjRiSideAr5 "fuel,ev";
BA_ "Match" SG_ 664 APS_ObjRiSideAr5 "APS_ObjRiSideAr5";
BA_ "GenSigCycleTime" SG_ 664 APS_ObjRiSideAr5 100;
BA_ "Origin" SG_ 664 APS_ObjLeSideAr1 "fuel,ev";
BA_ "Match" SG_ 664 APS_ObjLeSideAr1 "APS_ObjLeSideAr1";
BA_ "GenSigCycleTime" SG_ 664 APS_ObjLeSideAr1 100;
BA_ "Origin" SG_ 664 APS_ObjLeSideAr2 "fuel,ev";
BA_ "Match" SG_ 664 APS_ObjLeSideAr2 "APS_ObjLeSideAr2";
BA_ "GenSigCycleTime" SG_ 664 APS_ObjLeSideAr2 100;
BA_ "Origin" SG_ 664 APS_ObjLeSideAr3 "fuel,ev";
BA_ "Match" SG_ 664 APS_ObjLeSideAr3 "APS_ObjLeSideAr3";
BA_ "GenSigCycleTime" SG_ 664 APS_ObjLeSideAr3 100;
BA_ "Origin" SG_ 664 APS_ObjLeSideAr4 "fuel,ev";
BA_ "Match" SG_ 664 APS_ObjLeSideAr4 "APS_ObjLeSideAr4";
BA_ "GenSigCycleTime" SG_ 664 APS_ObjLeSideAr4 100;
BA_ "Origin" SG_ 664 APS_ObjLeSideAr5 "fuel,ev";
BA_ "Match" SG_ 664 APS_ObjLeSideAr5 "APS_ObjLeSideAr5";
BA_ "GenSigCycleTime" SG_ 664 APS_ObjLeSideAr5 100;
BA_ "Origin" SG_ 664 APS_FRSideSnsrFailSts "fuel,ev";
BA_ "Match" SG_ 664 APS_FRSideSnsrFailSts "APS_FRSideSnsrFailSts";
BA_ "GenSigCycleTime" SG_ 664 APS_FRSideSnsrFailSts 100;
BA_ "Origin" SG_ 664 APS_FLSideSnsrFailSts "fuel,ev";
BA_ "Match" SG_ 664 APS_FLSideSnsrFailSts "APS_FLSideSnsrFailSts";
BA_ "GenSigCycleTime" SG_ 664 APS_FLSideSnsrFailSts 100;
BA_ "Origin" SG_ 664 APS_RRSideSnsrFailSts "fuel,ev";
BA_ "Match" SG_ 664 APS_RRSideSnsrFailSts "APS_RRSideSnsrFailSts";
BA_ "GenSigCycleTime" SG_ 664 APS_RRSideSnsrFailSts 100;
BA_ "Origin" SG_ 664 APS_RLSideSnsrFailSts "fuel,ev";
BA_ "Match" SG_ 664 APS_RLSideSnsrFailSts "APS_RLSideSnsrFailSts";
BA_ "GenSigCycleTime" SG_ 664 APS_RLSideSnsrFailSts 100;
BA_ "Origin" SG_ 664 SDW_SoundIndcn "fuel,ev";
BA_ "Match" SG_ 664 SDW_SoundIndcn "SDW_SoundIndcn";
BA_ "GenSigCycleTime" SG_ 664 SDW_SoundIndcn 100;
BA_ "Origin" SG_ 664 SDWActiveSts "fuel,ev";
BA_ "Match" SG_ 664 SDWActiveSts "SDWActiveSts";
BA_ "GenSigCycleTime" SG_ 664 SDWActiveSts 100;
BA_ "Origin" SG_ 664 RPAS_ObjRRCornrAr1 "fuel,ev";
BA_ "Match" SG_ 664 RPAS_ObjRRCornrAr1 "RPAS_ObjRRCornrAr1";
BA_ "GenSigCycleTime" SG_ 664 RPAS_ObjRRCornrAr1 100;
BA_ "Origin" SG_ 664 RPAS_ObjRRCornrAr2 "fuel,ev";
BA_ "Match" SG_ 664 RPAS_ObjRRCornrAr2 "RPAS_ObjRRCornrAr2";
BA_ "GenSigCycleTime" SG_ 664 RPAS_ObjRRCornrAr2 100;
BA_ "Origin" SG_ 664 RPAS_ObjRRMidlAr1 "fuel,ev";
BA_ "Match" SG_ 664 RPAS_ObjRRMidlAr1 "RPAS_ObjRRMidlAr1";
BA_ "GenSigCycleTime" SG_ 664 RPAS_ObjRRMidlAr1 100;
BA_ "Origin" SG_ 664 RPAS_ObjRRMidlAr2 "fuel,ev";
BA_ "Match" SG_ 664 RPAS_ObjRRMidlAr2 "RPAS_ObjRRMidlAr2";
BA_ "GenSigCycleTime" SG_ 664 RPAS_ObjRRMidlAr2 100;
BA_ "Origin" SG_ 664 RPAS_ObjRLMidlAr1 "fuel,ev";
BA_ "Match" SG_ 664 RPAS_ObjRLMidlAr1 "RPAS_ObjRLMidlAr1";
BA_ "GenSigCycleTime" SG_ 664 RPAS_ObjRLMidlAr1 100;
BA_ "Origin" SG_ 664 RPAS_ObjRLMidlAr2 "fuel,ev";
BA_ "Match" SG_ 664 RPAS_ObjRLMidlAr2 "RPAS_ObjRLMidlAr2";
BA_ "GenSigCycleTime" SG_ 664 RPAS_ObjRLMidlAr2 100;
BA_ "Origin" SG_ 664 RPAS_ObjRLCornrAr1 "fuel,ev";
BA_ "Match" SG_ 664 RPAS_ObjRLCornrAr1 "RPAS_ObjRLCornrAr1";
BA_ "GenSigCycleTime" SG_ 664 RPAS_ObjRLCornrAr1 100;
BA_ "Origin" SG_ 664 RPAS_ObjRLCornrAr2 "fuel,ev";
BA_ "Match" SG_ 664 RPAS_ObjRLCornrAr2 "RPAS_ObjRLCornrAr2";
BA_ "GenSigCycleTime" SG_ 664 RPAS_ObjRLCornrAr2 100;
BA_ "Origin" SG_ 664 RPAS_RLCornrSnsrFailSts "fuel,ev";
BA_ "Match" SG_ 664 RPAS_RLCornrSnsrFailSts "RPAS_RLCornrSnsrFailSts";
BA_ "GenSigCycleTime" SG_ 664 RPAS_RLCornrSnsrFailSts 100;
BA_ "Origin" SG_ 664 RPAS_RLMiddlSnsrFailSts "fuel,ev";
BA_ "Match" SG_ 664 RPAS_RLMiddlSnsrFailSts "RPAS_RLMiddlSnsrFailSts";
BA_ "GenSigCycleTime" SG_ 664 RPAS_RLMiddlSnsrFailSts 100;
BA_ "Origin" SG_ 664 RPAS_RRMiddlSnsrFailSts "fuel,ev";
BA_ "Match" SG_ 664 RPAS_RRMiddlSnsrFailSts "RPAS_RRMiddlSnsrFailSts";
BA_ "GenSigCycleTime" SG_ 664 RPAS_RRMiddlSnsrFailSts 100;
BA_ "Origin" SG_ 664 RPAS_RRCornrSnsrFailSts "fuel,ev";
BA_ "Match" SG_ 664 RPAS_RRCornrSnsrFailSts "RPAS_RRCornrSnsrFailSts";
BA_ "GenSigCycleTime" SG_ 664 RPAS_RRCornrSnsrFailSts 100;
BA_ "Origin" SG_ 664 RPAS_WorkSts "fuel,ev";
BA_ "Match" SG_ 664 RPAS_WorkSts "RPAS_WorkSts";
BA_ "GenSigCycleTime" SG_ 664 RPAS_WorkSts 100;
BA_ "Origin" SG_ 664 RPAS_SoundIndcn "fuel,ev";
BA_ "Match" SG_ 664 RPAS_SoundIndcn "RPAS_SoundIndcn";
BA_ "GenSigCycleTime" SG_ 664 RPAS_SoundIndcn 100;
BA_ "Origin" SG_ 664 MEBWorkSts "fuel,ev";
BA_ "Match" SG_ 664 MEBWorkSts "MEBWorkSts";
BA_ "GenSigCycleTime" SG_ 664 MEBWorkSts 100;
BA_ "Origin" SG_ 664 MEB_EnableSts "fuel,ev";
BA_ "Match" SG_ 664 MEB_EnableSts "MEB_EnableSts";
BA_ "GenSigCycleTime" SG_ 664 MEB_EnableSts 100;
BA_ "Origin" SG_ 664 FPAS_ObjFLCornrAr1 "fuel,ev";
BA_ "Match" SG_ 664 FPAS_ObjFLCornrAr1 "FPAS_ObjFLCornrAr1";
BA_ "GenSigCycleTime" SG_ 664 FPAS_ObjFLCornrAr1 100;
BA_ "Origin" SG_ 664 FPAS_ObjFLCornrAr2 "fuel,ev";
BA_ "Match" SG_ 664 FPAS_ObjFLCornrAr2 "FPAS_ObjFLCornrAr2";
BA_ "GenSigCycleTime" SG_ 664 FPAS_ObjFLCornrAr2 100;
BA_ "Origin" SG_ 664 FPAS_ObjFLMidlAr1 "fuel,ev";
BA_ "Match" SG_ 664 FPAS_ObjFLMidlAr1 "FPAS_ObjFLMidlAr1";
BA_ "GenSigCycleTime" SG_ 664 FPAS_ObjFLMidlAr1 100;
BA_ "Origin" SG_ 664 FPAS_ObjFLMidlAr2 "fuel,ev";
BA_ "Match" SG_ 664 FPAS_ObjFLMidlAr2 "FPAS_ObjFLMidlAr2";
BA_ "GenSigCycleTime" SG_ 664 FPAS_ObjFLMidlAr2 100;
BA_ "Origin" SG_ 664 FPAS_ObjFRMidlAr1 "fuel,ev";
BA_ "Match" SG_ 664 FPAS_ObjFRMidlAr1 "FPAS_ObjFRMidlAr1";
BA_ "GenSigCycleTime" SG_ 664 FPAS_ObjFRMidlAr1 100;
BA_ "Origin" SG_ 664 FPAS_ObjFRMidlAr2 "fuel,ev";
BA_ "Match" SG_ 664 FPAS_ObjFRMidlAr2 "FPAS_ObjFRMidlAr2";
BA_ "GenSigCycleTime" SG_ 664 FPAS_ObjFRMidlAr2 100;
BA_ "Origin" SG_ 664 FPAS_ObjFRCornrAr1 "fuel,ev";
BA_ "Match" SG_ 664 FPAS_ObjFRCornrAr1 "FPAS_ObjFRCornrAr1";
BA_ "GenSigCycleTime" SG_ 664 FPAS_ObjFRCornrAr1 100;
BA_ "Origin" SG_ 664 FPAS_ObjFRCornrAr2 "fuel,ev";
BA_ "Match" SG_ 664 FPAS_ObjFRCornrAr2 "FPAS_ObjFRCornrAr2";
BA_ "GenSigCycleTime" SG_ 664 FPAS_ObjFRCornrAr2 100;
BA_ "Origin" SG_ 664 FPAS_FLCornrSnsrFailSts "fuel,ev";
BA_ "Match" SG_ 664 FPAS_FLCornrSnsrFailSts "FPAS_FLCornrSnsrFailSts";
BA_ "GenSigCycleTime" SG_ 664 FPAS_FLCornrSnsrFailSts 100;
BA_ "Origin" SG_ 664 FPAS_FLMiddlSnsrFailSts "fuel,ev";
BA_ "Match" SG_ 664 FPAS_FLMiddlSnsrFailSts "FPAS_FLMiddlSnsrFailSts";
BA_ "GenSigCycleTime" SG_ 664 FPAS_FLMiddlSnsrFailSts 100;
BA_ "Origin" SG_ 664 FPAS_FRMiddlSnsrFailSts "fuel,ev";
BA_ "Match" SG_ 664 FPAS_FRMiddlSnsrFailSts "FPAS_FRMiddlSnsrFailSts";
BA_ "GenSigCycleTime" SG_ 664 FPAS_FRMiddlSnsrFailSts 100;
BA_ "Origin" SG_ 664 FPAS_FRCornrSnsrFailSts "fuel,ev";
BA_ "Match" SG_ 664 FPAS_FRCornrSnsrFailSts "FPAS_FRCornrSnsrFailSts";
BA_ "GenSigCycleTime" SG_ 664 FPAS_FRCornrSnsrFailSts 100;
BA_ "Origin" SG_ 664 FPAS_WorkSts "fuel,ev";
BA_ "Match" SG_ 664 FPAS_WorkSts "FPAS_WorkSts";
BA_ "GenSigCycleTime" SG_ 664 FPAS_WorkSts 100;
BA_ "Origin" SG_ 664 FPAS_AutoModSts "fuel,ev";
BA_ "Match" SG_ 664 FPAS_AutoModSts "FPAS_AutoModSts";
BA_ "GenSigCycleTime" SG_ 664 FPAS_AutoModSts 100;
BA_ "Origin" SG_ 664 FPAS_SoundIndcn "fuel,ev";
BA_ "Match" SG_ 664 FPAS_SoundIndcn "FPAS_SoundIndcn";
BA_ "GenSigCycleTime" SG_ 664 FPAS_SoundIndcn 100;
BA_ "Origin" SG_ 664 FPAS_NearBrrdstn "fuel,ev";
BA_ "Match" SG_ 664 FPAS_NearBrrdstn "FPAS_NearBrrdstn";
BA_ "GenSigStartValue" SG_ 664 FPAS_NearBrrdstn 127;
BA_ "GenSigCycleTime" SG_ 664 FPAS_NearBrrdstn 100;
BA_ "Origin" SG_ 664 APA_MenuDispCtrlCmd "fuel,ev";
BA_ "Match" SG_ 664 APA_MenuDispCtrlCmd "APA_MenuDispCtrlCmd";
BA_ "GenSigCycleTime" SG_ 664 APA_MenuDispCtrlCmd 100;
BA_ "Origin" SG_ 664 APA_FuncSts "fuel,ev";
BA_ "Match" SG_ 664 APA_FuncSts "APA_FuncSts";
BA_ "GenSigCycleTime" SG_ 664 APA_FuncSts 100;
BA_ "Origin" SG_ 664 RADS_FuncSts "fuel,ev";
BA_ "Match" SG_ 664 RADS_FuncSts "RADS_FuncSts";
BA_ "GenSigCycleTime" SG_ 664 RADS_FuncSts 100;
BA_ "Origin" SG_ 664 FADS_FuncSts "fuel,ev";
BA_ "Match" SG_ 664 FADS_FuncSts "FADS_FuncSts";
BA_ "GenSigCycleTime" SG_ 664 FADS_FuncSts 100;
BA_ "Origin" SG_ 664 HAP_TextIconDispCtrl "fuel,ev";
BA_ "Match" SG_ 664 HAP_TextIconDispCtrl "HAP_TextIconDispCtrl";
BA_ "GenSigCycleTime" SG_ 664 HAP_TextIconDispCtrl 100;
BA_ "Origin" SG_ 664 P2P_FuncSts "fuel,ev";
BA_ "Match" SG_ 664 P2P_FuncSts "P2P_FuncSts";
BA_ "GenSigCycleTime" SG_ 664 P2P_FuncSts 100;
BA_ "Origin" SG_ 664 FrntCamDirtySts "fuel,ev";
BA_ "Match" SG_ 664 FrntCamDirtySts "FrntCamDirtySts";
BA_ "GenSigCycleTime" SG_ 664 FrntCamDirtySts 100;
BA_ "Origin" SG_ 664 RearCamDirtySts "fuel,ev";
BA_ "Match" SG_ 664 RearCamDirtySts "RearCamDirtySts";
BA_ "GenSigCycleTime" SG_ 664 RearCamDirtySts 100;
BA_ "Origin" SG_ 664 LeCamDirtySts "fuel,ev";
BA_ "Match" SG_ 664 LeCamDirtySts "LeCamDirtySts";
BA_ "GenSigCycleTime" SG_ 664 LeCamDirtySts 100;
BA_ "Origin" SG_ 664 RiCamDirtySts "fuel,ev";
BA_ "Match" SG_ 664 RiCamDirtySts "RiCamDirtySts";
BA_ "GenSigCycleTime" SG_ 664 RiCamDirtySts 100;
BA_ "Origin" SG_ 664 DVRCamDirtySts "fuel,ev";
BA_ "Match" SG_ 664 DVRCamDirtySts "DVRCamDirtySts";
BA_ "GenSigCycleTime" SG_ 664 DVRCamDirtySts 100;
BA_ "TransparentInitValue" SG_ 664 HAP_FD3_0x298 "0 255 254 254 0 0 0 0 0 0 0 0 0 0 0 0 0 0 0 0 0 0 0 0 0 0 0 0 0 0 7 240 0 0 0 0 0 0 0 0 0 0 0 0 0 0 0 0 0 0 0 0 0 0 0 0 0 0 0 0 0 0 0 0 ";
BA_ "GenSigCycleTime" SG_ 664 HAP_FD3_0x298 100;
BA_ "Origin" SG_ 665 FGA_Chan1LongTyp "fuel,ev";
BA_ "Match" SG_ 665 FGA_Chan1LongTyp "FGA_Chan1LongTyp";
BA_ "GenSigCycleTime" SG_ 665 FGA_Chan1LongTyp 100;
BA_ "Origin" SG_ 665 FGA_Chan2LongTyp "fuel,ev";
BA_ "Match" SG_ 665 FGA_Chan2LongTyp "FGA_Chan2LongTyp";
BA_ "GenSigCycleTime" SG_ 665 FGA_Chan2LongTyp 100;
BA_ "Origin" SG_ 665 FGA_Chan3LongTyp "fuel,ev";
BA_ "Match" SG_ 665 FGA_Chan3LongTyp "FGA_Chan3LongTyp";
BA_ "GenSigCycleTime" SG_ 665 FGA_Chan3LongTyp 100;
BA_ "TransparentInitValue" SG_ 665 AC14_0x299 "0 0 0 0 0 0 0 0 ";
BA_ "GenSigCycleTime" SG_ 665 AC14_0x299 100;
BA_ "Origin" SG_ 667 HAVP_LrngDst "fuel,ev";
BA_ "Match" SG_ 667 HAVP_LrngDst "HAVP_LrngDst";
BA_ "GenSigStartValue" SG_ 667 HAVP_LrngDst 1023;
BA_ "GenSigCycleTime" SG_ 667 HAVP_LrngDst 100;
BA_ "Origin" SG_ 667 HAVP_HUT_TextDisp "fuel,ev";
BA_ "Match" SG_ 667 HAVP_HUT_TextDisp "HAVP_HUT_TextDisp";
BA_ "GenSigCycleTime" SG_ 667 HAVP_HUT_TextDisp 100;
BA_ "Origin" SG_ 667 HAVP_ScFail_info "fuel,ev";
BA_ "Match" SG_ 667 HAVP_ScFail_info "HAVP_ScFail_info";
BA_ "GenSigCycleTime" SG_ 667 HAVP_ScFail_info 100;
BA_ "Origin" SG_ 667 PAVP_ScFail_info "fuel,ev";
BA_ "Match" SG_ 667 PAVP_ScFail_info "PAVP_ScFail_info";
BA_ "GenSigCycleTime" SG_ 667 PAVP_ScFail_info 100;
BA_ "TransparentInitValue" SG_ 667 HAP_FD7_0x29B "0 0 0 0 0 0 0 0 0 0 0 0 0 0 0 0 0 0 0 0 0 0 0 0 0 0 0 0 0 0 0 0 0 0 0 0 0 0 0 0 0 0 0 0 0 0 255 192 0 0 0 0 0 0 0 0 0 0 0 0 0 0 0 0 ";
BA_ "GenSigCycleTime" SG_ 667 HAP_FD7_0x29B 100;
BA_ "Origin" SG_ 669 InCarTemp "fuel,ev";
BA_ "Match" SG_ 669 InCarTemp "InCarTemp";
BA_ "GenSigStartValue" SG_ 669 InCarTemp 254;
BA_ "GenSigCycleTime" SG_ 669 InCarTemp 100;
BA_ "Origin" SG_ 669 ACAQSEnaSts "fuel,ev";
BA_ "Match" SG_ 669 ACAQSEnaSts "ACAQSEnaSts";
BA_ "GenSigCycleTime" SG_ 669 ACAQSEnaSts 100;
BA_ "Origin" SG_ 669 ACOperMod "fuel,ev";
BA_ "Match" SG_ 669 ACOperMod "ACOperMod";
BA_ "GenSigCycleTime" SG_ 669 ACOperMod 100;
BA_ "Origin" SG_ 669 ACAIUEnaSts "fuel,ev";
BA_ "Match" SG_ 669 ACAIUEnaSts "ACAIUEnaSts";
BA_ "GenSigCycleTime" SG_ 669 ACAIUEnaSts 100;
BA_ "Origin" SG_ 669 ACDrvAirDistriMod "fuel,ev";
BA_ "Match" SG_ 669 ACDrvAirDistriMod "ACDrvAirDistriMod";
BA_ "GenSigStartValue" SG_ 669 ACDrvAirDistriMod 7;
BA_ "GenSigCycleTime" SG_ 669 ACDrvAirDistriMod 100;
BA_ "Origin" SG_ 669 ACSteplessSpdSetEnaSts "fuel,ev";
BA_ "Match" SG_ 669 ACSteplessSpdSetEnaSts "ACSteplessSpdSetEnaSts";
BA_ "GenSigCycleTime" SG_ 669 ACSteplessSpdSetEnaSts 100;
BA_ "Origin" SG_ 669 ACFrntPassTempSteplessSetEnaSts "fuel,ev";
BA_ "Match" SG_ 669 ACFrntPassTempSteplessSetEnaSts "ACFrntPassTempSteplessSetEnaSts";
BA_ "GenSigCycleTime" SG_ 669 ACFrntPassTempSteplessSetEnaSts 100;
BA_ "Origin" SG_ 669 ACDrvTempSteplessSetEnaSts "fuel,ev";
BA_ "Match" SG_ 669 ACDrvTempSteplessSetEnaSts "ACDrvTempSteplessSetEnaSts";
BA_ "GenSigCycleTime" SG_ 669 ACDrvTempSteplessSetEnaSts 100;
BA_ "Origin" SG_ 669 ACEEMSts "fuel,ev";
BA_ "Match" SG_ 669 ACEEMSts "ACEEMSts";
BA_ "GenSigCycleTime" SG_ 669 ACEEMSts 100;
BA_ "Origin" SG_ 669 ACCbnClnEnasts "ev";
BA_ "Match" SG_ 669 ACCbnClnEnasts "ACCbnClnEnasts";
BA_ "GenSigCycleTime" SG_ 669 ACCbnClnEnasts 100;
BA_ "Origin" SG_ 669 ACCbnClnOffCode "ev";
BA_ "Match" SG_ 669 ACCbnClnOffCode "ACCbnClnOffCode";
BA_ "GenSigCycleTime" SG_ 669 ACCbnClnOffCode 100;
BA_ "TransparentInitValue" SG_ 669 AC1_0x29D "0 254 224 0 0 0 0 0 ";
BA_ "GenSigCycleTime" SG_ 669 AC1_0x29D 100;
BA_ "Origin" SG_ 671 RemoteModSts "fuel,ev";
BA_ "Match" SG_ 671 RemoteModSts "RemoteModSts";
BA_ "GenSigCycleTime" SG_ 671 RemoteModSts 100;
BA_ "Origin" SG_ 671 PASWorkCmd "fuel,ev";
BA_ "Match" SG_ 671 PASWorkCmd "PASWorkCmd";
BA_ "GenSigCycleTime" SG_ 671 PASWorkCmd 100;
BA_ "Origin" SG_ 671 KL30BRelaySts "fuel,ev";
BA_ "Match" SG_ 671 KL30BRelaySts "KL30BRelaySts";
BA_ "GenSigCycleTime" SG_ 671 KL30BRelaySts 100;
BA_ "Origin" SG_ 671 RViewMirrorSts "fuel,ev";
BA_ "Match" SG_ 671 RViewMirrorSts "RViewMirrorSts";
BA_ "GenSigCycleTime" SG_ 671 RViewMirrorSts 100;
BA_ "Origin" SG_ 671 WiprReq_F_PBox "fuel,ev";
BA_ "Match" SG_ 671 WiprReq_F_PBox "WiprReq_F_PBox";
BA_ "GenSigCycleTime" SG_ 671 WiprReq_F_PBox 100;
BA_ "Origin" SG_ 671 DrivingModReq "fuel,ev";
BA_ "Match" SG_ 671 DrivingModReq "DrivingModReq";
BA_ "GenSigCycleTime" SG_ 671 DrivingModReq 100;
BA_ "Origin" SG_ 671 WhistleSts "ev";
BA_ "Match" SG_ 671 WhistleSts "WhistleSts";
BA_ "GenSigCycleTime" SG_ 671 WhistleSts 100;
BA_ "TransparentInitValue" SG_ 671 BCM8_0x29F "0 0 0 0 0 0 0 0 ";
BA_ "GenSigCycleTime" SG_ 671 BCM8_0x29F 100;
BA_ "Origin" SG_ 675 DrvSeatHeatSts_Nine "fuel,ev";
BA_ "Match" SG_ 675 DrvSeatHeatSts_Nine "DrvSeatHeatSts_Nine";
BA_ "GenSigCycleTime" SG_ 675 DrvSeatHeatSts_Nine 100;
BA_ "Origin" SG_ 675 PassSeatHeatSts_Nine "fuel,ev";
BA_ "Match" SG_ 675 PassSeatHeatSts_Nine "PassSeatHeatSts_Nine";
BA_ "GenSigCycleTime" SG_ 675 PassSeatHeatSts_Nine 100;
BA_ "Origin" SG_ 675 SecRowLeSeatHeatSts_Nine "fuel,ev";
BA_ "Match" SG_ 675 SecRowLeSeatHeatSts_Nine "SecRowLeSeatHeatSts_Nine";
BA_ "GenSigCycleTime" SG_ 675 SecRowLeSeatHeatSts_Nine 100;
BA_ "Origin" SG_ 675 SecRowRiSeatHeatSts_Nine "fuel,ev";
BA_ "Match" SG_ 675 SecRowRiSeatHeatSts_Nine "SecRowRiSeatHeatSts_Nine";
BA_ "GenSigCycleTime" SG_ 675 SecRowRiSeatHeatSts_Nine 100;
BA_ "TransparentInitValue" SG_ 675 BCM14_0x2A3 "0 0 0 0 0 0 0 0 ";
BA_ "GenSigCycleTime" SG_ 675 BCM14_0x2A3 100;
BA_ "Origin" SG_ 680 TranPMode_Sts "fuel,ev";
BA_ "Match" SG_ 680 TranPMode_Sts "TranPMode_Sts";
BA_ "GenSigCycleTime" SG_ 680 TranPMode_Sts 100;
BA_ "Origin" SG_ 680 Stat_PwrSv_Lvl "fuel,ev";
BA_ "Match" SG_ 680 Stat_PwrSv_Lvl "Stat_PwrSv_Lvl";
BA_ "GenSigCycleTime" SG_ 680 Stat_PwrSv_Lvl 100;
BA_ "Origin" SG_ 680 Dyn_PwrSv_Lvl "fuel,ev";
BA_ "Match" SG_ 680 Dyn_PwrSv_Lvl "Dyn_PwrSv_Lvl";
BA_ "GenSigCycleTime" SG_ 680 Dyn_PwrSv_Lvl 100;
BA_ "Origin" SG_ 680 LvPwrSysErr "fuel,ev";
BA_ "Match" SG_ 680 LvPwrSysErr "LvPwrSysErr";
BA_ "GenSigCycleTime" SG_ 680 LvPwrSysErr 100;
BA_ "Origin" SG_ 680 DeepSlpCmd "ev";
BA_ "Match" SG_ 680 DeepSlpCmd "DeepSlpCmd";
BA_ "GenSigCycleTime" SG_ 680 DeepSlpCmd 100;
BA_ "TransparentInitValue" SG_ 680 EEM1_0x2A8 "0 0 0 0 0 0 0 0 ";
BA_ "GenSigCycleTime" SG_ 680 EEM1_0x2A8 100;
BA_ "Origin" SG_ 683 ACC_LeTgt_02_Dy "fuel,ev";
BA_ "Match" SG_ 683 ACC_LeTgt_02_Dy "ACC_LeTgt_02_Dy";
BA_ "GenSigCycleTime" SG_ 683 ACC_LeTgt_02_Dy 100;
BA_ "Origin" SG_ 683 ACC_LeTgt_02_Dx "fuel,ev";
BA_ "Match" SG_ 683 ACC_LeTgt_02_Dx "ACC_LeTgt_02_Dx";
BA_ "GenSigCycleTime" SG_ 683 ACC_LeTgt_02_Dx 100;
BA_ "Origin" SG_ 683 ACC_LeTgt_02_Typ "fuel,ev";
BA_ "Match" SG_ 683 ACC_LeTgt_02_Typ "ACC_LeTgt_02_Typ";
BA_ "GenSigCycleTime" SG_ 683 ACC_LeTgt_02_Typ 100;
BA_ "Origin" SG_ 683 ACC_LeTargrt_02_Detn "fuel,ev";
BA_ "Match" SG_ 683 ACC_LeTargrt_02_Detn "ACC_LeTargrt_02_Detn";
BA_ "GenSigCycleTime" SG_ 683 ACC_LeTargrt_02_Detn 100;
BA_ "Origin" SG_ 683 ACC_RiTargrt_02_Detn "fuel,ev";
BA_ "Match" SG_ 683 ACC_RiTargrt_02_Detn "ACC_RiTargrt_02_Detn";
BA_ "GenSigCycleTime" SG_ 683 ACC_RiTargrt_02_Detn 100;
BA_ "Origin" SG_ 683 ACC_RiTgt_02_Dy "fuel,ev";
BA_ "Match" SG_ 683 ACC_RiTgt_02_Dy "ACC_RiTgt_02_Dy";
BA_ "GenSigCycleTime" SG_ 683 ACC_RiTgt_02_Dy 100;
BA_ "Origin" SG_ 683 ACC_RiTgt_02_Dx "fuel,ev";
BA_ "Match" SG_ 683 ACC_RiTgt_02_Dx "ACC_RiTgt_02_Dx";
BA_ "GenSigCycleTime" SG_ 683 ACC_RiTgt_02_Dx 100;
BA_ "Origin" SG_ 683 ACC_RiTgt_02_Typ "fuel,ev";
BA_ "Match" SG_ 683 ACC_RiTgt_02_Typ "ACC_RiTgt_02_Typ";
BA_ "GenSigCycleTime" SG_ 683 ACC_RiTgt_02_Typ 100;
BA_ "Origin" SG_ 683 ACC_LeTgtObjBarDisp "fuel,ev";
BA_ "Match" SG_ 683 ACC_LeTgtObjBarDisp "ACC_LeTgtObjBarDisp";
BA_ "GenSigCycleTime" SG_ 683 ACC_LeTgtObjBarDisp 100;
BA_ "Origin" SG_ 683 ACC_RiTgtObjBarDisp "fuel,ev";
BA_ "Match" SG_ 683 ACC_RiTgtObjBarDisp "ACC_RiTgtObjBarDisp";
BA_ "GenSigCycleTime" SG_ 683 ACC_RiTgtObjBarDisp 100;
BA_ "Origin" SG_ 683 Checksum_ACC3 "fuel,ev";
BA_ "Match" SG_ 683 Checksum_ACC3 "Checksum_ACC3";
BA_ "GenSigCycleTime" SG_ 683 Checksum_ACC3 100;
BA_ "Origin" SG_ 683 ICA_HandsOffResp "fuel,ev";
BA_ "Match" SG_ 683 ICA_HandsOffResp "ICA_HandsOffResp";
BA_ "GenSigCycleTime" SG_ 683 ICA_HandsOffResp 100;
BA_ "Origin" SG_ 683 ALC_Resp "fuel,ev";
BA_ "Match" SG_ 683 ALC_Resp "ALC_Resp";
BA_ "GenSigCycleTime" SG_ 683 ALC_Resp 100;
BA_ "Origin" SG_ 683 HWA_Resp "fuel,ev";
BA_ "Match" SG_ 683 HWA_Resp "HWA_Resp";
BA_ "GenSigCycleTime" SG_ 683 HWA_Resp 100;
BA_ "Origin" SG_ 683 ISL_Resp "fuel,ev";
BA_ "Match" SG_ 683 ISL_Resp "ISL_Resp";
BA_ "GenSigCycleTime" SG_ 683 ISL_Resp 100;
BA_ "Origin" SG_ 683 HWA_SnvtySet_Resp "fuel,ev";
BA_ "Match" SG_ 683 HWA_SnvtySet_Resp "HWA_SnvtySet_Resp";
BA_ "GenSigCycleTime" SG_ 683 HWA_SnvtySet_Resp 100;
BA_ "Origin" SG_ 683 Longctrl_VehHldReq_DVR "fuel,ev";
BA_ "Match" SG_ 683 Longctrl_VehHldReq_DVR "Longctrl_VehHldReq_DVR";
BA_ "GenSigCycleTime" SG_ 683 Longctrl_VehHldReq_DVR 100;
BA_ "Origin" SG_ 683 Longctrl_DrvOFF_Req_DVR "fuel,ev";
BA_ "Match" SG_ 683 Longctrl_DrvOFF_Req_DVR "Longctrl_DrvOFF_Req_DVR";
BA_ "GenSigCycleTime" SG_ 683 Longctrl_DrvOFF_Req_DVR 100;
BA_ "Origin" SG_ 683 Longctrl_ModSts_DVR "fuel,ev";
BA_ "Match" SG_ 683 Longctrl_ModSts_DVR "Longctrl_ModSts_DVR";
BA_ "GenSigStartValue" SG_ 683 Longctrl_ModSts_DVR 1;
BA_ "GenSigCycleTime" SG_ 683 Longctrl_ModSts_DVR 100;
BA_ "Origin" SG_ 683 Longctrl_Decel_Req_DVR "fuel,ev";
BA_ "Match" SG_ 683 Longctrl_Decel_Req_DVR "Longctrl_Decel_Req_DVR";
BA_ "GenSigCycleTime" SG_ 683 Longctrl_Decel_Req_DVR 100;
BA_ "Origin" SG_ 683 Longctrl_EngTrqReq_DVR "fuel,ev";
BA_ "Match" SG_ 683 Longctrl_EngTrqReq_DVR "Longctrl_EngTrqReq_DVR";
BA_ "GenSigStartValue" SG_ 683 Longctrl_EngTrqReq_DVR 32767;
BA_ "GenSigCycleTime" SG_ 683 Longctrl_EngTrqReq_DVR 100;
BA_ "Origin" SG_ 683 Longctrl_EngTrqReqActive_DVR "fuel,ev";
BA_ "Match" SG_ 683 Longctrl_EngTrqReqActive_DVR "Longctrl_EngTrqReqActive_DVR";
BA_ "GenSigCycleTime" SG_ 683 Longctrl_EngTrqReqActive_DVR 100;
BA_ "Origin" SG_ 683 Longctrl_DecelToStopReq_DVR "fuel,ev";
BA_ "Match" SG_ 683 Longctrl_DecelToStopReq_DVR "Longctrl_DecelToStopReq_DVR";
BA_ "GenSigCycleTime" SG_ 683 Longctrl_DecelToStopReq_DVR 100;
BA_ "Origin" SG_ 683 Longctrl_ParkShiftReq_DVR "fuel,ev";
BA_ "Match" SG_ 683 Longctrl_ParkShiftReq_DVR "Longctrl_ParkShiftReq_DVR";
BA_ "GenSigCycleTime" SG_ 683 Longctrl_ParkShiftReq_DVR 100;
BA_ "Origin" SG_ 683 Longctrl_Decel_ReqValue_DVR "fuel,ev";
BA_ "Match" SG_ 683 Longctrl_Decel_ReqValue_DVR "Longctrl_Decel_ReqValue_DVR";
BA_ "GenSigCycleTime" SG_ 683 Longctrl_Decel_ReqValue_DVR 100;
BA_ "Origin" SG_ 683 ALC_InterSysInfoDisp "fuel,ev";
BA_ "Match" SG_ 683 ALC_InterSysInfoDisp "ALC_InterSysInfoDisp";
BA_ "GenSigCycleTime" SG_ 683 ALC_InterSysInfoDisp 100;
BA_ "Origin" SG_ 683 RollingCounter_ACC3 "fuel,ev";
BA_ "Match" SG_ 683 RollingCounter_ACC3 "RollingCounter_ACC3";
BA_ "GenSigCycleTime" SG_ 683 RollingCounter_ACC3 100;
BA_ "Origin" SG_ 683 Checksum_ACC4 "fuel,ev";
BA_ "Match" SG_ 683 Checksum_ACC4 "Checksum_ACC4";
BA_ "GenSigCycleTime" SG_ 683 Checksum_ACC4 100;
BA_ "Origin" SG_ 683 ACC_ObjDetecte "fuel,ev";
BA_ "Match" SG_ 683 ACC_ObjDetecte "ACC_ObjDetecte";
BA_ "GenSigCycleTime" SG_ 683 ACC_ObjDetecte 100;
BA_ "Origin" SG_ 683 ACC_TakeOverReq "fuel,ev";
BA_ "Match" SG_ 683 ACC_TakeOverReq "ACC_TakeOverReq";
BA_ "GenSigCycleTime" SG_ 683 ACC_TakeOverReq 100;
BA_ "Origin" SG_ 683 ACC_InterSysInfoDisp "fuel,ev";
BA_ "Match" SG_ 683 ACC_InterSysInfoDisp "ACC_InterSysInfoDisp";
BA_ "GenSigCycleTime" SG_ 683 ACC_InterSysInfoDisp 100;
BA_ "Origin" SG_ 683 ACC_ModDisp "fuel,ev";
BA_ "Match" SG_ 683 ACC_ModDisp "ACC_ModDisp";
BA_ "GenSigStartValue" SG_ 683 ACC_ModDisp 1;
BA_ "GenSigCycleTime" SG_ 683 ACC_ModDisp 100;
BA_ "Origin" SG_ 683 ACC_FctSts "fuel,ev";
BA_ "Match" SG_ 683 ACC_FctSts "ACC_FctSts";
BA_ "GenSigCycleTime" SG_ 683 ACC_FctSts 100;
BA_ "Origin" SG_ 683 ACC_TgtObjBarDisp "fuel,ev";
BA_ "Match" SG_ 683 ACC_TgtObjBarDisp "ACC_TgtObjBarDisp";
BA_ "GenSigCycleTime" SG_ 683 ACC_TgtObjBarDisp 100;
BA_ "Origin" SG_ 683 Longctrl_HazActv "fuel,ev";
BA_ "Match" SG_ 683 Longctrl_HazActv "Longctrl_HazActv";
BA_ "GenSigCycleTime" SG_ 683 Longctrl_HazActv 100;
BA_ "Origin" SG_ 683 TJA_ACC_SelSts "fuel,ev";
BA_ "Match" SG_ 683 TJA_ACC_SelSts "TJA_ACC_SelSts";
BA_ "GenSigCycleTime" SG_ 683 TJA_ACC_SelSts 100;
BA_ "Origin" SG_ 683 CruCha_ModDisp "fuel,ev";
BA_ "Match" SG_ 683 CruCha_ModDisp "CruCha_ModDisp";
BA_ "GenSigCycleTime" SG_ 683 CruCha_ModDisp 100;
BA_ "Origin" SG_ 683 TJA_ICA_InterSysInfoDisp "fuel,ev";
BA_ "Match" SG_ 683 TJA_ICA_InterSysInfoDisp "TJA_ICA_InterSysInfoDisp";
BA_ "GenSigCycleTime" SG_ 683 TJA_ICA_InterSysInfoDisp 100;
BA_ "Origin" SG_ 683 TJA_ICA_ModDisp "fuel,ev";
BA_ "Match" SG_ 683 TJA_ICA_ModDisp "TJA_ICA_ModDisp";
BA_ "GenSigStartValue" SG_ 683 TJA_ICA_ModDisp 1;
BA_ "GenSigCycleTime" SG_ 683 TJA_ICA_ModDisp 100;
BA_ "Origin" SG_ 683 ISL_InterSysInfoDisp "fuel,ev";
BA_ "Match" SG_ 683 ISL_InterSysInfoDisp "ISL_InterSysInfoDisp";
BA_ "GenSigCycleTime" SG_ 683 ISL_InterSysInfoDisp 100;
BA_ "Origin" SG_ 683 ACC_TimeGapSet "fuel,ev";
BA_ "Match" SG_ 683 ACC_TimeGapSet "ACC_TimeGapSet";
BA_ "GenSigCycleTime" SG_ 683 ACC_TimeGapSet 100;
BA_ "Origin" SG_ 683 ACC_SpdSetValue "fuel,ev";
BA_ "Match" SG_ 683 ACC_SpdSetValue "ACC_SpdSetValue";
BA_ "GenSigStartValue" SG_ 683 ACC_SpdSetValue 255;
BA_ "GenSigCycleTime" SG_ 683 ACC_SpdSetValue 100;
BA_ "Origin" SG_ 683 CruChar_InterSysInfoDisp "fuel,ev";
BA_ "Match" SG_ 683 CruChar_InterSysInfoDisp "CruChar_InterSysInfoDisp";
BA_ "GenSigCycleTime" SG_ 683 CruChar_InterSysInfoDisp 100;
BA_ "Origin" SG_ 683 RollingCounter_ACC4 "fuel,ev";
BA_ "Match" SG_ 683 RollingCounter_ACC4 "RollingCounter_ACC4";
BA_ "GenSigCycleTime" SG_ 683 RollingCounter_ACC4 100;
BA_ "Origin" SG_ 683 Checksum_ACC8 "fuel,ev";
BA_ "Match" SG_ 683 Checksum_ACC8 "Checksum_ACC8";
BA_ "GenSigCycleTime" SG_ 683 Checksum_ACC8 100;
BA_ "Origin" SG_ 683 HWA_ModDisp "fuel,ev";
BA_ "Match" SG_ 683 HWA_ModDisp "HWA_ModDisp";
BA_ "GenSigCycleTime" SG_ 683 HWA_ModDisp 100;
BA_ "Origin" SG_ 683 HWA_InterSysInfoDisp "fuel,ev";
BA_ "Match" SG_ 683 HWA_InterSysInfoDisp "HWA_InterSysInfoDisp";
BA_ "GenSigCycleTime" SG_ 683 HWA_InterSysInfoDisp 100;
BA_ "Origin" SG_ 683 HWA_LaneChange "fuel,ev";
BA_ "Match" SG_ 683 HWA_LaneChange "HWA_LaneChange";
BA_ "GenSigCycleTime" SG_ 683 HWA_LaneChange 100;
BA_ "Origin" SG_ 683 HWA_LaneChangeReq "fuel,ev";
BA_ "Match" SG_ 683 HWA_LaneChangeReq "HWA_LaneChangeReq";
BA_ "GenSigCycleTime" SG_ 683 HWA_LaneChangeReq 100;
BA_ "Origin" SG_ 683 HWA_Warning "fuel,ev";
BA_ "Match" SG_ 683 HWA_Warning "HWA_Warning";
BA_ "GenSigCycleTime" SG_ 683 HWA_Warning 100;
BA_ "Origin" SG_ 683 RollingCounter_ACC8 "fuel,ev";
BA_ "Match" SG_ 683 RollingCounter_ACC8 "RollingCounter_ACC8";
BA_ "GenSigCycleTime" SG_ 683 RollingCounter_ACC8 100;
BA_ "Origin" SG_ 683 Checksum_ACC6 "fuel,ev";
BA_ "Match" SG_ 683 Checksum_ACC6 "Checksum_ACC6";
BA_ "GenSigCycleTime" SG_ 683 Checksum_ACC6 100;
BA_ "Origin" SG_ 683 ACC_PotentialTgtDy "fuel,ev";
BA_ "Match" SG_ 683 ACC_PotentialTgtDy "ACC_PotentialTgtDy";
BA_ "GenSigCycleTime" SG_ 683 ACC_PotentialTgtDy 100;
BA_ "Origin" SG_ 683 ACC_PotentialTgtDx "fuel,ev";
BA_ "Match" SG_ 683 ACC_PotentialTgtDx "ACC_PotentialTgtDx";
BA_ "GenSigCycleTime" SG_ 683 ACC_PotentialTgtDx 100;
BA_ "Origin" SG_ 683 ACC_RlvTgtDetn "fuel,ev";
BA_ "Match" SG_ 683 ACC_RlvTgtDetn "ACC_RlvTgtDetn";
BA_ "GenSigCycleTime" SG_ 683 ACC_RlvTgtDetn 100;
BA_ "Origin" SG_ 683 ACC_EgoStatus "fuel,ev";
BA_ "Match" SG_ 683 ACC_EgoStatus "ACC_EgoStatus";
BA_ "GenSigCycleTime" SG_ 683 ACC_EgoStatus 100;
BA_ "Origin" SG_ 683 ACC_RlvTgtTyp "fuel,ev";
BA_ "Match" SG_ 683 ACC_RlvTgtTyp "ACC_RlvTgtTyp";
BA_ "GenSigCycleTime" SG_ 683 ACC_RlvTgtTyp 100;
BA_ "Origin" SG_ 683 ACC_RlvTgtDy "fuel,ev";
BA_ "Match" SG_ 683 ACC_RlvTgtDy "ACC_RlvTgtDy";
BA_ "GenSigCycleTime" SG_ 683 ACC_RlvTgtDy 100;
BA_ "Origin" SG_ 683 ACC_RlvTgtDx "fuel,ev";
BA_ "Match" SG_ 683 ACC_RlvTgtDx "ACC_RlvTgtDx";
BA_ "GenSigCycleTime" SG_ 683 ACC_RlvTgtDx 100;
BA_ "Origin" SG_ 683 ACC_PotentialTgtDetn "fuel,ev";
BA_ "Match" SG_ 683 ACC_PotentialTgtDetn "ACC_PotentialTgtDetn";
BA_ "GenSigCycleTime" SG_ 683 ACC_PotentialTgtDetn 100;
BA_ "Origin" SG_ 683 ACC_PotentialTgtTyp "fuel,ev";
BA_ "Match" SG_ 683 ACC_PotentialTgtTyp "ACC_PotentialTgtTyp";
BA_ "GenSigCycleTime" SG_ 683 ACC_PotentialTgtTyp 100;
BA_ "Origin" SG_ 683 RollingCounter_ACC6 "fuel,ev";
BA_ "Match" SG_ 683 RollingCounter_ACC6 "RollingCounter_ACC6";
BA_ "GenSigCycleTime" SG_ 683 RollingCounter_ACC6 100;
BA_ "Origin" SG_ 683 Checksum_ACC7 "fuel,ev";
BA_ "Match" SG_ 683 Checksum_ACC7 "Checksum_ACC7";
BA_ "GenSigCycleTime" SG_ 683 Checksum_ACC7 100;
BA_ "Origin" SG_ 683 Request_driveoff "fuel,ev";
BA_ "Match" SG_ 683 Request_driveoff "Request_driveoff";
BA_ "GenSigCycleTime" SG_ 683 Request_driveoff 100;
BA_ "Origin" SG_ 683 ACCSts "fuel,ev";
BA_ "Match" SG_ 683 ACCSts "ACCSts";
BA_ "GenSigCycleTime" SG_ 683 ACCSts 100;
BA_ "Origin" SG_ 683 ACC_LeTgtDy "fuel,ev";
BA_ "Match" SG_ 683 ACC_LeTgtDy "ACC_LeTgtDy";
BA_ "GenSigCycleTime" SG_ 683 ACC_LeTgtDy 100;
BA_ "Origin" SG_ 683 ACC_LeTgtDx "fuel,ev";
BA_ "Match" SG_ 683 ACC_LeTgtDx "ACC_LeTgtDx";
BA_ "GenSigCycleTime" SG_ 683 ACC_LeTgtDx 100;
BA_ "Origin" SG_ 683 ACC_LeTgtTyp "fuel,ev";
BA_ "Match" SG_ 683 ACC_LeTgtTyp "ACC_LeTgtTyp";
BA_ "GenSigCycleTime" SG_ 683 ACC_LeTgtTyp 100;
BA_ "Origin" SG_ 683 ACC_LeTargrtDection "fuel,ev";
BA_ "Match" SG_ 683 ACC_LeTargrtDection "ACC_LeTargrtDection";
BA_ "GenSigCycleTime" SG_ 683 ACC_LeTargrtDection 100;
BA_ "Origin" SG_ 683 ACC_RiTargrtDetn "fuel,ev";
BA_ "Match" SG_ 683 ACC_RiTargrtDetn "ACC_RiTargrtDetn";
BA_ "GenSigCycleTime" SG_ 683 ACC_RiTargrtDetn 100;
BA_ "Origin" SG_ 683 ACC_RiTgtDy "fuel,ev";
BA_ "Match" SG_ 683 ACC_RiTgtDy "ACC_RiTgtDy";
BA_ "GenSigCycleTime" SG_ 683 ACC_RiTgtDy 100;
BA_ "Origin" SG_ 683 ACC_RiTgtDx "fuel,ev";
BA_ "Match" SG_ 683 ACC_RiTgtDx "ACC_RiTgtDx";
BA_ "GenSigCycleTime" SG_ 683 ACC_RiTgtDx 100;
BA_ "Origin" SG_ 683 ACC_RiTgtTyp "fuel,ev";
BA_ "Match" SG_ 683 ACC_RiTgtTyp "ACC_RiTgtTyp";
BA_ "GenSigCycleTime" SG_ 683 ACC_RiTgtTyp 100;
BA_ "Origin" SG_ 683 RollingCounter_ACC7 "fuel,ev";
BA_ "Match" SG_ 683 RollingCounter_ACC7 "RollingCounter_ACC7";
BA_ "GenSigCycleTime" SG_ 683 RollingCounter_ACC7 100;
BA_ "Origin" SG_ 683 FreshnessValue_ACC_FD2 "fuel,ev";
BA_ "Match" SG_ 683 FreshnessValue_ACC_FD2 "FreshnessValue_ACC_FD2";
BA_ "GenSigCycleTime" SG_ 683 FreshnessValue_ACC_FD2 100;
BA_ "Origin" SG_ 683 MAC_Check_ACC_FD2 "fuel,ev";
BA_ "Match" SG_ 683 MAC_Check_ACC_FD2 "MAC_Check_ACC_FD2";
BA_ "GenSigCycleTime" SG_ 683 MAC_Check_ACC_FD2 100;
BA_ "Origin" SG_ 683 ACC_RlvTgtfusion "fuel,ev";
BA_ "Match" SG_ 683 ACC_RlvTgtfusion "ACC_RlvTgtfusion";
BA_ "GenSigCycleTime" SG_ 683 ACC_RlvTgtfusion 100;
BA_ "Origin" SG_ 683 ACC_RlvTgtHeading "fuel,ev";
BA_ "Match" SG_ 683 ACC_RlvTgtHeading "ACC_RlvTgtHeading";
BA_ "GenSigStartValue" SG_ 683 ACC_RlvTgtHeading 30;
BA_ "GenSigCycleTime" SG_ 683 ACC_RlvTgtHeading 100;
BA_ "Origin" SG_ 683 ACC_LeTgtfusion "fuel,ev";
BA_ "Match" SG_ 683 ACC_LeTgtfusion "ACC_LeTgtfusion";
BA_ "GenSigCycleTime" SG_ 683 ACC_LeTgtfusion 100;
BA_ "Origin" SG_ 683 ACC_LeTgtHeading "fuel,ev";
BA_ "Match" SG_ 683 ACC_LeTgtHeading "ACC_LeTgtHeading";
BA_ "GenSigStartValue" SG_ 683 ACC_LeTgtHeading 30;
BA_ "GenSigCycleTime" SG_ 683 ACC_LeTgtHeading 100;
BA_ "Origin" SG_ 683 ACC_RiTgtfusion "fuel,ev";
BA_ "Match" SG_ 683 ACC_RiTgtfusion "ACC_RiTgtfusion";
BA_ "GenSigCycleTime" SG_ 683 ACC_RiTgtfusion 100;
BA_ "Origin" SG_ 683 ACC_RiTgtHeading "fuel,ev";
BA_ "Match" SG_ 683 ACC_RiTgtHeading "ACC_RiTgtHeading";
BA_ "GenSigStartValue" SG_ 683 ACC_RiTgtHeading 30;
BA_ "GenSigCycleTime" SG_ 683 ACC_RiTgtHeading 100;
BA_ "Origin" SG_ 683 ACC_PotentialTgtfusion "fuel,ev";
BA_ "Match" SG_ 683 ACC_PotentialTgtfusion "ACC_PotentialTgtfusion";
BA_ "GenSigCycleTime" SG_ 683 ACC_PotentialTgtfusion 100;
BA_ "Origin" SG_ 683 ACC_PotentialTgtHeading "fuel,ev";
BA_ "Match" SG_ 683 ACC_PotentialTgtHeading "ACC_PotentialTgtHeading";
BA_ "GenSigStartValue" SG_ 683 ACC_PotentialTgtHeading 30;
BA_ "GenSigCycleTime" SG_ 683 ACC_PotentialTgtHeading 100;
BA_ "Origin" SG_ 683 TargetCutinPro "fuel,ev";
BA_ "Match" SG_ 683 TargetCutinPro "TargetCutinPro";
BA_ "GenSigCycleTime" SG_ 683 TargetCutinPro 100;
BA_ "Origin" SG_ 683 TargetCutoutPro "fuel,ev";
BA_ "Match" SG_ 683 TargetCutoutPro "TargetCutoutPro";
BA_ "GenSigCycleTime" SG_ 683 TargetCutoutPro 100;
BA_ "Origin" SG_ 683 Longctrl_WheelTrqReqActive_DVR "ev";
BA_ "Match" SG_ 683 Longctrl_WheelTrqReqActive_DVR "Longctrl_WheelTrqReqActive_DVR";
BA_ "GenSigCycleTime" SG_ 683 Longctrl_WheelTrqReqActive_DVR 100;
BA_ "Origin" SG_ 683 Longctrl_WheelTrqReq_DVR "ev";
BA_ "Match" SG_ 683 Longctrl_WheelTrqReq_DVR "Longctrl_WheelTrqReq_DVR";
BA_ "GenSigCycleTime" SG_ 683 Longctrl_WheelTrqReq_DVR 100;
BA_ "TransparentInitValue" SG_ 683 ACC_FD2_0x2AB "0 0 0 0 0 0 0 0 0 0 4 127 255 0 0 0 0 0 8 0 0 32 255 0 0 0 0 0 0 0 0 0 0 0 0 0 0 0 0 0 0 0 0 0 0 0 0 0 0 60 120 121 224 0 0 0 0 0 0 0 0 0 0 0 ";
BA_ "GenSigCycleTime" SG_ 683 ACC_FD2_0x2AB 100;
BA_ "Origin" SG_ 692 JAPedObjExist "fuel,ev";
BA_ "Match" SG_ 692 JAPedObjExist "JAPedObjExist";
BA_ "GenSigCycleTime" SG_ 692 JAPedObjExist 100;
BA_ "Origin" SG_ 692 AEBJAObjID "fuel,ev";
BA_ "Match" SG_ 692 AEBJAObjID "AEBJAObjID";
BA_ "GenSigStartValue" SG_ 692 AEBJAObjID 255;
BA_ "GenSigCycleTime" SG_ 692 AEBJAObjID 100;
BA_ "Origin" SG_ 692 AEBJAObjExist "fuel,ev";
BA_ "Match" SG_ 692 AEBJAObjExist "AEBJAObjExist";
BA_ "GenSigCycleTime" SG_ 692 AEBJAObjExist 100;
BA_ "Origin" SG_ 692 JAPedObjID "fuel,ev";
BA_ "Match" SG_ 692 JAPedObjID "JAPedObjID";
BA_ "GenSigStartValue" SG_ 692 JAPedObjID 255;
BA_ "GenSigCycleTime" SG_ 692 JAPedObjID 100;
BA_ "Origin" SG_ 692 AEBJAObjVideoCfmd "fuel,ev";
BA_ "Match" SG_ 692 AEBJAObjVideoCfmd "AEBJAObjVideoCfmd";
BA_ "GenSigCycleTime" SG_ 692 AEBJAObjVideoCfmd 100;
BA_ "Origin" SG_ 692 AEBJAObjVx "fuel,ev";
BA_ "Match" SG_ 692 AEBJAObjVx "AEBJAObjVx";
BA_ "GenSigCycleTime" SG_ 692 AEBJAObjVx 100;
BA_ "Origin" SG_ 692 AEBJAObjDx "fuel,ev";
BA_ "Match" SG_ 692 AEBJAObjDx "AEBJAObjDx";
BA_ "GenSigCycleTime" SG_ 692 AEBJAObjDx 100;
BA_ "Origin" SG_ 692 JAPedObjVideoCfmd "fuel,ev";
BA_ "Match" SG_ 692 JAPedObjVideoCfmd "JAPedObjVideoCfmd";
BA_ "GenSigCycleTime" SG_ 692 JAPedObjVideoCfmd 100;
BA_ "Origin" SG_ 692 AEBJAObjState "fuel,ev";
BA_ "Match" SG_ 692 AEBJAObjState "AEBJAObjState";
BA_ "GenSigCycleTime" SG_ 692 AEBJAObjState 100;
BA_ "Origin" SG_ 692 AEBJAObjCntAlive "fuel,ev";
BA_ "Match" SG_ 692 AEBJAObjCntAlive "AEBJAObjCntAlive";
BA_ "GenSigCycleTime" SG_ 692 AEBJAObjCntAlive 100;
BA_ "Origin" SG_ 692 AEBJAObjDy "fuel,ev";
BA_ "Match" SG_ 692 AEBJAObjDy "AEBJAObjDy";
BA_ "GenSigCycleTime" SG_ 692 AEBJAObjDy 100;
BA_ "Origin" SG_ 692 JAPedObjState "fuel,ev";
BA_ "Match" SG_ 692 JAPedObjState "JAPedObjState";
BA_ "GenSigCycleTime" SG_ 692 JAPedObjState 100;
BA_ "Origin" SG_ 692 AEBJAObjObstcl "fuel,ev";
BA_ "Match" SG_ 692 AEBJAObjObstcl "AEBJAObjObstcl";
BA_ "GenSigCycleTime" SG_ 692 AEBJAObjObstcl 100;
BA_ "Origin" SG_ 692 AEBJAObjVy "fuel,ev";
BA_ "Match" SG_ 692 AEBJAObjVy "AEBJAObjVy";
BA_ "GenSigCycleTime" SG_ 692 AEBJAObjVy 100;
BA_ "Origin" SG_ 692 AEBJAObjAx "fuel,ev";
BA_ "Match" SG_ 692 AEBJAObjAx "AEBJAObjAx";
BA_ "GenSigCycleTime" SG_ 692 AEBJAObjAx 100;
BA_ "Origin" SG_ 692 AEBJAObjAy "fuel,ev";
BA_ "Match" SG_ 692 AEBJAObjAy "AEBJAObjAy";
BA_ "GenSigCycleTime" SG_ 692 AEBJAObjAy 100;
BA_ "Origin" SG_ 692 JAPedObjObstcl "fuel,ev";
BA_ "Match" SG_ 692 JAPedObjObstcl "JAPedObjObstcl";
BA_ "GenSigCycleTime" SG_ 692 JAPedObjObstcl 100;
BA_ "Origin" SG_ 692 JAPedObjDy "fuel,ev";
BA_ "Match" SG_ 692 JAPedObjDy "JAPedObjDy";
BA_ "GenSigCycleTime" SG_ 692 JAPedObjDy 100;
BA_ "Origin" SG_ 692 JAPedObjDx "fuel,ev";
BA_ "Match" SG_ 692 JAPedObjDx "JAPedObjDx";
BA_ "GenSigCycleTime" SG_ 692 JAPedObjDx 100;
BA_ "Origin" SG_ 692 FCWAEB_JATTC "fuel,ev";
BA_ "Match" SG_ 692 FCWAEB_JATTC "FCWAEB_JATTC";
BA_ "GenSigCycleTime" SG_ 692 FCWAEB_JATTC 100;
BA_ "Origin" SG_ 692 JAPedObjVx "fuel,ev";
BA_ "Match" SG_ 692 JAPedObjVx "JAPedObjVx";
BA_ "GenSigCycleTime" SG_ 692 JAPedObjVx 100;
BA_ "Origin" SG_ 692 JAPedObjVy "fuel,ev";
BA_ "Match" SG_ 692 JAPedObjVy "JAPedObjVy";
BA_ "GenSigCycleTime" SG_ 692 JAPedObjVy 100;
BA_ "Origin" SG_ 692 JAPedObjAy "fuel,ev";
BA_ "Match" SG_ 692 JAPedObjAy "JAPedObjAy";
BA_ "GenSigCycleTime" SG_ 692 JAPedObjAy 100;
BA_ "Origin" SG_ 692 JAPedObjCntAlive "fuel,ev";
BA_ "Match" SG_ 692 JAPedObjCntAlive "JAPedObjCntAlive";
BA_ "GenSigCycleTime" SG_ 692 JAPedObjCntAlive 100;
BA_ "Origin" SG_ 692 FCWAEB_longTTC "fuel,ev";
BA_ "Match" SG_ 692 FCWAEB_longTTC "FCWAEB_longTTC";
BA_ "GenSigCycleTime" SG_ 692 FCWAEB_longTTC 100;
BA_ "Origin" SG_ 692 FCWAEB_crossingTTC "fuel,ev";
BA_ "Match" SG_ 692 FCWAEB_crossingTTC "FCWAEB_crossingTTC";
BA_ "GenSigCycleTime" SG_ 692 FCWAEB_crossingTTC 100;
BA_ "Origin" SG_ 692 JAPedObjAx "fuel,ev";
BA_ "Match" SG_ 692 JAPedObjAx "JAPedObjAx";
BA_ "GenSigCycleTime" SG_ 692 JAPedObjAx 100;
BA_ "Origin" SG_ 692 NOH_Sts "fuel,ev";
BA_ "Match" SG_ 692 NOH_Sts "NOH_Sts";
BA_ "GenSigCycleTime" SG_ 692 NOH_Sts 100;
BA_ "Origin" SG_ 692 NOH_Swt_Resp "fuel,ev";
BA_ "Match" SG_ 692 NOH_Swt_Resp "NOH_Swt_Resp";
BA_ "GenSigCycleTime" SG_ 692 NOH_Swt_Resp 100;
BA_ "Origin" SG_ 692 NOH_Act_Resp "fuel,ev";
BA_ "Match" SG_ 692 NOH_Act_Resp "NOH_Act_Resp";
BA_ "GenSigCycleTime" SG_ 692 NOH_Act_Resp 100;
BA_ "Origin" SG_ 692 NOH_SysInfoDisplay "fuel,ev";
BA_ "Match" SG_ 692 NOH_SysInfoDisplay "NOH_SysInfoDisplay";
BA_ "GenSigCycleTime" SG_ 692 NOH_SysInfoDisplay 100;
BA_ "Origin" SG_ 692 NOH_DistToExit "fuel,ev";
BA_ "Match" SG_ 692 NOH_DistToExit "NOH_DistToExit";
BA_ "GenSigCycleTime" SG_ 692 NOH_DistToExit 100;
BA_ "TransparentInitValue" SG_ 692 ACC_FD3_0x2B4 "0 0 0 0 0 0 0 0 0 255 0 0 0 0 255 0 0 0 0 0 0 0 0 0 0 0 0 0 0 0 0 0 0 0 0 0 0 0 0 0 0 0 0 0 0 0 0 0 0 0 0 0 0 0 0 0 0 0 0 0 0 0 0 0 ";
BA_ "GenSigCycleTime" SG_ 692 ACC_FD3_0x2B4 100;
BA_ "Origin" SG_ 694 PassSeatAdjmtSwt_HUT "fuel,ev";
BA_ "Match" SG_ 694 PassSeatAdjmtSwt_HUT "PassSeatAdjmtSwt_HUT";
BA_ "GenSigCycleTime" SG_ 694 PassSeatAdjmtSwt_HUT 100;
BA_ "Origin" SG_ 694 SeatFlankAdjmtSwt_HUT "fuel,ev";
BA_ "Match" SG_ 694 SeatFlankAdjmtSwt_HUT "SeatFlankAdjmtSwt_HUT";
BA_ "GenSigCycleTime" SG_ 694 SeatFlankAdjmtSwt_HUT 100;
BA_ "Origin" SG_ 694 AVM_dispsts "fuel,ev";
BA_ "Match" SG_ 694 AVM_dispsts "AVM_dispsts";
BA_ "GenSigCycleTime" SG_ 694 AVM_dispsts 100;
BA_ "TransparentInitValue" SG_ 694 HUT26_0x2B6 "0 0 0 0 0 0 0 0 ";
BA_ "GenSigCycleTime" SG_ 694 HUT26_0x2B6 100;
BA_ "Origin" SG_ 696 AEBObjID "fuel,ev";
BA_ "Match" SG_ 696 AEBObjID "AEBObjID";
BA_ "GenSigStartValue" SG_ 696 AEBObjID 255;
BA_ "GenSigCycleTime" SG_ 696 AEBObjID 100;
BA_ "Origin" SG_ 696 AEBObjExist "fuel,ev";
BA_ "Match" SG_ 696 AEBObjExist "AEBObjExist";
BA_ "GenSigCycleTime" SG_ 696 AEBObjExist 100;
BA_ "Origin" SG_ 696 AEBObjVideoCfmd "fuel,ev";
BA_ "Match" SG_ 696 AEBObjVideoCfmd "AEBObjVideoCfmd";
BA_ "GenSigCycleTime" SG_ 696 AEBObjVideoCfmd 100;
BA_ "Origin" SG_ 696 AEBObjVx "fuel,ev";
BA_ "Match" SG_ 696 AEBObjVx "AEBObjVx";
BA_ "GenSigCycleTime" SG_ 696 AEBObjVx 100;
BA_ "Origin" SG_ 696 AEBObjDx "fuel,ev";
BA_ "Match" SG_ 696 AEBObjDx "AEBObjDx";
BA_ "GenSigCycleTime" SG_ 696 AEBObjDx 100;
BA_ "Origin" SG_ 696 AEBObjCntAlive "fuel,ev";
BA_ "Match" SG_ 696 AEBObjCntAlive "AEBObjCntAlive";
BA_ "GenSigCycleTime" SG_ 696 AEBObjCntAlive 100;
BA_ "Origin" SG_ 696 AEBObjDy "fuel,ev";
BA_ "Match" SG_ 696 AEBObjDy "AEBObjDy";
BA_ "GenSigCycleTime" SG_ 696 AEBObjDy 100;
BA_ "Origin" SG_ 696 AEBObjState "fuel,ev";
BA_ "Match" SG_ 696 AEBObjState "AEBObjState";
BA_ "GenSigCycleTime" SG_ 696 AEBObjState 100;
BA_ "Origin" SG_ 696 AEBObjObstcl "fuel,ev";
BA_ "Match" SG_ 696 AEBObjObstcl "AEBObjObstcl";
BA_ "GenSigCycleTime" SG_ 696 AEBObjObstcl 100;
BA_ "Origin" SG_ 696 AEBObjVy "fuel,ev";
BA_ "Match" SG_ 696 AEBObjVy "AEBObjVy";
BA_ "GenSigCycleTime" SG_ 696 AEBObjVy 100;
BA_ "Origin" SG_ 696 CyclistObjExist "fuel,ev";
BA_ "Match" SG_ 696 CyclistObjExist "CyclistObjExist";
BA_ "GenSigCycleTime" SG_ 696 CyclistObjExist 100;
BA_ "Origin" SG_ 696 AEBObjAx "fuel,ev";
BA_ "Match" SG_ 696 AEBObjAx "AEBObjAx";
BA_ "GenSigCycleTime" SG_ 696 AEBObjAx 100;
BA_ "Origin" SG_ 696 AEBObjAy "fuel,ev";
BA_ "Match" SG_ 696 AEBObjAy "AEBObjAy";
BA_ "GenSigCycleTime" SG_ 696 AEBObjAy 100;
BA_ "Origin" SG_ 696 CyclistObjDx "fuel,ev";
BA_ "Match" SG_ 696 CyclistObjDx "CyclistObjDx";
BA_ "GenSigCycleTime" SG_ 696 CyclistObjDx 100;
BA_ "Origin" SG_ 696 CyclistObjID "fuel,ev";
BA_ "Match" SG_ 696 CyclistObjID "CyclistObjID";
BA_ "GenSigStartValue" SG_ 696 CyclistObjID 255;
BA_ "GenSigCycleTime" SG_ 696 CyclistObjID 100;
BA_ "Origin" SG_ 696 CyclistObjObstcl "fuel,ev";
BA_ "Match" SG_ 696 CyclistObjObstcl "CyclistObjObstcl";
BA_ "GenSigCycleTime" SG_ 696 CyclistObjObstcl 100;
BA_ "Origin" SG_ 696 CyclistObjDy "fuel,ev";
BA_ "Match" SG_ 696 CyclistObjDy "CyclistObjDy";
BA_ "GenSigCycleTime" SG_ 696 CyclistObjDy 100;
BA_ "Origin" SG_ 696 CyclistObjVx "fuel,ev";
BA_ "Match" SG_ 696 CyclistObjVx "CyclistObjVx";
BA_ "GenSigCycleTime" SG_ 696 CyclistObjVx 100;
BA_ "Origin" SG_ 696 CyclistObjCntAlive "fuel,ev";
BA_ "Match" SG_ 696 CyclistObjCntAlive "CyclistObjCntAlive";
BA_ "GenSigCycleTime" SG_ 696 CyclistObjCntAlive 100;
BA_ "Origin" SG_ 696 CyclistObjVy "fuel,ev";
BA_ "Match" SG_ 696 CyclistObjVy "CyclistObjVy";
BA_ "GenSigCycleTime" SG_ 696 CyclistObjVy 100;
BA_ "Origin" SG_ 696 CyclistObjState "fuel,ev";
BA_ "Match" SG_ 696 CyclistObjState "CyclistObjState";
BA_ "GenSigCycleTime" SG_ 696 CyclistObjState 100;
BA_ "Origin" SG_ 696 CyclistObjVideoCfmd "fuel,ev";
BA_ "Match" SG_ 696 CyclistObjVideoCfmd "CyclistObjVideoCfmd";
BA_ "GenSigCycleTime" SG_ 696 CyclistObjVideoCfmd 100;
BA_ "Origin" SG_ 696 CyclistObjAx "fuel,ev";
BA_ "Match" SG_ 696 CyclistObjAx "CyclistObjAx";
BA_ "GenSigCycleTime" SG_ 696 CyclistObjAx 100;
BA_ "Origin" SG_ 696 CyclistObjAy "fuel,ev";
BA_ "Match" SG_ 696 CyclistObjAy "CyclistObjAy";
BA_ "GenSigCycleTime" SG_ 696 CyclistObjAy 100;
BA_ "Origin" SG_ 696 PedObjExist "fuel,ev";
BA_ "Match" SG_ 696 PedObjExist "PedObjExist";
BA_ "GenSigCycleTime" SG_ 696 PedObjExist 100;
BA_ "Origin" SG_ 696 PedObjID "fuel,ev";
BA_ "Match" SG_ 696 PedObjID "PedObjID";
BA_ "GenSigStartValue" SG_ 696 PedObjID 255;
BA_ "GenSigCycleTime" SG_ 696 PedObjID 100;
BA_ "Origin" SG_ 696 PedObjObstcl "fuel,ev";
BA_ "Match" SG_ 696 PedObjObstcl "PedObjObstcl";
BA_ "GenSigCycleTime" SG_ 696 PedObjObstcl 100;
BA_ "Origin" SG_ 696 PedObjDy "fuel,ev";
BA_ "Match" SG_ 696 PedObjDy "PedObjDy";
BA_ "GenSigCycleTime" SG_ 696 PedObjDy 100;
BA_ "Origin" SG_ 696 PedObjDx "fuel,ev";
BA_ "Match" SG_ 696 PedObjDx "PedObjDx";
BA_ "GenSigCycleTime" SG_ 696 PedObjDx 100;
BA_ "Origin" SG_ 696 PedObjVx "fuel,ev";
BA_ "Match" SG_ 696 PedObjVx "PedObjVx";
BA_ "GenSigCycleTime" SG_ 696 PedObjVx 100;
BA_ "Origin" SG_ 696 PedObjVy "fuel,ev";
BA_ "Match" SG_ 696 PedObjVy "PedObjVy";
BA_ "GenSigCycleTime" SG_ 696 PedObjVy 100;
BA_ "Origin" SG_ 696 PedObjVideoCfmd "fuel,ev";
BA_ "Match" SG_ 696 PedObjVideoCfmd "PedObjVideoCfmd";
BA_ "GenSigCycleTime" SG_ 696 PedObjVideoCfmd 100;
BA_ "Origin" SG_ 696 ACCTgtObjDx "fuel,ev";
BA_ "Match" SG_ 696 ACCTgtObjDx "ACCTgtObjDx";
BA_ "GenSigCycleTime" SG_ 696 ACCTgtObjDx 100;
BA_ "Origin" SG_ 696 PedObjAy "fuel,ev";
BA_ "Match" SG_ 696 PedObjAy "PedObjAy";
BA_ "GenSigCycleTime" SG_ 696 PedObjAy 100;
BA_ "Origin" SG_ 696 PedObjCntAlive "fuel,ev";
BA_ "Match" SG_ 696 PedObjCntAlive "PedObjCntAlive";
BA_ "GenSigCycleTime" SG_ 696 PedObjCntAlive 100;
BA_ "Origin" SG_ 696 PedObjAx "fuel,ev";
BA_ "Match" SG_ 696 PedObjAx "PedObjAx";
BA_ "GenSigCycleTime" SG_ 696 PedObjAx 100;
BA_ "Origin" SG_ 696 ACCTgtObjID "fuel,ev";
BA_ "Match" SG_ 696 ACCTgtObjID "ACCTgtObjID";
BA_ "GenSigStartValue" SG_ 696 ACCTgtObjID 255;
BA_ "GenSigCycleTime" SG_ 696 ACCTgtObjID 100;
BA_ "Origin" SG_ 696 ACCTgtObjObstcl "fuel,ev";
BA_ "Match" SG_ 696 ACCTgtObjObstcl "ACCTgtObjObstcl";
BA_ "GenSigCycleTime" SG_ 696 ACCTgtObjObstcl 100;
BA_ "Origin" SG_ 696 ACCTgtObjDy "fuel,ev";
BA_ "Match" SG_ 696 ACCTgtObjDy "ACCTgtObjDy";
BA_ "GenSigCycleTime" SG_ 696 ACCTgtObjDy 100;
BA_ "Origin" SG_ 696 ACCTgtObjExist "fuel,ev";
BA_ "Match" SG_ 696 ACCTgtObjExist "ACCTgtObjExist";
BA_ "GenSigCycleTime" SG_ 696 ACCTgtObjExist 100;
BA_ "Origin" SG_ 696 ACCTgtObjVy "fuel,ev";
BA_ "Match" SG_ 696 ACCTgtObjVy "ACCTgtObjVy";
BA_ "GenSigCycleTime" SG_ 696 ACCTgtObjVy 100;
BA_ "Origin" SG_ 696 ACCTgtObjVx "fuel,ev";
BA_ "Match" SG_ 696 ACCTgtObjVx "ACCTgtObjVx";
BA_ "GenSigCycleTime" SG_ 696 ACCTgtObjVx 100;
BA_ "Origin" SG_ 696 ACCTgtObjAx "fuel,ev";
BA_ "Match" SG_ 696 ACCTgtObjAx "ACCTgtObjAx";
BA_ "GenSigCycleTime" SG_ 696 ACCTgtObjAx 100;
BA_ "Origin" SG_ 696 ACCTgtObjAy "fuel,ev";
BA_ "Match" SG_ 696 ACCTgtObjAy "ACCTgtObjAy";
BA_ "GenSigCycleTime" SG_ 696 ACCTgtObjAy 100;
BA_ "Origin" SG_ 696 ACCTgtObjState "fuel,ev";
BA_ "Match" SG_ 696 ACCTgtObjState "ACCTgtObjState";
BA_ "GenSigCycleTime" SG_ 696 ACCTgtObjState 100;
BA_ "Origin" SG_ 696 ACCTgtObjVideoCfmd "fuel,ev";
BA_ "Match" SG_ 696 ACCTgtObjVideoCfmd "ACCTgtObjVideoCfmd";
BA_ "GenSigCycleTime" SG_ 696 ACCTgtObjVideoCfmd 100;
BA_ "Origin" SG_ 696 ACCTgtObjCntAlive "fuel,ev";
BA_ "Match" SG_ 696 ACCTgtObjCntAlive "ACCTgtObjCntAlive";
BA_ "GenSigCycleTime" SG_ 696 ACCTgtObjCntAlive 100;
BA_ "Origin" SG_ 696 RadarHorMisalign "fuel,ev";
BA_ "Match" SG_ 696 RadarHorMisalign "RadarHorMisalign";
BA_ "GenSigCycleTime" SG_ 696 RadarHorMisalign 100;
BA_ "Origin" SG_ 696 HandsoffDetd "fuel,ev";
BA_ "Match" SG_ 696 HandsoffDetd "HandsoffDetd";
BA_ "GenSigCycleTime" SG_ 696 HandsoffDetd 100;
BA_ "Origin" SG_ 696 DrvgOnHiWay "fuel,ev";
BA_ "Match" SG_ 696 DrvgOnHiWay "DrvgOnHiWay";
BA_ "GenSigCycleTime" SG_ 696 DrvgOnHiWay 100;
BA_ "Origin" SG_ 696 RoadCrvt "fuel,ev";
BA_ "Match" SG_ 696 RoadCrvt "RoadCrvt";
BA_ "GenSigStartValue" SG_ 696 RoadCrvt 511;
BA_ "GenSigCycleTime" SG_ 696 RoadCrvt 100;
BA_ "Origin" SG_ 696 SpdLimitDst "fuel,ev";
BA_ "Match" SG_ 696 SpdLimitDst "SpdLimitDst";
BA_ "GenSigStartValue" SG_ 696 SpdLimitDst 63;
BA_ "GenSigCycleTime" SG_ 696 SpdLimitDst 100;
BA_ "Origin" SG_ 696 RoadCrvtFar "fuel,ev";
BA_ "Match" SG_ 696 RoadCrvtFar "RoadCrvtFar";
BA_ "GenSigStartValue" SG_ 696 RoadCrvtFar 511;
BA_ "GenSigCycleTime" SG_ 696 RoadCrvtFar 100;
BA_ "Origin" SG_ 696 RampDst "fuel,ev";
BA_ "Match" SG_ 696 RampDst "RampDst";
BA_ "GenSigStartValue" SG_ 696 RampDst 63;
BA_ "GenSigCycleTime" SG_ 696 RampDst 100;
BA_ "Origin" SG_ 696 SpdLimit "fuel,ev";
BA_ "Match" SG_ 696 SpdLimit "SpdLimit";
BA_ "GenSigStartValue" SG_ 696 SpdLimit 254;
BA_ "GenSigCycleTime" SG_ 696 SpdLimit 100;
BA_ "Origin" SG_ 696 CurveDst "fuel,ev";
BA_ "Match" SG_ 696 CurveDst "CurveDst";
BA_ "GenSigStartValue" SG_ 696 CurveDst 63;
BA_ "GenSigCycleTime" SG_ 696 CurveDst 100;
BA_ "Origin" SG_ 696 NavSpdLimUnit "fuel,ev";
BA_ "Match" SG_ 696 NavSpdLimUnit "NavSpdLimUnit";
BA_ "GenSigCycleTime" SG_ 696 NavSpdLimUnit 100;
BA_ "Origin" SG_ 696 TunnelDst "fuel,ev";
BA_ "Match" SG_ 696 TunnelDst "TunnelDst";
BA_ "GenSigStartValue" SG_ 696 TunnelDst 63;
BA_ "GenSigCycleTime" SG_ 696 TunnelDst 100;
BA_ "Origin" SG_ 696 DrvgOnRiLane "fuel,ev";
BA_ "Match" SG_ 696 DrvgOnRiLane "DrvgOnRiLane";
BA_ "GenSigCycleTime" SG_ 696 DrvgOnRiLane 100;
BA_ "Origin" SG_ 696 BrdgDst "fuel,ev";
BA_ "Match" SG_ 696 BrdgDst "BrdgDst";
BA_ "GenSigStartValue" SG_ 696 BrdgDst 63;
BA_ "GenSigCycleTime" SG_ 696 BrdgDst 100;
BA_ "Origin" SG_ 696 RadarDrvrAttentive "fuel,ev";
BA_ "Match" SG_ 696 RadarDrvrAttentive "RadarDrvrAttentive";
BA_ "GenSigCycleTime" SG_ 696 RadarDrvrAttentive 100;
BA_ "Origin" SG_ 696 ACC_DataRecReq "fuel,ev";
BA_ "Match" SG_ 696 ACC_DataRecReq "ACC_DataRecReq";
BA_ "GenSigCycleTime" SG_ 696 ACC_DataRecReq 100;
BA_ "Origin" SG_ 696 ACC_SOSReq "fuel,ev";
BA_ "Match" SG_ 696 ACC_SOSReq "ACC_SOSReq";
BA_ "GenSigCycleTime" SG_ 696 ACC_SOSReq 100;
BA_ "Origin" SG_ 696 PedObjState "fuel,ev";
BA_ "Match" SG_ 696 PedObjState "PedObjState";
BA_ "GenSigCycleTime" SG_ 696 PedObjState 100;
BA_ "Origin" SG_ 696 MapDataValid "fuel,ev";
BA_ "Match" SG_ 696 MapDataValid "MapDataValid";
BA_ "GenSigCycleTime" SG_ 696 MapDataValid 100;
BA_ "Origin" SG_ 696 DrvrSts "fuel,ev";
BA_ "Match" SG_ 696 DrvrSts "DrvrSts";
BA_ "GenSigCycleTime" SG_ 696 DrvrSts 100;
BA_ "Origin" SG_ 696 AEBObjOverlap "fuel,ev";
BA_ "Match" SG_ 696 AEBObjOverlap "AEBObjOverlap";
BA_ "GenSigCycleTime" SG_ 696 AEBObjOverlap 100;
BA_ "Origin" SG_ 696 AEBObjDrvby "fuel,ev";
BA_ "Match" SG_ 696 AEBObjDrvby "AEBObjDrvby";
BA_ "GenSigCycleTime" SG_ 696 AEBObjDrvby 100;
BA_ "TransparentInitValue" SG_ 696 ACC_FD4_0x2B8 "255 0 0 0 0 0 0 0 0 0 0 0 0 0 0 255 0 0 0 0 0 0 0 0 0 0 255 0 0 0 0 0 0 0 0 0 0 0 0 255 0 0 0 0 0 0 0 0 0 0 0 0 127 255 127 255 254 252 252 252 0 0 0 0 ";
BA_ "GenSigCycleTime" SG_ 696 ACC_FD4_0x2B8 100;
BA_ "Origin" SG_ 697 DWD_WorkSts "fuel,ev";
BA_ "Match" SG_ 697 DWD_WorkSts "DWD_WorkSts";
BA_ "GenSigCycleTime" SG_ 697 DWD_WorkSts 100;
BA_ "Origin" SG_ 697 DWD_TextDisp "fuel,ev";
BA_ "Match" SG_ 697 DWD_TextDisp "DWD_TextDisp";
BA_ "GenSigCycleTime" SG_ 697 DWD_TextDisp 100;
BA_ "Origin" SG_ 697 DWD_Dis "fuel,ev";
BA_ "Match" SG_ 697 DWD_Dis "DWD_Dis";
BA_ "GenSigCycleTime" SG_ 697 DWD_Dis 100;
BA_ "Origin" SG_ 697 DWD_SoundIndcn "fuel,ev";
BA_ "Match" SG_ 697 DWD_SoundIndcn "DWD_SoundIndcn";
BA_ "GenSigCycleTime" SG_ 697 DWD_SoundIndcn 100;
BA_ "Origin" SG_ 697 RSnsrFailSts "fuel,ev";
BA_ "Match" SG_ 697 RSnsrFailSts "RSnsrFailSts";
BA_ "GenSigCycleTime" SG_ 697 RSnsrFailSts 100;
BA_ "Origin" SG_ 697 LSnsrFailSts "fuel,ev";
BA_ "Match" SG_ 697 LSnsrFailSts "LSnsrFailSts";
BA_ "GenSigCycleTime" SG_ 697 LSnsrFailSts 100;
BA_ "TransparentInitValue" SG_ 697 DWD1_0x2B9 "0 0 0 0 0 0 0 0 ";
BA_ "GenSigCycleTime" SG_ 697 DWD1_0x2B9 100;
BA_ "Origin" SG_ 698 WPC_ChrgSts "fuel,ev";
BA_ "Match" SG_ 698 WPC_ChrgSts "WPC_ChrgSts";
BA_ "GenSigCycleTime" SG_ 698 WPC_ChrgSts 100;
BA_ "Origin" SG_ 698 WPC_SwtSts "fuel,ev";
BA_ "Match" SG_ 698 WPC_SwtSts "WPC_SwtSts";
BA_ "GenSigCycleTime" SG_ 698 WPC_SwtSts 100;
BA_ "Origin" SG_ 698 WPC_FaultSts "fuel,ev";
BA_ "Match" SG_ 698 WPC_FaultSts "WPC_FaultSts";
BA_ "GenSigCycleTime" SG_ 698 WPC_FaultSts 100;
BA_ "Origin" SG_ 698 WPC_PhoneReminder "fuel,ev";
BA_ "Match" SG_ 698 WPC_PhoneReminder "WPC_PhoneReminder";
BA_ "GenSigCycleTime" SG_ 698 WPC_PhoneReminder 100;
BA_ "TransparentInitValue" SG_ 698 WPC1_0x2BA "0 0 0 0 0 0 0 0 ";
BA_ "GenSigCycleTime" SG_ 698 WPC1_0x2BA 100;
VAL_ 628 AutoAVMSwtSet_Sts 0 "Off" 1 "ON" ;
VAL_ 628 AVM_CurrSts 0 "Off" 1 "ON" 2 "AVM no videoÃ¯Â¼ÂˆÃ©Â›Â·Ã¨Â¾Â¾Ã¦Â¨Â¡Ã¥Â¼ÂÃ¯Â¼Â‰" 3 "Reserved" ;
VAL_ 628 GuidOvlSts 0 "Around View and Single View" 1 "Only Around View" 2 "Only Single View" 3 "No Guidance" ;
VAL_ 628 FrntCamInpFailSts 0 "no failure" 1 "failure" ;
VAL_ 628 RearCamInpFailSts 0 "no failure" 1 "failure" ;
VAL_ 628 LeCamInpFailSts 0 "no failure" 1 "failure" ;
VAL_ 628 RiCamInpFailSts 0 "no failure" 1 "failure" ;
VAL_ 628 EolNotCmpltd 0 "Ccompleted" 1 "No completed" ;
VAL_ 628 OvlOpFailSts 0 "no failure" 1 "failure" ;
VAL_ 628 LaneCalSts 0 "No Commands" 1 "In Calibration process" 2 "Calibration success" 3 "Calibration failure" ;
VAL_ 628 RadarDispSts 0 "Both Around View and Single View Radar Display" 1 "Only Around View Radar Display" 2 "Only Single View Radar Display" 3 "No Radar Display" ;
VAL_ 628 LaneCalFltSts 0 "No fault" 1 "Front view Calibration abnormal" 2 "Rear view Calibration abnormal" 3 "left view Calibration abnormal" 4 "Right view Calibration abnormal" 5 "Calibration data storage failed" 6 "Reserved" 7 "Reserved" ;
VAL_ 628 AutoViewChgFuncSts 0 "Off" 1 "ON" ;
VAL_ 628 CarMdlTrsprcySts 0 "Opaque" 1 "Translucent" 2 "Completely transparent" 3 "Reserved" ;
VAL_ 628 CarMdlDispSts 0 "2D mode" 1 "3D mode" ;
VAL_ 628 CurrCalResultSts 0 "Use Factory Calibration Result" 1 "Use Lane Calibration Result" ;
VAL_ 628 MdlColrSts 0 "Silvery" 1 "Red" 2 "Gray" 3 "White" 4 "Black" 5 "Brown" 6 "Blue" 7 "Orange" 8 "Green" 9 "Gold" 10 "Purple" 11 "Reserved" 15 "Reserved" ;
VAL_ 628 SigViewIndcn 0 "No Commands" 1 "Front to Center View" 2 "Rear to Center View" 3 "Left to Center View" 4 "Right to Center View" 5 "Left Front to Center View" 6 "Right Front to Center View" 7 "Left Rear to Center View" 8 "Right Rear to Center View" 9 "Front View" 10 "Rear View" 11 "Left View" 12 "Right View" 13 "Left Turn 3D View" 14 "Right Turn 3D View" 15 "Front Overlook View" 16 "Rear Overlook View" 17 "Front 180 Deg View" 18 "Rear 180 Deg View" 19 "Front Wheel View" 20 "Rear Wheel View" 21 "Front Wash View" 22 "Rear Wash View" 23 "Free_3D View" 24 "LeftRight View" 25 "Engine Room View" 26 "CCO View" 27 "Reserved" 62 "Reserved" 63 "3D Car Model Round View" ;
VAL_ 628 HAP_DispCmd 0 "OFF" 1 "ON" ;
VAL_ 628 AVM_3DAngSts 0 "Not active" 1 "0~360Ã‚Â°" 361 "0~360Ã‚Â°" 362 "reserved" 510 "reserved" 511 "invalid" ;
VAL_ 628 MOD_WorkSts 0 "OFF" 1 "ON" ;
VAL_ 628 MOD_AlarmSts 0 "OFF" 1 "ON" ;
VAL_ 628 DVRWorkSts 0 "DVR_Standby" 1 "DVR_Active" 2 "DVR_InterFailed" 3 "DVR_NetFailed" ;
VAL_ 628 HAP_Hmi_Index 0 "Reserved" 1 "Main Screen" 2 "EOLTest" 3 "P2P Screen" 4 "Assist Screen" 5 "HAVP Screen" 6 "PAVP Screen" 7 "Reserved" 15 "Reserved" ;
VAL_ 636 RearInCarTemp 0 "Valid value" 253 "Valid value" 254 "Initial value" 255 "Invalid value" ;
VAL_ 636 ACRLTemp_ATC 0 "Low" 1 "Valid value" 31 "Valid value" 32 "High" 33 "Initial value" 34 "Reserved" 63 "Reserved" ;
VAL_ 639 CheckSum_IP2 0 "Valid values" 255 "Valid values" ;
VAL_ 639 IP_DrvSeatBeltWarnLmpFailSts 0 "No failure" 1 "Failure" 2 "Signal not available" 3 "Reserved" ;
VAL_ 639 IP_PassSeatBeltWarnLmpFailSts 0 "No failure" 1 "Failure" 2 "Signal not available" 3 "Reserved" ;
VAL_ 639 IP_VehTotDistance 0 "0-9999999-km" 9999999 "0-9999999-km" 10000000 "Reserved" 16777214 "Reserved" 16777215 "Invalid" ;
VAL_ 639 IP_VehTotDistanceValid 0 "Invalid" 1 "Valid" ;
VAL_ 639 IP_FuelLvlInfo 0 "Valid Value" 200 "Valid Value" 201 "Reserved" 254 "Reserved" 255 "Invalid Value" ;
VAL_ 639 IP_FuelLvlLowLmpSts 0 "OFF" 1 "ON" 2 "Internal Error" 3 "Reserved" ;
VAL_ 639 IP_BattChrgLmpSts 0 "OFF" 1 "ON" 2 "Internal Error" 3 "Reserved" ;
VAL_ 639 IP_EngOilPressLowLmpSts 0 "OFF" 1 "ON" 2 "Internal Error" 3 "Reserved" ;
VAL_ 639 IP_ABMWarnLmpFailrSts 0 "No failure" 1 "Failure" 2 "Signal not available" 3 "Reserved" ;
VAL_ 639 IP_Err 0 "No error" 1 "Error" ;
VAL_ 639 IP_ACCErr 0 "No error" 1 "Error" ;
VAL_ 639 IP_VehSpdUnit 0 "kph" 1 "mph" ;
VAL_ 639 IP_VINcompr 0 "equality" 1 "inequality" ;
VAL_ 639 RollingCounter_IP2 0 "Valid value" 14 "Valid value" 15 "Invalid value" ;
VAL_ 647 CheckSum_HC1 0 "Valid values" 255 "Valid values" ;
VAL_ 647 ALS_FailSts 0 "No failure" 1 "Failure" ;
VAL_ 647 RollingCounter_HC1 0 "Valid value" 14 "Valid value" 15 "Invalid value" ;
VAL_ 649 HAP_RtCam_WorkSts 0 "Disable" 1 "Enable" 2 "Active" 3 "Failed" ;
VAL_ 649 HAP_RtSide_Obj1_ID 0 "Valid values" 3 "Valid values" 4 "Invalid values" 15 "Invalid values" ;
VAL_ 649 HAP_RtSide_Obj1_type 0 "No target" 1 "Pedestrian" 2 "Biker" 3 "Vehicle" 4 "Ground Locker" 5 "Barrier" 6 "Reserved" 7 "Unknown type" ;
VAL_ 649 HAP_RtSide_Obj1_Confidence 0 "Valid value" 10 "Invalid" 15 "Invalid" ;
VAL_ 649 HAP_RtSide_Obj1_Ground_Pos_X 0 "Valid values" 4000 "Valid values" 4001 "Reserved" 4094 "Reserved" 4095 "Invalid values" ;
VAL_ 649 HAP_RtSide_Obj1_Ground_Pos_Y 0 "Valid values" 4000 "Valid values" 4001 "Reserved" 4094 "Reserved" 4095 "Invalid values" ;
VAL_ 649 HAP_RtSide_Obj2_ID 0 "Valid values" 3 "Valid values" 4 "Invalid values" 15 "Invalid values" ;
VAL_ 649 HAP_RtSide_Obj2_type 0 "No target" 1 "Pedestrian" 2 "Biker" 3 "Vehicle" 4 "Ground Locker" 5 "Barrier" 6 "Reserved" 7 "Unknown type" ;
VAL_ 649 HAP_RtSide_Obj2_Confidence 0 "Valid value" 10 "Invalid" 15 "Invalid" ;
VAL_ 649 HAP_RtSide_Obj2_Ground_Pos_X 0 "Valid values" 4000 "Valid values" 4001 "Reserved" 4094 "Reserved" 4095 "Invalid values" ;
VAL_ 649 HAP_RtSide_Obj2_Ground_Pos_Y 0 "Valid values" 4000 "Valid values" 4001 "Reserved" 4094 "Reserved" 4095 "Invalid values" ;
VAL_ 649 HAP_RtSide_Obj3_ID 0 "Valid values" 3 "Valid values" 4 "Invalid values" 15 "Invalid values" ;
VAL_ 649 HAP_RtSide_Obj3_type 0 "No target" 1 "Pedestrian" 2 "Biker" 3 "Vehicle" 4 "Ground Locker" 5 "Barrier" 6 "Reserved" 7 "Unknown type" ;
VAL_ 649 HAP_RtSide_Obj3_Confidence 0 "Valid value" 10 "Invalid" 15 "Invalid" ;
VAL_ 649 HAP_RtSide_Obj3_Ground_Pos_X 0 "Valid values" 4000 "Valid values" 4001 "Reserved" 4094 "Reserved" 4095 "Invalid values" ;
VAL_ 649 HAP_RtSide_Obj3_Ground_Pos_Y 0 "Valid values" 4000 "Valid values" 4001 "Reserved" 4094 "Reserved" 4095 "Invalid values" ;
VAL_ 649 HAP_RtSide_Obj4_ID 0 "Valid values" 3 "Valid values" 4 "Invalid values" 15 "Invalid values" ;
VAL_ 649 HAP_RtSide_Obj4_type 0 "No target" 1 "Pedestrian" 2 "Biker" 3 "Vehicle" 4 "Ground Locker" 5 "Barrier" 6 "Reserved" 7 "Unknown type" ;
VAL_ 649 HAP_RtSide_Obj4_Confidence 0 "Valid value" 10 "Invalid" 15 "Invalid" ;
VAL_ 649 HAP_RtSide_Obj4_Ground_Pos_X 0 "Valid values" 4000 "Valid values" 4001 "Reserved" 4094 "Reserved" 4095 "Invalid values" ;
VAL_ 649 HAP_RtSide_Obj4_Ground_Pos_Y 0 "Valid values" 4000 "Valid values" 4001 "Reserved" 4094 "Reserved" 4095 "Invalid values" ;
VAL_ 649 USS_FLSide1_Status 0 "Disable" 1 "Enable" 2 "Active" 3 "Failed" ;
VAL_ 649 USS_FLSide1_Dist 0 "Valid values" 126 "Valid values" 127 "Invalid" ;
VAL_ 649 USS_RLSide2_Status 0 "Disable" 1 "Enable" 2 "Active" 3 "Failed" ;
VAL_ 649 USS_RLSide2_Dist 0 "Valid values" 126 "Valid values" 127 "Invalid" ;
VAL_ 649 USS_FRSide1_Status 0 "Disable" 1 "Enable" 2 "Active" 3 "Failed" ;
VAL_ 649 USS_FRSide1_Dist 0 "Valid values" 126 "Valid values" 127 "Invalid" ;
VAL_ 649 USS_RRSide2_Status 0 "Disable" 1 "Enable" 2 "Active" 3 "Failed" ;
VAL_ 649 USS_RRSide2_Dist 0 "Valid values" 126 "Valid values" 127 "Invalid" ;
VAL_ 653 SecRowLeSeatVentSts 0 "OFF" 1 "Level 1_low" 2 "Level 2_middle" 3 "Level 3_high" ;
VAL_ 653 SecRowRiSeatVentSts 0 "OFF" 1 "Level 1_low" 2 "Level 2_middle" 3 "Level 3_high" ;
VAL_ 656 EngOilLvl 0 "No display" 1 "Waiting for measruement" 2 "Below min" 3 "Min" 4 "14 Max" 5 "12 Max" 6 "34Max" 7 "Max" 8 "Overfill" 9 "Failed because low temperature" 10 "Failed because Large slope" 11 "Failed because vehicle condition changed" 12 "Failed because loss of communication" 13 "Failed because vehicle is running" 14 "Reserved" 15 "Reserved" ;
VAL_ 656 FTIVFault 0 "No warning" 1 "Warning" ;
VAL_ 656 FuelTankCapWarning 0 "No warning" 1 "Warning(Fuel tank cap did not close)" 2 "Reserved" 3 "Fault(Fuel tank cap did not open)" ;
VAL_ 656 PressReliProgs 0 "Valid values" 99 "Valid values" 100 "Finish" 101 "reserved" 127 "reserved" ;
VAL_ 659 IP_CurrTheme 0 "Valid Value" 3 "Valid Value" 4 "Initial value" 5 "Reserved" 7 "Reserved" ;
VAL_ 659 IP_VehSpdDisp 0 "Valid" 510 "Valid" 511 "Invalid" ;
VAL_ 659 IP_VelSpdDisp_Mile 0 "Valid" 254 "Valid" 255 "Invalid" ;
VAL_ 659 IP_FuelMainTankR 0 "Invalid value" 1 "Reserved" 9 "Reserved" 10 "Valid value" 1000 "Valid value" 1001 "Reserved" 1022 "Reserved" 1023 "Invalid value" ;
VAL_ 659 IP_FuelAuxTankR 0 "Invalid value" 1 "Reserved" 9 "Reserved" 10 "Valid value" 1000 "Valid value" 1001 "Reserved" 1022 "Reserved" 1023 "Invalid value" ;
VAL_ 659 IP_LagueSet 0 "Chinese" 1 "English" 2 "Russian" 3 "Spaish" 4 "Portuguese" 5 "German" 6 "French" 7 "Italian" 8 "Arabic" 9 "Thai" 10 "Ukrainian" 11 "Indonesian" 12 "Reserve" 14 "Reserve" 15 "Invalid value" ;
VAL_ 661 SysPowerMod 0 "OFF" 1 "ACC (reserved)" 2 "ON" 3 "Crank" ;
VAL_ 661 SysPowerModVld 0 "Invalid" 1 "Valid" ;
VAL_ 661 PEPS_PowerRlyOutpSts 0 "ACC & IGN1 & IGN2 are disconnected" 1 "ACC connected, others are disconnected(Reserved)" 2 "IGN2 connected, others are disconnected" 3 "ACC & IGN2 connected, IGN1 disconnected(Reserved)" 4 "IGN1 connected, others are disconnected" 5 "IGN1 & ACC connected, IGN2 disconnected(Reserved)" 6 "IGN1 & IGN2 connected, ACC disconnected(Reserved)" 7 "ACC & IGN1 & IGN2 connected" ;
VAL_ 661 RemPowerFailureSts 0 "No failure" 1 "power on condition not satisfied" 2 "power off condition not satisfied" 3 "Reserved" ;
VAL_ 661 RemUpgrdModSysPower 0 "OFF" 1 "Remote upgrade mode ON (Engine OFF )" 2 "Reserved" 3 "Reserved" ;
VAL_ 664 RPAS_NearBrrdstn 0 "Valid value" 150 "Valid value" 151 "Reserved" 254 "Reserved" 255 "No Display" ;
VAL_ 664 HAVP_ProcRa 0 "0-100%" 100 "0-100%" 101 "Reserved" 126 "Reserved" 127 "No Display" ;
VAL_ 664 P2P_ProcBar 0 "0-100" 100 "0-100" 101 "Reserved" 126 "Reserved" 127 "No Display" ;
VAL_ 664 APS_ObjRiSideAr1 0 "No object" 1 "Object in zone 1, 0~10cm" 2 "Object in zone 2, 11~20cm" 3 "Object in zone 3, 21~30cm" 4 "Object in zone 4, 31~40cm" 5 "Object in zone 5, 41~50cm" 6 "Object in zone 6, 51~60cm" 7 "Reserved" 15 "Reserved" ;
VAL_ 664 APS_ObjRiSideAr2 0 "No object" 1 "Object in zone 1, 0~10cm" 2 "Object in zone 2, 11~20cm" 3 "Object in zone 3, 21~30cm" 4 "Object in zone 4, 31~40cm" 5 "Object in zone 5, 41~50cm" 6 "Object in zone 6, 51~60cm" 7 "Reserved" 15 "Reserved" ;
VAL_ 664 APS_ObjRiSideAr3 0 "No object" 1 "Object in zone 1, 0~10cm" 2 "Object in zone 2, 11~20cm" 3 "Object in zone 3, 21~30cm" 4 "Object in zone 4, 31~40cm" 5 "Object in zone 5, 41~50cm" 6 "Object in zone 6, 51~60cm" 7 "Reserved" 15 "Reserved" ;
VAL_ 664 APS_ObjRiSideAr4 0 "No object" 1 "Object in zone 1, 0~10cm" 2 "Object in zone 2, 11~20cm" 3 "Object in zone 3, 21~30cm" 4 "Object in zone 4, 31~40cm" 5 "Object in zone 5, 41~50cm" 6 "Object in zone 6, 51~60cm" 7 "Reserved" 15 "Reserved" ;
VAL_ 664 APS_ObjRiSideAr5 0 "No object" 1 "Object in zone 1, 0~10cm" 2 "Object in zone 2, 11~20cm" 3 "Object in zone 3, 21~30cm" 4 "Object in zone 4, 31~40cm" 5 "Object in zone 5, 41~50cm" 6 "Object in zone 6, 51~60cm" 7 "Reserved" 15 "Reserved" ;
VAL_ 664 APS_ObjLeSideAr1 0 "No object" 1 "Object in zone 1, 0~10cm" 2 "Object in zone 2, 11~20cm" 3 "Object in zone 3, 21~30cm" 4 "Object in zone 4, 31~40cm" 5 "Object in zone 5, 41~50cm" 6 "Object in zone 6, 51~60cm" 7 "Reserved" 15 "Reserved" ;
VAL_ 664 APS_ObjLeSideAr2 0 "No object" 1 "Object in zone 1, 0~10cm" 2 "Object in zone 2, 11~20cm" 3 "Object in zone 3, 21~30cm" 4 "Object in zone 4, 31~40cm" 5 "Object in zone 5, 41~50cm" 6 "Object in zone 6, 51~60cm" 7 "Reserved" 15 "Reserved" ;
VAL_ 664 APS_ObjLeSideAr3 0 "No object" 1 "Object in zone 1, 0~10cm" 2 "Object in zone 2, 11~20cm" 3 "Object in zone 3, 21~30cm" 4 "Object in zone 4, 31~40cm" 5 "Object in zone 5, 41~50cm" 6 "Object in zone 6, 51~60cm" 7 "Reserved" 15 "Reserved" ;
VAL_ 664 APS_ObjLeSideAr4 0 "No object" 1 "Object in zone 1, 0~10cm" 2 "Object in zone 2, 11~20cm" 3 "Object in zone 3, 21~30cm" 4 "Object in zone 4, 31~40cm" 5 "Object in zone 5, 41~50cm" 6 "Object in zone 6, 51~60cm" 7 "Reserved" 15 "Reserved" ;
VAL_ 664 APS_ObjLeSideAr5 0 "No object" 1 "Object in zone 1, 0~10cm" 2 "Object in zone 2, 11~20cm" 3 "Object in zone 3, 21~30cm" 4 "Object in zone 4, 31~40cm" 5 "Object in zone 5, 41~50cm" 6 "Object in zone 6, 51~60cm" 7 "Reserved" 15 "Reserved" ;
VAL_ 664 APS_FRSideSnsrFailSts 0 "no failure" 1 "failure" ;
VAL_ 664 APS_FLSideSnsrFailSts 0 "no failure" 1 "failure" ;
VAL_ 664 APS_RRSideSnsrFailSts 0 "no failure" 1 "failure" ;
VAL_ 664 APS_RLSideSnsrFailSts 0 "no failure" 1 "failure" ;
VAL_ 664 SDW_SoundIndcn 0 "Tone 0 - No warning" 1 "Tone 1 - Long beep" 2 "Tone 2 - 1.5 Hz" 3 "Tone 3 - 3Hz" ;
VAL_ 664 SDWActiveSts 0 "Not active" 1 "Active" ;
VAL_ 664 RPAS_ObjRRCornrAr1 0 "No object" 1 "Object in zone 1, 0~10cm" 2 "Object in zone 2, 11~20cm" 3 "Object in zone 3, 21~30cm" 4 "Object in zone 4, 31~40cm" 5 "Object in zone 5, 41~50cm" 6 "Object in zone 6, 51~60cm" 7 "Reserved" 15 "Reserved" ;
VAL_ 664 RPAS_ObjRRCornrAr2 0 "No object" 1 "Object in zone 1, 0~10cm" 2 "Object in zone 2, 11~20cm" 3 "Object in zone 3, 21~30cm" 4 "Object in zone 4, 31~40cm" 5 "Object in zone 5, 41~50cm" 6 "Object in zone 6, 51~60cm" 7 "Reserved" 15 "Reserved" ;
VAL_ 664 RPAS_ObjRRMidlAr1 0 "No object" 1 "Object in zone 1, 0~10cm" 2 "Object in zone 2, 11~20cm" 3 "Object in zone 3, 21~30cm" 4 "Object in zone 4, 31~40cm" 5 "Object in zone 5, 41~50cm" 6 "Object in zone 6, 51~60cm" 7 "Object in zone 7, 61~70cm" 8 "Object in zone 8, 71~80cm" 9 "Object in zone 9, 81~90cm" 10 "Object in zone 10, 91~100cm" 11 "Object in zone 11, 101~110cm" 12 "Object in zone 12, 111~120cm" 13 "Object in zone 13, 121~130cm" 14 "Object in zone 14, 131~140cm" 15 "Object in zone 15, 141~150cm" ;
VAL_ 664 RPAS_ObjRRMidlAr2 0 "No object" 1 "Object in zone 1, 0~10cm" 2 "Object in zone 2, 11~20cm" 3 "Object in zone 3, 21~30cm" 4 "Object in zone 4, 31~40cm" 5 "Object in zone 5, 41~50cm" 6 "Object in zone 6, 51~60cm" 7 "Object in zone 7, 61~70cm" 8 "Object in zone 8, 71~80cm" 9 "Object in zone 9, 81~90cm" 10 "Object in zone 10, 91~100cm" 11 "Object in zone 11, 101~110cm" 12 "Object in zone 12, 111~120cm" 13 "Object in zone 13, 121~130cm" 14 "Object in zone 14, 131~140cm" 15 "Object in zone 15, 141~150cm" ;
VAL_ 664 RPAS_ObjRLMidlAr1 0 "No object" 1 "Object in zone 1, 0~10cm" 2 "Object in zone 2, 11~20cm" 3 "Object in zone 3, 21~30cm" 4 "Object in zone 4, 31~40cm" 5 "Object in zone 5, 41~50cm" 6 "Object in zone 6, 51~60cm" 7 "Object in zone 7, 61~70cm" 8 "Object in zone 8, 71~80cm" 9 "Object in zone 9, 81~90cm" 10 "Object in zone 10, 91~100cm" 11 "Object in zone 11, 101~110cm" 12 "Object in zone 12, 111~120cm" 13 "Object in zone 13, 121~130cm" 14 "Object in zone 14, 131~140cm" 15 "Object in zone 15, 141~150cm" ;
VAL_ 664 RPAS_ObjRLMidlAr2 0 "No object" 1 "Object in zone 1, 0~10cm" 2 "Object in zone 2, 11~20cm" 3 "Object in zone 3, 21~30cm" 4 "Object in zone 4, 31~40cm" 5 "Object in zone 5, 41~50cm" 6 "Object in zone 6, 51~60cm" 7 "Object in zone 7, 61~70cm" 8 "Object in zone 8, 71~80cm" 9 "Object in zone 9, 81~90cm" 10 "Object in zone 10, 91~100cm" 11 "Object in zone 11, 101~110cm" 12 "Object in zone 12, 111~120cm" 13 "Object in zone 13, 121~130cm" 14 "Object in zone 14, 131~140cm" 15 "Object in zone 15, 141~150cm" ;
VAL_ 664 RPAS_ObjRLCornrAr1 0 "No object" 1 "Object in zone 1, 0~10cm" 2 "Object in zone 2, 11~20cm" 3 "Object in zone 3, 21~30cm" 4 "Object in zone 4, 31~40cm" 5 "Object in zone 5, 41~50cm" 6 "Object in zone 6, 51~60cm" 7 "Reserved" 15 "Reserved" ;
VAL_ 664 RPAS_ObjRLCornrAr2 0 "No object" 1 "Object in zone 1, 0~10cm" 2 "Object in zone 2, 11~20cm" 3 "Object in zone 3, 21~30cm" 4 "Object in zone 4, 31~40cm" 5 "Object in zone 5, 41~50cm" 6 "Object in zone 6, 51~60cm" 7 "Reserved" 15 "Reserved" ;
VAL_ 664 RPAS_RLCornrSnsrFailSts 0 "no failure" 1 "failure" ;
VAL_ 664 RPAS_RLMiddlSnsrFailSts 0 "no failure" 1 "failure" ;
VAL_ 664 RPAS_RRMiddlSnsrFailSts 0 "no failure" 1 "failure" ;
VAL_ 664 RPAS_RRCornrSnsrFailSts 0 "no failure" 1 "failure" ;
VAL_ 664 RPAS_WorkSts 0 "Disable" 1 "Enable" 2 "Active" 3 "Failed" ;
VAL_ 664 RPAS_SoundIndcn 0 "Tone zero No warning" 1 "Tone one  Long beep" 2 "Tone two 1.5 Hz" 3 "Tone three  3Hz" ;
VAL_ 664 MEBWorkSts 0 "Off" 1 "Enable" 2 "Active" 3 "Failed" ;
VAL_ 664 MEB_EnableSts 0 "Disable" 1 "Enable" ;
VAL_ 664 FPAS_ObjFLCornrAr1 0 "No object" 1 "Object in zone 1, 0~10cm" 2 "Object in zone 2, 11~20cm" 3 "Object in zone 3, 21~30cm" 4 "Object in zone 4, 31~40cm" 5 "Object in zone 5, 41~50cm" 6 "Object in zone 6, 51~60cm" 7 "Reserved" 15 "Reserved" ;
VAL_ 664 FPAS_ObjFLCornrAr2 0 "No object" 1 "Object in zone 1, 0~10cm" 2 "Object in zone 2, 11~20cm" 3 "Object in zone 3, 21~30cm" 4 "Object in zone 4, 31~40cm" 5 "Object in zone 5, 41~50cm" 6 "Object in zone 6, 51~60cm" 7 "Reserved" 15 "Reserved" ;
VAL_ 664 FPAS_ObjFLMidlAr1 0 "No object" 1 "Object in zone 1, 0~10cm" 2 "Object in zone 2, 11~20cm" 3 "Object in zone 3, 21~30cm" 4 "Object in zone 4, 31~40cm" 5 "Object in zone 5, 41~50cm" 6 "Object in zone 6, 51~60cm" 7 "Object in zone 7, 61~70cm" 8 "Object in zone 8, 71~80cm" 9 "Object in zone 9, 81~90cm" 10 "Object in zone 10, 91~100cm" 11 "Reserved" 15 "Reserved" ;
VAL_ 664 FPAS_ObjFLMidlAr2 0 "No object" 1 "Object in zone 1, 0~10cm" 2 "Object in zone 2, 11~20cm" 3 "Object in zone 3, 21~30cm" 4 "Object in zone 4, 31~40cm" 5 "Object in zone 5, 41~50cm" 6 "Object in zone 6, 51~60cm" 7 "Object in zone 7, 61~70cm" 8 "Object in zone 8, 71~80cm" 9 "Object in zone 9, 81~90cm" 10 "Object in zone 10, 91~100cm" 11 "Reserved" 15 "Reserved" ;
VAL_ 664 FPAS_ObjFRMidlAr1 0 "No object" 1 "Object in zone 1, 0~10cm" 2 "Object in zone 2, 11~20cm" 3 "Object in zone 3, 21~30cm" 4 "Object in zone 4, 31~40cm" 5 "Object in zone 5, 41~50cm" 6 "Object in zone 6, 51~60cm" 7 "Object in zone 7, 61~70cm" 8 "Object in zone 8, 71~80cm" 9 "Object in zone 9, 81~90cm" 10 "Object in zone 10, 91~100cm" 11 "Reserved" 15 "Reserved" ;
VAL_ 664 FPAS_ObjFRMidlAr2 0 "No object" 1 "Object in zone 1, 0~10cm" 2 "Object in zone 2, 11~20cm" 3 "Object in zone 3, 21~30cm" 4 "Object in zone 4, 31~40cm" 5 "Object in zone 5, 41~50cm" 6 "Object in zone 6, 51~60cm" 7 "Object in zone 7, 61~70cm" 8 "Object in zone 8, 71~80cm" 9 "Object in zone 9, 81~90cm" 10 "Object in zone 10, 91~100cm" 11 "Reserved" 15 "Reserved" ;
VAL_ 664 FPAS_ObjFRCornrAr1 0 "No object" 1 "Object in zone 1, 0~10cm" 2 "Object in zone 2, 11~20cm" 3 "Object in zone 3, 21~30cm" 4 "Object in zone 4, 31~40cm" 5 "Object in zone 5, 41~50cm" 6 "Object in zone 6, 51~60cm" 7 "Reserved" 15 "Reserved" ;
VAL_ 664 FPAS_ObjFRCornrAr2 0 "No object" 1 "Object in zone 1, 0~10cm" 2 "Object in zone 2, 11~20cm" 3 "Object in zone 3, 21~30cm" 4 "Object in zone 4, 31~40cm" 5 "Object in zone 5, 41~50cm" 6 "Object in zone 6, 51~60cm" 7 "Reserved" 15 "Reserved" ;
VAL_ 664 FPAS_FLCornrSnsrFailSts 0 "no failure" 1 "failure" ;
VAL_ 664 FPAS_FLMiddlSnsrFailSts 0 "no failure" 1 "failure" ;
VAL_ 664 FPAS_FRMiddlSnsrFailSts 0 "no failure" 1 "failure" ;
VAL_ 664 FPAS_FRCornrSnsrFailSts 0 "no failure" 1 "failure" ;
VAL_ 664 FPAS_WorkSts 0 "Disable" 1 "Enable" 2 "Active" 3 "Failed" ;
VAL_ 664 FPAS_AutoModSts 0 "Not available" 1 "available" ;
VAL_ 664 FPAS_SoundIndcn 0 "Tone zero  No warning" 1 "Tone one  Long beep" 2 "Tone two 1.5 Hz" 3 "Tone three 3Hz" ;
VAL_ 664 FPAS_NearBrrdstn 0 "Valid value" 100 "Valid value" 101 "Reserved" 126 "Reserved" 127 "No Display" ;
VAL_ 664 APA_MenuDispCtrlCmd 0 "No_Disp_avm_menu" 1 "park_in_indicate_menu" 2 "park_in_select_slot_menu" 3 "park_in_mode_select_menu" 4 "park_in_process" 5 "remote_park_in_process" 6 "park_out_confirm_menu" 7 "park_out_process" 8 "park_in_indicate_menu_NoRPA" 9 "park_in_select_slot_menu_NoRPA" 10 "park_in_mode_select_menu_NoRPA" 11 "park_out _indicate_menu" 12 "Reversed" 15 "Reversed" ;
VAL_ 664 APA_FuncSts 0 "APA Function standby" 1 "APA Function active" 2 "APA Function disable" 3 "Reserved" ;
VAL_ 664 RADS_FuncSts 0 "Reverse Asist Function standby" 1 "Reverse Asist Function active" 2 "Reverse Asist Function disable" 3 "Reserved" ;
VAL_ 664 FADS_FuncSts 0 "FADS Function standby" 1 "FADS Function active" 2 "FADS Function disable" 3 "Reserved" ;
VAL_ 664 HAP_TextIconDispCtrl 0 "No display" 1 "Display According to text info" 2 "Display parking mode" 3 "Reserved" ;
VAL_ 664 P2P_FuncSts 0 "P2P Functionstandby" 1 "P2P Function active" 2 "P2P Function disable" 3 "P2P Coming soon" ;
VAL_ 664 FrntCamDirtySts 0 "Normal" 1 "Abnormal" ;
VAL_ 664 RearCamDirtySts 0 "Normal" 1 "Abnormal" ;
VAL_ 664 LeCamDirtySts 0 "Normal" 1 "Abnormal" ;
VAL_ 664 RiCamDirtySts 0 "Normal" 1 "Abnormal" ;
VAL_ 664 DVRCamDirtySts 0 "Normal" 1 "Abnormal" ;
VAL_ 665 FGA_Chan1LongTyp 0 "Valid Value" 14 "Valid Value" 15 "No_connect" 16 "Valid Value" 2047 "Valid Value" ;
VAL_ 665 FGA_Chan2LongTyp 0 "Valid Value" 14 "Valid Value" 15 "No_connect" 16 "Valid Value" 2047 "Valid Value" ;
VAL_ 665 FGA_Chan3LongTyp 0 "Valid Value" 14 "Valid Value" 15 "No_connect" 16 "Valid Value" 2047 "Valid Value" ;
VAL_ 667 HAVP_LrngDst 0 "Valid_values" 1000 "Valid_values" 1001 "Invalid" 1022 "Invalid" 1023 "No_display" ;
VAL_ 667 HAVP_HUT_TextDisp 0 "Idle" 1 "Path list screen" 2 "Reserved" 3 "Path learning inprocess,set starting point after stop" 4 "Insufficient brightness,reset starting point" 5 "Too empty environment,reset start-ing point" 6 "Front car is too close,reset starting point" 7 "Camera is blocked,reset starting point" 8 "Environment is abnormal,reset starting point" 9 "Path learning inprocess,continue driving to ending point" 10 "Path learning inprocess,set ending point or choose ending lot after stop" 11 "Too high speed,lower speed below 15kmh" 12 "Too high speed,path learning quit" 13 "Distance limited, set ending point after stop" 14 "Distance exceed,path learning quit" 15 "Too long time,path learning quit" 16 "Insufficient brightness,reset end-ing point" 17 "Too empty environment,reset ending point" 18 "Front car is too close,reset ending point" 19 "Camera is blocked,reset ending point" 20 "Environment is abnormal,reset ending point" 21 "Please select new path parking lot" 22 "Please set path name" 23 "Please wait, path generating" 24 "Whether auto parking in" 25 "System error,function quit" 26 "Path learning succeed" 27 "Insufficient brightness,path learning failed" 28 "Too empty environment,path learning failed" 29 "Front car is too close,path learn-ing failed" 30 "Camera is blocked,path learning failed" 31 "Environment is abnormal,path learning failed" 32 "Path matching, driving to learned path scope" 33 "Path matching timeout, parking quit" 34 "Path matched succeed, stop and apply P+EPB" 35 "Please activite HAVP on APP" 36 "Show HAVP inprocess picture" 37 "Please select suitable parking slot icon" 38 "Please drag the parking slot to suitable place and adjust the angle" 39 "Reserved" 63 "Reserved" ;
VAL_ 667 HAVP_ScFail_info 0 "Idle" 1 "Front Wide Camera fault" 2 "Around View Camera fault" 3 "Ultrasonic fault" 4 "Controller HW fault" 5 "Controller SW fault" 6 "Reserved" 31 "Reserved" ;
VAL_ 667 PAVP_ScFail_info 0 "Idle" 1 "Camera fault" 2 "Ultrasonic fault" 3 "AVP HW fault" 4 "AVP SW fault" 5 "AVP Eth1 connection fault" 6 "AVP Eth2 connection fault" 7 "Chasis&Powertrain ECU fault" 8 "Reserved" 49 "Reserved" ;
VAL_ 669 InCarTemp 0 "Valid value" 253 "Valid value" 254 "Initial value" 255 "Invalid value" ;
VAL_ 669 ACAQSEnaSts 0 "Disable" 1 "Enable" ;
VAL_ 669 ACOperMod 0 "Economy Mode" 1 "Standard Mode" 2 "Strong Mode" 3 "Reserved" 7 "Reserved" ;
VAL_ 669 ACAIUEnaSts 0 "Disable" 1 "Enable" ;
VAL_ 669 ACDrvAirDistriMod 0 "Face" 1 "Face & Foot" 2 "Foot" 3 "Foot & Defrost" 4 "Defrost" 5 "Reserved" 6 "Reserved" 7 "Auto air distribution mode" ;
VAL_ 669 ACSteplessSpdSetEnaSts 0 "Disable" 1 "Enable" ;
VAL_ 669 ACFrntPassTempSteplessSetEnaSts 0 "Disable" 1 "Enable" ;
VAL_ 669 ACDrvTempSteplessSetEnaSts 0 "Disable" 1 "Enable" ;
VAL_ 669 ACEEMSts 0 "Normal mode" 1 "Transport_static mode" 2 "Transport_Dynamic mode" 3 "Static_power saving level 1" 4 "Static_power saving level 2" 5 "Dynamic_power saving level 4" 6 "Dynamic_power saving level 5" 7 "Power system error" 8 "Reserved" 15 "Reserved" ;
VAL_ 669 ACCbnClnEnasts 0 "Disable" 1 "Enable" ;
VAL_ 669 ACCbnClnOffCode 0 "No offcode" 1 "Any door is open" 2 "SystemPowerMode is not off" 3 "Status of Battery is not ok" 4 "Any door is open and SystemPowerMode is not off" 5 "Status of Battery is not ok and Any door is open" 6 "Status of Battery is not ok and SystemPowerMode is not off" 7 "Status of Battery is not ok and SystemPowerMode is not off and  Any door is open" 8 "SystemPowerMode is not on" 9 "SystemPowerMode is not on and  Any door is open" 10 "Remote mode status is off" 11 "Engine is on" 12 "Reserved" 15 "Reserved" ;
VAL_ 671 RemoteModSts 0 "Normal mode" 1 "Remote mode" ;
VAL_ 671 PASWorkCmd 0 "OFF" 1 "ON" ;
VAL_ 671 KL30BRelaySts 0 "Off" 1 "On" ;
VAL_ 671 RViewMirrorSts 0 "Unfold" 1 "Fold" ;
VAL_ 671 WiprReq_F_PBox 0 "Wiper Off" 1 "Wiper action once" 2 "Speed1 (Lo)" 3 "Speed2 (Hi)" 4 "Reserved" 6 "Reserved" 7 "Invalid" ;
VAL_ 671 DrivingModReq 0 "Standard" 1 "reserved" 2 "Reserved" 3 "Economic" 4 "Sport" 5 "Reserved" 6 "Reserved" 7 "Reserved" 8 "Reserved" 9 "AUTO" 10 "Reserved" 11 "Mud" 12 "_Snow_TOD" 13 "Sand" 14 "_Rock" 15 "4H" ;
VAL_ 671 WhistleSts 0 "OFF" 1 "ON" ;
VAL_ 675 DrvSeatHeatSts_Nine 0 "OFF" 1 "Level1_Low" 2 "Level2" 3 "Level3" 4 "Level4" 5 "Level5" 6 "Level6" 7 "Level7" 8 "Level8" 9 "Level9_High" 10 "Reserved" 15 "Reserved" ;
VAL_ 675 PassSeatHeatSts_Nine 0 "OFF" 1 "Level1_Low" 2 "Level2" 3 "Level3" 4 "Level4" 5 "Level5" 6 "Level6" 7 "Level7" 8 "Level8" 9 "Level9_High" 10 "Reserved" 15 "Reserved" ;
VAL_ 675 SecRowLeSeatHeatSts_Nine 0 "OFF" 1 "Level1_Low" 2 "Level2" 3 "Level3" 4 "Level4" 5 "Level5" 6 "Level6" 7 "Level7" 8 "Level8" 9 "Level9_High" 10 "Reserved" 15 "Reserved" ;
VAL_ 675 SecRowRiSeatHeatSts_Nine 0 "OFF" 1 "Level1_Low" 2 "Level2" 3 "Level3" 4 "Level4" 5 "Level5" 6 "Level6" 7 "Level7" 8 "Level8" 9 "Level9_High" 10 "Reserved" 15 "Reserved" ;
VAL_ 680 TranPMode_Sts 0 "Normal Mode" 1 "Transport Mode" ;
VAL_ 680 Stat_PwrSv_Lvl 0 "Normal" 1 "Level 1" 2 "Level 2" 3 "Reserved" 7 "Reserved" ;
VAL_ 680 Dyn_PwrSv_Lvl 0 "Normal" 1 "Level 1" 2 "Level 2" 3 "Level 3" 4 "Level 4" 5 "Level 5" 6 "Reserved" 7 "Reserved" ;
VAL_ 680 LvPwrSysErr 0 "No error" 1 "error" 2 "Reservrd" 3 "Reservrd" ;
VAL_ 680 DeepSlpCmd 0 "Normal" 1 "Sleep Commend" 2 "Deep Sleep Commend" 3 "Reserved" ;
VAL_ 683 ACC_LeTgt_02_Dy 0 "Valid value" 81 "Valid value" 82 "Reserved" 127 "Reserved" ;
VAL_ 683 ACC_LeTgt_02_Dx 0 "Valid value" 300 "Valid value" 301 "Reserved" 511 "Reserved" ;
VAL_ 683 ACC_LeTgt_02_Typ 0 "Unkown" 1 "Sedan" 2 "Truck" 3 "Motorcycle" 4 "Pedestrian" 5 "Bicycle" 6 "Traffic_cone" 7 "Obstacle" ;
VAL_ 683 ACC_LeTargrt_02_Detn 0 "Not dectected" 1 "Dectected" 2 "Reserved" 3 "Invalid" ;
VAL_ 683 ACC_RiTargrt_02_Detn 0 "Not dectected" 1 "Dectected" 2 "Reserved" 3 "Invalid" ;
VAL_ 683 ACC_RiTgt_02_Dy 0 "Valid value" 81 "Valid value" 82 "Reserved" 127 "Reserved" ;
VAL_ 683 ACC_RiTgt_02_Dx 0 "Valid value" 300 "Valid value" 301 "Reserved" 511 "Reserved" ;
VAL_ 683 ACC_RiTgt_02_Typ 0 "Unkown" 1 "Sedan" 2 "Truck" 3 "Motorcycle" 4 "Pedestrian" 5 "Bicycle" 6 "Traffic_cone" 7 "Obstacle" ;
VAL_ 683 ACC_LeTgtObjBarDisp 0 "No display" 1 "Distance_1 one bar" 2 "Distance_2 two bars" 3 "Distance_3 three bars" 4 "Distance_4 four bars" 5 "Resvered" 7 "Resvered" ;
VAL_ 683 ACC_RiTgtObjBarDisp 0 "No display" 1 "Distance_1 one bar" 2 "Distance_2 two bars" 3 "Distance_3 three bars" 4 "Distance_4 four bars" 5 "Resvered" 7 "Resvered" ;
VAL_ 683 Checksum_ACC3 0 "Valid value" 255 "Valid value" ;
VAL_ 683 ICA_HandsOffResp 0 "OFF" 1 "ON" ;
VAL_ 683 ALC_Resp 0 "OFF" 1 "ON" ;
VAL_ 683 HWA_Resp 0 "OFF" 1 "ON" ;
VAL_ 683 ISL_Resp 0 "OFF" 1 "ON" ;
VAL_ 683 HWA_SnvtySet_Resp 0 "Normal" 1 "High sensitivity" 2 "Low sensitivity" 3 "Reserved" ;
VAL_ 683 Longctrl_VehHldReq_DVR 0 "No Request" 1 "Request" ;
VAL_ 683 Longctrl_DrvOFF_Req_DVR 0 "No Request" 1 "Request" ;
VAL_ 683 Longctrl_ModSts_DVR 0 "OFF mode" 1 "Passive mode(Reject)" 2 "Passive mode(Stand-by)" 3 "Active-Control mode" 4 "Brake-only mode" 5 "Override" 6 "Standstill" 7 "Failure mode Longctrl" 8 "Reserved" 9 "Shut off" 10 "Reserved" 15 "Reserved" ;
VAL_ 683 Longctrl_Decel_Req_DVR 0 "No Request" 1 "Request" ;
VAL_ 683 Longctrl_EngTrqReq_DVR 0 "Valid value" 65535 "Valid value" ;
VAL_ 683 Longctrl_EngTrqReqActive_DVR 0 "Not active" 1 "Active" ;
VAL_ 683 Longctrl_DecelToStopReq_DVR 0 "No Request" 1 "Request" ;
VAL_ 683 Longctrl_ParkShiftReq_DVR 0 "No request" 1 "Request park Shift" 2 "Invalid" 3 "Reserved" ;
VAL_ 683 Longctrl_Decel_ReqValue_DVR 0 "Valid value" 255 "Valid value" ;
VAL_ 683 ALC_InterSysInfoDisp 0 "No display" 1 "Automatic lane change function failure" 2 "Reserve" 3 "Reserve" ;
VAL_ 683 RollingCounter_ACC3 0 "Valid value" 14 "Valid value" 15 "Invalid value" ;
VAL_ 683 Checksum_ACC4 0 "Valid value" 255 "Valid value" ;
VAL_ 683 ACC_ObjDetecte 0 "No object" 1 "Target object detected" ;
VAL_ 683 ACC_TakeOverReq 0 "No TakeOver request" 1 "Valid TakeOver request" ;
VAL_ 683 ACC_InterSysInfoDisp 0 "No display" 1 "Unable to activate ACC due to speed not achive" 2 "ACC active control is cancelled" 3 "Resvered" 4 "ACC and PEBS temporary unavailable" 5 "Unable to activate ACC due to other limitation(except speed not achive)" 6 "ACC and PEBS error" 7 "ACC temporary unavailable" 8 "ACC is active" 9 "Blindness" 10 "Resvered" 31 "Resvered" ;
VAL_ 683 ACC_ModDisp 0 "OFF Mode" 1 "Passive Mode" 2 "StandBy Mode" 3 "Active-Control Mode" 4 "Brake-Only Mode" 5 "Override" 6 "Reserved" 7 "ACC and PEBS Failure mode" 8 "ACC Failure mode" 9 "Reserved" 31 "Reserved" ;
VAL_ 683 ACC_FctSts 0 "Fuction Not  Available" 1 "Fuction Available" 2 "Performance degradation" 3 "Reserved" ;
VAL_ 683 ACC_TgtObjBarDisp 0 "No display" 1 "Distance_1 one bar" 2 "Distance_2 two bars" 3 "Distance_3 three bars" 4 "Distance_4 four bars" 5 "Resvered" 7 "Resvered" ;
VAL_ 683 Longctrl_HazActv 0 "Not active" 1 "AEB active" 2 "Safestop active" 3 "Reserved" ;
VAL_ 683 TJA_ACC_SelSts 0 "off" 1 "ACC selected" 2 "TJAICA selected" 3 "Off selected" 4 "ACC on" 5 "TJAICA on" 6 "Reserved" 7 "Reserved" ;
VAL_ 683 CruCha_ModDisp 0 "OFF mode" 1 "Idle mode" 2 "Ready mode" 3 "Active" 4 "Reserved" 5 "Warning Level 1" 6 "Warning Level 2" 7 "Warning Level 3" 8 "Reserved" 9 "Failure" 10 "Reserved" 15 "Reserved" ;
VAL_ 683 TJA_ICA_InterSysInfoDisp 0 "No display" 1 "Unable to activate TJAICA due to other limitation" 2 "TJAICA active control is cancelled" 3 "TJAICA   temporarily unavailable" 4 "Current IGN Cycle Function Inhibit" 5 "TJA is active" 6 "Restart or P gear to activate" 7 "Resvered" ;
VAL_ 683 TJA_ICA_ModDisp 0 "OFF_mode" 1 "Passive_mode" 2 "Active_mode" 3 "Ready_mode" 4 "Failure" 5 "Recoverable_mode" 6 "Reserved" 7 "Reserved" ;
VAL_ 683 ISL_InterSysInfoDisp 0 "no_display" 1 "Speed_Limit_Confirm_Request" 2 "Speed_Limit_Take_Over_Request" 3 "Reduce_speed_on_a_curve" ;
VAL_ 683 ACC_TimeGapSet 0 "No display" 1 "TimeGap_1 1s" 2 "TimeGap_2 1.4s" 3 "TimeGap_3 1.8s" 4 "TimeGap_4 2.1s" 5 "Reserved" 7 "Reserved" ;
VAL_ 683 ACC_SpdSetValue 0 "Valid value" 254 "Valid value" 255 "No display" ;
VAL_ 683 CruChar_InterSysInfoDisp 0 "No display" 1 "Unable to activate CruiseChauffer due to other limitation" 2 "CruiseChauffer active control is cancelled" 3 "CruiseChauffer temporarily unavailable" 4 "Take over request" 5 "Current IGN Cycle Function Inhibit" 6 "Please Keep Attention" 7 "To cross the tunnel, please take over  in time" 8 "Have a branch road ahead. Please take over in time" 9 "Hands off warning" 10 "Reserved" 15 "Reserved" ;
VAL_ 683 RollingCounter_ACC4 0 "Valid value" 14 "Valid value" 15 "Invalid value" ;
VAL_ 683 Checksum_ACC8 0 "Valid value" 255 "Valid value" ;
VAL_ 683 HWA_ModDisp 0 "OFF" 1 "Safstop" 2 "Passive" 3 "Ready" 4 "Active" 5 "Override" 6 "Slow retreat" 7 "Standstill" 8 "Reserved" 14 "Reserved" 15 "Fault" ;
VAL_ 683 HWA_InterSysInfoDisp 0 "No display" 1 "Left Overtaking" 2 "Right Overtaking" 3 "Turn off the turn light" 4 "Rainmode activated" 5 "Overtime for lane change" 6 "lane change is cancelled" 7 "Rainmode deactivated" 8 "Speed is too low to support lane change" 9 "Reserved" 10 "Take over request" 11 "Please Keep Attention" 12 "To cross the tunnel, please take over in time" 13 "Have a branch road ahead Please take over in time" 14 "Sharp bend ahead Please take over in time" 15 "Speed is too high to support lane change" ;
VAL_ 683 HWA_LaneChange 0 "No display" 1 "left" 2 "right" 3 "reserved" ;
VAL_ 683 HWA_LaneChangeReq 0 "No display" 1 "left satisfied" 2 "right satisfied" 3 "left not satisfied" 4 "right not satisfied" 5 "reserved" 7 "reserved" ;
VAL_ 683 HWA_Warning 0 "No Warning" 1 "Warning Level 1" 2 "Warning Level 2" 3 "Warning Level 3" ;
VAL_ 683 RollingCounter_ACC8 0 "Valid value" 14 "Valid value" 15 "Invalid value" ;
VAL_ 683 Checksum_ACC6 0 "Valid value" 255 "Valid value" ;
VAL_ 683 ACC_PotentialTgtDy 0 "Valid value" 160 "Valid value" 161 "Reserved" 255 "Reserved" ;
VAL_ 683 ACC_PotentialTgtDx 0 "Valid value" 300 "Valid value" 301 "Reserved" 511 "Reserved" ;
VAL_ 683 ACC_RlvTgtDetn 0 "Not dectected" 1 "Dectected" 2 "Reserved" 3 "Invalid" ;
VAL_ 683 ACC_EgoStatus 0 "No Display" 1 "Override" 2 "Deceleration" 3 "Reserved" ;
VAL_ 683 ACC_RlvTgtTyp 0 "Unkown" 1 "Sedan" 2 "Truck" 3 "Motorcycle" 4 "Pedestrian" 5 "Bicycle" 6 "Traffic_cone" 7 "Obstacle" ;
VAL_ 683 ACC_RlvTgtDy 0 "Valid value" 160 "Valid value" 161 "Reserved" 255 "Reserved" ;
VAL_ 683 ACC_RlvTgtDx 0 "Valid value" 300 "Valid value" 301 "Reserved" 511 "Reserved" ;
VAL_ 683 ACC_PotentialTgtDetn 0 "Not dectected" 1 "Dectected" 2 "Reserved" 3 "Invalid" ;
VAL_ 683 ACC_PotentialTgtTyp 0 "Unkown" 1 "Sedan" 2 "Truck" 3 "Motorcycle" 4 "Pedestrian" 5 "Bicycle" 6 "Traffic_cone" 7 "Obstacle" ;
VAL_ 683 RollingCounter_ACC6 0 "Valid value" 14 "Valid value" 15 "Invalid value" ;
VAL_ 683 Checksum_ACC7 0 "Valid value" 255 "Valid value" ;
VAL_ 683 Request_driveoff 0 "no request" 1 "The front car has started" 2 "The front car has started,Please pay attention to the road environment ahead" 3 "The front car has started,please keep your attention" 4 "The front car has started,please take over the car" 5 "Reserved" 7 "Reserved" ;
VAL_ 683 ACCSts 0 "Deactive" 1 "Active" ;
VAL_ 683 ACC_LeTgtDy 0 "Valid value" 160 "Valid value" 161 "Reserved" 255 "Reserved" ;
VAL_ 683 ACC_LeTgtDx 0 "Valid value" 300 "Valid value" 301 "Reserved" 511 "Reserved" ;
VAL_ 683 ACC_LeTgtTyp 0 "Unkown" 1 "Sedan" 2 "Truck" 3 "Motorcycle" 4 "Pedestrian" 5 "Bicycle" 6 "Traffic_cone" 7 "Obstacle" ;
VAL_ 683 ACC_LeTargrtDection 0 "Not dectected" 1 "Dectected" 2 "Reserved" 3 "Invalid" ;
VAL_ 683 ACC_RiTargrtDetn 0 "Not dectected" 1 "Dectected" 2 "Reserved" 3 "Invalid" ;
VAL_ 683 ACC_RiTgtDy 0 "Valid value" 160 "Valid value" 161 "Reserved" 255 "Reserved" ;
VAL_ 683 ACC_RiTgtDx 0 "Valid value" 300 "Valid value" 301 "Reserved" 511 "Reserved" ;
VAL_ 683 ACC_RiTgtTyp 0 "Unkown" 1 "Sedan" 2 "Truck" 3 "Motorcycle" 4 "Pedestrian" 5 "Bicycle" 6 "Traffic_cone" 7 "Obstacle" ;
VAL_ 683 RollingCounter_ACC7 0 "Valid value" 14 "Valid value" 15 "Invalid value" ;
VAL_ 683 ACC_RlvTgtfusion 0 "no fusion" 1 "fusion" ;
VAL_ 683 ACC_RlvTgtHeading 0 "valid value" 60 "valid value" 61 "Reserved" 63 "Reserved" ;
VAL_ 683 ACC_LeTgtfusion 0 "no fusion" 1 "fusion" ;
VAL_ 683 ACC_LeTgtHeading 0 "valid value" 60 "valid value" 61 "Reserved" 63 "Reserved" ;
VAL_ 683 ACC_RiTgtfusion 0 "no fusion" 1 "fusion" ;
VAL_ 683 ACC_RiTgtHeading 0 "valid value" 60 "valid value" 61 "Reserved" 63 "Reserved" ;
VAL_ 683 ACC_PotentialTgtfusion 0 "no fusion" 1 "fusion" ;
VAL_ 683 ACC_PotentialTgtHeading 0 "valid value" 60 "valid value" 61 "Reserved" 63 "Reserved" ;
VAL_ 683 TargetCutinPro 0 "valid value" 50 "Reserved" 63 "Reserved" ;
VAL_ 683 TargetCutoutPro 0 "valid value" 50 "Reserved" 63 "Reserved" ;
VAL_ 683 Longctrl_WheelTrqReqActive_DVR 0 "Not active" 1 "Active" ;
VAL_ 683 Longctrl_WheelTrqReq_DVR 0 "Valid value" 65535 "Valid value" ;
VAL_ 692 JAPedObjExist 0 "Valid Value" 63 "Valid Value" ;
VAL_ 692 AEBJAObjID 0 "Valid Value" 254 "Valid Value" 255 "No Object" ;
VAL_ 692 AEBJAObjExist 0 "Valid Value" 63 "Valid Value" ;
VAL_ 692 JAPedObjID 0 "Valid Value" 254 "Valid Value" 255 "No Object" ;
VAL_ 692 AEBJAObjVideoCfmd 0 "No Fusion" 1 "Fusion" ;
VAL_ 692 AEBJAObjVx 0 "Valid Value" 2047 "Valid Value" 4081 "Reserved" 4095 "Reserved" ;
VAL_ 692 AEBJAObjDx 0 "Valid Value" 4095 "Valid Value" ;
VAL_ 692 JAPedObjVideoCfmd 0 "No Fusion" 1 "Fusion" ;
VAL_ 692 AEBJAObjState 0 "UNDEFINED" 1 "PRECEDING" 2 "STATIONARY" 3 "STOPPED" 4 "ONCOMING" 5 "Reserved" 7 "Reserved" ;
VAL_ 692 AEBJAObjCntAlive 0 "Valid Value" 3855 "Valid Value" 3856 "Reserved" 4095 "Reserved" ;
VAL_ 692 AEBJAObjDy 0 "Valid Value" 2047 "Valid Value" ;
VAL_ 692 JAPedObjState 0 "UNDEFINED" 1 "PRECEDING" 2 "STATIONARY" 3 "STOPPED" 4 "ONCOMING" 5 "Reserved" 7 "Reserved" ;
VAL_ 692 AEBJAObjObstcl 0 "Valid Value" 31 "Valid Value" ;
VAL_ 692 AEBJAObjVy 0 "Valid Value" 1023 "Valid Value" ;
VAL_ 692 AEBJAObjAx 0 "Valid Value" 1023 "Valid Value" ;
VAL_ 692 AEBJAObjAy 0 "Valid Value" 1023 "Valid Value" ;
VAL_ 692 JAPedObjObstcl 0 "Valid Value" 31 "Valid Value" ;
VAL_ 692 JAPedObjDy 0 "Valid Value" 2047 "Valid Value" ;
VAL_ 692 JAPedObjDx 0 "Valid Value" 4095 "Valid Value" ;
VAL_ 692 FCWAEB_JATTC 0 "No Display" 1 "valid value" 63 "valid value" ;
VAL_ 692 JAPedObjVx 0 "Valid Value" 4080 "Valid Value" 4081 "Reserved" 4095 "Reserved" ;
VAL_ 692 JAPedObjVy 0 "Valid Value" 1023 "Valid Value" ;
VAL_ 692 JAPedObjAy 0 "Valid Value" 1023 "Valid Value" ;
VAL_ 692 JAPedObjCntAlive 0 "Valid Value" 3855 "Valid Value" 3856 "Reserved" 4095 "Reserved" ;
VAL_ 692 FCWAEB_longTTC 0 "No Display" 1 "valid value" 63 "valid value" ;
VAL_ 692 FCWAEB_crossingTTC 0 "No Display" 1 "valid value" 63 "valid value" ;
VAL_ 692 JAPedObjAx 0 "Valid Value" 1023 "Valid Value" ;
VAL_ 692 NOH_Sts 0 "OFF" 1 "Passive" 2 "Standby" 3 "Active" 4 "Override" 5 "Slow_retreat" 6 "Standstill" 7 "Inhibit" 8 "Reserved" 14 "Reserved" 15 "Fail" ;
VAL_ 692 NOH_Swt_Resp 0 "OFF" 1 "ON" ;
VAL_ 692 NOH_Act_Resp 0 "Deactivate" 1 "Activate" ;
VAL_ 692 NOH_SysInfoDisplay 0 "Default" 1 "In NOH GeoFence" 2 "NOH is activated" 3 "Please confirm L lane change" 4 "Please confirm R lane change" 5 "To overtake from left" 6 "To overtake from right" 7 "Lane change waiting" 8 "To merge in mainroad" 9 "NOH to be deactivated" 10 "NOH cancelled" 11 "NOH deactivated" 12 "Cruise speed has been set by NOH" 13 "Speed is too high to support NOH" 14 "To merge in fast route" 15 "To merge in ramp" ;
VAL_ 692 NOH_DistToExit 0 "Valid value" 4095 "Valid value" ;
VAL_ 694 PassSeatAdjmtSwt_HUT 0 "Seat_Swt_Idle" 1 "Seat_Swt_Slide_Fwd" 2 "Seat_Swt_Slide_Rwd" 3 "Seat_Swt_BckRst_Fwd" 4 "Seat_Swt_BckRst_Rwd" 5 "Seat_Swt_Height_F_up" 6 "Seat_Swt_Height_F_down" 7 "Seat_Swt_Height_R_up" 8 "Seat_Swt_Height_R_down" 9 "Reserved" 15 "Reserved" ;
VAL_ 694 SeatFlankAdjmtSwt_HUT 0 "Seat_Swt_Idle" 1 "Seat_Swt_BckRst_In" 2 "Seat_Swt_BckRst_Out" 3 "Seat_Swt_Sflank_In" 4 "Seat_Swt_Sflank_Out" 5 "Reserved" 7 "Reserved" ;
VAL_ 694 AVM_dispsts 0 "OFF" 1 "ON" ;
VAL_ 696 AEBObjID 0 "Valid Value" 254 "Valid Value" 255 "No Object" ;
VAL_ 696 AEBObjExist 0 "Valid Value" 63 "Valid Value" ;
VAL_ 696 AEBObjVideoCfmd 0 "No Fusion" 1 "Fusion" ;
VAL_ 696 AEBObjVx 0 "Valid Value" 2047 "Valid Value" 4081 "Reserved" 4095 "Reserved" ;
VAL_ 696 AEBObjDx 0 "Valid Value" 4095 "Valid Value" ;
VAL_ 696 AEBObjCntAlive 0 "Valid Value" 3855 "Valid Value" 3856 "Reserved" 4095 "Reserved" ;
VAL_ 696 AEBObjDy 0 "Valid Value" 2047 "Valid Value" ;
VAL_ 696 AEBObjState 0 "UNDEFINED" 1 "PRECEDING" 2 "STATIONARY" 3 "STOPPED" 4 "Reserved" 7 "Reserved" ;
VAL_ 696 AEBObjObstcl 0 "Valid Value" 31 "Valid Value" ;
VAL_ 696 AEBObjVy 0 "Valid Value" 1023 "Valid Value" ;
VAL_ 696 CyclistObjExist 0 "Valid Value" 63 "Valid Value" ;
VAL_ 696 AEBObjAx 0 "Valid Value" 1023 "Valid Value" ;
VAL_ 696 AEBObjAy 0 "Valid Value" 1023 "Valid Value" ;
VAL_ 696 CyclistObjDx 0 "Valid Value" 4095 "Valid Value" ;
VAL_ 696 CyclistObjID 0 "Valid Value" 254 "Valid Value" 255 "No Object" ;
VAL_ 696 CyclistObjObstcl 0 "Valid Value" 31 "Valid Value" ;
VAL_ 696 CyclistObjDy 0 "Valid Value" 2047 "Valid Value" ;
VAL_ 696 CyclistObjVx 0 "Valid Value" 4080 "Valid Value" 4081 "Reserved" 4095 "Reserved" ;
VAL_ 696 CyclistObjCntAlive 0 "Valid Value" 3855 "Valid Value" 3856 "Reserved" 4095 "Reserved" ;
VAL_ 696 CyclistObjVy 0 "Valid Value" 1023 "Valid Value" ;
VAL_ 696 CyclistObjState 0 "UNDEFINED" 1 "PRECEDING" 2 "STATIONARY" 3 "STOPPED" 4 "Reserved" 7 "Reserved" ;
VAL_ 696 CyclistObjVideoCfmd 0 "No Fusion" 1 "Fusion" ;
VAL_ 696 CyclistObjAx 0 "Valid Value" 1023 "Valid Value" ;
VAL_ 696 CyclistObjAy 0 "Valid Value" 1023 "Valid Value" ;
VAL_ 696 PedObjExist 0 "Valid Value" 63 "Valid Value" ;
VAL_ 696 PedObjID 0 "Valid Value" 254 "Valid Value" 255 "No Object" ;
VAL_ 696 PedObjObstcl 0 "Valid Value" 31 "Valid Value" ;
VAL_ 696 PedObjDy 0 "Valid Value" 2047 "Valid Value" ;
VAL_ 696 PedObjDx 0 "Valid Value" 4095 "Valid Value" ;
VAL_ 696 PedObjVx 0 "Valid Value" 4080 "Valid Value" 4081 "Reserved" 4095 "Reserved" ;
VAL_ 696 PedObjVy 0 "Valid Value" 1023 "Valid Value" ;
VAL_ 696 PedObjVideoCfmd 0 "No Fusion" 1 "Fusion" ;
VAL_ 696 ACCTgtObjDx 0 "Valid Value" 4095 "Valid Value" ;
VAL_ 696 PedObjAy 0 "Valid Value" 1023 "Valid Value" ;
VAL_ 696 PedObjCntAlive 0 "Valid Value" 3855 "Valid Value" 3856 "Reserved" 4095 "Reserved" ;
VAL_ 696 PedObjAx 0 "Valid Value" 1023 "Valid Value" ;
VAL_ 696 ACCTgtObjID 0 "Valid Value" 254 "Valid Value" 255 "No Object" ;
VAL_ 696 ACCTgtObjObstcl 0 "Valid Value" 31 "Valid Value" ;
VAL_ 696 ACCTgtObjDy 0 "Valid Value" 2047 "Valid Value" ;
VAL_ 696 ACCTgtObjExist 0 "Valid Value" 63 "Valid Value" ;
VAL_ 696 ACCTgtObjVy 0 "Valid Value" 1023 "Valid Value" ;
VAL_ 696 ACCTgtObjVx 0 "Valid Value" 4080 "Valid Value" 4081 "Reserved" 4095 "Reserved" ;
VAL_ 696 ACCTgtObjAx 0 "Valid Value" 1023 "Valid Value" ;
VAL_ 696 ACCTgtObjAy 0 "Valid Value" 1023 "Valid Value" ;
VAL_ 696 ACCTgtObjState 0 "UNDEFINED" 1 "PRECEDING" 2 "STATIONARY" 3 "STOPPED" 4 "Reserved" 7 "Reserved" ;
VAL_ 696 ACCTgtObjVideoCfmd 0 "No Fusion" 1 "Fusion" ;
VAL_ 696 ACCTgtObjCntAlive 0 "Valid Value" 3855 "Valid Value" 3856 "Reserved" 4095 "Reserved" ;
VAL_ 696 RadarHorMisalign 0 "Valid Value" 4095 "Valid Value" ;
VAL_ 696 HandsoffDetd 0 "Unknown" 1 "Hands off" 2 "Not hands off" 3 "Reserved" ;
VAL_ 696 DrvgOnHiWay 0 "Unknown" 1 "On Hignway" 2 "Not on hgh way" 3 "Reserved" ;
VAL_ 696 RoadCrvt 0 "Valid Value(Left bend)" 510 "Valid Value(Left bend)" 511 "Straightaway" 512 "Valid Value((Reft bend))" 1021 "Valid Value((Reft bend))" 1022 "Reserved" 1023 "Unknown" ;
VAL_ 696 SpdLimitDst 0 "Valid Value" 60 "Valid Value" 61 "Out of Range" 62 "Reserved" 63 "Unknown" ;
VAL_ 696 RoadCrvtFar 0 "Valid Value(Left bend)" 510 "Valid Value(Left bend)" 511 "Straightaway" 512 "Valid Value((Reft bend))" 1021 "Valid Value((Reft bend))" 1022 "Reserved" 1023 "Unknown" ;
VAL_ 696 RampDst 0 "Valid Value" 60 "Valid Value" 61 "Out of Range" 62 "Reserved" 63 "Unknown" ;
VAL_ 696 SpdLimit 0 "No SPL" 1 "SPL 5" 2 "SPL 10" 3 "SPL 15" 4 "SPL 20" 5 "SPL 25" 6 "SPL 30" 7 "SPL 35" 8 "SPL 40" 9 "SPL 45" 10 "SPL 50" 11 "SPL 55" 12 "SPL 60" 13 "SPL 65" 14 "SPL 70" 15 "SPL 75" 16 "SPL 80" 17 "SPL 85" 18 "SPL 90" 19 "SPL 95" 20 "SPL 100" 21 "SPL 105" 22 "SPL 110" 23 "SPL 115" 24 "SPL 120" 25 "SPL 120" 26 "SPL 130" 27 "SPL 135" 28 "SPL 140" 29 "SPL 145" 30 "SPL 150" 31 "Reserved" 62 "Reserved" 63 "Invalid" ;
VAL_ 696 CurveDst 0 "Valid Value" 60 "Valid Value" 61 "Out of Range" 62 "Reserved" 63 "Unknown" ;
VAL_ 696 NavSpdLimUnit 0 "Unknown" 1 "KMH" 2 "MPH" 3 "Reserved" ;
VAL_ 696 TunnelDst 0 "Valid Value" 60 "Valid Value" 61 "Out of Range" 62 "Reserved" 63 "Unknown" ;
VAL_ 696 DrvgOnRiLane 0 "Unknown" 1 "On right most lane" 2 "Not on right most lane" 3 "Reserved" ;
VAL_ 696 BrdgDst 0 "Valid Value" 60 "Valid Value" 61 "Out of Range" 62 "Reserved" 63 "Unknown" ;
VAL_ 696 RadarDrvrAttentive 0 "Inattentive" 1 "Attentive" ;
VAL_ 696 ACC_DataRecReq 0 "No Demand" 1 "Scenario01" 2 "Scenario02" 3 "Scenario03" 4 "Scenario04" 5 "Scenario05" 6 "Scenario06" 7 "Scenario07" 8 "Scenario08" 9 "Scenario09" 10 "Scenario10" 11 "Scenario11" 12 "Scenario12" 13 "Scenario13" 14 "Scenario14" 15 "Scenario15" 16 "Scenario16" 17 "Scenario17" 18 "Scenario18" 19 "Scenario19" 20 "Scenario20" 21 "Scenario21" 22 "Scenario22" 23 "Scenario23" 24 "Scenario24" 25 "Scenario25" 26 "Scenario26" 27 "Scenario27" 28 "Scenario28" 29 "Scenario29" 30 "Scenario30" 31 "Scenario31" 32 "Scenario32" 33 "Scenario33" 34 "Scenario34" 35 "Scenario35" 36 "Scenario36" 37 "Scenario37" 38 "Scenario38" 39 "Scenario39" 40 "Scenario40" 41 "Scenario41" 42 "Scenario42" 43 "Scenario43" 44 "Scenario44" 45 "Scenario45" 46 "Scenario46" 47 "Scenario47" 48 "Scenario48" 49 "Scenario49" 50 "Scenario50" 51 "Reserved" 255 "Reserved" ;
VAL_ 696 ACC_SOSReq 0 "No Request" 1 "Request" 2 "Reserved" 3 "Invalid" ;
VAL_ 696 PedObjState 0 "UNDEFINED" 1 "PRECEDING" 2 "STATIONARY" 3 "STOPPED" 4 "Reserved" 7 "Reserved" ;
VAL_ 696 MapDataValid 0 "Valid" 1 "Invalid" ;
VAL_ 696 DrvrSts 0 "Good" 1 "Unbelievable" 2 "Low" 3 "Middle" 4 "High Level 1" 5 "High Level 2" 6 "Reserved" 7 "Reserved" ;
VAL_ 696 AEBObjOverlap 0 "Valid" 20 "Valid" 21 "reserved" 30 "reserved" 31 "invalid" ;
VAL_ 696 AEBObjDrvby 0 "Valid" 20 "Valid" 21 "reserved" 30 "reserved" 31 "invalid" ;
VAL_ 697 DWD_WorkSts 0 "Disable" 1 "Standby" 2 "Active" 3 "Failure" ;
VAL_ 697 DWD_TextDisp 0 "No Request" 1 "Smark stop system is on" 2 "Speed exceed 10kmh" 3 "Controller pedal undeploy" 4 "Slope exceed 10Ã‚Â°" 5 "Driving mode is snowÃ£Â€ÂmudÃ£Â€Âsand" 6 "Parking System is activated" 7 "Out rearview mirror undeploy" 8 "Doors are open" 9 "Trunk are open" 10 "System is fail" 11 "System is not available" 12 "sys exit" 13 "System is in disturb" 14 "Reserved" 31 "Reserved" ;
VAL_ 697 DWD_Dis 0 "No object" 1 "Object in zone 1, 0~10cm" 2 "Object in zone 2, 11~20cm" 3 "Object in zone 3, 21~30cm" 4 "Object in zone 4, 31~40cm" 5 "Object in zone 5, 41~50cm" 6 "Object in zone 6, 51~60cm" 7 "Object in zone 7, 61~70cm" 8 "Object in zone 8, 71~80cm" 9 "Object in zone 9, 81~90cm" 10 "Object in zone 10, 91~100cm" 11 "Object in zone 11, 101~110cm" 12 "Object in zone 12, 111~120cm" 13 "Object in zone 13, 121~130cm" 14 "Object in zone 14, 131~140cm" 15 "Object in zone 15, 141~150cm" ;
VAL_ 697 DWD_SoundIndcn 0 "No warning" 1 "Long beep" 2 "3Hz" 3 "1.5Hz" ;
VAL_ 697 RSnsrFailSts 0 "Sensor normal" 1 "Sensor fault" ;
VAL_ 697 LSnsrFailSts 0 "Sensor normal" 1 "Sensor fault" ;
VAL_ 698 WPC_ChrgSts 0 "Standby" 1 "Charging" 2 "Charging Completed" 3 "WPC Fault" ;
VAL_ 698 WPC_SwtSts 0 "Initial Value" 1 "ON" 2 "OFF" 3 "Reserved" ;
VAL_ 698 WPC_FaultSts 0 "No Fault" 1 "Foreign Object Detection_FOD" 2 "Over Voltage Protection_OVP" 3 "Low Voltage Protection_LVP" 4 "Over Temperature Protection_OTP" 5 "System Fault" 6 "Reserved" 7 "Reserved" ;
VAL_ 698 WPC_PhoneReminder 0 "No need to remind" 1 "Remind forgotten phone" ;
SIG_GROUP_ 639 IP2 1 : CheckSum_IP2 IP_VehTotDistance IP_FuelLvlInfo IP_ACCErr IP_VehTotDistanceValid IP_FuelLvlLowLmpSts IP_BattChrgLmpSts IP_EngOilPressLowLmpSts IP_ABMWarnLmpFailrSts IP_VehSpdUnit IP_Err IP_DrvSeatBeltWarnLmpFailSts IP_PassSeatBeltWarnLmpFailSts IP_VINcompr RollingCounter_IP2;
SIG_GROUP_ 647 ALS1 1 : CheckSum_HC1 ALS_FailSts RollingCounter_HC1;
SIG_GROUP_ 683 ACC3_ACC_FD2 1 : Checksum_ACC3 ISL_Resp ICA_HandsOffResp HWA_Resp HWA_SnvtySet_Resp ALC_Resp Longctrl_VehHldReq_DVR Longctrl_DrvOFF_Req_DVR Longctrl_ModSts_DVR Longctrl_Decel_Req_DVR Longctrl_EngTrqReqActive_DVR Longctrl_EngTrqReq_DVR Longctrl_Decel_ReqValue_DVR Longctrl_DecelToStopReq_DVR Longctrl_ParkShiftReq_DVR ALC_InterSysInfoDisp RollingCounter_ACC3;
SIG_GROUP_ 683 ACC4_ACC_FD2 1 : Checksum_ACC4 ACC_ObjDetecte ACC_TakeOverReq ACC_InterSysInfoDisp ACC_ModDisp ACC_FctSts ACC_TgtObjBarDisp Longctrl_HazActv TJA_ACC_SelSts CruCha_ModDisp TJA_ICA_InterSysInfoDisp TJA_ICA_ModDisp ISL_InterSysInfoDisp ACC_TimeGapSet ACC_SpdSetValue CruChar_InterSysInfoDisp RollingCounter_ACC4;
SIG_GROUP_ 683 ACC8_ACC_FD2 1 : Checksum_ACC8 HWA_ModDisp HWA_InterSysInfoDisp HWA_LaneChange HWA_LaneChangeReq HWA_Warning RollingCounter_ACC8;
SIG_GROUP_ 683 ACC6_ACC_FD2 1 : Checksum_ACC6 ACC_PotentialTgtDy ACC_PotentialTgtDx ACC_RlvTgtDetn ACC_EgoStatus ACC_RlvTgtTyp ACC_RlvTgtDy ACC_RlvTgtDx ACC_PotentialTgtDetn ACC_PotentialTgtTyp RollingCounter_ACC6;
SIG_GROUP_ 683 ACC7_ACC_FD2 1 : Checksum_ACC7 ACC_LeTgtDy ACC_LeTgtDx ACC_LeTgtTyp ACC_LeTargrtDection ACC_RiTargrtDetn ACC_RiTgtDy ACC_RiTgtDx ACC_RiTgtTyp Request_driveoff ACCSts RollingCounter_ACC7;
