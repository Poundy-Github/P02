VERSION "created by canmatrix"

NS_ :

BS_:

BU_: CEM HUT GW T_BOX XBOX_D DVR Tester

BO_ 493 HUT33: 8 HUT
 SG_ FlaoutUnlockSet : 5|2@0+ (1,0) [0|3] ""  CEM
 SG_ PrkInDirChoice : 12|2@0+ (1,0) [0|3] ""  GW
 SG_ ADASDispSwt : 61|2@0+ (1,0) [0|1] "" Vector__XXX
 SG_ NaviDispSwt : 57|2@0+ (1,0) [0|1] "" Vector__XXX
 SG_ NaviDispSwt_VR : 59|2@0+ (1,0) [0|1] "" Vector__XXX
 SG_ ADASDispSwt_VR : 63|2@0+ (1,0) [0|1] "" Vector__XXX
 SG_ ApproachLampSet : 7|2@0+ (1,0) [0|3] ""  CEM
 SG_ SuperLockSet : 3|2@0+ (1,0) [0|3] ""  CEM
 SG_ ALCMDynModSet : 52|3@0+ (1,0) [0|7] ""  CEM
 SG_ RLWinSwtReq_VR : 34|3@0+ (1,0) [0|7] ""  CEM
 SG_ RRWinSwtReq_VR : 55|3@0+ (1,0) [0|7] ""  CEM
 SG_ DrvWinSwtReq_VR : 15|3@0+ (1,0) [0|7] ""  CEM
 SG_ PassWinSwtReq_VR : 37|3@0+ (1,0) [0|7] ""  CEM
 SG_ ChairMemPosnSetSwt : 10|3@0+ (1,0) [0|7] ""  CEM
 SG_ PathLrngFinshCmd : 17|1@0+ (1,0) [0|1] ""  GW
 SG_ PathLrngStartCmd : 18|1@0+ (1,0) [0|1] ""  GW
 SG_ SelPrkOutDirReq : 23|3@0+ (1,0) [0|7] ""  GW
 SG_ StartPrkgPath2Cmd : 25|1@0+ (1,0) [0|1] ""  GW
 SG_ DeletePath2Cmd : 26|1@0+ (1,0) [0|1] ""  GW
 SG_ StartPrkgPath1Cmd : 27|1@0+ (1,0) [0|1] ""  GW
 SG_ DeletePath1Cmd : 28|1@0+ (1,0) [0|1] ""  GW
 SG_ SelPrkgFctnCmd : 31|3@0+ (1,0) [0|7] ""  GW
 SG_ ParkMdlCmd : 19|1@0+ (1,0) [0|1] ""  GW
 SG_ BackReq_APS : 20|1@0+ (1,0) [0|1] ""  GW
 SG_ ACFGAEnaReq_TC : 47|2@0+ (1,0) [0|3] ""  GW
 SG_ ACFGAChanTyp_TC : 45|3@0+ (1,0) [0|7] ""  GW
 SG_ ACFGALvlReq_TC : 42|3@0+ (1,0) [0|7] ""  GW
 SG_ P2P_PrkgDirectSwtCmd : 16|1@0+ (1,0) [0|1] ""  GW
 SG_ HUT33_0x1ED : 0|64@1+ (1,0) [0|0] "" Vector__XXX

BO_ 494 HUT15: 16 HUT
 SG_ SunShadeSwtReq_VR : 43|4@0+ (1,0) [0|15] ""  CEM
 SG_ SunRoofSwtReq_VR : 47|4@0+ (1,0) [0|15] ""  CEM
 SG_ FrntRearACDispSts : 49|2@0+ (1,0) [0|3] ""  GW,CEM
 SG_ ACOperMod_TC : 7|2@0+ (1,0) [0|3] ""  GW,CEM
 SG_ ACOperMod_VR : 5|2@0+ (1,0) [0|3] ""  GW,CEM
 SG_ ACDrvSetTempSteplsReq_TC : 23|6@0+ (0.5,15.5) [16|32] ""  GW,CEM
 SG_ ACPassSetTempSteplsReq_TC : 31|6@0+ (0.5,15.5) [16|32] ""  GW,CEM
 SG_ SDWSwtSet : 39|1@0+ (1,0) [0|1] ""  GW
 SG_ APSSwtReq_VR : 55|2@0+ (1,0) [0|3] ""  GW
 SG_ APSPrkgTypSeln : 34|2@0+ (1,0) [0|3] ""  GW
 SG_ SportModLightSet : 1|2@0+ (1,0) [0|3] ""  CEM
 SG_ ABSLmpSet : 14|1@0+ (1,0) [0|1] ""  CEM
 SG_ AutoWshWipSet : 12|2@0+ (1,0) [0|3] ""  CEM
 SG_ SeekVehSet : 10|2@0+ (1,0) [0|3] ""  CEM
 SG_ SpdAutoLockModSet : 25|2@0+ (1,0) [0|3] ""  CEM
 SG_ ParkLmpSet : 8|1@0+ (1,0) [0|1] ""  CEM
 SG_ DoorUnlockModSet : 15|1@0+ (1,0) [0|1] ""  CEM
 SG_ SteerWheelHeatSwtReq : 3|2@0+ (1,0) [0|3] ""  GW
 SG_ PASExitSpdSwt : 53|2@0+ (1,0) [0|3] ""  CEM
 SG_ FreshnessValue_HUT15 : 71|16@0+ (1,0) [0|65535] ""  GW
 SG_ MAC_Check_HUT15 : 87|48@0+ (1,0) [0|281474976710655] ""  GW
 SG_ HUT15_0x1EE : 0|64@1+ (1,0) [0|0] "" Vector__XXX

BO_ 497 ETC2: 8 GW
 SG_ AntiDisIdnRndNumber : 7|64@0+ (1,0) [0|1.84467440737096E+019] ""  HUT
 SG_ ETC2_0x1F1 : 0|64@1+ (1,0) [0|0] ""  HUT

BO_ 498 ETC4: 8 GW
 SG_ TransSts : 7|8@0+ (1,0) [0|255] ""  HUT
 SG_ EntrAndExitCdn : 15|8@0+ (1,0) [0|255] ""  HUT
 SG_ TransAmnt : 23|32@0+ (1,0) [0|4294967295] "cent"  HUT
 SG_ ETC4_0x1F2 : 0|64@1+ (1,0) [0|0] ""  HUT

BO_ 505 HUT42: 8 HUT
 SG_ ACRLTempSteplsReq_TC : 37|6@0+ (0.5,15.5) [16|32] ""  GW
 SG_ HUT42_0x1F9 : 0|64@1+ (1,0) [0|0] "" Vector__XXX

BO_ 506 BLE5: 8 GW
 SG_ BLE_BeanID : 7|64@0+ (1,0) [0|1.84467440737096E+019] ""  HUT
 SG_ BLE5_0x1FA : 0|64@1+ (1,0) [0|0] ""  HUT

BO_ 507 HUT41: 8 HUT
 SG_ RRDoorALCMClrSet : 7|7@0+ (1,0) [0|127] ""  CEM
 SG_ LeftPanelALCMClrSet : 15|7@0+ (1,0) [0|127] ""  CEM
 SG_ RightPanelALCMClrSet : 23|7@0+ (1,0) [0|127] ""  CEM
 SG_ FootALCMClrSet : 31|7@0+ (1,0) [0|127] ""  CEM
 SG_ DrvDoorALCMLightLvlSet : 39|4@0+ (1,0) [0|15] ""  CEM
 SG_ PassDoorALCMLightLvlSet : 35|4@0+ (1,0) [0|15] ""  CEM
 SG_ LRDoorALCMLightLvlSet : 47|4@0+ (1,0) [0|15] ""  CEM
 SG_ RRDoorALCMLightLvlSet : 43|4@0+ (1,0) [0|15] ""  CEM
 SG_ LeftPanelALCMLightLvlSet : 55|4@0+ (1,0) [0|15] ""  CEM
 SG_ RightPanelALCMLightLvlSet : 51|4@0+ (1,0) [0|15] ""  CEM
 SG_ FootALCMLightLvlSet : 63|4@0+ (1,0) [0|15] ""  CEM
 SG_ ALCMFloSwt : 0|1@0+ (1,0) [0|1] ""  CEM
 SG_ ALCMBreSwt : 8|1@0+ (1,0) [0|1] ""  CEM
 SG_ RightPanelALCMSwt : 24|1@0+ (1,0) [0|1] ""  CEM
 SG_ LRDoorALCMSwt : 59|1@0+ (1,0) [0|1] ""  CEM
 SG_ RRDoorALCMSwt : 58|1@0+ (1,0) [0|1] ""  CEM
 SG_ FootALCMSwt : 57|1@0+ (1,0) [0|1] ""  CEM
 SG_ RoofALCMSwt : 56|1@0+ (1,0) [0|1] ""  CEM
 SG_ LeftPanelALCMSwt : 16|1@0+ (1,0) [0|1] ""  CEM
 SG_ HUT41_0x1FB : 0|64@1+ (1,0) [0|0] "" Vector__XXX

BO_ 509 HUT43: 8 HUT
 SG_ RLSeatMassgModSet : 23|4@0+ (1,0) [0|15] ""  GW,CEM
 SG_ RRSeatMassgModSet : 19|4@0+ (1,0) [0|15] ""  GW,CEM
 SG_ DrvSeatHeatgLvlSet_Nine : 7|4@0+ (1,0) [0|15] ""  CEM
 SG_ PassSeatHeatgLvlSet_Nine : 3|4@0+ (1,0) [0|15] ""  CEM
 SG_ RLSeatHeatgLvlSet_Nine : 15|4@0+ (1,0) [0|15] ""  CEM
 SG_ RRSeatHeatgLvlSet_Nine : 11|4@0+ (1,0) [0|15] ""  CEM
 SG_ HUT43_0x1FD : 0|64@1+ (1,0) [0|0] "" Vector__XXX

BO_ 545 DCT5: 8 GW
 SG_ CurrentGearValid : 18|1@0+ (1,0) [0|1] ""  HUT
 SG_ CURRENT_GEAR : 55|4@0+ (1,0) [0|15] ""  HUT,T_BOX
 SG_ TGS_LEVER : 51|4@0+ (1,0) [0|15] ""  HUT,T_BOX
 SG_ TRANS_Warning_LAMP : 63|1@0+ (1,0) [0|1] ""  HUT
 SG_ DCT5_0x221 : 0|64@1+ (1,0) [0|0] ""  HUT

BO_ 546 IFC_FD6: 64 GW
 SG_ IFC_Line01_DxStart : 15|15@0+ (0.01,0) [0|200] "m"  HUT
 SG_ IFC_Line01_DxEnd : 16|15@0+ (0.01,0) [0|200] "m"  HUT
 SG_ IFC_Line01_HeadingAngle : 33|9@0+ (0.01,-2) [-2|2] "rad"  HUT
 SG_ IFC_Line02_HeadingAngle : 40|9@0+ (0.01,-2) [-2|2] "rad"  HUT
 SG_ IFC_Line02_DxStart : 79|15@0+ (0.01,0) [0|200] "m"  HUT
 SG_ IFC_Line02_DxEnd : 95|15@0+ (0.01,0) [0|200] "m"  HUT
 SG_ IFC_Line03_DxStart : 111|15@0+ (0.01,0) [0|200] "m"  HUT
 SG_ IFC_Line03_DxEnd : 143|15@0+ (0.01,0) [0|200] "m"  HUT
 SG_ IFC_Line03_HeadingAngle : 144|9@0+ (0.01,-2) [-2|2] "rad"  HUT
 SG_ IFC_Line04_DxStart : 167|15@0+ (0.01,0) [0|200] "m"  HUT
 SG_ IFC_Line04_HeadingAngle : 168|9@0+ (0.01,-2) [-2|2] "rad"  HUT
 SG_ IFC_Line04_DxEnd : 207|15@0+ (0.01,0) [0|200] "m"  HUT
 SG_ IFC_Roadedge01_DxStart : 223|15@0+ (0.01,0) [0|200] "m"  HUT
 SG_ IFC_Roadedge01_DxEnd : 239|15@0+ (0.01,0) [0|200] "m"  HUT
 SG_ IFC_Roadedge01_HeadingAngle : 271|9@0+ (0.01,-2) [-2|2] "rad"  HUT
 SG_ IFC_Roadedge02_DxStart : 278|15@0+ (0.01,0) [0|200] "m"  HUT
 SG_ IFC_Roadedge02_DxEnd : 295|15@0+ (0.01,0) [0|200] "m"  HUT
 SG_ IFC_Roadedge02_HeadingAngle : 296|9@0+ (0.01,-2) [-2|2] "rad"  HUT
 SG_ IFC_FD6_0x222 : 0|512@1+ (1,0) [0|0] ""  HUT

BO_ 548 HUT40: 8 HUT
 SG_ ALCMMasterSwt : 61|1@0+ (1,0) [0|1] ""  CEM
 SG_ ALCMPartitionSwt : 62|1@0+ (1,0) [0|1] ""  CEM
 SG_ MusicFrq0 : 15|7@0+ (1,0) [0|127] ""  CEM
 SG_ MusicFrq1 : 8|7@0+ (1,0) [0|127] ""  CEM
 SG_ MusicFrq2 : 17|7@0+ (1,0) [0|127] ""  CEM
 SG_ MusicFrq3 : 26|7@0+ (1,0) [0|127] ""  CEM
 SG_ MusicFrq4 : 35|7@0+ (1,0) [0|127] ""  CEM
 SG_ MusicFrq5 : 44|7@0+ (1,0) [0|127] ""  CEM
 SG_ MusicFrq6 : 53|7@0+ (1,0) [0|127] ""  CEM
 SG_ HUT40_0x224 : 0|64@1+ (1,0) [0|0] "" Vector__XXX

BO_ 551 AEB_FD2: 64 GW
 SG_ Checksum_AEB2 : 71|8@0+ (1,0) [0|255] ""  HUT
 SG_ AEB_PedResp : 79|1@0+ (1,0) [0|1] ""  HUT
 SG_ AEB_VehResp : 78|1@0+ (1,0) [0|1] ""  HUT
 SG_ FCW_Snvty : 77|2@0+ (1,0) [0|3] ""  HUT
 SG_ AEB_JA_Resp : 75|1@0+ (1,0) [0|1] ""  HUT
 SG_ RollingCounter_AEB2 : 123|4@0+ (1,0) [0|15] ""  HUT
 SG_ Checksum_AEB3 : 135|8@0+ (1,0) [0|255] ""  HUT
 SG_ AEB_VehTrig : 143|1@0+ (1,0) [0|1] ""  HUT
 SG_ AEB_PedTrig : 142|1@0+ (1,0) [0|1] ""  HUT
 SG_ FCW_AEB_VehFctSts : 138|2@0+ (1,0) [0|3] ""  HUT
 SG_ FCW_AEB_PedFctSts : 151|2@0+ (1,0) [0|3] ""  HUT
 SG_ FCW_Warn : 149|2@0+ (1,0) [0|3] ""  HUT
 SG_ AEB_JAFuncSts : 147|2@0+ (1,0) [0|3] ""  HUT
 SG_ AEB_JA_Warn : 145|2@0+ (1,0) [0|3] ""  HUT
 SG_ AEB_JABrkTrig : 159|2@0+ (1,0) [0|3] ""  HUT
 SG_ RollingCounter_AEB3 : 187|4@0+ (1,0) [0|15] ""  HUT
 SG_ ACC_PotentialTgt_02_Dy : 207|8@0+ (0.1,-8) [-8|8] "m"  HUT
 SG_ ACC_PotentialTgt_02_Dx : 215|9@0+ (0.5,0) [0|150] "m"  HUT
 SG_ ACC_PotentialTgt_02_Detn : 222|2@0+ (1,0) [0|3] ""  HUT
 SG_ ACC_PotentialTgt_02_Typ : 220|3@0+ (1,0) [0|7] ""  HUT
 SG_ ACC_PotentialTgt_02_fusion : 217|1@0+ (1,0) [0|1] ""  HUT
 SG_ ACC_PotentialTgt_02_Heading : 239|6@0+ (0.05,-1.5) [-1.5|1.5] "rad"  HUT
 SG_ ACC_LeTgt_03_Dy : 247|8@0+ (0.1,-8) [-8|8] "m"  HUT
 SG_ ACC_LeTgt_03_Dx : 216|9@0+ (0.5,-50) [-50|150] "m"  HUT
 SG_ ACC_LeTargrt_03_Detn : 233|2@0+ (1,0) [0|3] ""  HUT
 SG_ ACC_LeTgt_03_Typ : 255|3@0+ (1,0) [0|7] ""  HUT
 SG_ ACC_LeTgt_03_fusion : 252|1@0+ (1,0) [0|1] ""  HUT
 SG_ ACC_LeTgt_03_Heading : 271|6@0+ (0.05,-1.5) [-1.5|1.5] "rad"  HUT
 SG_ ACC_RiTgt_03_Dy : 279|8@0+ (0.1,-8) [-8|7] "m"  HUT
 SG_ ACC_RiTgt_03_Dx : 287|9@0+ (0.5,-50) [-50|150] "m"  HUT
 SG_ ACC_RiTargrt_03_Detn : 265|2@0+ (1,0) [0|3] ""  HUT
 SG_ ACC_RiTgt_03_Typ : 294|3@0+ (1,0) [0|7] ""  HUT
 SG_ ACC_RiTgt_03_fusion : 291|1@0+ (1,0) [0|1] ""  HUT
 SG_ ACC_RiTgt_03_Heading : 303|6@0+ (0.05,-1.5) [-1.5|1.5] "rad"  HUT
 SG_ FreshnessValue_AEB_FD2 : 455|16@0+ (1,0) [0|65535] ""  HUT
 SG_ MAC_Check_AEB_FD2 : 471|48@0+ (1,0) [0|281474976710655] ""  HUT
 SG_ AEB_FD2_0x227 : 0|448@1+ (1,0) [0|0] ""  HUT

BO_ 561 ABS1: 8 GW
 SG_ FLWheelDriveDirection : 15|2@0+ (1,0) [0|3] ""  HUT
 SG_ FRWheelDriveDirection : 31|2@0+ (1,0) [0|3] ""  HUT
 SG_ FLWheelSpd : 12|13@0+ (1,0) [0|299.98125] "kmh"  HUT
 SG_ FLWheelSpdVld : 13|1@0+ (1,0) [0|1] ""  HUT
 SG_ FRWheelSpdVld : 29|1@0+ (1,0) [0|1] ""  HUT
 SG_ FRWheelSpd : 28|13@0+ (1,0) [0|299.98125] "kmh"  HUT
 SG_ WssFLEdgesSum : 47|8@0+ (1,0) [0|255] ""  HUT
 SG_ WssFREdgesSum : 55|8@0+ (1,0) [0|255] ""  HUT
 SG_ WssFLEdgesSumVld : 63|1@0+ (1,0) [0|1] ""  HUT
 SG_ WssFREdgesSumVld : 62|1@0+ (1,0) [0|1] ""  HUT
 SG_ ABS1_0x231 : 0|64@1+ (1,0) [0|0] ""  HUT

BO_ 566 DCT_FD4: 64 GW
 SG_ CheckSum_DCT7 : 71|8@0+ (1,0) [0|255] ""  HUT
 SG_ TrsmStNID : 106|3@0+ (1,0) [0|7] ""  HUT
 SG_ DCT_RaceModeSts : 74|3@0+ (1,0) [0|7] ""  HUT
 SG_ TRANS_OIL_TEMP : 87|8@0+ (1,-40) [-40|214] "Ã¢Â„Âƒ"  HUT
 SG_ DCT_PrsBrk_Warn : 95|2@0+ (1,0) [0|3] ""  HUT
 SG_ DCT_ShftNotAlwd_Warn : 93|2@0+ (1,0) [0|3] ""  HUT
 SG_ DCT_ShftRecom_M : 91|2@0+ (1,0) [0|3] ""  HUT
 SG_ DrvWarnMsg : 103|3@0+ (1,0) [0|7] ""  HUT
 SG_ DrvFaiMsg : 100|4@0+ (1,0) [0|15] ""  HUT
 SG_ DrvModDisp : 111|3@0+ (1,0) [0|7] ""  HUT
 SG_ DrvModDispSts : 108|2@0+ (1,0) [0|3] ""  HUT
 SG_ DrvAutoGearDisp : 127|4@0+ (1,0) [0|15] ""  HUT,T_BOX
 SG_ DrvGearDispSts : 119|2@0+ (1,0) [0|3] ""  HUT
 SG_ RollingCounter_DCT7 : 123|4@0+ (1,0) [0|15] ""  HUT
 SG_ FreshnessValue_DCT_FD4 : 455|16@0+ (1,0) [0|65535] "" Vector__XXX
 SG_ MAC_Check_DCT_FD4 : 471|48@0+ (1,0) [0|281474976710655] "" Vector__XXX
 SG_ DCT_FD4_0x236 : 0|512@1+ (1,0) [0|0] ""  HUT

BO_ 568 BCM12: 8 CEM
 SG_ SrAntiPinch : 47|1@0+ (1,0) [0|1] ""  HUT,T_BOX
 SG_ SsPosn_VR_APP : 46|7@0+ (1,0) [0|127] ""  HUT,T_BOX
 SG_ SsAntiPinch : 55|1@0+ (1,0) [0|1] ""  HUT,T_BOX
 SG_ SrPosn_VR_APP : 54|7@0+ (1,0) [0|127] ""  HUT,T_BOX
 SG_ RLS_IRBrightness : 15|8@0+ (400,0) [0|101600] ""  HUT
 SG_ RLS_FwBrightness : 23|12@0+ (6,0) [0|24564] ""  HUT
 SG_ RLS_AmbBrightness : 27|12@0+ (20,0) [0|81880] ""  HUT
 SG_ BCM12_0x238 : 0|64@1+ (1,0) [0|0] ""  HUT

BO_ 573 IFC_FD2: 64 GW
 SG_ Checksum_IFC3 : 71|8@0+ (1,0) [0|255] ""  HUT
 SG_ LDWResp : 79|1@0+ (1,0) [0|1] ""  HUT
 SG_ LKAResp : 78|1@0+ (1,0) [0|1] ""  HUT
 SG_ LCKResp : 77|1@0+ (1,0) [0|1] ""  HUT
 SG_ ELKResp : 76|1@0+ (1,0) [0|1] ""  HUT
 SG_ LDW_LKA_Snvty : 74|2@0+ (1,0) [0|3] ""  HUT
 SG_ IFCHUTInterface : 72|1@0+ (1,0) [0|1] ""  HUT
 SG_ LSSWarnFormResp : 85|2@0+ (1,0) [0|3] ""  HUT
 SG_ LSSResp : 83|1@0+ (1,0) [0|1] ""  HUT
 SG_ AESSts : 81|2@0+ (1,0) [0|3] ""  HUT
 SG_ ESSSts : 95|2@0+ (1,0) [0|3] ""  HUT
 SG_ AESErrSts : 93|1@0+ (1,0) [0|1] ""  HUT
 SG_ ESSErrSts : 92|1@0+ (1,0) [0|1] ""  HUT
 SG_ RollingCounter_IFC3 : 123|4@0+ (1,0) [0|15] ""  HUT
 SG_ Checksum_IFC4 : 135|8@0+ (1,0) [0|255] ""  HUT
 SG_ IFC_Handsoffwarn : 157|3@0+ (1,0) [0|7] ""  HUT
 SG_ IFCCalibrationSts : 154|2@0+ (1,0) [0|3] ""  HUT
 SG_ CameraBlockageSts : 152|1@0+ (1,0) [0|1] ""  HUT
 SG_ LDW_LKAWarn : 143|2@0+ (1,0) [0|3] ""  HUT
 SG_ LSSIntervention : 141|3@0+ (1,0) [0|7] ""  HUT,T_BOX
 SG_ LSSFuncSts : 138|3@0+ (1,0) [0|7] ""  HUT
 SG_ ELKMainState : 151|3@0+ (1,0) [0|7] ""  HUT
 SG_ LaneAvailability : 148|2@0+ (1,0) [0|3] ""  HUT
 SG_ TJA_FollowSts : 146|2@0+ (1,0) [0|3] ""  HUT
 SG_ LSSErrSts : 144|3@0+ (1,0) [0|7] ""  HUT
 SG_ AESintervention : 191|2@0+ (1,0) [0|3] ""  HUT
 SG_ ESSintervention : 189|2@0+ (1,0) [0|3] ""  HUT
 SG_ ELKActSts : 167|2@0+ (1,0) [0|3] ""  HUT
 SG_ IntelligentEvaActSts : 165|2@0+ (1,0) [0|3] ""  HUT
 SG_ LCKStsIndcr : 163|2@0+ (1,0) [0|3] ""  HUT
 SG_ RollingCounter_IFC4 : 187|4@0+ (1,0) [0|15] ""  HUT
 SG_ Checksum_IFC5 : 199|8@0+ (1,0) [0|255] ""  HUT
 SG_ IFC_LaneCurve : 207|12@0+ (1.5E-005,-0.030705) [-0.030705|0.030705] ""  HUT
 SG_ IFC_LeLaneTyp : 211|3@0+ (1,0) [0|7] ""  HUT
 SG_ IFC_RiLaneTyp : 208|3@0+ (1,0) [0|7] ""  HUT
 SG_ IFC_NextLeLaneTyp : 221|3@0+ (1,0) [0|7] ""  HUT
 SG_ IFC_NextRiLaneTyp : 218|3@0+ (1,0) [0|7] ""  HUT
 SG_ IFC_LeLane_dy : 231|12@0+ (0.00390625,-8) [-8|7.9921875] ""  HUT
 SG_ IFC_RiLane_dy : 235|12@0+ (0.00390625,-8) [-8|7.9921875] ""  HUT
 SG_ RollingCounter_IFC5 : 251|4@0+ (1,0) [0|15] ""  HUT
 SG_ Checksum_IFC6 : 263|8@0+ (1,0) [0|255] ""  HUT
 SG_ IFC_NextLeLane_dy : 271|12@0+ (0.00390625,-8) [-8|7.9921875] ""  HUT
 SG_ IFC_NextRiLane_dy : 275|12@0+ (0.00390625,-8) [-8|7.9921875] ""  HUT
 SG_ RollingCounter_IFC6 : 315|4@0+ (1,0) [0|15] ""  HUT
 SG_ AESResp : 75|1@0+ (1,0) [0|1] ""  HUT
 SG_ ESS_Pedresp : 87|1@0+ (1,0) [0|1] ""  HUT
 SG_ ESS_Vehresp : 86|1@0+ (1,0) [0|1] ""  HUT
 SG_ IntelligentEvaResp : 82|1@0+ (1,0) [0|1] ""  HUT
 SG_ FreshnessValue_IFC_FD2 : 455|16@0+ (1,0) [0|65535] ""  HUT
 SG_ MAC_Check_IFC_FD2 : 471|48@0+ (1,0) [0|281474976710655] ""  HUT
 SG_ IFC_FD2_0x23D : 0|448@1+ (1,0) [0|0] ""  HUT

BO_ 579 HUT_FD3: 64 HUT
 SG_ AutoSpdSetSwt : 25|1@0+ (1,0) [0|1] ""  GW
 SG_ LaneChngCfmSwt : 24|1@0+ (1,0) [0|1] ""  GW
 SG_ VoiceBrdcSwt : 63|1@0+ (1,0) [0|1] ""  GW
 SG_ UsrManSts : 29|4@0+ (1,0) [0|15] ""  GW
 SG_ HUT_OD_WorkSts : 113|2@0+ (1,0) [0|3] ""  GW
 SG_ HUT_OD_Obj_Timestamp : 79|16@0+ (1,0) [0|65535] "ms"  GW
 SG_ HUT_FSD1_distance : 95|6@0+ (0.1,0) [0|6] "m"  GW
 SG_ HUT_FSD2_distance : 89|6@0+ (0.1,0) [0|6] "m"  GW
 SG_ HUT_FSD3_distance : 99|6@0+ (0.1,0) [0|6] "m"  GW
 SG_ HUT_FSD4_distance : 109|6@0+ (0.1,0) [0|6] "m"  GW
 SG_ HUT_FSD5_distance : 119|6@0+ (0.1,0) [0|6] "m"  GW
 SG_ HUT_FSD6_distance : 143|6@0+ (0.1,0) [0|6] "m"  GW
 SG_ HUT_FSD7_distance : 137|6@0+ (0.1,0) [0|6] "m"  GW
 SG_ HUT_FSD8_distance : 147|6@0+ (0.1,0) [0|6] "m"  GW
 SG_ HUT_FSD9_distance : 157|6@0+ (0.1,0) [0|6] "m"  GW
 SG_ HUT_FSD10_distance : 167|6@0+ (0.1,0) [0|6] "m"  GW
 SG_ HUT_FSD11_distance : 161|6@0+ (0.1,0) [0|6] "m"  GW
 SG_ HUT_FSD12_distance : 171|6@0+ (0.1,0) [0|6] "m"  GW
 SG_ HUT_FSD13_distance : 181|6@0+ (0.1,0) [0|6] "m"  GW
 SG_ HUT_FSD14_distance : 207|6@0+ (0.1,0) [0|6] "m"  GW
 SG_ HUT_FSD15_distance : 201|6@0+ (0.1,0) [0|6] "m"  GW
 SG_ HUT_FSD16_distance : 211|6@0+ (0.1,0) [0|6] "m"  GW
 SG_ HUT_FSD17_distance : 221|6@0+ (0.1,0) [0|6] "m"  GW
 SG_ HUT_FSD18_distance : 231|6@0+ (0.1,0) [0|6] "m"  GW
 SG_ NOH_Swt_Req : 335|1@0+ (1,0) [0|1] ""  GW
 SG_ NOH_Act_Req : 334|1@0+ (1,0) [0|1] ""  GW
 SG_ HUT_OD_Obj7_ID : 15|4@0+ (1,0) [0|9] "" Vector__XXX
 SG_ HUT_OD_Obj7_type : 23|3@0+ (1,0) [0|7] "" Vector__XXX
 SG_ HUT_OD_Obj7_Confidence : 11|4@0+ (0.1,0) [0|1] "" Vector__XXX
 SG_ HUT_OD_Obj7_width : 20|7@0+ (0.1,0) [0|12.6] "m" Vector__XXX
 SG_ HUT_OD_Obj7_Ground_Pos_X : 39|12@0+ (0.01,0) [0|40] "m" Vector__XXX
 SG_ HUT_OD_Obj7_Ground_Pos_Y : 43|12@0+ (0.01,-20) [-20|20] "m" Vector__XXX
 SG_ HUT_FD3_0x243 : 0|512@1+ (1,0) [0|0] "" Vector__XXX

BO_ 580 CSA3: 8 GW
 SG_ MenuReturnSwtSts : 49|2@0+ (1,0) [0|3] ""  HUT
 SG_ SteerWheelHeatdSts : 40|1@0+ (1,0) [0|1] ""  HUT,T_BOX
 SG_ HomeSwtSts : 51|2@0+ (1,0) [0|3] ""  HUT
 SG_ MuteSwtSts : 53|2@0+ (1,0) [0|3] ""  HUT
 SG_ CustomSwtSts : 55|2@0+ (1,0) [0|3] ""  HUT
 SG_ PageUpSwtSts : 15|2@0+ (1,0) [0|3] ""  HUT
 SG_ PageDwnSwtSts : 13|2@0+ (1,0) [0|3] ""  HUT
 SG_ PageLSwtSts : 11|2@0+ (1,0) [0|3] ""  HUT
 SG_ PageRSwtSts : 9|2@0+ (1,0) [0|3] ""  HUT
 SG_ SeekUpSwtSts : 63|2@0+ (1,0) [0|3] ""  HUT
 SG_ SeekDwnSwtSts : 61|2@0+ (1,0) [0|3] ""  HUT
 SG_ AdjVolUpSwtSts : 23|2@0+ (1,0) [0|3] ""  HUT
 SG_ AdjVolDwnSwtSts : 21|2@0+ (1,0) [0|3] ""  HUT
 SG_ VRSwtSts : 19|2@0+ (1,0) [0|3] ""  HUT
 SG_ EnterSwtSts : 31|2@0+ (1,0) [0|3] ""  HUT
 SG_ EnterSwtSts_Mmed : 27|2@0+ (1,0) [0|3] ""  HUT
 SG_ CustomSwtSts_Mmed : 39|2@0+ (1,0) [0|3] ""  HUT
 SG_ IpMenuSwtSts : 42|2@0+ (1,0) [0|3] ""  HUT
 SG_ CSA3_0x244 : 0|64@1+ (1,0) [0|0] ""  HUT

BO_ 581 ABM2: 8 GW
 SG_ VehLgtAccel : 15|16@0+ (0.00098,-21.592) [-21.592|21.592] "ms^2"  HUT,T_BOX
 SG_ VehLatAccel : 31|16@0+ (0.00098,-21.592) [-21.592|21.592] "ms^2"  HUT,T_BOX
 SG_ VehYawRate : 47|16@0+ (0.00024,-2.093) [-2.093|2.093] "rads"  HUT,T_BOX
 SG_ VehLgtAccelVld : 63|1@0+ (1,0) [0|1] ""  HUT,T_BOX
 SG_ VehLatAccelVld : 62|1@0+ (1,0) [0|1] ""  HUT,T_BOX
 SG_ VehDynYawRateVld : 61|1@0+ (1,0) [0|1] ""  HUT,T_BOX
 SG_ ABM2_0x245 : 0|64@1+ (1,0) [0|0] ""  HUT

BO_ 582 ABS2: 8 GW
 SG_ RLWheelSpdVld : 13|1@0+ (1,0) [0|1] ""  HUT,T_BOX
 SG_ RLWheelSpd : 12|13@0+ (0.05625,0) [0|299.98125] "kmh"  HUT,T_BOX
 SG_ RRWheelSpdVld : 29|1@0+ (1,0) [0|1] ""  HUT,T_BOX
 SG_ RRWheelSpd : 28|13@0+ (0.05625,0) [0|299.98125] "kmh"  HUT,T_BOX
 SG_ RLWheelDriveDirection : 15|2@0+ (1,0) [0|3] ""  HUT
 SG_ RRWheelDriveDirection : 31|2@0+ (1,0) [0|3] ""  HUT
 SG_ WssRREdgesSum : 47|8@0+ (1,0) [0|255] ""  HUT
 SG_ WssRLEdgesSum : 55|8@0+ (1,0) [0|255] ""  HUT
 SG_ WssRLEdgesSumVld : 63|1@0+ (1,0) [0|1] ""  HUT
 SG_ WssRREdgesSumVld : 62|1@0+ (1,0) [0|1] ""  HUT
 SG_ ABS2_0x246 : 0|64@1+ (1,0) [0|0] ""  HUT

BO_ 584 HCU_PT7: 8 GW
 SG_ HCU_12VSysErr_1 : 24|1@0+ (1,0) [0|1] ""  HUT
 SG_ HCU_12VSysErr_2 : 39|1@0+ (1,0) [0|1] ""  HUT
 SG_ HCU_HybSysErr_1 : 15|1@0+ (1,0) [0|1] ""  HUT
 SG_ HCU_HybSysErr_2 : 14|1@0+ (1,0) [0|1] ""  HUT
 SG_ HCU_HybSysErr_5 : 11|1@0+ (1,0) [0|1] ""  HUT
 SG_ HCU_HybSysErr_6 : 10|1@0+ (1,0) [0|1] ""  HUT
 SG_ HCU_HybSysErr_7 : 9|1@0+ (1,0) [0|1] ""  HUT
 SG_ HCU_12VSysErrLmpSts : 8|1@0+ (1,0) [0|1] ""  HUT
 SG_ HCU_HybSysErrLmpSts : 27|2@0+ (1,0) [0|3] ""  HUT
 SG_ HCU_PowerRedWarnLmpCmd : 25|1@0+ (1,0) [0|1] ""  HUT
 SG_ HCU_EnrgFlowInd : 55|5@0+ (1,0) [0|31] ""  HUT
 SG_ HCU_HybSysErr_3 : 13|1@0+ (1,0) [0|1] ""  HUT
 SG_ HCU_RdyLmpSts : 37|1@0+ (1,0) [0|1] ""  HUT
 SG_ CheckSum_HCU_PT7 : 7|8@0+ (1,0) [0|255] ""  HUT
 SG_ HCU_HybSysErr_4 : 12|1@0+ (1,0) [0|1] ""  HUT
 SG_ HCU_EnrgFlowInd_P2 : 23|5@0+ (1,0) [0|31] ""  HUT
 SG_ HCU_12VSysErr_3 : 38|1@0+ (1,0) [0|1] ""  HUT
 SG_ HCU_OPDLmpSts : 36|1@0+ (1,0) [0|1] ""  HUT
 SG_ HCU_OPDSts : 43|3@0+ (1,0) [0|7] ""  HUT
 SG_ HCU_ModSwtFail : 63|4@0+ (1,0) [0|15] ""  HUT
 SG_ RollingCounter_HCU_PT7 : 59|4@0+ (1,0) [0|15] ""  HUT
 SG_ HCU_PT7_0x248 : 0|64@1+ (1,0) [0|0] ""  HUT

BO_ 589 DMS_FD1: 64 HUT
 SG_ DrowsnsLvl : 13|3@0+ (1,0) [0|7] ""  CEM
 SG_ DrowsnsLvlQlty : 10|7@0+ (1,0) [0|100] "%"  CEM
 SG_ GenderSts : 36|2@0+ (1,0) [0|3] ""  CEM
 SG_ GenderStsQlty : 47|7@0+ (1,0) [0|100] "%"  CEM
 SG_ ExprsnSts : 34|3@0+ (1,0) [0|7] ""  GW
 SG_ Checksum_DMS2 : 71|8@0+ (1,0) [0|255] ""  GW
 SG_ DistrctnLvl_ACC : 95|3@0+ (1,0) [0|7] ""  GW
 SG_ DistrctnLvlQlty_ACC : 79|7@0+ (1,0) [0|100] "%"  GW
 SG_ DrowsnsLvl_ACC : 92|3@0+ (1,0) [0|7] ""  GW
 SG_ DrowsnsLvlQlty_ACC : 87|7@0+ (1,0) [0|100] "%"  GW
 SG_ RollingCounter_DMS2 : 123|4@0+ (1,0) [0|15] ""  GW
 SG_ Checksum_DMS3 : 135|8@0+ (1,0) [0|255] ""  GW
 SG_ HeadPosnX : 143|11@0+ (1,-500) [-500|1000] "mm"  GW
 SG_ HeadPosnY : 148|11@0+ (1,-500) [-500|500] "mm"  GW
 SG_ HeadPosnZ : 153|11@0+ (1,-500) [-500|500] "mm"  GW
 SG_ HeadPosQlty : 174|7@0+ (1,0) [0|100] "%"  GW
 SG_ RollingCounter_DMS3 : 187|4@0+ (1,0) [0|15] ""  GW
 SG_ GazePosnX : 207|11@0+ (1,-500) [-500|1000] "mm"  GW
 SG_ GazePosnY : 212|11@0+ (1,-500) [-500|500] "mm"  GW
 SG_ GazePosnZ : 217|11@0+ (1,-500) [-500|500] "mm"  GW
 SG_ Checksum_DMS5 : 263|8@0+ (1,0) [0|255] ""  GW
 SG_ DMSSts : 303|3@0+ (1,0) [0|7] ""  GW
 SG_ HeadDetn : 288|1@0+ (1,0) [0|1] ""  GW
 SG_ HeadYawAng : 271|8@0+ (1,-75) [-75|75] "degree"  GW
 SG_ HeadPitchAng : 279|8@0+ (1,-25) [-25|45] "degree"  GW
 SG_ HeadRollAng : 287|8@0+ (1,-45) [-45|45] "degree"  GW
 SG_ HeadRotAngQlty : 295|7@0+ (1,0) [0|100] "%"  GW
 SG_ RollingCounter_DMS5 : 315|4@0+ (1,0) [0|15] ""  GW
 SG_ Checksum_DMS6 : 327|8@0+ (1,0) [0|255] ""  GW
 SG_ LEyeOpenSts : 375|2@0+ (1,0) [0|3] ""  GW
 SG_ LEyeOpenStsQlty : 351|7@0+ (1,0) [0|100] "%"  GW
 SG_ REyeOpenSts : 373|2@0+ (1,0) [0|3] ""  GW
 SG_ REyeOpenStsQlty : 359|7@0+ (1,0) [0|100] "%"  GW
 SG_ RobustGazeYawAng : 335|8@0+ (1,-90) [-90|90] "degree"  GW
 SG_ RobustGazePitchAng : 343|8@0+ (1,-90) [-90|90] "degree"  GW
 SG_ RobustGazeAngQlty : 367|7@0+ (1,0) [0|100] "%"  GW
 SG_ DrvBehvSts : 370|3@0+ (1,0) [0|7] ""  GW
 SG_ RollingCounter_DMS6 : 379|4@0+ (1,0) [0|15] ""  GW
 SG_ DMS_FD1_0x24D : 0|512@1+ (1,0) [0|0] "" Vector__XXX

BO_ 593 TOD1: 8 GW
 SG_ FuncProtnSts : 19|1@0+ (1,0) [0|1] ""  HUT
 SG_ ShiftSysStuInLow : 12|1@0+ (1,0) [0|1] ""  HUT
 SG_ SystemOperMod : 6|4@0+ (1,0) [0|15] ""  HUT,T_BOX
 SG_ CouplingFaultSts : 9|2@0+ (1,0) [0|3] ""  HUT
 SG_ CouplingThermWarning : 10|1@0+ (1,0) [0|1] ""  HUT,T_BOX
 SG_ DiagLmpReq : 14|1@0+ (1,0) [0|1] ""  HUT,T_BOX
 SG_ ModeShiftTimeout : 26|1@0+ (1,0) [0|1] ""  HUT
 SG_ AutoShiftSts : 25|2@0+ (1,0) [0|3] ""  HUT
 SG_ EstimatedTorque : 47|16@0+ (0.25,0) [0|3000] "Nm"  HUT
 SG_ TOD1_0x251 : 0|64@1+ (1,0) [0|0] ""  HUT

BO_ 604 BLE1: 8 GW
 SG_ BLEConnSts : 15|2@0+ (1,0) [0|3] ""  HUT
 SG_ BLESecuritySts : 13|2@0+ (1,0) [0|3] ""  HUT
 SG_ BLE1_0x25C : 0|64@1+ (1,0) [0|0] ""  HUT

BO_ 623 HUT32: 8 HUT
 SG_ CheckSum_HUT32 : 7|8@0+ (1,0) [0|255] ""  GW
 SG_ ScrnOpSts : 47|2@0+ (1,0) [0|3] ""  GW
 SG_ XLvl : 23|11@0+ (1,0) [0|2046] ""  GW
 SG_ YLvl : 26|11@0+ (1,0) [0|2046] ""  GW
 SG_ DetVideoLost : 9|1@0+ (1,0) [0|1] ""  GW
 SG_ PrkgCtrlModReqValid : 10|1@0+ (1,0) [0|1] ""  GW
 SG_ PrkgCtrlModReq : 13|2@0+ (1,0) [0|3] ""  GW
 SG_ ContnPrkgReqValid : 8|1@0+ (1,0) [0|1] ""  GW
 SG_ ContnPrkgReq : 15|2@0+ (1,0) [0|3] ""  GW
 SG_ PrkStraightSwtReq_HUT : 11|1@0+ (1,0) [0|1] ""  GW
 SG_ PrkStraightSuspendOrFinishReq_HU : 28|2@0+ (1,0) [0|3] ""  GW
 SG_ PrkStraightModSel_HUT : 63|3@0+ (1,0) [0|3] ""  GW
 SG_ PrkStraightSts_HUT : 60|1@0+ (1,0) [0|1] ""  GW
 SG_ PrkStraightStrtReq_HUT : 45|1@0+ (1,0) [0|1] ""  GW
 SG_ PrkStraightVehStrtReq_HUT_Valid : 44|1@0+ (1,0) [0|1] ""  GW
 SG_ PrkStraightContinueReq_HUT : 55|1@0+ (1,0) [0|1] ""  GW
 SG_ P2P_PrkgDirSwtReq : 54|1@0+ (1,0) [0|1] ""  GW
 SG_ RainMode_Swt_Req : 51|1@0+ (1,0) [0|1] ""  GW
 SG_ LCMode_Swt_Req : 50|2@0+ (1,0) [0|3] ""  GW
 SG_ NavDecSwtReq : 48|1@0+ (1,0) [0|1] "_"  GW
 SG_ RollingCounter_HUT32 : 59|4@0+ (1,0) [0|15] ""  GW
 SG_ HUT32_0x26F : 0|64@1+ (1,0) [0|0] "" Vector__XXX

BO_ 625 ECM2: 8 GW
 SG_ FuelConsumption : 15|16@0+ (2,0) [0|131070] "ÃŽÂ¼l"  HUT
 SG_ TgtCrsVehSpd : 47|8@0+ (1,0) [0|255] "kphmph"  HUT
 SG_ CruiseCtrlSts : 55|2@0+ (1,0) [0|2] ""  HUT
 SG_ AccelPedalPosn : 31|8@0+ (0.3937,0) [0|100.3935] "%"  HUT
 SG_ AccelPedalPosnVldty : 50|2@0+ (1,0) [0|2] ""  HUT
 SG_ ThrtlPosRatio : 39|8@0+ (0.3937,0) [0|99.9998] "%"  HUT
 SG_ EngSVSSig : 48|1@0+ (1,0) [0|1] ""  HUT
 SG_ MILSts : 63|1@0+ (1,0) [0|1] ""  HUT
 SG_ EngState : 62|2@0+ (1,0) [0|3] ""  HUT,XBOX_D,T_BOX
 SG_ ECM2_0x271 : 0|64@1+ (1,0) [0|0] ""  HUT

BO_ 627 Trailer1: 8 GW
 SG_ TrailerSts : 7|1@0+ (1,0) [0|1] ""  HUT
 SG_ Trailer1_0x273 : 0|64@1+ (1,0) [0|0] ""  HUT

CM_ SG_ 493 FlaoutUnlockSet "Flameout unlock set";
CM_ SG_ 493 PrkInDirChoice "UsedÃ‚Â toÃ‚Â chooseÃ‚Â whetherÃ‚Â toÃ‚Â parkÃ‚Â inÃ‚Â frontÃ‚Â orÃ‚Â rear of carADAS-CANFD To:HAP";
CM_ SG_ 493 ADASDispSwt "ADAS display switch by HUT";
CM_ SG_ 493 NaviDispSwt "Navigation display switch by HUT";
CM_ SG_ 493 NaviDispSwt_VR "Navigation display switch by HUT(Voice Request)";
CM_ SG_ 493 ADASDispSwt_VR "ADAS display switch by HUT(Voice Request)";
CM_ SG_ 493 ApproachLampSet "Approach lamp set";
CM_ SG_ 493 SuperLockSet "Super lock set";
CM_ SG_ 493 ALCMDynModSet "ALCM dynamic mode set";
CM_ SG_ 493 RLWinSwtReq_VR "Rear left window Switch request status(Voice Request)";
CM_ SG_ 493 RRWinSwtReq_VR "Rear right window Switch request status(Voice Request)";
CM_ SG_ 493 DrvWinSwtReq_VR "Driver window Switch request status(Voice Request)";
CM_ SG_ 493 PassWinSwtReq_VR "Passenger window Switch request status(Voice Request)";
CM_ SG_ 493 ChairMemPosnSetSwt "Chair Memory Position Set switch";
CM_ SG_ 493 PathLrngFinshCmd "Path learning finished commandADAS-CANFD To:HAP";
CM_ SG_ 493 PathLrngStartCmd "Start path learning commandADAS-CANFD To:HAP";
CM_ SG_ 493 SelPrkOutDirReq "Select parking out direction requestADAS-CANFD To:HAP";
CM_ SG_ 493 StartPrkgPath2Cmd "Start parking path two commandADAS-CANFD To:HAP";
CM_ SG_ 493 DeletePath2Cmd "Delete path two commandADAS-CANFD To:HAP";
CM_ SG_ 493 StartPrkgPath1Cmd "Start parking path one commandADAS-CANFD To:HAP";
CM_ SG_ 493 DeletePath1Cmd "Delete path one commandADAS-CANFD To:HAP";
CM_ SG_ 493 SelPrkgFctnCmd "Select Parking function commandADAS-CANFD To:HAP";
CM_ SG_ 493 ParkMdlCmd "Parking mode change requestADAS-CANFD To:HAP";
CM_ SG_ 493 BackReq_APS "Back to AVM interface requestADAS-CANFD To:HAP";
CM_ SG_ 493 ACFGAEnaReq_TC "AC(Air Conditioning) Fragrance system enable request-Touch ControlBD1_CAN:To AC";
CM_ SG_ 493 ACFGAChanTyp_TC "AC(Air Conditioning) Fragrance Type Channel Select-Touch ControlBD1_CAN:To AC";
CM_ SG_ 493 ACFGALvlReq_TC "AC(Air Conditioning) Fragrance concentration request-Touch ControlBD1_CAN:To AC";
CM_ SG_ 493 P2P_PrkgDirectSwtCmd "P2P Parking Direction switch commandADAS1_CAN:To ICU1.5";
CM_ SG_ 494 SunShadeSwtReq_VR "Sun shade switch request(Voice Request)";
CM_ SG_ 494 SunRoofSwtReq_VR "Sun roof switch request(Voice Request)";
CM_ SG_ 494 FrntRearACDispSts "Feedback current front&rear AC display status on HMIBD1-CAN To:AC";
CM_ SG_ 494 ACOperMod_TC "AC(Air Conditioning) operation mode request-Touch ControlBD1-CAN To:AC";
CM_ SG_ 494 ACOperMod_VR "AC(Air Conditioning) operation mode request (Voice Request)BD1-CAN To:AC";
CM_ SG_ 494 ACDrvSetTempSteplsReq_TC "AC(Air Conditioning) Driver Set Temperature Stepless Request-Touch ControlBD1-CAN To:AC";
CM_ SG_ 494 ACPassSetTempSteplsReq_TC "AC(Air Conditioning) Passenger Set Temperature Stepless Request-Touch ControlBD1-CAN To:AC";
CM_ SG_ 494 SDWSwtSet "Side Distance Warning  switch SetADAS-CANFD To:HAP";
CM_ SG_ 494 APSSwtReq_VR "APS(Automatic Parking System) switch request(Voice Request)ADAS-CANFD To:HAP";
CM_ SG_ 494 APSPrkgTypSeln "APS(Automatic Parking System) parking type selectionADAS-CANFD To:HAP";
CM_ SG_ 494 SportModLightSet "The light mode set in the sport mode";
CM_ SG_ 494 ABSLmpSet "ABS Lamp Setting";
CM_ SG_ 494 AutoWshWipSet "Auto Wash Wipe Setting";
CM_ SG_ 494 SeekVehSet "Seek Vehicle Setting";
CM_ SG_ 494 SpdAutoLockModSet "Speed Auto Lock Mode Setting";
CM_ SG_ 494 ParkLmpSet "Set the park lamp state";
CM_ SG_ 494 DoorUnlockModSet "Door  Unlock Mode Setting";
CM_ SG_ 494 SteerWheelHeatSwtReq "Steer wheel Heating Switch Request by HUTBD1-CAN To:CSA";
CM_ SG_ 494 PASExitSpdSwt "PAS exit speed switch";
CM_ SG_ 494 MAC_Check_HUT15 "MAC protection mechanism should comply with the GWM MAC Specificatio";
CM_ SG_ 497 AntiDisIdnRndNumber "Anti-dismantle identification random number";
CM_ SG_ 498 TransSts "Transaction Status";
CM_ SG_ 498 EntrAndExitCdn "Entrance And Exit Condition";
CM_ SG_ 498 TransAmnt "Amount of the Transaction";
CM_ SG_ 505 ACRLTempSteplsReq_TC "AC(Air Conditioning) Rear Left  Temperature Stepless  Request-Touch ControlBD1_CAN:To AC";
CM_ SG_ 506 BLE_BeanID "Bluetooth bean ID";
CM_ SG_ 507 RRDoorALCMClrSet "Right rear door ALCM color set";
CM_ SG_ 507 LeftPanelALCMClrSet "Left panel ALCM color set";
CM_ SG_ 507 RightPanelALCMClrSet "Right panel ALCM color set";
CM_ SG_ 507 FootALCMClrSet "Foot ALCM color set";
CM_ SG_ 507 DrvDoorALCMLightLvlSet "Driver door ALCM light level set";
CM_ SG_ 507 PassDoorALCMLightLvlSet "Passenger door ALCM light level set";
CM_ SG_ 507 LRDoorALCMLightLvlSet "Left rear door ALCM light level set";
CM_ SG_ 507 RRDoorALCMLightLvlSet "Right rear door ALCM light level set";
CM_ SG_ 507 LeftPanelALCMLightLvlSet "Left panel ALCM light level set";
CM_ SG_ 507 RightPanelALCMLightLvlSet "Right panel ALCM light level set";
CM_ SG_ 507 FootALCMLightLvlSet "Foot ALCM light level set";
CM_ SG_ 507 ALCMFloSwt "Flowing mode Swtich";
CM_ SG_ 507 ALCMBreSwt "Breathing mode Swtich";
CM_ SG_ 507 RightPanelALCMSwt "Right panel ALCM switch";
CM_ SG_ 507 LRDoorALCMSwt "Left rear door ALCM switch";
CM_ SG_ 507 RRDoorALCMSwt "Right rear door ALCM switch";
CM_ SG_ 507 FootALCMSwt "Foot ALCM switch";
CM_ SG_ 507 RoofALCMSwt "Roof ALCM switch";
CM_ SG_ 507 LeftPanelALCMSwt "Left panel ALCM switch";
CM_ SG_ 509 RLSeatMassgModSet "Rear Left Seat massage mode setBD_Sub_CAN:To DSC";
CM_ SG_ 509 RRSeatMassgModSet "Rear Right Seat massage mode setBD_Sub_CAN:To DSC";
CM_ SG_ 509 DrvSeatHeatgLvlSet_Nine "Driver Seat Heating 9 level  set";
CM_ SG_ 509 PassSeatHeatgLvlSet_Nine "Passenger Seat Heating 9 level set";
CM_ SG_ 509 RLSeatHeatgLvlSet_Nine "Rear Left Passenger Seat Heating 9 level set";
CM_ SG_ 509 RRSeatHeatgLvlSet_Nine "Rear Right Passenger Seat Heating 9 level set";
CM_ SG_ 545 CurrentGearValid "Current gear valid";
CM_ SG_ 545 CURRENT_GEAR "To indicate which gear the DCT is in now";
CM_ SG_ 545 TGS_LEVER "Transmission gear selector lever position";
CM_ SG_ 545 TRANS_Warning_LAMP "Indication of MIL relevant failure on transmission side.";
CM_ SG_ 546 IFC_Line01_DxStart "Longitudinal start point of the line, also called dxStart";
CM_ SG_ 546 IFC_Line01_DxEnd "Longitudinal range of the line, also called dxEnd";
CM_ SG_ 546 IFC_Line01_HeadingAngle "Heading angle, difference in yaw angle between vehicle heading and Line";
CM_ SG_ 546 IFC_Line02_HeadingAngle "Heading angle, difference in yaw angle between vehicle heading and Line";
CM_ SG_ 546 IFC_Line02_DxStart "Longitudinal start point of the line, also called dxStart";
CM_ SG_ 546 IFC_Line02_DxEnd "Longitudinal range of the line, also called dxEnd";
CM_ SG_ 546 IFC_Line03_DxStart "Longitudinal start point of the line, also called dxStart";
CM_ SG_ 546 IFC_Line03_DxEnd "Longitudinal range of the line, also called dxEnd";
CM_ SG_ 546 IFC_Line03_HeadingAngle "Heading angle, difference in yaw angle between vehicle heading and Line";
CM_ SG_ 546 IFC_Line04_DxStart "Longitudinal start point of the line, also called dxStart";
CM_ SG_ 546 IFC_Line04_HeadingAngle "Heading angle, difference in yaw angle between vehicle heading and Line";
CM_ SG_ 546 IFC_Line04_DxEnd "Longitudinal range of the line, also called dxEnd";
CM_ SG_ 546 IFC_Roadedge01_DxStart "Longitudinal start point of the line, also called dxStart";
CM_ SG_ 546 IFC_Roadedge01_DxEnd "Longitudinal range of the line, also called dxEnd";
CM_ SG_ 546 IFC_Roadedge01_HeadingAngle "Heading angle, difference in yaw angle between vehicle heading and Line";
CM_ SG_ 546 IFC_Roadedge02_DxStart "Longitudinal start point of the line, also called dxStart";
CM_ SG_ 546 IFC_Roadedge02_DxEnd "Longitudinal range of the line, also called dxEnd";
CM_ SG_ 546 IFC_Roadedge02_HeadingAngle "Heading angle, difference in yaw angle between vehicle heading and Line";
CM_ SG_ 548 ALCMMasterSwt "ALCM master switch";
CM_ SG_ 548 ALCMPartitionSwt "ALCM partition switch";
CM_ SG_ 548 MusicFrq0 "Music frequency 0";
CM_ SG_ 548 MusicFrq1 "Music frequency 1";
CM_ SG_ 548 MusicFrq2 "Music frequency 2";
CM_ SG_ 548 MusicFrq3 "Music frequency 3";
CM_ SG_ 548 MusicFrq4 "Music frequency 4";
CM_ SG_ 548 MusicFrq5 "Music frequency 5";
CM_ SG_ 548 MusicFrq6 "Music frequency 6";
CM_ SG_ 551 Checksum_AEB2 "Use the checksum strategy from document Ã¢Â€ÂœEnd-to-End Communication Protection SpecificationÃ¢Â€Â";
CM_ SG_ 551 AEB_PedResp "Indicate AEB-P(Pedestrian) switch status.";
CM_ SG_ 551 AEB_VehResp "Indicate AEB-V(Vehicle) switch status.IP Received";
CM_ SG_ 551 FCW_Snvty "Indicate FCW Sensitive";
CM_ SG_ 551 AEB_JA_Resp "Indicate AEB-JA(Junction Assist) switch status.IP Received";
CM_ SG_ 551 RollingCounter_AEB2 "RollingCounter_AEB2";
CM_ SG_ 551 Checksum_AEB3 "Use the checksum strategy from document Ã¢Â€ÂœEnd-to-End Communication Protection SpecificationÃ¢Â€Â";
CM_ SG_ 551 AEB_VehTrig "Indicate the AEB_Veh function had been triggeredIP Received";
CM_ SG_ 551 AEB_PedTrig "Indicate the AEB_Ped function had been triggeredIP Received";
CM_ SG_ 551 FCW_AEB_VehFctSts "Indicate FCWAEB-V fuction system working statusIP Received";
CM_ SG_ 551 FCW_AEB_PedFctSts "Indicate FCWAEB-P fuction system working statusIP Received";
CM_ SG_ 551 FCW_Warn "FCW latent(visual) warning or pre(acoustic)  warning. Used with ACC_FCW_ON_OFF signal.IP Received";
CM_ SG_ 551 AEB_JAFuncSts "Indicate AEB-JA fuction system working statusIP Received";
CM_ SG_ 551 AEB_JA_Warn "visual warning oracousticwarning.IP Received";
CM_ SG_ 551 AEB_JABrkTrig "Indicate the AEB_JA function had been triggeredIP Received";
CM_ SG_ 551 RollingCounter_AEB3 "RollingCounter_AEB3";
CM_ SG_ 551 ACC_PotentialTgt_02_Dy "Lateral distance of potential target 02 in this lane";
CM_ SG_ 551 ACC_PotentialTgt_02_Dx "Longitudinal distance of potential target02 in this lane";
CM_ SG_ 551 ACC_PotentialTgt_02_Detn "Detection of potential targets02 in this lane";
CM_ SG_ 551 ACC_PotentialTgt_02_Typ "Types of potential targets02 in this lane";
CM_ SG_ 551 ACC_PotentialTgt_02_fusion "fusion flag of potential target02 in this lane";
CM_ SG_ 551 ACC_PotentialTgt_02_Heading "the heading angle of potential target02 in this lane";
CM_ SG_ 551 ACC_LeTgt_03_Dy "Lateral distance of the 03 nearest target in left lane";
CM_ SG_ 551 ACC_LeTgt_03_Dx "Longitudinal distance  of the 03 nearest target in left lane";
CM_ SG_ 551 ACC_LeTargrt_03_Detn "Detection  of the03 nearest target in left lane";
CM_ SG_ 551 ACC_LeTgt_03_Typ "Types  of the03 nearest target in left lane";
CM_ SG_ 551 ACC_LeTgt_03_fusion "fusion flag  of the 03 nearest target in left lane";
CM_ SG_ 551 ACC_LeTgt_03_Heading "the heading angle  of the 03 nearest target in left lane";
CM_ SG_ 551 ACC_RiTgt_03_Dy "Lateral distance of the 03 nearest target in right lane";
CM_ SG_ 551 ACC_RiTgt_03_Dx "Longitudinal distance  of the 03 nearest target in right lane";
CM_ SG_ 551 ACC_RiTargrt_03_Detn "Detection  of the03 nearest target in right lane";
CM_ SG_ 551 ACC_RiTgt_03_Typ "Types  of the03 nearest target in right lane";
CM_ SG_ 551 ACC_RiTgt_03_fusion "fusion flag  of the 03 nearest target in right lane";
CM_ SG_ 551 ACC_RiTgt_03_Heading "the heading angle  of the 03 nearest target in right lane";
CM_ SG_ 551 MAC_Check_AEB_FD2 "MAC protection mechanism should comply with the GWM MAC Specificatio";
CM_ SG_ 561 FLWheelDriveDirection "Front left wheel Moving direction";
CM_ SG_ 561 FRWheelDriveDirection "Front right wheel  Moving direction";
CM_ SG_ 561 FLWheelSpd "Front left wheel speed(when v <0.1 kph, set value to 0)";
CM_ SG_ 561 FLWheelSpdVld "Front left wheel speed valid";
CM_ SG_ 561 FRWheelSpdVld "Front right wheel speed valid";
CM_ SG_ 561 FRWheelSpd "Front right wheel speed(when v <0.1 kph, set value to 0)";
CM_ SG_ 561 WssFLEdgesSum "Sum of edge of Front Left Wheel speed sensor";
CM_ SG_ 561 WssFREdgesSum "Sum of edge of Front Right Wheel speed sensor";
CM_ SG_ 561 WssFLEdgesSumVld "Valid signal for Sum of edge of Front Left Wheel speed sensor";
CM_ SG_ 561 WssFREdgesSumVld "Valid signal for Sum of edge of Front Right Wheel speed sensor";
CM_ SG_ 566 CheckSum_DCT7 "Use the checksum strategy from document Ã¢Â€ÂœEnd-to-End Communication Protection SpecificationÃ¢Â€ÂIP Received";
CM_ SG_ 566 TrsmStNID "The status of the Neutral in D control functionIP Received";
CM_ SG_ 566 DCT_RaceModeSts "Vehicle RaceMode stauteIP Received";
CM_ SG_ 566 TRANS_OIL_TEMP "Transmission oil temperatureIP Received";
CM_ SG_ 566 DCT_PrsBrk_Warn "Press brake to engage gearIP Received";
CM_ SG_ 566 DCT_ShftNotAlwd_Warn "Transmission shifting not allowedIP Received";
CM_ SG_ 566 DCT_ShftRecom_M "Transmission  shift recommendation in M modeIP Received";
CM_ SG_ 566 DrvWarnMsg "Driver display warning messagesIP Received";
CM_ SG_ 566 DrvFaiMsg "Driver display failure messagesIP Received
Ã¦Â™ÂºÃ¨ÂƒÂ½Ã©Â©Â¾Ã©Â©Â¶Ã§Â³Â»Ã§Â»ÂŸÃ¨Â¯Â†Ã¥ÂˆÂ«Ã¨Â¯Â¥Ã¤Â¿Â¡Ã¥ÂÂ·Ã§ÂšÂ„0x1 Transmission Malfunction Ã¥Â’ÂŒ 0xFtransmission limit function Ã¦ÂÂ¥Ã¥ÂˆÂ¤Ã¥Â®Âš TCUÃ¦Â˜Â¯Ã¥ÂÂ¦Ã¦Â”Â¯Ã¦ÂŒÂÃ¦Â™ÂºÃ¨ÂƒÂ½Ã©Â©Â¾Ã©Â©Â¶Ã§Â±Â»Ã¥ÂŠÂŸÃ¨ÂƒÂ½";
CM_ SG_ 566 DrvModDisp "Driver display drive mode valueIP Received";
CM_ SG_ 566 DrvModDispSts "Driver display drive mode statusIP Received";
CM_ SG_ 566 DrvAutoGearDisp "Driver display gear valueIP Received";
CM_ SG_ 566 DrvGearDispSts "Driver display gear statusIP Received";
CM_ SG_ 566 RollingCounter_DCT7 "Rolling Counter_DCT7IP Received";
CM_ SG_ 566 MAC_Check_DCT_FD4 "MAC protection mechanism should comply with the GWM MAC Specificatio";
CM_ SG_ 568 SrAntiPinch "SR Curtain anti-pinch";
CM_ SG_ 568 SsPosn_VR_APP "Report sunshade position for HUT and T_Box";
CM_ SG_ 568 SsAntiPinch "SS Curtain anti-pinch";
CM_ SG_ 568 SrPosn_VR_APP "Report sunroof position for HUT and T_Box";
CM_ SG_ 568 RLS_IRBrightness "IR BrightnessSub_CAN:To HUD";
CM_ SG_ 568 RLS_FwBrightness "Fw BrightnessSub_CAN:To HUD";
CM_ SG_ 568 RLS_AmbBrightness "Amb BrightnessSub_CAN:To HUD";
CM_ SG_ 573 Checksum_IFC3 "Use the checksum strategy from document Ã¢Â€ÂœEnd-to-End Communication Protection SpecificationÃ¢Â€Â";
CM_ SG_ 573 LDWResp "Indicate LDW(Lane Detection Warning) Switch status";
CM_ SG_ 573 LKAResp "Indicate LKA(Ã‚Â Lane Keeping Assist) Switch status";
CM_ SG_ 573 LCKResp "Indicate LCK(Ã‚Â Lane Center Keeping ) Switch status";
CM_ SG_ 573 ELKResp "Indicate ELK(Ã‚Â Emergency Lane Keeping ) Switch status";
CM_ SG_ 573 LDW_LKA_Snvty "LDW(Lane Detection Warning)_LKA(Ã‚Â Lane Keeping Assist)   Sensitivity";
CM_ SG_ 573 IFCHUTInterface "This signal indicates if IFC and HUT communication  interface is available or not.";
CM_ SG_ 573 LSSWarnFormResp "LSS Warning Form Switch status";
CM_ SG_ 573 LSSResp "Indicate LSS(Ã‚Â Lane Support System ) Switch status";
CM_ SG_ 573 AESSts "AES function statusIP Received";
CM_ SG_ 573 ESSSts "ESS function statusIP Received";
CM_ SG_ 573 AESErrSts "AES function error statusIP Received";
CM_ SG_ 573 ESSErrSts "ESS function error statusIP Received";
CM_ SG_ 573 RollingCounter_IFC3 "RollingCounter_IFC3";
CM_ SG_ 573 Checksum_IFC4 "Use the checksum strategy from document Ã¢Â€ÂœEnd-to-End Communication Protection SpecificationÃ¢Â€Â";
CM_ SG_ 573 IFC_Handsoffwarn "Hands Off Warning";
CM_ SG_ 573 IFCCalibrationSts "Lane Detection Warning Calibration Status
IFC Calibration StatusIP Received";
CM_ SG_ 573 CameraBlockageSts "Camera Blockage StatusIP Received";
CM_ SG_ 573 LDW_LKAWarn "LDW waring statusIP Received";
CM_ SG_ 573 LSSIntervention "LSS(Lane Support System)  torque intercention statusIP Received";
CM_ SG_ 573 LSSFuncSts "LSS(Lane Support System) statusIP Received";
CM_ SG_ 573 ELKMainState "ELK Main State";
CM_ SG_ 573 LaneAvailability "Lane availabilityIP Received";
CM_ SG_ 573 TJA_FollowSts "Indicator TJA function lateral control's following status";
CM_ SG_ 573 LSSErrSts "LSS(Lane Support System)  error status.IP Received";
CM_ SG_ 573 AESintervention "AES intervention statusIP Received";
CM_ SG_ 573 ESSintervention "ESS intervention statusIP Received";
CM_ SG_ 573 ELKActSts "ELK function active status";
CM_ SG_ 573 IntelligentEvaActSts "Intelligent Evade function active status";
CM_ SG_ 573 LCKStsIndcr "LCK(Lane Center Keeping) Status Indicator";
CM_ SG_ 573 RollingCounter_IFC4 "RollingCounter_IFC4";
CM_ SG_ 573 Checksum_IFC5 "Use the checksum strategy from document Ã¢Â€ÂœEnd-to-End Communication Protection SpecificationÃ¢Â€Â";
CM_ SG_ 573 IFC_LaneCurve "Lane curatureIP Received";
CM_ SG_ 573 IFC_LeLaneTyp "Left lane typeIP Received";
CM_ SG_ 573 IFC_RiLaneTyp "Right lane typeIP Received";
CM_ SG_ 573 IFC_NextLeLaneTyp "Left Next lane typeIP Received";
CM_ SG_ 573 IFC_NextRiLaneTyp "Right Next lane typeIP Received";
CM_ SG_ 573 IFC_LeLane_dy "Distance from the vehicle to the left next laneIP Received";
CM_ SG_ 573 IFC_RiLane_dy "Distance from the vehicle to the right next laneIP Received";
CM_ SG_ 573 RollingCounter_IFC5 "RollingCounter_IFC5";
CM_ SG_ 573 Checksum_IFC6 "Use the checksum strategy from document Ã¢Â€ÂœEnd-to-End Communication Protection SpecificationÃ¢Â€Â";
CM_ SG_ 573 IFC_NextLeLane_dy "Distance from the vehicle to the left lane";
CM_ SG_ 573 IFC_NextRiLane_dy "Distance from the vehicle to the right lane";
CM_ SG_ 573 RollingCounter_IFC6 "RollingCounter_IFC6";
CM_ SG_ 573 AESResp "Indicate AES(Automatic Emergency Steering) Switch status";
CM_ SG_ 573 ESS_Pedresp "ESS(Evasive Steering Support)-Pedestrian switch status response";
CM_ SG_ 573 ESS_Vehresp "ESS(Evasive Steering Support)-Vehicle switch status response";
CM_ SG_ 573 IntelligentEvaResp "Intelligent evade switch status response";
CM_ SG_ 573 MAC_Check_IFC_FD2 "MAC protection mechanism should comply with the GWM MAC Specificatio";
CM_ SG_ 579 AutoSpdSetSwt "switch for adjusting cruise speed automatically Ã¨Â‡ÂªÃ¥ÂŠÂ¨Ã¨Â°ÂƒÃ¨ÂŠÂ‚Ã¨Â½Â¦Ã¨Â¾Â†Ã©Â™ÂÃ©Â€ÂŸÃ¥ÂŠÂŸÃ¨ÂƒÂ½Ã¥Â¼Â€Ã¥Â…Â³(Ã¦ÂŒÂ‰Ã¨Â®Â°Ã¥Â½Â•Ã§ÂšÂ„Ã§ÂŠÂ¶Ã¦Â€ÂÃ¨Â¿Â›Ã¨Â¡ÂŒÃ¥ÂÂ‘Ã©Â€Â)ADAS1_CAN:To ICU1.5";
CM_ SG_ 579 LaneChngCfmSwt "switch for manual confirmation of lane change Ã§Â”Â¨Ã¦ÂˆÂ·Ã©Â€ÂšÃ¨Â¿Â‡Ã¤Â¸Â­Ã¦ÂŽÂ§Ã¨Â®Â¾Ã§Â½Â®Ã§Â•ÂŒÃ©ÂÂ¢Ã¨Â®Â¾Ã§Â½Â®Ã¦Â„ÂÃ¥Â›Â¾Ã§Â¡Â®Ã¨Â®Â¤Ã¥ÂŠÂŸÃ¨ÂƒÂ½Ã¤Â¸ÂºÃ¥Â¼Â€Ã¥ÂÂ¯Ã¦ÂˆÂ–Ã¥Â…Â³Ã©Â—Â­ADAS1_CAN:To ICU1.5";
CM_ SG_ 579 VoiceBrdcSwt "Switch for adas voice broadcastÃ§Â”Â¨Ã¦ÂˆÂ·Ã¦Â‰Â“Ã¥Â¼Â€Ã¥Â’ÂŒÃ¥Â…Â³Ã©Â—Â­Ã¨Â¯Â­Ã©ÂŸÂ³Ã¦Â’Â­Ã¦ÂŠÂ¥Ã§ÂšÂ„Ã¦ÂƒÂ…Ã¥Â†ÂµÃ¯Â¼ÂˆÃ§Â”Â¨Ã¤ÂºÂŽÃ¦Â•Â°Ã¦ÂÂ®Ã¥Â›ÂžÃ¤Â¼Â Ã¯Â¼Â‰ADAS1_CAN:To ICU1.5";
CM_ SG_ 579 UsrManSts "survey of user manual usage Ã§Â”Â¨Ã¦ÂˆÂ·Ã¦Â‰Â“Ã¥Â¼Â€Ã¥Â’ÂŒÃ¥Â…Â³Ã©Â—Â­Ã¦Â–Â°Ã¦Â‰Â‹Ã¦Â•Â™Ã§Â¨Â‹Ã§ÂšÂ„Ã¦ÂƒÂ…Ã¥Â†ÂµÃ¯Â¼ÂˆÃ§Â”Â¨Ã¤ÂºÂŽÃ¦Â•Â°Ã¦ÂÂ®Ã¥Â›ÂžÃ¤Â¼Â Ã¯Â¼Â‰ADAS1_CAN:To ICU1.5";
CM_ SG_ 579 HUT_OD_WorkSts "Working Status of HUT CameraADAS-CANFD To:PAS,RPAS";
CM_ SG_ 579 HUT_OD_Obj_Timestamp "Timestamp of detecting the targetADAS-CANFD To:PAS,RPAS";
CM_ SG_ 579 HUT_FSD1_distance "Freespace_distance to pointADAS-CANFD To:PAS,RPAS";
CM_ SG_ 579 HUT_FSD2_distance "Freespace_distance to pointADAS-CANFD To:PAS,RPAS";
CM_ SG_ 579 HUT_FSD3_distance "Freespace_distance to pointADAS-CANFD To:PAS,RPAS";
CM_ SG_ 579 HUT_FSD4_distance "Freespace_distance to pointADAS-CANFD To:PAS,RPAS";
CM_ SG_ 579 HUT_FSD5_distance "Freespace_distance to pointADAS-CANFD To:PAS,RPAS";
CM_ SG_ 579 HUT_FSD6_distance "Freespace_distance to pointADAS-CANFD To:PAS,RPAS";
CM_ SG_ 579 HUT_FSD7_distance "Freespace_distance to pointADAS-CANFD To:PAS,RPAS";
CM_ SG_ 579 HUT_FSD8_distance "Freespace_distance to pointADAS-CANFD To:PAS,RPAS";
CM_ SG_ 579 HUT_FSD9_distance "Freespace_distance to pointADAS-CANFD To:PAS,RPAS";
CM_ SG_ 579 HUT_FSD10_distance "Freespace_distance to pointADAS-CANFD To:PAS,RPAS";
CM_ SG_ 579 HUT_FSD11_distance "Freespace_distance to pointADAS-CANFD To:PAS,RPAS";
CM_ SG_ 579 HUT_FSD12_distance "Freespace_distance to pointADAS-CANFD To:PAS,RPAS";
CM_ SG_ 579 HUT_FSD13_distance "Freespace_distance to pointADAS-CANFD To:PAS,RPAS";
CM_ SG_ 579 HUT_FSD14_distance "Freespace_distance to pointADAS-CANFD To:PAS,RPAS";
CM_ SG_ 579 HUT_FSD15_distance "Freespace_distance to pointADAS-CANFD To:PAS,RPAS";
CM_ SG_ 579 HUT_FSD16_distance "Freespace_distance to pointADAS-CANFD To:PAS,RPAS";
CM_ SG_ 579 HUT_FSD17_distance "Freespace_distance to pointADAS-CANFD To:PAS,RPAS";
CM_ SG_ 579 HUT_FSD18_distance "Freespace_distance to pointADAS-CANFD To:PAS,RPAS";
CM_ SG_ 579 NOH_Swt_Req "Indicate Switch  of NOH switch statusADAS_CAN:To ICU1.5";
CM_ SG_ 579 NOH_Act_Req "Indicate Switch  of NOH activate statusADAS_CAN:To ICU1.5";
CM_ SG_ 579 HUT_OD_Obj7_ID "ID of the Target obstacleADAS-CANFD To:PAS,RPAS";
CM_ SG_ 579 HUT_OD_Obj7_type "OD_typeADAS-CANFD To:PAS,RPAS";
CM_ SG_ 579 HUT_OD_Obj7_Confidence "Confidence of the Target obstacleADAS-CANFD To:PAS,RPAS";
CM_ SG_ 579 HUT_OD_Obj7_width "Width of the Target obstacleADAS-CANFD To:PAS,RPAS";
CM_ SG_ 579 HUT_OD_Obj7_Ground_Pos_X "X-Axis Position of the Target obstacleADAS-CANFD To:PAS,RPAS";
CM_ SG_ 579 HUT_OD_Obj7_Ground_Pos_Y "Y-Axis Position of the Target obstacleADAS-CANFD To:PAS,RPAS";
CM_ SG_ 580 MenuReturnSwtSts "Menu Return Switch StatusIP Received";
CM_ SG_ 580 SteerWheelHeatdSts "Steer wheel heated statusCSA-LIN IFCom SWHM";
CM_ SG_ 580 HomeSwtSts "Home Switch StatusIP Received";
CM_ SG_ 580 MuteSwtSts "Mute Switch Status";
CM_ SG_ 580 CustomSwtSts "Custom Switch StatusIP Received";
CM_ SG_ 580 PageUpSwtSts "Page Up Switch StatusIP Received";
CM_ SG_ 580 PageDwnSwtSts "Page Down Switch StatusIP Received";
CM_ SG_ 580 PageLSwtSts "Page Left Switch StatusIP Received";
CM_ SG_ 580 PageRSwtSts "Page Right Switch StatusIP Received";
CM_ SG_ 580 SeekUpSwtSts "Seek Up Switch Status";
CM_ SG_ 580 SeekDwnSwtSts "Seek Down Switch Status";
CM_ SG_ 580 AdjVolUpSwtSts "Adjust Volume Up Switch  Status";
CM_ SG_ 580 AdjVolDwnSwtSts "Adjust Volume Down Switch Status";
CM_ SG_ 580 VRSwtSts "Voice Recognition Switch Status";
CM_ SG_ 580 EnterSwtSts "Enter Switch StatusIP Received";
CM_ SG_ 580 EnterSwtSts_Mmed "Enter Switch Status For Multimedia";
CM_ SG_ 580 CustomSwtSts_Mmed "Custom Switch Status For Multimedia";
CM_ SG_ 580 IpMenuSwtSts "Ip menu switch status";
CM_ SG_ 581 VehLgtAccel "Vehicle Longitudinal acceleration";
CM_ SG_ 581 VehLatAccel "Vehicle Lateral Acceleration";
CM_ SG_ 581 VehYawRate "Vehicle yaw rate";
CM_ SG_ 581 VehLgtAccelVld "Vehicle Longitudinal acceleration valid";
CM_ SG_ 581 VehLatAccelVld "Vehicle Lateral Acceleratio valid";
CM_ SG_ 581 VehDynYawRateVld "Vehicle yaw rate valid";
CM_ SG_ 582 RLWheelSpdVld "Rear left wheel speed valid";
CM_ SG_ 582 RLWheelSpd "Rear left wheel speed(when v <0.1 kph, set value to 0)";
CM_ SG_ 582 RRWheelSpdVld "Rear right wheel speed valid";
CM_ SG_ 582 RRWheelSpd "Rear right wheel speed(when v <0.1 kph, set value to 0)";
CM_ SG_ 582 RLWheelDriveDirection "Rear left wheel  Moving direction";
CM_ SG_ 582 RRWheelDriveDirection "Rear right wheel Moving direction";
CM_ SG_ 582 WssRREdgesSum "Sum of edge of rear Right Wheel speed sensor";
CM_ SG_ 582 WssRLEdgesSum "Sum of edge of rear Left Wheel speed sensor";
CM_ SG_ 582 WssRLEdgesSumVld "Valid signal for Sum of edge of rear Left Wheel speed sensor";
CM_ SG_ 582 WssRREdgesSumVld "Valid signal for Sum of edge of rear Right Wheel speed sensor";
CM_ SG_ 584 HCU_12VSysErr_1 "12V system error indicate word:12V system error Ã¯Â¼ÂŒstop the vehicle in a safety place.IP Received";
CM_ SG_ 584 HCU_12VSysErr_2 "12V system error indicate word:12V system error Ã¯Â¼ÂŒgo to the service piont.IP Received";
CM_ SG_ 584 HCU_HybSysErr_1 "Hybrid error indicate word: Hybrid system error stop the vehicle in a safety place.IP Received";
CM_ SG_ 584 HCU_HybSysErr_2 "Hybrid error indicate word: Hybrid system not available due to collision .IP Received";
CM_ SG_ 584 HCU_HybSysErr_5 "Hybrid error indicate word: BSG system error Ã¯Â¼ÂŒgo to the service piont.IP Received";
CM_ SG_ 584 HCU_HybSysErr_6 "Hybrid error indicate word:  temporary hybrid system limitations drive carefullyIP Received";
CM_ SG_ 584 HCU_HybSysErr_7 "Hybrid error indicate word: Braking energy recovery system error,go to the service piont.IP Received";
CM_ SG_ 584 HCU_12VSysErrLmpSts "12V system error indicate lamp  statusIP Received";
CM_ SG_ 584 HCU_HybSysErrLmpSts "Hybrid system error  indicate lamp statusIP Received";
CM_ SG_ 584 HCU_PowerRedWarnLmpCmd "The power reduction warning lamp comes on. Whenever a power reduction warning happens.IP Received";
CM_ SG_ 584 HCU_EnrgFlowInd "the mode of current energy flowIP Received";
CM_ SG_ 584 HCU_HybSysErr_3 "Hybrid error indicate word: Hybrid system error ,go to the service piont.IP Received";
CM_ SG_ 584 HCU_RdyLmpSts "Hybrid system ready lampÃ¯Â¼ÂˆÃ§Â‚Â¹Ã¤ÂºÂ®readyÃ§ÂÂ¯Ã¯Â¼Â‰";
CM_ SG_ 584 CheckSum_HCU_PT7 "Use the checksum strategy from document Ã¢Â€ÂœEnd-to-End Communication Protection SpecificationÃ¢Â€Â";
CM_ SG_ 584 HCU_HybSysErr_4 "Hybrid error indicate word: Rear traction system error ,go to the service piont.IP";
CM_ SG_ 584 HCU_EnrgFlowInd_P2 "the mode of current energy flowHUT";
CM_ SG_ 584 HCU_12VSysErr_3 "12V system error indicate word:12V system error Ã¯Â¼ÂŒcomfort function limited.IP";
CM_ SG_ 584 HCU_OPDLmpSts "OPD indicator light requestIP Received";
CM_ SG_ 584 HCU_OPDSts "One Pedal Driving StatusIP Received";
CM_ SG_ 584 HCU_ModSwtFail "Mode Switch Failure prompt MessageIPHUT Received";
CM_ SG_ 584 RollingCounter_HCU_PT7 "Rolling counter";
CM_ SG_ 589 DrowsnsLvl "Drowsiness level";
CM_ SG_ 589 DrowsnsLvlQlty "Drowsiness level Quality";
CM_ SG_ 589 GenderSts "Gender Status";
CM_ SG_ 589 GenderStsQlty "Gender Status Quality";
CM_ SG_ 589 ExprsnSts "Expression StatusADAS1_CAN:To ICU1.5";
CM_ SG_ 589 Checksum_DMS2 "Use the checksum strategy from document Ã¢Â€ÂœEnd-to-End Communication Protection SpecificationÃ¢Â€ÂADAS-CANFD To:IFC,IDC_L2,";
CM_ SG_ 589 DistrctnLvl_ACC "Distraction level to ACCADAS-CANFD To:IFC,IDC_L2,";
CM_ SG_ 589 DistrctnLvlQlty_ACC "Distraction level Quality to ACCADAS-CANFD To:IFC,IDC_L2,";
CM_ SG_ 589 DrowsnsLvl_ACC "Drowsiness level to ACCADAS-CANFD To:IFC,IDC_L2";
CM_ SG_ 589 DrowsnsLvlQlty_ACC "Drowsiness level Quality to ACCADAS-CANFD To:IFC,IDC_L2";
CM_ SG_ 589 RollingCounter_DMS2 "RollingCounter_DMS2ADAS-CANFD To:IFC,IDC_L2,";
CM_ SG_ 589 Checksum_DMS3 "Use the checksum strategy from document Ã¢Â€ÂœEnd-to-End Communication Protection SpecificationÃ¢Â€ÂADAS-CANFD To:IFC,IDC_L2,";
CM_ SG_ 589 HeadPosnX "Head position at X-axisADAS-CANFD To:IFC,IDC_L2";
CM_ SG_ 589 HeadPosnY "Head position at Y-axisADAS-CANFD To:IFC,IDC_L2";
CM_ SG_ 589 HeadPosnZ "Head position at Z-axisADAS-CANFD To:IFC,IDC_L2";
CM_ SG_ 589 HeadPosQlty "Head position qualityADAS-CANFD To:IFC,IDC_L2";
CM_ SG_ 589 RollingCounter_DMS3 "RollingCounter_DMS3ADAS-CANFD To:IFC,IDC_L2,";
CM_ SG_ 589 GazePosnX "Gaze position at X-axisADAS-CANFD To:IFC,IDC_L2";
CM_ SG_ 589 GazePosnY "Gaze position at Y-axisADAS-CANFD To:IFC,IDC_L2";
CM_ SG_ 589 GazePosnZ "Gaze position at Z-axisADAS-CANFD To:IFC,IDC_L2";
CM_ SG_ 589 Checksum_DMS5 "Use the checksum strategy from document Ã¢Â€ÂœEnd-to-End Communication Protection SpecificationÃ¢Â€ÂADAS-CANFD To:IFC,IDC_L2,";
CM_ SG_ 589 DMSSts "DMS StatusADAS-CANFD To:IFC,IDC_L2";
CM_ SG_ 589 HeadDetn "Head DetectionADAS-CANFD To:IFC,IDC_L2,";
CM_ SG_ 589 HeadYawAng "Head Yaw AngleADAS-CANFD To:IFC,IDC_L2,";
CM_ SG_ 589 HeadPitchAng "Head Pitch AngleADAS-CANFD To:IFC,IDC_L2,";
CM_ SG_ 589 HeadRollAng "Head Roll AngleADAS-CANFD To:IFC,IDC_L2,";
CM_ SG_ 589 HeadRotAngQlty "Head Rotation angle QualityADAS-CANFD To:IFC,IDC_L2";
CM_ SG_ 589 RollingCounter_DMS5 "RollingCounter_DMS5ADAS-CANFD To:IFC,IDC_L2,";
CM_ SG_ 589 Checksum_DMS6 "Use the checksum strategy from document Ã¢Â€ÂœEnd-to-End Communication Protection SpecificationÃ¢Â€ÂADAS-CANFD To:IFC,IDC_L2,";
CM_ SG_ 589 LEyeOpenSts "Left eye open statusADAS-CANFD To:IFC,IDC_L2,";
CM_ SG_ 589 LEyeOpenStsQlty "Left eye open status qualityADAS-CANFD To:IFC,IDC_L2,";
CM_ SG_ 589 REyeOpenSts "Right eye open statusADAS-CANFD To:IFC,IDC_L2,";
CM_ SG_ 589 REyeOpenStsQlty "Right eye open status qualityADAS-CANFD To:IFC,IDC_L2,";
CM_ SG_ 589 RobustGazeYawAng "Robust gaze yaw angleADAS-CANFD To:IFC,IDC_L2";
CM_ SG_ 589 RobustGazePitchAng "Robust gaze Pitch angleADAS-CANFD To:IFC,IDC_L2";
CM_ SG_ 589 RobustGazeAngQlty "Robust gaze angle qualityADAS-CANFD To:IFC,IDC_L2";
CM_ SG_ 589 DrvBehvSts "Driver Behavioral Area StatusADAS1_CAN:To ICU1.5";
CM_ SG_ 589 RollingCounter_DMS6 "RollingCounter_DMS6ADAS-CANFD To:IFC,IDC_L2,";
CM_ SG_ 593 FuncProtnSts "Identifies the function demotion status through wheel speed.IP Received";
CM_ SG_ 593 ShiftSysStuInLow "Shift System Stuck in Low";
CM_ SG_ 593 SystemOperMod "Identifies the current AWD(all wheel drive) Mode";
CM_ SG_ 593 CouplingFaultSts "indicates that which fault the coupling  has";
CM_ SG_ 593 CouplingThermWarning "Indicates that the system is shutdown due to thermal protection WarningIP Received";
CM_ SG_ 593 DiagLmpReq "Identifies there is a light diagnostic lamp request.";
CM_ SG_ 593 ModeShiftTimeout "Mode Shift Timeout";
CM_ SG_ 593 AutoShiftSts "Identifies there is a light Neutral mode lamp request";
CM_ SG_ 593 EstimatedTorque "Estimated Coupling Torque";
CM_ SG_ 604 BLEConnSts "Smartphone BLE and vehicle BLE connection status";
CM_ SG_ 604 BLESecuritySts "Smartphone BLE and vehicle BLE Security certification status";
CM_ SG_ 623 CheckSum_HUT32 "Use the checksum strategy from document Ã¢Â€ÂœEnd-to-End Communication Protection SpecificationÃ¢Â€ÂADAS-CANFD To:HAP";
CM_ SG_ 623 ScrnOpSts "HUT screen operate statusADAS-CANFD To:HAP,PAS";
CM_ SG_ 623 XLvl "View's global X-coordinate signalADAS-CANFD To:HAP,PAS";
CM_ SG_ 623 YLvl "View's global Y-coordinate signalADAS-CANFD To:HAP,PAS";
CM_ SG_ 623 DetVideoLost "HUT detect video lostADAS-CANFD To:HAP,PAS";
CM_ SG_ 623 PrkgCtrlModReqValid "Parking control mode request validADAS-CANFD To:HAP";
CM_ SG_ 623 PrkgCtrlModReq "Parking control mode requestADAS-CANFD To:HAP";
CM_ SG_ 623 ContnPrkgReqValid "Continue parking request validADAS-CANFD To:HAP";
CM_ SG_ 623 ContnPrkgReq "Continue parking requestADAS-CANFD To:HAP";
CM_ SG_ 623 PrkStraightSwtReq_HUT "Remote parking straight Switch requestADAS-CANFD To:HAP";
CM_ SG_ 623 PrkStraightSuspendOrFinishReq_HU "User suspend or finish parking straight functionADAS-CANFD To:HAP";
CM_ SG_ 623 PrkStraightModSel_HUT "Remote parking straight mode selection requestADAS-CANFD To:HAP";
CM_ SG_ 623 PrkStraightSts_HUT "Remote parking straight statusADAS-CANFD To:HAP";
CM_ SG_ 623 PrkStraightStrtReq_HUT "Remote parking straight handshake requestADAS-CANFD To:HAP";
CM_ SG_ 623 PrkStraightVehStrtReq_HUT_Valid "Remote parking straight handshake request validADAS-CANFD To:HAP";
CM_ SG_ 623 PrkStraightContinueReq_HUT "Remote parking straight continue forward or backwark requestADAS-CANFD To:HAP";
CM_ SG_ 623 P2P_PrkgDirSwtReq "Point to Point Parking Direct Switch requestADAS-CANFD To:IDC1.5";
CM_ SG_ 623 RainMode_Swt_Req "Request_of_rain_mode_switchADAS-CANFD To:ICU1.5";
CM_ SG_ 623 LCMode_Swt_Req "Request_of_lane_change_mode_switchADAS-CANFD To:ICU1.5";
CM_ SG_ 623 NavDecSwtReq "Request_of_Control_NavDec(Navigation_Deceleration__Recognition)_SwitchADAS1_CAN:To ICU1.5";
CM_ SG_ 623 RollingCounter_HUT32 "Rolling Counter_HUT32ADAS-CANFD To:HAP";
CM_ SG_ 625 FuelConsumption "Accumulated Fuel quantity injected since IGN ON.
Fuel quantity counter overflow is allowed.IP Received";
CM_ SG_ 625 TgtCrsVehSpd "Target cruise speedIP Received
When the signal \"SpdUnit\" sent by IP is 0x0:kph,the unit of signal \"TgtCruiseVehSpd\" is kph. When the signal \"SpdUnit\" sent by IP is 0x1:mph,the unit of signal \"TgtCruiseVehSpd\" is mph.
only for CC";
CM_ SG_ 625 CruiseCtrlSts "Cruise control statusIP Received
only for CC";
CM_ SG_ 625 AccelPedalPosn "Acceleration Pedal PositionSub_CAN:To HUD";
CM_ SG_ 625 AccelPedalPosnVldty "Acceleration pedal postion validityIP Received";
CM_ SG_ 625 ThrtlPosRatio "Throttle position ratioSub_CAN:To HUD";
CM_ SG_ 625 EngSVSSig "Engine SVSÃ¯Â¼Âˆservice vehicle soonÃ¯Â¼Â‰ SignalIP Received";
CM_ SG_ 625 MILSts "MILÃ¯Â¼Âˆmalfunction indicator lampÃ¯Â¼Â‰statusIP Received";
CM_ SG_ 625 EngState "Engine stateCoding 3 is stalling which means engine speed is not correct, therefore engine state can not be sure.";
CM_ SG_ 627 TrailerSts "Trailer Status";
BA_DEF_ BO_  "DiagRequest" ENUM  "No","Yes";
BA_DEF_ BO_  "DiagResponse" ENUM  "No","Yes";
BA_DEF_ BO_  "DiagState" ENUM  "No","Yes";
BA_DEF_ BO_  "GenMsgCycleTime" INT 0 65535;
BA_DEF_ BO_  "GenMsgCycleTimeFast" INT 0 65535;
BA_DEF_ BO_  "GenMsgILSupport" ENUM  "No","Yes";
BA_DEF_ BO_  "GenMsgNrOfRepetition" INT 0 65535;
BA_DEF_ BO_  "GenMsgSendType" ENUM  "Cyclic","CyclicAndSpontanX","Event";
BA_DEF_ BO_  "NmAsrMessage" ENUM  "No","Yes";
BA_DEF_ BO_  "OriginFrame" STRING ;
BA_DEF_ BO_  "SCP_AuthInfoTxLength" INT 0 512;
BA_DEF_ BO_  "SCP_DataId" INT 0 65535;
BA_DEF_ BO_  "SCP_FreshnessValueLength" INT 0 512;
BA_DEF_ BO_  "SCP_FreshnessValueTxLength" INT 0 512;
BA_DEF_ BO_  "SC_Message" ENUM  "NO","YES";
BA_DEF_ BO_  "VFrameFormat" ENUM  "StandardCAN","ExtendedCAN","reserved","reserved","reserved","reserved","reserved","reserved","reserved","reserved","reserved","reserved","reserved","reserved","StandardCAN_FD","ExtendedCAN_FD";
BA_DEF_ SG_  "GenSigCycleTime" INT 0 65535;
BA_DEF_ SG_  "GenSigSendType" ENUM  "Cyclic","OnWrite","OnWriteWithRepetition","OnChange","OnChangeWithRepetition","NotUsed","NotUsed","NoSigSendType";
BA_DEF_ SG_  "GenSigStartValue" FLOAT 0 100000000000;
BA_DEF_ SG_  "Match" STRING ;
BA_DEF_ SG_  "Origin" STRING ;
BA_DEF_ SG_  "TransparentInitValue" STRING ;
BA_DEF_ SG_  "SystemSignalLongSymbol" STRING ;
BA_DEF_DEF_  "DiagRequest" "No";
BA_DEF_DEF_  "DiagResponse" "No";
BA_DEF_DEF_  "DiagState" "No";
BA_DEF_DEF_  "GenMsgCycleTime" 0;
BA_DEF_DEF_  "GenMsgCycleTimeFast" 0;
BA_DEF_DEF_  "GenMsgILSupport" "No";
BA_DEF_DEF_  "GenMsgNrOfRepetition" 0;
BA_DEF_DEF_  "GenMsgSendType" "Cyclic";
BA_DEF_DEF_  "NmAsrMessage" "No";
BA_DEF_DEF_  "OriginFrame" "";
BA_DEF_DEF_  "SCP_AuthInfoTxLength" 0;
BA_DEF_DEF_  "SCP_DataId" 0;
BA_DEF_DEF_  "SCP_FreshnessValueLength" 0;
BA_DEF_DEF_  "SCP_FreshnessValueTxLength" 0;
BA_DEF_DEF_  "SC_Message" "NO";
BA_DEF_DEF_  "VFrameFormat" "";
BA_DEF_DEF_  "GenSigCycleTime" 0;
BA_DEF_DEF_  "GenSigSendType" "Cyclic";
BA_DEF_DEF_  "GenSigStartValue" 0;
BA_DEF_DEF_  "Match" "";
BA_DEF_DEF_  "Origin" "";
BA_DEF_DEF_  "TransparentInitValue" "";
BA_DEF_DEF_  "SystemSignalLongSymbol" "";
BA_ "OriginFrame" BO_ 493 "fuel,ev";
BA_ "GenMsgSendType" BO_ 493 2;
BA_ "GenMsgNrOfRepetition" BO_ 493 6;
BA_ "GenMsgILSupport" BO_ 493 1;
BA_ "GenMsgCycleTimeFast" BO_ 493 50;
BA_ "VFrameFormat" BO_ 493 14;
BA_ "SC_Message" BO_ 494 1;
BA_ "SCP_FreshnessValueTxLength" BO_ 494 16;
BA_ "SCP_FreshnessValueLength" BO_ 494 64;
BA_ "SCP_DataId" BO_ 494 494;
BA_ "SCP_AuthInfoTxLength" BO_ 494 48;
BA_ "OriginFrame" BO_ 494 "fuel,ev";
BA_ "GenMsgSendType" BO_ 494 2;
BA_ "GenMsgNrOfRepetition" BO_ 494 5;
BA_ "GenMsgILSupport" BO_ 494 1;
BA_ "GenMsgCycleTimeFast" BO_ 494 50;
BA_ "VFrameFormat" BO_ 494 14;
BA_ "OriginFrame" BO_ 497 "fuel,ev";
BA_ "GenMsgSendType" BO_ 497 2;
BA_ "GenMsgNrOfRepetition" BO_ 497 5;
BA_ "GenMsgILSupport" BO_ 497 1;
BA_ "GenMsgCycleTimeFast" BO_ 497 20;
BA_ "VFrameFormat" BO_ 497 14;
BA_ "OriginFrame" BO_ 498 "fuel,ev";
BA_ "GenMsgSendType" BO_ 498 2;
BA_ "GenMsgNrOfRepetition" BO_ 498 5;
BA_ "GenMsgILSupport" BO_ 498 1;
BA_ "GenMsgCycleTimeFast" BO_ 498 20;
BA_ "VFrameFormat" BO_ 498 14;
BA_ "OriginFrame" BO_ 505 "fuel,ev";
BA_ "GenMsgSendType" BO_ 505 2;
BA_ "GenMsgNrOfRepetition" BO_ 505 5;
BA_ "GenMsgILSupport" BO_ 505 1;
BA_ "GenMsgCycleTimeFast" BO_ 505 50;
BA_ "VFrameFormat" BO_ 505 14;
BA_ "OriginFrame" BO_ 506 "fuel,ev";
BA_ "GenMsgSendType" BO_ 506 2;
BA_ "GenMsgNrOfRepetition" BO_ 506 5;
BA_ "GenMsgILSupport" BO_ 506 1;
BA_ "GenMsgCycleTimeFast" BO_ 506 20;
BA_ "VFrameFormat" BO_ 506 14;
BA_ "OriginFrame" BO_ 507 "fuel,ev";
BA_ "GenMsgSendType" BO_ 507 2;
BA_ "GenMsgNrOfRepetition" BO_ 507 5;
BA_ "GenMsgILSupport" BO_ 507 1;
BA_ "GenMsgCycleTimeFast" BO_ 507 50;
BA_ "VFrameFormat" BO_ 507 14;
BA_ "OriginFrame" BO_ 509 "fuel,ev";
BA_ "GenMsgSendType" BO_ 509 2;
BA_ "GenMsgNrOfRepetition" BO_ 509 5;
BA_ "GenMsgILSupport" BO_ 509 1;
BA_ "GenMsgCycleTimeFast" BO_ 509 50;
BA_ "VFrameFormat" BO_ 509 14;
BA_ "OriginFrame" BO_ 545 "fuel,ev";
BA_ "GenMsgILSupport" BO_ 545 1;
BA_ "GenMsgCycleTime" BO_ 545 20;
BA_ "VFrameFormat" BO_ 545 14;
BA_ "OriginFrame" BO_ 546 "fuel,ev";
BA_ "GenMsgILSupport" BO_ 546 1;
BA_ "GenMsgCycleTime" BO_ 546 50;
BA_ "VFrameFormat" BO_ 546 14;
BA_ "OriginFrame" BO_ 548 "fuel,ev";
BA_ "GenMsgILSupport" BO_ 548 1;
BA_ "GenMsgCycleTime" BO_ 548 50;
BA_ "VFrameFormat" BO_ 548 14;
BA_ "SC_Message" BO_ 551 1;
BA_ "SCP_FreshnessValueTxLength" BO_ 551 16;
BA_ "SCP_FreshnessValueLength" BO_ 551 64;
BA_ "SCP_DataId" BO_ 551 551;
BA_ "SCP_AuthInfoTxLength" BO_ 551 48;
BA_ "OriginFrame" BO_ 551 "fuel,ev";
BA_ "GenMsgILSupport" BO_ 551 1;
BA_ "GenMsgCycleTime" BO_ 551 50;
BA_ "VFrameFormat" BO_ 551 14;
BA_ "OriginFrame" BO_ 561 "fuel,ev";
BA_ "GenMsgILSupport" BO_ 561 1;
BA_ "GenMsgCycleTime" BO_ 561 20;
BA_ "VFrameFormat" BO_ 561 14;
BA_ "OriginFrame" BO_ 566 "fuel,ev";
BA_ "GenMsgILSupport" BO_ 566 1;
BA_ "GenMsgCycleTime" BO_ 566 50;
BA_ "VFrameFormat" BO_ 566 14;
BA_ "OriginFrame" BO_ 568 "fuel,ev";
BA_ "GenMsgILSupport" BO_ 568 1;
BA_ "GenMsgCycleTime" BO_ 568 50;
BA_ "VFrameFormat" BO_ 568 14;
BA_ "SC_Message" BO_ 573 1;
BA_ "SCP_FreshnessValueTxLength" BO_ 573 16;
BA_ "SCP_FreshnessValueLength" BO_ 573 64;
BA_ "SCP_DataId" BO_ 573 573;
BA_ "SCP_AuthInfoTxLength" BO_ 573 48;
BA_ "OriginFrame" BO_ 573 "fuel,ev";
BA_ "GenMsgILSupport" BO_ 573 1;
BA_ "GenMsgCycleTime" BO_ 573 50;
BA_ "VFrameFormat" BO_ 573 14;
BA_ "OriginFrame" BO_ 579 "fuel,ev";
BA_ "GenMsgILSupport" BO_ 579 1;
BA_ "GenMsgCycleTime" BO_ 579 50;
BA_ "VFrameFormat" BO_ 579 14;
BA_ "OriginFrame" BO_ 580 "fuel,ev";
BA_ "GenMsgILSupport" BO_ 580 1;
BA_ "GenMsgCycleTime" BO_ 580 50;
BA_ "VFrameFormat" BO_ 580 14;
BA_ "OriginFrame" BO_ 581 "fuel,ev";
BA_ "GenMsgILSupport" BO_ 581 1;
BA_ "GenMsgCycleTime" BO_ 581 20;
BA_ "VFrameFormat" BO_ 581 14;
BA_ "OriginFrame" BO_ 582 "fuel,ev";
BA_ "GenMsgILSupport" BO_ 582 1;
BA_ "GenMsgCycleTime" BO_ 582 20;
BA_ "VFrameFormat" BO_ 582 14;
BA_ "OriginFrame" BO_ 584 "fuel,ev";
BA_ "GenMsgILSupport" BO_ 584 1;
BA_ "GenMsgCycleTime" BO_ 584 50;
BA_ "VFrameFormat" BO_ 584 14;
BA_ "OriginFrame" BO_ 589 "fuel,ev";
BA_ "GenMsgILSupport" BO_ 589 1;
BA_ "GenMsgCycleTime" BO_ 589 50;
BA_ "VFrameFormat" BO_ 589 14;
BA_ "OriginFrame" BO_ 593 "fuel,ev";
BA_ "GenMsgILSupport" BO_ 593 1;
BA_ "GenMsgCycleTime" BO_ 593 20;
BA_ "VFrameFormat" BO_ 593 14;
BA_ "OriginFrame" BO_ 604 "fuel,ev";
BA_ "GenMsgILSupport" BO_ 604 1;
BA_ "GenMsgCycleTime" BO_ 604 50;
BA_ "VFrameFormat" BO_ 604 14;
BA_ "OriginFrame" BO_ 623 "fuel,ev";
BA_ "GenMsgILSupport" BO_ 623 1;
BA_ "GenMsgCycleTime" BO_ 623 50;
BA_ "VFrameFormat" BO_ 623 14;
BA_ "OriginFrame" BO_ 625 "fuel,ev";
BA_ "GenMsgILSupport" BO_ 625 1;
BA_ "GenMsgCycleTime" BO_ 625 20;
BA_ "VFrameFormat" BO_ 625 14;
BA_ "OriginFrame" BO_ 627 "fuel,ev";
BA_ "GenMsgILSupport" BO_ 627 1;
BA_ "GenMsgCycleTime" BO_ 627 50;
BA_ "VFrameFormat" BO_ 627 14;
BA_ "Origin" SG_ 493 FlaoutUnlockSet "fuel,ev";
BA_ "Match" SG_ 493 FlaoutUnlockSet "FlaoutUnlockSet";
BA_ "GenSigStartValue" SG_ 493 FlaoutUnlockSet 2;
BA_ "GenSigSendType" SG_ 493 FlaoutUnlockSet 2;
BA_ "Origin" SG_ 493 PrkInDirChoice "fuel,ev";
BA_ "Match" SG_ 493 PrkInDirChoice "PrkInDirChoice";
BA_ "GenSigSendType" SG_ 493 PrkInDirChoice 2;
BA_ "Origin" SG_ 493 ADASDispSwt "fuel,ev";
BA_ "Match" SG_ 493 ADASDispSwt "ADASDispSwt";
BA_ "GenSigSendType" SG_ 493 ADASDispSwt 2;
BA_ "Origin" SG_ 493 NaviDispSwt "fuel,ev";
BA_ "Match" SG_ 493 NaviDispSwt "NaviDispSwt";
BA_ "GenSigSendType" SG_ 493 NaviDispSwt 2;
BA_ "Origin" SG_ 493 NaviDispSwt_VR "fuel,ev";
BA_ "Match" SG_ 493 NaviDispSwt_VR "NaviDispSwt_VR";
BA_ "GenSigSendType" SG_ 493 NaviDispSwt_VR 2;
BA_ "Origin" SG_ 493 ADASDispSwt_VR "fuel,ev";
BA_ "Match" SG_ 493 ADASDispSwt_VR "ADASDispSwt_VR";
BA_ "GenSigSendType" SG_ 493 ADASDispSwt_VR 2;
BA_ "Origin" SG_ 493 ApproachLampSet "fuel,ev";
BA_ "Match" SG_ 493 ApproachLampSet "ApproachLampSet";
BA_ "GenSigStartValue" SG_ 493 ApproachLampSet 2;
BA_ "GenSigSendType" SG_ 493 ApproachLampSet 2;
BA_ "Origin" SG_ 493 SuperLockSet "fuel,ev";
BA_ "Match" SG_ 493 SuperLockSet "SuperLockSet";
BA_ "GenSigStartValue" SG_ 493 SuperLockSet 2;
BA_ "GenSigSendType" SG_ 493 SuperLockSet 2;
BA_ "Origin" SG_ 493 ALCMDynModSet "fuel,ev";
BA_ "Match" SG_ 493 ALCMDynModSet "ALCMDynModSet";
BA_ "GenSigSendType" SG_ 493 ALCMDynModSet 2;
BA_ "Origin" SG_ 493 RLWinSwtReq_VR "fuel,ev";
BA_ "Match" SG_ 493 RLWinSwtReq_VR "RLWinSwtReq_VR";
BA_ "GenSigSendType" SG_ 493 RLWinSwtReq_VR 2;
BA_ "Origin" SG_ 493 RRWinSwtReq_VR "fuel,ev";
BA_ "Match" SG_ 493 RRWinSwtReq_VR "RRWinSwtReq_VR";
BA_ "GenSigSendType" SG_ 493 RRWinSwtReq_VR 2;
BA_ "Origin" SG_ 493 DrvWinSwtReq_VR "fuel,ev";
BA_ "Match" SG_ 493 DrvWinSwtReq_VR "DrvWinSwtReq_VR";
BA_ "GenSigSendType" SG_ 493 DrvWinSwtReq_VR 2;
BA_ "Origin" SG_ 493 PassWinSwtReq_VR "fuel,ev";
BA_ "Match" SG_ 493 PassWinSwtReq_VR "PassWinSwtReq_VR";
BA_ "GenSigSendType" SG_ 493 PassWinSwtReq_VR 2;
BA_ "Origin" SG_ 493 ChairMemPosnSetSwt "fuel,ev";
BA_ "Match" SG_ 493 ChairMemPosnSetSwt "ChairMemPosnSetSwt";
BA_ "GenSigSendType" SG_ 493 ChairMemPosnSetSwt 2;
BA_ "Origin" SG_ 493 PathLrngFinshCmd "fuel,ev";
BA_ "Match" SG_ 493 PathLrngFinshCmd "PathLrngFinshCmd";
BA_ "GenSigSendType" SG_ 493 PathLrngFinshCmd 2;
BA_ "Origin" SG_ 493 PathLrngStartCmd "fuel,ev";
BA_ "Match" SG_ 493 PathLrngStartCmd "PathLrngStartCmd";
BA_ "GenSigSendType" SG_ 493 PathLrngStartCmd 2;
BA_ "Origin" SG_ 493 SelPrkOutDirReq "fuel,ev";
BA_ "Match" SG_ 493 SelPrkOutDirReq "SelPrkOutDirReq";
BA_ "GenSigSendType" SG_ 493 SelPrkOutDirReq 2;
BA_ "Origin" SG_ 493 StartPrkgPath2Cmd "fuel,ev";
BA_ "Match" SG_ 493 StartPrkgPath2Cmd "StartPrkgPath2Cmd";
BA_ "GenSigSendType" SG_ 493 StartPrkgPath2Cmd 2;
BA_ "Origin" SG_ 493 DeletePath2Cmd "fuel,ev";
BA_ "Match" SG_ 493 DeletePath2Cmd "DeletePath2Cmd";
BA_ "GenSigSendType" SG_ 493 DeletePath2Cmd 2;
BA_ "Origin" SG_ 493 StartPrkgPath1Cmd "fuel,ev";
BA_ "Match" SG_ 493 StartPrkgPath1Cmd "StartPrkgPath1Cmd";
BA_ "GenSigSendType" SG_ 493 StartPrkgPath1Cmd 2;
BA_ "Origin" SG_ 493 DeletePath1Cmd "fuel,ev";
BA_ "Match" SG_ 493 DeletePath1Cmd "DeletePath1Cmd";
BA_ "GenSigSendType" SG_ 493 DeletePath1Cmd 2;
BA_ "Origin" SG_ 493 SelPrkgFctnCmd "fuel,ev";
BA_ "Match" SG_ 493 SelPrkgFctnCmd "SelPrkgFctnCmd";
BA_ "GenSigSendType" SG_ 493 SelPrkgFctnCmd 2;
BA_ "Origin" SG_ 493 ParkMdlCmd "fuel,ev";
BA_ "Match" SG_ 493 ParkMdlCmd "ParkMdlCmd";
BA_ "GenSigSendType" SG_ 493 ParkMdlCmd 2;
BA_ "Origin" SG_ 493 BackReq_APS "fuel,ev";
BA_ "Match" SG_ 493 BackReq_APS "BackReq_APS";
BA_ "GenSigSendType" SG_ 493 BackReq_APS 2;
BA_ "Origin" SG_ 493 ACFGAEnaReq_TC "fuel,ev";
BA_ "Match" SG_ 493 ACFGAEnaReq_TC "ACFGAEnaReq_TC";
BA_ "GenSigSendType" SG_ 493 ACFGAEnaReq_TC 2;
BA_ "Origin" SG_ 493 ACFGAChanTyp_TC "fuel,ev";
BA_ "Match" SG_ 493 ACFGAChanTyp_TC "ACFGAChanTyp_TC";
BA_ "GenSigSendType" SG_ 493 ACFGAChanTyp_TC 2;
BA_ "Origin" SG_ 493 ACFGALvlReq_TC "fuel,ev";
BA_ "Match" SG_ 493 ACFGALvlReq_TC "ACFGALvlReq_TC";
BA_ "GenSigSendType" SG_ 493 ACFGALvlReq_TC 2;
BA_ "Origin" SG_ 493 P2P_PrkgDirectSwtCmd "fuel,ev";
BA_ "Match" SG_ 493 P2P_PrkgDirectSwtCmd "P2P_PrkgDirectSwtCmd";
BA_ "GenSigSendType" SG_ 493 P2P_PrkgDirectSwtCmd 2;
BA_ "TransparentInitValue" SG_ 493 HUT33_0x1ED "168 0 0 0 0 0 0 0 ";
BA_ "GenSigSendType" SG_ 493 HUT33_0x1ED 2;
BA_ "Origin" SG_ 494 SunShadeSwtReq_VR "fuel,ev";
BA_ "Match" SG_ 494 SunShadeSwtReq_VR "SunShadeSwtReq_VR";
BA_ "GenSigSendType" SG_ 494 SunShadeSwtReq_VR 2;
BA_ "Origin" SG_ 494 SunRoofSwtReq_VR "fuel,ev";
BA_ "Match" SG_ 494 SunRoofSwtReq_VR "SunRoofSwtReq_VR";
BA_ "GenSigSendType" SG_ 494 SunRoofSwtReq_VR 2;
BA_ "Origin" SG_ 494 FrntRearACDispSts "fuel,ev";
BA_ "Match" SG_ 494 FrntRearACDispSts "FrntRearACDispSts";
BA_ "GenSigSendType" SG_ 494 FrntRearACDispSts 2;
BA_ "Origin" SG_ 494 ACOperMod_TC "fuel,ev";
BA_ "Match" SG_ 494 ACOperMod_TC "ACOperMod_TC";
BA_ "GenSigSendType" SG_ 494 ACOperMod_TC 2;
BA_ "Origin" SG_ 494 ACOperMod_VR "fuel,ev";
BA_ "Match" SG_ 494 ACOperMod_VR "ACOperMod_VR";
BA_ "GenSigSendType" SG_ 494 ACOperMod_VR 2;
BA_ "Origin" SG_ 494 ACDrvSetTempSteplsReq_TC "fuel,ev";
BA_ "Match" SG_ 494 ACDrvSetTempSteplsReq_TC "ACDrvSetTempSteplsReq_TC";
BA_ "GenSigSendType" SG_ 494 ACDrvSetTempSteplsReq_TC 2;
BA_ "Origin" SG_ 494 ACPassSetTempSteplsReq_TC "fuel,ev";
BA_ "Match" SG_ 494 ACPassSetTempSteplsReq_TC "ACPassSetTempSteplsReq_TC";
BA_ "GenSigSendType" SG_ 494 ACPassSetTempSteplsReq_TC 2;
BA_ "Origin" SG_ 494 SDWSwtSet "fuel,ev";
BA_ "Match" SG_ 494 SDWSwtSet "SDWSwtSet";
BA_ "GenSigSendType" SG_ 494 SDWSwtSet 2;
BA_ "Origin" SG_ 494 APSSwtReq_VR "fuel,ev";
BA_ "Match" SG_ 494 APSSwtReq_VR "APSSwtReq_VR";
BA_ "GenSigSendType" SG_ 494 APSSwtReq_VR 2;
BA_ "Origin" SG_ 494 APSPrkgTypSeln "fuel,ev";
BA_ "Match" SG_ 494 APSPrkgTypSeln "APSPrkgTypSeln";
BA_ "GenSigSendType" SG_ 494 APSPrkgTypSeln 2;
BA_ "Origin" SG_ 494 SportModLightSet "fuel,ev";
BA_ "Match" SG_ 494 SportModLightSet "SportModLightSet";
BA_ "GenSigStartValue" SG_ 494 SportModLightSet 1;
BA_ "GenSigSendType" SG_ 494 SportModLightSet 2;
BA_ "Origin" SG_ 494 ABSLmpSet "fuel,ev";
BA_ "Match" SG_ 494 ABSLmpSet "ABSLmpSet";
BA_ "GenSigStartValue" SG_ 494 ABSLmpSet 1;
BA_ "GenSigSendType" SG_ 494 ABSLmpSet 2;
BA_ "Origin" SG_ 494 AutoWshWipSet "fuel,ev";
BA_ "Match" SG_ 494 AutoWshWipSet "AutoWshWipSet";
BA_ "GenSigStartValue" SG_ 494 AutoWshWipSet 2;
BA_ "GenSigSendType" SG_ 494 AutoWshWipSet 2;
BA_ "Origin" SG_ 494 SeekVehSet "fuel,ev";
BA_ "Match" SG_ 494 SeekVehSet "SeekVehSet";
BA_ "GenSigSendType" SG_ 494 SeekVehSet 2;
BA_ "Origin" SG_ 494 SpdAutoLockModSet "fuel,ev";
BA_ "Match" SG_ 494 SpdAutoLockModSet "SpdAutoLockModSet";
BA_ "GenSigStartValue" SG_ 494 SpdAutoLockModSet 2;
BA_ "GenSigSendType" SG_ 494 SpdAutoLockModSet 2;
BA_ "Origin" SG_ 494 ParkLmpSet "fuel,ev";
BA_ "Match" SG_ 494 ParkLmpSet "ParkLmpSet";
BA_ "GenSigStartValue" SG_ 494 ParkLmpSet 1;
BA_ "GenSigSendType" SG_ 494 ParkLmpSet 2;
BA_ "Origin" SG_ 494 DoorUnlockModSet "fuel,ev";
BA_ "Match" SG_ 494 DoorUnlockModSet "DoorUnlockModSet";
BA_ "GenSigSendType" SG_ 494 DoorUnlockModSet 2;
BA_ "Origin" SG_ 494 SteerWheelHeatSwtReq "fuel,ev";
BA_ "Match" SG_ 494 SteerWheelHeatSwtReq "SteerWheelHeatSwtReq";
BA_ "GenSigStartValue" SG_ 494 SteerWheelHeatSwtReq 1;
BA_ "GenSigSendType" SG_ 494 SteerWheelHeatSwtReq 2;
BA_ "Origin" SG_ 494 PASExitSpdSwt "fuel,ev";
BA_ "Match" SG_ 494 PASExitSpdSwt "PASExitSpdSwt";
BA_ "GenSigSendType" SG_ 494 PASExitSpdSwt 2;
BA_ "Origin" SG_ 494 FreshnessValue_HUT15 "fuel,ev";
BA_ "Match" SG_ 494 FreshnessValue_HUT15 "FreshnessValue_HUT15";
BA_ "GenSigSendType" SG_ 494 FreshnessValue_HUT15 2;
BA_ "Origin" SG_ 494 MAC_Check_HUT15 "fuel,ev";
BA_ "Match" SG_ 494 MAC_Check_HUT15 "MAC_Check_HUT15";
BA_ "GenSigSendType" SG_ 494 MAC_Check_HUT15 2;
BA_ "TransparentInitValue" SG_ 494 HUT15_0x1EE "5 81 0 2 0 0 0 0 0 0 0 0 0 0 0 0 ";
BA_ "GenSigSendType" SG_ 494 HUT15_0x1EE 2;
BA_ "Origin" SG_ 497 AntiDisIdnRndNumber "fuel,ev";
BA_ "Match" SG_ 497 AntiDisIdnRndNumber "AntiDisIdnRndNumber";
BA_ "GenSigSendType" SG_ 497 AntiDisIdnRndNumber 2;
BA_ "TransparentInitValue" SG_ 497 ETC2_0x1F1 "0 0 0 0 0 0 0 0 ";
BA_ "GenSigSendType" SG_ 497 ETC2_0x1F1 2;
BA_ "Origin" SG_ 498 TransSts "fuel,ev";
BA_ "Match" SG_ 498 TransSts "TransSts";
BA_ "GenSigSendType" SG_ 498 TransSts 2;
BA_ "Origin" SG_ 498 EntrAndExitCdn "fuel,ev";
BA_ "Match" SG_ 498 EntrAndExitCdn "EntrAndExitCdn";
BA_ "GenSigSendType" SG_ 498 EntrAndExitCdn 2;
BA_ "Origin" SG_ 498 TransAmnt "fuel,ev";
BA_ "Match" SG_ 498 TransAmnt "TransAmnt";
BA_ "GenSigSendType" SG_ 498 TransAmnt 2;
BA_ "TransparentInitValue" SG_ 498 ETC4_0x1F2 "0 0 0 0 0 0 0 0 ";
BA_ "GenSigSendType" SG_ 498 ETC4_0x1F2 2;
BA_ "Origin" SG_ 505 ACRLTempSteplsReq_TC "fuel,ev";
BA_ "Match" SG_ 505 ACRLTempSteplsReq_TC "ACRLTempSteplsReq_TC";
BA_ "GenSigSendType" SG_ 505 ACRLTempSteplsReq_TC 2;
BA_ "TransparentInitValue" SG_ 505 HUT42_0x1F9 "0 0 0 0 0 0 0 0 ";
BA_ "GenSigSendType" SG_ 505 HUT42_0x1F9 2;
BA_ "Origin" SG_ 506 BLE_BeanID "fuel,ev";
BA_ "Match" SG_ 506 BLE_BeanID "BLE_BeanID";
BA_ "GenSigSendType" SG_ 506 BLE_BeanID 2;
BA_ "TransparentInitValue" SG_ 506 BLE5_0x1FA "0 0 0 0 0 0 0 0 ";
BA_ "GenSigSendType" SG_ 506 BLE5_0x1FA 2;
BA_ "Origin" SG_ 507 RRDoorALCMClrSet "fuel,ev";
BA_ "Match" SG_ 507 RRDoorALCMClrSet "RRDoorALCMClrSet";
BA_ "GenSigStartValue" SG_ 507 RRDoorALCMClrSet 64;
BA_ "GenSigSendType" SG_ 507 RRDoorALCMClrSet 2;
BA_ "Origin" SG_ 507 LeftPanelALCMClrSet "fuel,ev";
BA_ "Match" SG_ 507 LeftPanelALCMClrSet "LeftPanelALCMClrSet";
BA_ "GenSigStartValue" SG_ 507 LeftPanelALCMClrSet 64;
BA_ "GenSigSendType" SG_ 507 LeftPanelALCMClrSet 2;
BA_ "Origin" SG_ 507 RightPanelALCMClrSet "fuel,ev";
BA_ "Match" SG_ 507 RightPanelALCMClrSet "RightPanelALCMClrSet";
BA_ "GenSigStartValue" SG_ 507 RightPanelALCMClrSet 64;
BA_ "GenSigSendType" SG_ 507 RightPanelALCMClrSet 2;
BA_ "Origin" SG_ 507 FootALCMClrSet "fuel";
BA_ "Match" SG_ 507 FootALCMClrSet "FootALCMClrSet";
BA_ "GenSigStartValue" SG_ 507 FootALCMClrSet 64;
BA_ "GenSigSendType" SG_ 507 FootALCMClrSet 2;
BA_ "Origin" SG_ 507 DrvDoorALCMLightLvlSet "fuel,ev";
BA_ "Match" SG_ 507 DrvDoorALCMLightLvlSet "DrvDoorALCMLightLvlSet";
BA_ "GenSigSendType" SG_ 507 DrvDoorALCMLightLvlSet 2;
BA_ "Origin" SG_ 507 PassDoorALCMLightLvlSet "fuel,ev";
BA_ "Match" SG_ 507 PassDoorALCMLightLvlSet "PassDoorALCMLightLvlSet";
BA_ "GenSigSendType" SG_ 507 PassDoorALCMLightLvlSet 2;
BA_ "Origin" SG_ 507 LRDoorALCMLightLvlSet "fuel,ev";
BA_ "Match" SG_ 507 LRDoorALCMLightLvlSet "LRDoorALCMLightLvlSet";
BA_ "GenSigSendType" SG_ 507 LRDoorALCMLightLvlSet 2;
BA_ "Origin" SG_ 507 RRDoorALCMLightLvlSet "fuel,ev";
BA_ "Match" SG_ 507 RRDoorALCMLightLvlSet "RRDoorALCMLightLvlSet";
BA_ "GenSigSendType" SG_ 507 RRDoorALCMLightLvlSet 2;
BA_ "Origin" SG_ 507 LeftPanelALCMLightLvlSet "fuel,ev";
BA_ "Match" SG_ 507 LeftPanelALCMLightLvlSet "LeftPanelALCMLightLvlSet";
BA_ "GenSigSendType" SG_ 507 LeftPanelALCMLightLvlSet 2;
BA_ "Origin" SG_ 507 RightPanelALCMLightLvlSet "fuel,ev";
BA_ "Match" SG_ 507 RightPanelALCMLightLvlSet "RightPanelALCMLightLvlSet";
BA_ "GenSigSendType" SG_ 507 RightPanelALCMLightLvlSet 2;
BA_ "Origin" SG_ 507 FootALCMLightLvlSet "fuel";
BA_ "Match" SG_ 507 FootALCMLightLvlSet "FootALCMLightLvlSet";
BA_ "GenSigSendType" SG_ 507 FootALCMLightLvlSet 2;
BA_ "Origin" SG_ 507 ALCMFloSwt "fuel,ev";
BA_ "Match" SG_ 507 ALCMFloSwt "ALCMFloSwt";
BA_ "GenSigSendType" SG_ 507 ALCMFloSwt 2;
BA_ "Origin" SG_ 507 ALCMBreSwt "fuel,ev";
BA_ "Match" SG_ 507 ALCMBreSwt "ALCMBreSwt";
BA_ "GenSigSendType" SG_ 507 ALCMBreSwt 2;
BA_ "Origin" SG_ 507 RightPanelALCMSwt "fuel,ev";
BA_ "Match" SG_ 507 RightPanelALCMSwt "RightPanelALCMSwt";
BA_ "GenSigSendType" SG_ 507 RightPanelALCMSwt 2;
BA_ "Origin" SG_ 507 LRDoorALCMSwt "fuel,ev";
BA_ "Match" SG_ 507 LRDoorALCMSwt "LRDoorALCMSwt";
BA_ "GenSigSendType" SG_ 507 LRDoorALCMSwt 2;
BA_ "Origin" SG_ 507 RRDoorALCMSwt "fuel,ev";
BA_ "Match" SG_ 507 RRDoorALCMSwt "RRDoorALCMSwt";
BA_ "GenSigSendType" SG_ 507 RRDoorALCMSwt 2;
BA_ "Origin" SG_ 507 FootALCMSwt "fuel,ev";
BA_ "Match" SG_ 507 FootALCMSwt "FootALCMSwt";
BA_ "GenSigSendType" SG_ 507 FootALCMSwt 2;
BA_ "Origin" SG_ 507 RoofALCMSwt "fuel,ev";
BA_ "Match" SG_ 507 RoofALCMSwt "RoofALCMSwt";
BA_ "GenSigSendType" SG_ 507 RoofALCMSwt 2;
BA_ "Origin" SG_ 507 LeftPanelALCMSwt "fuel,ev";
BA_ "Match" SG_ 507 LeftPanelALCMSwt "LeftPanelALCMSwt";
BA_ "GenSigStartValue" SG_ 507 LeftPanelALCMSwt 1;
BA_ "GenSigSendType" SG_ 507 LeftPanelALCMSwt 2;
BA_ "TransparentInitValue" SG_ 507 HUT41_0x1FB "128 128 129 128 0 0 0 0 ";
BA_ "GenSigSendType" SG_ 507 HUT41_0x1FB 2;
BA_ "Origin" SG_ 509 RLSeatMassgModSet "fuel,ev";
BA_ "Match" SG_ 509 RLSeatMassgModSet "RLSeatMassgModSet";
BA_ "GenSigSendType" SG_ 509 RLSeatMassgModSet 2;
BA_ "Origin" SG_ 509 RRSeatMassgModSet "fuel,ev";
BA_ "Match" SG_ 509 RRSeatMassgModSet "RRSeatMassgModSet";
BA_ "GenSigSendType" SG_ 509 RRSeatMassgModSet 2;
BA_ "Origin" SG_ 509 DrvSeatHeatgLvlSet_Nine "fuel,ev";
BA_ "Match" SG_ 509 DrvSeatHeatgLvlSet_Nine "DrvSeatHeatgLvlSet_Nine";
BA_ "GenSigSendType" SG_ 509 DrvSeatHeatgLvlSet_Nine 2;
BA_ "Origin" SG_ 509 PassSeatHeatgLvlSet_Nine "fuel,ev";
BA_ "Match" SG_ 509 PassSeatHeatgLvlSet_Nine "PassSeatHeatgLvlSet_Nine";
BA_ "GenSigSendType" SG_ 509 PassSeatHeatgLvlSet_Nine 2;
BA_ "Origin" SG_ 509 RLSeatHeatgLvlSet_Nine "fuel,ev";
BA_ "Match" SG_ 509 RLSeatHeatgLvlSet_Nine "RLSeatHeatgLvlSet_Nine";
BA_ "GenSigSendType" SG_ 509 RLSeatHeatgLvlSet_Nine 2;
BA_ "Origin" SG_ 509 RRSeatHeatgLvlSet_Nine "fuel,ev";
BA_ "Match" SG_ 509 RRSeatHeatgLvlSet_Nine "RRSeatHeatgLvlSet_Nine";
BA_ "GenSigSendType" SG_ 509 RRSeatHeatgLvlSet_Nine 2;
BA_ "TransparentInitValue" SG_ 509 HUT43_0x1FD "0 0 0 0 0 0 0 0 ";
BA_ "GenSigSendType" SG_ 509 HUT43_0x1FD 2;
BA_ "Origin" SG_ 545 CurrentGearValid "fuel,ev";
BA_ "Match" SG_ 545 CurrentGearValid "CurrentGearValid";
BA_ "GenSigCycleTime" SG_ 545 CurrentGearValid 20;
BA_ "Origin" SG_ 545 CURRENT_GEAR "fuel,ev";
BA_ "Match" SG_ 545 CURRENT_GEAR "CURRENT_GEAR";
BA_ "GenSigCycleTime" SG_ 545 CURRENT_GEAR 20;
BA_ "Origin" SG_ 545 TGS_LEVER "fuel,ev";
BA_ "Match" SG_ 545 TGS_LEVER "TGS_LEVER";
BA_ "GenSigStartValue" SG_ 545 TGS_LEVER 14;
BA_ "GenSigCycleTime" SG_ 545 TGS_LEVER 20;
BA_ "Origin" SG_ 545 TRANS_Warning_LAMP "fuel,ev";
BA_ "Match" SG_ 545 TRANS_Warning_LAMP "TRANS_Warning_LAMP";
BA_ "GenSigCycleTime" SG_ 545 TRANS_Warning_LAMP 20;
BA_ "TransparentInitValue" SG_ 545 DCT5_0x221 "0 0 0 0 0 0 14 0 ";
BA_ "GenSigCycleTime" SG_ 545 DCT5_0x221 20;
BA_ "Origin" SG_ 546 IFC_Line01_DxStart "fuel,ev";
BA_ "Match" SG_ 546 IFC_Line01_DxStart "IFC_Line01_DxStart";
BA_ "GenSigCycleTime" SG_ 546 IFC_Line01_DxStart 50;
BA_ "Origin" SG_ 546 IFC_Line01_DxEnd "fuel,ev";
BA_ "Match" SG_ 546 IFC_Line01_DxEnd "IFC_Line01_DxEnd";
BA_ "GenSigCycleTime" SG_ 546 IFC_Line01_DxEnd 50;
BA_ "Origin" SG_ 546 IFC_Line01_HeadingAngle "fuel,ev";
BA_ "Match" SG_ 546 IFC_Line01_HeadingAngle "IFC_Line01_HeadingAngle";
BA_ "GenSigStartValue" SG_ 546 IFC_Line01_HeadingAngle 201;
BA_ "GenSigCycleTime" SG_ 546 IFC_Line01_HeadingAngle 50;
BA_ "Origin" SG_ 546 IFC_Line02_HeadingAngle "fuel,ev";
BA_ "Match" SG_ 546 IFC_Line02_HeadingAngle "IFC_Line02_HeadingAngle";
BA_ "GenSigStartValue" SG_ 546 IFC_Line02_HeadingAngle 201;
BA_ "GenSigCycleTime" SG_ 546 IFC_Line02_HeadingAngle 50;
BA_ "Origin" SG_ 546 IFC_Line02_DxStart "fuel,ev";
BA_ "Match" SG_ 546 IFC_Line02_DxStart "IFC_Line02_DxStart";
BA_ "GenSigCycleTime" SG_ 546 IFC_Line02_DxStart 50;
BA_ "Origin" SG_ 546 IFC_Line02_DxEnd "fuel,ev";
BA_ "Match" SG_ 546 IFC_Line02_DxEnd "IFC_Line02_DxEnd";
BA_ "GenSigCycleTime" SG_ 546 IFC_Line02_DxEnd 50;
BA_ "Origin" SG_ 546 IFC_Line03_DxStart "fuel,ev";
BA_ "Match" SG_ 546 IFC_Line03_DxStart "IFC_Line03_DxStart";
BA_ "GenSigCycleTime" SG_ 546 IFC_Line03_DxStart 50;
BA_ "Origin" SG_ 546 IFC_Line03_DxEnd "fuel,ev";
BA_ "Match" SG_ 546 IFC_Line03_DxEnd "IFC_Line03_DxEnd";
BA_ "GenSigCycleTime" SG_ 546 IFC_Line03_DxEnd 50;
BA_ "Origin" SG_ 546 IFC_Line03_HeadingAngle "fuel,ev";
BA_ "Match" SG_ 546 IFC_Line03_HeadingAngle "IFC_Line03_HeadingAngle";
BA_ "GenSigStartValue" SG_ 546 IFC_Line03_HeadingAngle 201;
BA_ "GenSigCycleTime" SG_ 546 IFC_Line03_HeadingAngle 50;
BA_ "Origin" SG_ 546 IFC_Line04_DxStart "fuel,ev";
BA_ "Match" SG_ 546 IFC_Line04_DxStart "IFC_Line04_DxStart";
BA_ "GenSigCycleTime" SG_ 546 IFC_Line04_DxStart 50;
BA_ "Origin" SG_ 546 IFC_Line04_HeadingAngle "fuel,ev";
BA_ "Match" SG_ 546 IFC_Line04_HeadingAngle "IFC_Line04_HeadingAngle";
BA_ "GenSigStartValue" SG_ 546 IFC_Line04_HeadingAngle 201;
BA_ "GenSigCycleTime" SG_ 546 IFC_Line04_HeadingAngle 50;
BA_ "Origin" SG_ 546 IFC_Line04_DxEnd "fuel,ev";
BA_ "Match" SG_ 546 IFC_Line04_DxEnd "IFC_Line04_DxEnd";
BA_ "GenSigCycleTime" SG_ 546 IFC_Line04_DxEnd 50;
BA_ "Origin" SG_ 546 IFC_Roadedge01_DxStart "fuel,ev";
BA_ "Match" SG_ 546 IFC_Roadedge01_DxStart "IFC_Roadedge01_DxStart";
BA_ "GenSigCycleTime" SG_ 546 IFC_Roadedge01_DxStart 50;
BA_ "Origin" SG_ 546 IFC_Roadedge01_DxEnd "fuel,ev";
BA_ "Match" SG_ 546 IFC_Roadedge01_DxEnd "IFC_Roadedge01_DxEnd";
BA_ "GenSigCycleTime" SG_ 546 IFC_Roadedge01_DxEnd 50;
BA_ "Origin" SG_ 546 IFC_Roadedge01_HeadingAngle "fuel,ev";
BA_ "Match" SG_ 546 IFC_Roadedge01_HeadingAngle "IFC_Roadedge01_HeadingAngle";
BA_ "GenSigStartValue" SG_ 546 IFC_Roadedge01_HeadingAngle 201;
BA_ "GenSigCycleTime" SG_ 546 IFC_Roadedge01_HeadingAngle 50;
BA_ "Origin" SG_ 546 IFC_Roadedge02_DxStart "fuel,ev";
BA_ "Match" SG_ 546 IFC_Roadedge02_DxStart "IFC_Roadedge02_DxStart";
BA_ "GenSigCycleTime" SG_ 546 IFC_Roadedge02_DxStart 50;
BA_ "Origin" SG_ 546 IFC_Roadedge02_DxEnd "fuel,ev";
BA_ "Match" SG_ 546 IFC_Roadedge02_DxEnd "IFC_Roadedge02_DxEnd";
BA_ "GenSigCycleTime" SG_ 546 IFC_Roadedge02_DxEnd 50;
BA_ "Origin" SG_ 546 IFC_Roadedge02_HeadingAngle "fuel,ev";
BA_ "Match" SG_ 546 IFC_Roadedge02_HeadingAngle "IFC_Roadedge02_HeadingAngle";
BA_ "GenSigStartValue" SG_ 546 IFC_Roadedge02_HeadingAngle 201;
BA_ "GenSigCycleTime" SG_ 546 IFC_Roadedge02_HeadingAngle 50;
BA_ "TransparentInitValue" SG_ 546 IFC_FD6_0x222 "0 0 0 0 1 146 201 0 0 0 0 0 0 0 0 0 0 0 0 201 0 0 201 0 0 0 0 0 0 0 0 0 0 100 128 0 0 0 201 0 0 0 0 0 0 0 0 0 0 0 0 0 0 0 0 0 0 0 0 0 0 0 0 0 ";
BA_ "GenSigCycleTime" SG_ 546 IFC_FD6_0x222 50;
BA_ "Origin" SG_ 548 ALCMMasterSwt "fuel,ev";
BA_ "Match" SG_ 548 ALCMMasterSwt "ALCMMasterSwt";
BA_ "GenSigStartValue" SG_ 548 ALCMMasterSwt 1;
BA_ "GenSigCycleTime" SG_ 548 ALCMMasterSwt 50;
BA_ "Origin" SG_ 548 ALCMPartitionSwt "fuel,ev";
BA_ "Match" SG_ 548 ALCMPartitionSwt "ALCMPartitionSwt";
BA_ "GenSigCycleTime" SG_ 548 ALCMPartitionSwt 50;
BA_ "Origin" SG_ 548 MusicFrq0 "fuel,ev";
BA_ "Match" SG_ 548 MusicFrq0 "MusicFrq0";
BA_ "GenSigStartValue" SG_ 548 MusicFrq0 101;
BA_ "GenSigCycleTime" SG_ 548 MusicFrq0 50;
BA_ "Origin" SG_ 548 MusicFrq1 "fuel,ev";
BA_ "Match" SG_ 548 MusicFrq1 "MusicFrq1";
BA_ "GenSigStartValue" SG_ 548 MusicFrq1 101;
BA_ "GenSigCycleTime" SG_ 548 MusicFrq1 50;
BA_ "Origin" SG_ 548 MusicFrq2 "fuel,ev";
BA_ "Match" SG_ 548 MusicFrq2 "MusicFrq2";
BA_ "GenSigStartValue" SG_ 548 MusicFrq2 101;
BA_ "GenSigCycleTime" SG_ 548 MusicFrq2 50;
BA_ "Origin" SG_ 548 MusicFrq3 "fuel,ev";
BA_ "Match" SG_ 548 MusicFrq3 "MusicFrq3";
BA_ "GenSigStartValue" SG_ 548 MusicFrq3 101;
BA_ "GenSigCycleTime" SG_ 548 MusicFrq3 50;
BA_ "Origin" SG_ 548 MusicFrq4 "fuel,ev";
BA_ "Match" SG_ 548 MusicFrq4 "MusicFrq4";
BA_ "GenSigStartValue" SG_ 548 MusicFrq4 101;
BA_ "GenSigCycleTime" SG_ 548 MusicFrq4 50;
BA_ "Origin" SG_ 548 MusicFrq5 "fuel,ev";
BA_ "Match" SG_ 548 MusicFrq5 "MusicFrq5";
BA_ "GenSigStartValue" SG_ 548 MusicFrq5 101;
BA_ "GenSigCycleTime" SG_ 548 MusicFrq5 50;
BA_ "Origin" SG_ 548 MusicFrq6 "fuel,ev";
BA_ "Match" SG_ 548 MusicFrq6 "MusicFrq6";
BA_ "GenSigStartValue" SG_ 548 MusicFrq6 101;
BA_ "GenSigCycleTime" SG_ 548 MusicFrq6 50;
BA_ "TransparentInitValue" SG_ 548 HUT40_0x224 "0 203 151 46 92 185 114 160 ";
BA_ "GenSigCycleTime" SG_ 548 HUT40_0x224 50;
BA_ "Origin" SG_ 551 Checksum_AEB2 "fuel,ev";
BA_ "Match" SG_ 551 Checksum_AEB2 "Checksum_AEB2";
BA_ "GenSigCycleTime" SG_ 551 Checksum_AEB2 50;
BA_ "Origin" SG_ 551 AEB_PedResp "fuel,ev";
BA_ "Match" SG_ 551 AEB_PedResp "AEB_PedResp";
BA_ "GenSigStartValue" SG_ 551 AEB_PedResp 1;
BA_ "GenSigCycleTime" SG_ 551 AEB_PedResp 50;
BA_ "Origin" SG_ 551 AEB_VehResp "fuel,ev";
BA_ "Match" SG_ 551 AEB_VehResp "AEB_VehResp";
BA_ "GenSigStartValue" SG_ 551 AEB_VehResp 1;
BA_ "GenSigCycleTime" SG_ 551 AEB_VehResp 50;
BA_ "Origin" SG_ 551 FCW_Snvty "fuel,ev";
BA_ "Match" SG_ 551 FCW_Snvty "FCW_Snvty";
BA_ "GenSigCycleTime" SG_ 551 FCW_Snvty 50;
BA_ "Origin" SG_ 551 AEB_JA_Resp "fuel,ev";
BA_ "Match" SG_ 551 AEB_JA_Resp "AEB_JA_Resp";
BA_ "GenSigStartValue" SG_ 551 AEB_JA_Resp 1;
BA_ "GenSigCycleTime" SG_ 551 AEB_JA_Resp 50;
BA_ "Origin" SG_ 551 RollingCounter_AEB2 "fuel,ev";
BA_ "Match" SG_ 551 RollingCounter_AEB2 "RollingCounter_AEB2";
BA_ "GenSigCycleTime" SG_ 551 RollingCounter_AEB2 50;
BA_ "Origin" SG_ 551 Checksum_AEB3 "fuel,ev";
BA_ "Match" SG_ 551 Checksum_AEB3 "Checksum_AEB3";
BA_ "GenSigCycleTime" SG_ 551 Checksum_AEB3 50;
BA_ "Origin" SG_ 551 AEB_VehTrig "fuel,ev";
BA_ "Match" SG_ 551 AEB_VehTrig "AEB_VehTrig";
BA_ "GenSigCycleTime" SG_ 551 AEB_VehTrig 50;
BA_ "Origin" SG_ 551 AEB_PedTrig "fuel,ev";
BA_ "Match" SG_ 551 AEB_PedTrig "AEB_PedTrig";
BA_ "GenSigCycleTime" SG_ 551 AEB_PedTrig 50;
BA_ "Origin" SG_ 551 FCW_AEB_VehFctSts "fuel,ev";
BA_ "Match" SG_ 551 FCW_AEB_VehFctSts "FCW_AEB_VehFctSts";
BA_ "GenSigCycleTime" SG_ 551 FCW_AEB_VehFctSts 50;
BA_ "Origin" SG_ 551 FCW_AEB_PedFctSts "fuel,ev";
BA_ "Match" SG_ 551 FCW_AEB_PedFctSts "FCW_AEB_PedFctSts";
BA_ "GenSigCycleTime" SG_ 551 FCW_AEB_PedFctSts 50;
BA_ "Origin" SG_ 551 FCW_Warn "fuel,ev";
BA_ "Match" SG_ 551 FCW_Warn "FCW_Warn";
BA_ "GenSigCycleTime" SG_ 551 FCW_Warn 50;
BA_ "Origin" SG_ 551 AEB_JAFuncSts "fuel,ev";
BA_ "Match" SG_ 551 AEB_JAFuncSts "AEB_JAFuncSts";
BA_ "GenSigCycleTime" SG_ 551 AEB_JAFuncSts 50;
BA_ "Origin" SG_ 551 AEB_JA_Warn "fuel,ev";
BA_ "Match" SG_ 551 AEB_JA_Warn "AEB_JA_Warn";
BA_ "GenSigCycleTime" SG_ 551 AEB_JA_Warn 50;
BA_ "Origin" SG_ 551 AEB_JABrkTrig "fuel,ev";
BA_ "Match" SG_ 551 AEB_JABrkTrig "AEB_JABrkTrig";
BA_ "GenSigCycleTime" SG_ 551 AEB_JABrkTrig 50;
BA_ "Origin" SG_ 551 RollingCounter_AEB3 "fuel,ev";
BA_ "Match" SG_ 551 RollingCounter_AEB3 "RollingCounter_AEB3";
BA_ "GenSigCycleTime" SG_ 551 RollingCounter_AEB3 50;
BA_ "Origin" SG_ 551 ACC_PotentialTgt_02_Dy "fuel,ev";
BA_ "Match" SG_ 551 ACC_PotentialTgt_02_Dy "ACC_PotentialTgt_02_Dy";
BA_ "GenSigCycleTime" SG_ 551 ACC_PotentialTgt_02_Dy 50;
BA_ "Origin" SG_ 551 ACC_PotentialTgt_02_Dx "fuel,ev";
BA_ "Match" SG_ 551 ACC_PotentialTgt_02_Dx "ACC_PotentialTgt_02_Dx";
BA_ "GenSigCycleTime" SG_ 551 ACC_PotentialTgt_02_Dx 50;
BA_ "Origin" SG_ 551 ACC_PotentialTgt_02_Detn "fuel,ev";
BA_ "Match" SG_ 551 ACC_PotentialTgt_02_Detn "ACC_PotentialTgt_02_Detn";
BA_ "GenSigCycleTime" SG_ 551 ACC_PotentialTgt_02_Detn 50;
BA_ "Origin" SG_ 551 ACC_PotentialTgt_02_Typ "fuel,ev";
BA_ "Match" SG_ 551 ACC_PotentialTgt_02_Typ "ACC_PotentialTgt_02_Typ";
BA_ "GenSigCycleTime" SG_ 551 ACC_PotentialTgt_02_Typ 50;
BA_ "Origin" SG_ 551 ACC_PotentialTgt_02_fusion "fuel,ev";
BA_ "Match" SG_ 551 ACC_PotentialTgt_02_fusion "ACC_PotentialTgt_02_fusion";
BA_ "GenSigCycleTime" SG_ 551 ACC_PotentialTgt_02_fusion 50;
BA_ "Origin" SG_ 551 ACC_PotentialTgt_02_Heading "fuel,ev";
BA_ "Match" SG_ 551 ACC_PotentialTgt_02_Heading "ACC_PotentialTgt_02_Heading";
BA_ "GenSigStartValue" SG_ 551 ACC_PotentialTgt_02_Heading 30;
BA_ "GenSigCycleTime" SG_ 551 ACC_PotentialTgt_02_Heading 50;
BA_ "Origin" SG_ 551 ACC_LeTgt_03_Dy "fuel,ev";
BA_ "Match" SG_ 551 ACC_LeTgt_03_Dy "ACC_LeTgt_03_Dy";
BA_ "GenSigCycleTime" SG_ 551 ACC_LeTgt_03_Dy 50;
BA_ "Origin" SG_ 551 ACC_LeTgt_03_Dx "fuel,ev";
BA_ "Match" SG_ 551 ACC_LeTgt_03_Dx "ACC_LeTgt_03_Dx";
BA_ "GenSigCycleTime" SG_ 551 ACC_LeTgt_03_Dx 50;
BA_ "Origin" SG_ 551 ACC_LeTargrt_03_Detn "fuel,ev";
BA_ "Match" SG_ 551 ACC_LeTargrt_03_Detn "ACC_LeTargrt_03_Detn";
BA_ "GenSigCycleTime" SG_ 551 ACC_LeTargrt_03_Detn 50;
BA_ "Origin" SG_ 551 ACC_LeTgt_03_Typ "fuel,ev";
BA_ "Match" SG_ 551 ACC_LeTgt_03_Typ "ACC_LeTgt_03_Typ";
BA_ "GenSigCycleTime" SG_ 551 ACC_LeTgt_03_Typ 50;
BA_ "Origin" SG_ 551 ACC_LeTgt_03_fusion "fuel,ev";
BA_ "Match" SG_ 551 ACC_LeTgt_03_fusion "ACC_LeTgt_03_fusion";
BA_ "GenSigCycleTime" SG_ 551 ACC_LeTgt_03_fusion 50;
BA_ "Origin" SG_ 551 ACC_LeTgt_03_Heading "fuel,ev";
BA_ "Match" SG_ 551 ACC_LeTgt_03_Heading "ACC_LeTgt_03_Heading";
BA_ "GenSigStartValue" SG_ 551 ACC_LeTgt_03_Heading 30;
BA_ "GenSigCycleTime" SG_ 551 ACC_LeTgt_03_Heading 50;
BA_ "Origin" SG_ 551 ACC_RiTgt_03_Dy "fuel,ev";
BA_ "Match" SG_ 551 ACC_RiTgt_03_Dy "ACC_RiTgt_03_Dy";
BA_ "GenSigCycleTime" SG_ 551 ACC_RiTgt_03_Dy 50;
BA_ "Origin" SG_ 551 ACC_RiTgt_03_Dx "fuel,ev";
BA_ "Match" SG_ 551 ACC_RiTgt_03_Dx "ACC_RiTgt_03_Dx";
BA_ "GenSigCycleTime" SG_ 551 ACC_RiTgt_03_Dx 50;
BA_ "Origin" SG_ 551 ACC_RiTargrt_03_Detn "fuel,ev";
BA_ "Match" SG_ 551 ACC_RiTargrt_03_Detn "ACC_RiTargrt_03_Detn";
BA_ "GenSigCycleTime" SG_ 551 ACC_RiTargrt_03_Detn 50;
BA_ "Origin" SG_ 551 ACC_RiTgt_03_Typ "fuel,ev";
BA_ "Match" SG_ 551 ACC_RiTgt_03_Typ "ACC_RiTgt_03_Typ";
BA_ "GenSigCycleTime" SG_ 551 ACC_RiTgt_03_Typ 50;
BA_ "Origin" SG_ 551 ACC_RiTgt_03_fusion "fuel,ev";
BA_ "Match" SG_ 551 ACC_RiTgt_03_fusion "ACC_RiTgt_03_fusion";
BA_ "GenSigCycleTime" SG_ 551 ACC_RiTgt_03_fusion 50;
BA_ "Origin" SG_ 551 ACC_RiTgt_03_Heading "fuel,ev";
BA_ "Match" SG_ 551 ACC_RiTgt_03_Heading "ACC_RiTgt_03_Heading";
BA_ "GenSigStartValue" SG_ 551 ACC_RiTgt_03_Heading 30;
BA_ "GenSigCycleTime" SG_ 551 ACC_RiTgt_03_Heading 50;
BA_ "Origin" SG_ 551 FreshnessValue_AEB_FD2 "fuel,ev";
BA_ "Match" SG_ 551 FreshnessValue_AEB_FD2 "FreshnessValue_AEB_FD2";
BA_ "GenSigCycleTime" SG_ 551 FreshnessValue_AEB_FD2 50;
BA_ "Origin" SG_ 551 MAC_Check_AEB_FD2 "fuel,ev";
BA_ "Match" SG_ 551 MAC_Check_AEB_FD2 "MAC_Check_AEB_FD2";
BA_ "GenSigCycleTime" SG_ 551 MAC_Check_AEB_FD2 50;
BA_ "TransparentInitValue" SG_ 551 AEB_FD2_0x227 "0 0 0 0 0 0 0 0 0 200 0 0 0 0 0 0 0 0 0 0 0 0 0 0 0 0 0 0 0 120 0 0 0 120 0 0 0 120 0 0 0 0 0 0 0 0 0 0 0 0 0 0 0 0 0 0 0 0 0 0 0 0 0 0 ";
BA_ "GenSigCycleTime" SG_ 551 AEB_FD2_0x227 50;
BA_ "Origin" SG_ 561 FLWheelDriveDirection "fuel,ev";
BA_ "Match" SG_ 561 FLWheelDriveDirection "FLWheelDriveDirection";
BA_ "GenSigCycleTime" SG_ 561 FLWheelDriveDirection 20;
BA_ "Origin" SG_ 561 FRWheelDriveDirection "fuel,ev";
BA_ "Match" SG_ 561 FRWheelDriveDirection "FRWheelDriveDirection";
BA_ "GenSigCycleTime" SG_ 561 FRWheelDriveDirection 20;
BA_ "Origin" SG_ 561 FLWheelSpd "fuel,ev";
BA_ "Match" SG_ 561 FLWheelSpd "FLWheelSpd";
BA_ "GenSigCycleTime" SG_ 561 FLWheelSpd 20;
BA_ "Origin" SG_ 561 FLWheelSpdVld "fuel,ev";
BA_ "Match" SG_ 561 FLWheelSpdVld "FLWheelSpdVld";
BA_ "GenSigCycleTime" SG_ 561 FLWheelSpdVld 20;
BA_ "Origin" SG_ 561 FRWheelSpdVld "fuel,ev";
BA_ "Match" SG_ 561 FRWheelSpdVld "FRWheelSpdVld";
BA_ "GenSigCycleTime" SG_ 561 FRWheelSpdVld 20;
BA_ "Origin" SG_ 561 FRWheelSpd "fuel,ev";
BA_ "Match" SG_ 561 FRWheelSpd "FRWheelSpd";
BA_ "GenSigCycleTime" SG_ 561 FRWheelSpd 20;
BA_ "Origin" SG_ 561 WssFLEdgesSum "fuel,ev";
BA_ "Match" SG_ 561 WssFLEdgesSum "WssFLEdgesSum";
BA_ "GenSigCycleTime" SG_ 561 WssFLEdgesSum 20;
BA_ "Origin" SG_ 561 WssFREdgesSum "fuel,ev";
BA_ "Match" SG_ 561 WssFREdgesSum "WssFREdgesSum";
BA_ "GenSigCycleTime" SG_ 561 WssFREdgesSum 20;
BA_ "Origin" SG_ 561 WssFLEdgesSumVld "fuel,ev";
BA_ "Match" SG_ 561 WssFLEdgesSumVld "WssFLEdgesSumVld";
BA_ "GenSigCycleTime" SG_ 561 WssFLEdgesSumVld 20;
BA_ "Origin" SG_ 561 WssFREdgesSumVld "fuel,ev";
BA_ "Match" SG_ 561 WssFREdgesSumVld "WssFREdgesSumVld";
BA_ "GenSigCycleTime" SG_ 561 WssFREdgesSumVld 20;
BA_ "TransparentInitValue" SG_ 561 ABS1_0x231 "0 0 0 0 0 0 0 0 ";
BA_ "GenSigCycleTime" SG_ 561 ABS1_0x231 20;
BA_ "Origin" SG_ 566 CheckSum_DCT7 "fuel,ev";
BA_ "Match" SG_ 566 CheckSum_DCT7 "CheckSum_DCT7";
BA_ "GenSigCycleTime" SG_ 566 CheckSum_DCT7 50;
BA_ "Origin" SG_ 566 TrsmStNID "fuel,ev";
BA_ "Match" SG_ 566 TrsmStNID "TrsmStNID";
BA_ "GenSigCycleTime" SG_ 566 TrsmStNID 50;
BA_ "Origin" SG_ 566 DCT_RaceModeSts "fuel";
BA_ "Match" SG_ 566 DCT_RaceModeSts "DCT_RaceModeSts";
BA_ "GenSigCycleTime" SG_ 566 DCT_RaceModeSts 50;
BA_ "Origin" SG_ 566 TRANS_OIL_TEMP "fuel,ev";
BA_ "Match" SG_ 566 TRANS_OIL_TEMP "TRANS_OIL_TEMP";
BA_ "GenSigCycleTime" SG_ 566 TRANS_OIL_TEMP 50;
BA_ "Origin" SG_ 566 DCT_PrsBrk_Warn "fuel,ev";
BA_ "Match" SG_ 566 DCT_PrsBrk_Warn "DCT_PrsBrk_Warn";
BA_ "GenSigCycleTime" SG_ 566 DCT_PrsBrk_Warn 50;
BA_ "Origin" SG_ 566 DCT_ShftNotAlwd_Warn "fuel,ev";
BA_ "Match" SG_ 566 DCT_ShftNotAlwd_Warn "DCT_ShftNotAlwd_Warn";
BA_ "GenSigCycleTime" SG_ 566 DCT_ShftNotAlwd_Warn 50;
BA_ "Origin" SG_ 566 DCT_ShftRecom_M "fuel,ev";
BA_ "Match" SG_ 566 DCT_ShftRecom_M "DCT_ShftRecom_M";
BA_ "GenSigCycleTime" SG_ 566 DCT_ShftRecom_M 50;
BA_ "Origin" SG_ 566 DrvWarnMsg "fuel,ev";
BA_ "Match" SG_ 566 DrvWarnMsg "DrvWarnMsg";
BA_ "GenSigCycleTime" SG_ 566 DrvWarnMsg 50;
BA_ "Origin" SG_ 566 DrvFaiMsg "fuel,ev";
BA_ "Match" SG_ 566 DrvFaiMsg "DrvFaiMsg";
BA_ "GenSigCycleTime" SG_ 566 DrvFaiMsg 50;
BA_ "Origin" SG_ 566 DrvModDisp "fuel,ev";
BA_ "Match" SG_ 566 DrvModDisp "DrvModDisp";
BA_ "GenSigCycleTime" SG_ 566 DrvModDisp 50;
BA_ "Origin" SG_ 566 DrvModDispSts "fuel,ev";
BA_ "Match" SG_ 566 DrvModDispSts "DrvModDispSts";
BA_ "GenSigCycleTime" SG_ 566 DrvModDispSts 50;
BA_ "Origin" SG_ 566 DrvAutoGearDisp "fuel,ev";
BA_ "Match" SG_ 566 DrvAutoGearDisp "DrvAutoGearDisp";
BA_ "GenSigCycleTime" SG_ 566 DrvAutoGearDisp 50;
BA_ "Origin" SG_ 566 DrvGearDispSts "fuel,ev";
BA_ "Match" SG_ 566 DrvGearDispSts "DrvGearDispSts";
BA_ "GenSigCycleTime" SG_ 566 DrvGearDispSts 50;
BA_ "Origin" SG_ 566 RollingCounter_DCT7 "fuel,ev";
BA_ "Match" SG_ 566 RollingCounter_DCT7 "RollingCounter_DCT7";
BA_ "GenSigCycleTime" SG_ 566 RollingCounter_DCT7 50;
BA_ "Origin" SG_ 566 FreshnessValue_DCT_FD4 "ev";
BA_ "Match" SG_ 566 FreshnessValue_DCT_FD4 "FreshnessValue_DCT_FD4";
BA_ "GenSigCycleTime" SG_ 566 FreshnessValue_DCT_FD4 50;
BA_ "Origin" SG_ 566 MAC_Check_DCT_FD4 "ev";
BA_ "Match" SG_ 566 MAC_Check_DCT_FD4 "MAC_Check_DCT_FD4";
BA_ "GenSigCycleTime" SG_ 566 MAC_Check_DCT_FD4 50;
BA_ "TransparentInitValue" SG_ 566 DCT_FD4_0x236 "0 0 0 0 0 0 0 0 0 0 0 0 0 0 0 0 0 0 0 0 0 0 0 0 0 0 0 0 0 0 0 0 0 0 0 0 0 0 0 0 0 0 0 0 0 0 0 0 0 0 0 0 0 0 0 0 0 0 0 0 0 0 0 0 ";
BA_ "GenSigCycleTime" SG_ 566 DCT_FD4_0x236 50;
BA_ "Origin" SG_ 568 SrAntiPinch "fuel,ev";
BA_ "Match" SG_ 568 SrAntiPinch "SrAntiPinch";
BA_ "GenSigCycleTime" SG_ 568 SrAntiPinch 50;
BA_ "Origin" SG_ 568 SsPosn_VR_APP "fuel,ev";
BA_ "Match" SG_ 568 SsPosn_VR_APP "SsPosn_VR_APP";
BA_ "GenSigStartValue" SG_ 568 SsPosn_VR_APP 127;
BA_ "GenSigCycleTime" SG_ 568 SsPosn_VR_APP 50;
BA_ "Origin" SG_ 568 SsAntiPinch "fuel,ev";
BA_ "Match" SG_ 568 SsAntiPinch "SsAntiPinch";
BA_ "GenSigCycleTime" SG_ 568 SsAntiPinch 50;
BA_ "Origin" SG_ 568 SrPosn_VR_APP "fuel,ev";
BA_ "Match" SG_ 568 SrPosn_VR_APP "SrPosn_VR_APP";
BA_ "GenSigStartValue" SG_ 568 SrPosn_VR_APP 127;
BA_ "GenSigCycleTime" SG_ 568 SrPosn_VR_APP 50;
BA_ "Origin" SG_ 568 RLS_IRBrightness "fuel,ev";
BA_ "Match" SG_ 568 RLS_IRBrightness "RLS_IRBrightness";
BA_ "GenSigCycleTime" SG_ 568 RLS_IRBrightness 50;
BA_ "Origin" SG_ 568 RLS_FwBrightness "fuel,ev";
BA_ "Match" SG_ 568 RLS_FwBrightness "RLS_FwBrightness";
BA_ "GenSigCycleTime" SG_ 568 RLS_FwBrightness 50;
BA_ "Origin" SG_ 568 RLS_AmbBrightness "fuel,ev";
BA_ "Match" SG_ 568 RLS_AmbBrightness "RLS_AmbBrightness";
BA_ "GenSigCycleTime" SG_ 568 RLS_AmbBrightness 50;
BA_ "TransparentInitValue" SG_ 568 BCM12_0x238 "0 0 0 0 0 127 127 0 ";
BA_ "GenSigCycleTime" SG_ 568 BCM12_0x238 50;
BA_ "Origin" SG_ 573 Checksum_IFC3 "fuel,ev";
BA_ "Match" SG_ 573 Checksum_IFC3 "Checksum_IFC3";
BA_ "GenSigCycleTime" SG_ 573 Checksum_IFC3 50;
BA_ "Origin" SG_ 573 LDWResp "fuel,ev";
BA_ "Match" SG_ 573 LDWResp "LDWResp";
BA_ "GenSigCycleTime" SG_ 573 LDWResp 50;
BA_ "Origin" SG_ 573 LKAResp "fuel,ev";
BA_ "Match" SG_ 573 LKAResp "LKAResp";
BA_ "GenSigCycleTime" SG_ 573 LKAResp 50;
BA_ "Origin" SG_ 573 LCKResp "fuel,ev";
BA_ "Match" SG_ 573 LCKResp "LCKResp";
BA_ "GenSigCycleTime" SG_ 573 LCKResp 50;
BA_ "Origin" SG_ 573 ELKResp "fuel,ev";
BA_ "Match" SG_ 573 ELKResp "ELKResp";
BA_ "GenSigCycleTime" SG_ 573 ELKResp 50;
BA_ "Origin" SG_ 573 LDW_LKA_Snvty "fuel,ev";
BA_ "Match" SG_ 573 LDW_LKA_Snvty "LDW_LKA_Snvty";
BA_ "GenSigCycleTime" SG_ 573 LDW_LKA_Snvty 50;
BA_ "Origin" SG_ 573 IFCHUTInterface "fuel,ev";
BA_ "Match" SG_ 573 IFCHUTInterface "IFCHUTInterface";
BA_ "GenSigCycleTime" SG_ 573 IFCHUTInterface 50;
BA_ "Origin" SG_ 573 LSSWarnFormResp "fuel,ev";
BA_ "Match" SG_ 573 LSSWarnFormResp "LSSWarnFormResp";
BA_ "GenSigCycleTime" SG_ 573 LSSWarnFormResp 50;
BA_ "Origin" SG_ 573 LSSResp "fuel,ev";
BA_ "Match" SG_ 573 LSSResp "LSSResp";
BA_ "GenSigCycleTime" SG_ 573 LSSResp 50;
BA_ "Origin" SG_ 573 AESSts "fuel,ev";
BA_ "Match" SG_ 573 AESSts "AESSts";
BA_ "GenSigCycleTime" SG_ 573 AESSts 50;
BA_ "Origin" SG_ 573 ESSSts "fuel,ev";
BA_ "Match" SG_ 573 ESSSts "ESSSts";
BA_ "GenSigCycleTime" SG_ 573 ESSSts 50;
BA_ "Origin" SG_ 573 AESErrSts "fuel,ev";
BA_ "Match" SG_ 573 AESErrSts "AESErrSts";
BA_ "GenSigCycleTime" SG_ 573 AESErrSts 50;
BA_ "Origin" SG_ 573 ESSErrSts "fuel,ev";
BA_ "Match" SG_ 573 ESSErrSts "ESSErrSts";
BA_ "GenSigCycleTime" SG_ 573 ESSErrSts 50;
BA_ "Origin" SG_ 573 RollingCounter_IFC3 "fuel,ev";
BA_ "Match" SG_ 573 RollingCounter_IFC3 "RollingCounter_IFC3";
BA_ "GenSigCycleTime" SG_ 573 RollingCounter_IFC3 50;
BA_ "Origin" SG_ 573 Checksum_IFC4 "fuel,ev";
BA_ "Match" SG_ 573 Checksum_IFC4 "Checksum_IFC4";
BA_ "GenSigCycleTime" SG_ 573 Checksum_IFC4 50;
BA_ "Origin" SG_ 573 IFC_Handsoffwarn "fuel,ev";
BA_ "Match" SG_ 573 IFC_Handsoffwarn "IFC_Handsoffwarn";
BA_ "GenSigCycleTime" SG_ 573 IFC_Handsoffwarn 50;
BA_ "Origin" SG_ 573 IFCCalibrationSts "fuel,ev";
BA_ "Match" SG_ 573 IFCCalibrationSts "IFCCalibrationSts";
BA_ "GenSigCycleTime" SG_ 573 IFCCalibrationSts 50;
BA_ "Origin" SG_ 573 CameraBlockageSts "fuel,ev";
BA_ "Match" SG_ 573 CameraBlockageSts "CameraBlockageSts";
BA_ "GenSigCycleTime" SG_ 573 CameraBlockageSts 50;
BA_ "Origin" SG_ 573 LDW_LKAWarn "fuel,ev";
BA_ "Match" SG_ 573 LDW_LKAWarn "LDW_LKAWarn";
BA_ "GenSigCycleTime" SG_ 573 LDW_LKAWarn 50;
BA_ "Origin" SG_ 573 LSSIntervention "fuel,ev";
BA_ "Match" SG_ 573 LSSIntervention "LSSIntervention";
BA_ "GenSigCycleTime" SG_ 573 LSSIntervention 50;
BA_ "Origin" SG_ 573 LSSFuncSts "fuel,ev";
BA_ "Match" SG_ 573 LSSFuncSts "LSSFuncSts";
BA_ "GenSigCycleTime" SG_ 573 LSSFuncSts 50;
BA_ "Origin" SG_ 573 ELKMainState "fuel,ev";
BA_ "Match" SG_ 573 ELKMainState "ELKMainState";
BA_ "GenSigCycleTime" SG_ 573 ELKMainState 50;
BA_ "Origin" SG_ 573 LaneAvailability "fuel,ev";
BA_ "Match" SG_ 573 LaneAvailability "LaneAvailability";
BA_ "GenSigCycleTime" SG_ 573 LaneAvailability 50;
BA_ "Origin" SG_ 573 TJA_FollowSts "fuel,ev";
BA_ "Match" SG_ 573 TJA_FollowSts "TJA_FollowSts";
BA_ "GenSigCycleTime" SG_ 573 TJA_FollowSts 50;
BA_ "Origin" SG_ 573 LSSErrSts "fuel,ev";
BA_ "Match" SG_ 573 LSSErrSts "LSSErrSts";
BA_ "GenSigCycleTime" SG_ 573 LSSErrSts 50;
BA_ "Origin" SG_ 573 AESintervention "fuel,ev";
BA_ "Match" SG_ 573 AESintervention "AESintervention";
BA_ "GenSigCycleTime" SG_ 573 AESintervention 50;
BA_ "Origin" SG_ 573 ESSintervention "fuel,ev";
BA_ "Match" SG_ 573 ESSintervention "ESSintervention";
BA_ "GenSigCycleTime" SG_ 573 ESSintervention 50;
BA_ "Origin" SG_ 573 ELKActSts "fuel,ev";
BA_ "Match" SG_ 573 ELKActSts "ELKActSts";
BA_ "GenSigCycleTime" SG_ 573 ELKActSts 50;
BA_ "Origin" SG_ 573 IntelligentEvaActSts "fuel,ev";
BA_ "Match" SG_ 573 IntelligentEvaActSts "IntelligentEvaActSts";
BA_ "GenSigCycleTime" SG_ 573 IntelligentEvaActSts 50;
BA_ "Origin" SG_ 573 LCKStsIndcr "fuel,ev";
BA_ "Match" SG_ 573 LCKStsIndcr "LCKStsIndcr";
BA_ "GenSigCycleTime" SG_ 573 LCKStsIndcr 50;
BA_ "Origin" SG_ 573 RollingCounter_IFC4 "fuel,ev";
BA_ "Match" SG_ 573 RollingCounter_IFC4 "RollingCounter_IFC4";
BA_ "GenSigCycleTime" SG_ 573 RollingCounter_IFC4 50;
BA_ "Origin" SG_ 573 Checksum_IFC5 "fuel,ev";
BA_ "Match" SG_ 573 Checksum_IFC5 "Checksum_IFC5";
BA_ "GenSigCycleTime" SG_ 573 Checksum_IFC5 50;
BA_ "Origin" SG_ 573 IFC_LaneCurve "fuel,ev";
BA_ "Match" SG_ 573 IFC_LaneCurve "IFC_LaneCurve";
BA_ "GenSigStartValue" SG_ 573 IFC_LaneCurve 2047;
BA_ "GenSigCycleTime" SG_ 573 IFC_LaneCurve 50;
BA_ "Origin" SG_ 573 IFC_LeLaneTyp "fuel,ev";
BA_ "Match" SG_ 573 IFC_LeLaneTyp "IFC_LeLaneTyp";
BA_ "GenSigCycleTime" SG_ 573 IFC_LeLaneTyp 50;
BA_ "Origin" SG_ 573 IFC_RiLaneTyp "fuel,ev";
BA_ "Match" SG_ 573 IFC_RiLaneTyp "IFC_RiLaneTyp";
BA_ "GenSigCycleTime" SG_ 573 IFC_RiLaneTyp 50;
BA_ "Origin" SG_ 573 IFC_NextLeLaneTyp "fuel,ev";
BA_ "Match" SG_ 573 IFC_NextLeLaneTyp "IFC_NextLeLaneTyp";
BA_ "GenSigCycleTime" SG_ 573 IFC_NextLeLaneTyp 50;
BA_ "Origin" SG_ 573 IFC_NextRiLaneTyp "fuel,ev";
BA_ "Match" SG_ 573 IFC_NextRiLaneTyp "IFC_NextRiLaneTyp";
BA_ "GenSigCycleTime" SG_ 573 IFC_NextRiLaneTyp 50;
BA_ "Origin" SG_ 573 IFC_LeLane_dy "fuel,ev";
BA_ "Match" SG_ 573 IFC_LeLane_dy "IFC_LeLane_dy";
BA_ "GenSigStartValue" SG_ 573 IFC_LeLane_dy 2496;
BA_ "GenSigCycleTime" SG_ 573 IFC_LeLane_dy 50;
BA_ "Origin" SG_ 573 IFC_RiLane_dy "fuel,ev";
BA_ "Match" SG_ 573 IFC_RiLane_dy "IFC_RiLane_dy";
BA_ "GenSigStartValue" SG_ 573 IFC_RiLane_dy 2496;
BA_ "GenSigCycleTime" SG_ 573 IFC_RiLane_dy 50;
BA_ "Origin" SG_ 573 RollingCounter_IFC5 "fuel,ev";
BA_ "Match" SG_ 573 RollingCounter_IFC5 "RollingCounter_IFC5";
BA_ "GenSigCycleTime" SG_ 573 RollingCounter_IFC5 50;
BA_ "Origin" SG_ 573 Checksum_IFC6 "fuel,ev";
BA_ "Match" SG_ 573 Checksum_IFC6 "Checksum_IFC6";
BA_ "GenSigCycleTime" SG_ 573 Checksum_IFC6 50;
BA_ "Origin" SG_ 573 IFC_NextLeLane_dy "fuel,ev";
BA_ "Match" SG_ 573 IFC_NextLeLane_dy "IFC_NextLeLane_dy";
BA_ "GenSigStartValue" SG_ 573 IFC_NextLeLane_dy 2496;
BA_ "GenSigCycleTime" SG_ 573 IFC_NextLeLane_dy 50;
BA_ "Origin" SG_ 573 IFC_NextRiLane_dy "fuel,ev";
BA_ "Match" SG_ 573 IFC_NextRiLane_dy "IFC_NextRiLane_dy";
BA_ "GenSigStartValue" SG_ 573 IFC_NextRiLane_dy 2496;
BA_ "GenSigCycleTime" SG_ 573 IFC_NextRiLane_dy 50;
BA_ "Origin" SG_ 573 RollingCounter_IFC6 "fuel,ev";
BA_ "Match" SG_ 573 RollingCounter_IFC6 "RollingCounter_IFC6";
BA_ "GenSigCycleTime" SG_ 573 RollingCounter_IFC6 50;
BA_ "Origin" SG_ 573 AESResp "fuel,ev";
BA_ "Match" SG_ 573 AESResp "AESResp";
BA_ "GenSigCycleTime" SG_ 573 AESResp 50;
BA_ "Origin" SG_ 573 ESS_Pedresp "fuel,ev";
BA_ "Match" SG_ 573 ESS_Pedresp "ESS_Pedresp";
BA_ "GenSigCycleTime" SG_ 573 ESS_Pedresp 50;
BA_ "Origin" SG_ 573 ESS_Vehresp "fuel,ev";
BA_ "Match" SG_ 573 ESS_Vehresp "ESS_Vehresp";
BA_ "GenSigCycleTime" SG_ 573 ESS_Vehresp 50;
BA_ "Origin" SG_ 573 IntelligentEvaResp "fuel,ev";
BA_ "Match" SG_ 573 IntelligentEvaResp "IntelligentEvaResp";
BA_ "GenSigCycleTime" SG_ 573 IntelligentEvaResp 50;
BA_ "Origin" SG_ 573 FreshnessValue_IFC_FD2 "fuel,ev";
BA_ "Match" SG_ 573 FreshnessValue_IFC_FD2 "FreshnessValue_IFC_FD2";
BA_ "GenSigCycleTime" SG_ 573 FreshnessValue_IFC_FD2 50;
BA_ "Origin" SG_ 573 MAC_Check_IFC_FD2 "fuel,ev";
BA_ "Match" SG_ 573 MAC_Check_IFC_FD2 "MAC_Check_IFC_FD2";
BA_ "GenSigCycleTime" SG_ 573 MAC_Check_IFC_FD2 50;
BA_ "TransparentInitValue" SG_ 573 IFC_FD2_0x23D "0 0 0 0 0 0 0 0 0 0 0 0 0 0 0 0 0 0 0 0 0 0 0 0 0 127 240 0 156 9 192 0 0 156 9 192 0 0 0 0 0 0 0 0 0 0 0 0 0 0 0 0 0 0 0 0 0 0 0 0 0 0 0 0 ";
BA_ "GenSigCycleTime" SG_ 573 IFC_FD2_0x23D 50;
BA_ "Origin" SG_ 579 AutoSpdSetSwt "fuel,ev";
BA_ "Match" SG_ 579 AutoSpdSetSwt "AutoSpdSetSwt";
BA_ "GenSigCycleTime" SG_ 579 AutoSpdSetSwt 50;
BA_ "Origin" SG_ 579 LaneChngCfmSwt "fuel,ev";
BA_ "Match" SG_ 579 LaneChngCfmSwt "LaneChngCfmSwt";
BA_ "GenSigCycleTime" SG_ 579 LaneChngCfmSwt 50;
BA_ "Origin" SG_ 579 VoiceBrdcSwt "fuel,ev";
BA_ "Match" SG_ 579 VoiceBrdcSwt "VoiceBrdcSwt";
BA_ "GenSigCycleTime" SG_ 579 VoiceBrdcSwt 50;
BA_ "Origin" SG_ 579 UsrManSts "fuel,ev";
BA_ "Match" SG_ 579 UsrManSts "UsrManSts";
BA_ "GenSigCycleTime" SG_ 579 UsrManSts 50;
BA_ "Origin" SG_ 579 HUT_OD_WorkSts "fuel,ev";
BA_ "Match" SG_ 579 HUT_OD_WorkSts "HUT_OD_WorkSts";
BA_ "GenSigCycleTime" SG_ 579 HUT_OD_WorkSts 50;
BA_ "Origin" SG_ 579 HUT_OD_Obj_Timestamp "fuel,ev";
BA_ "Match" SG_ 579 HUT_OD_Obj_Timestamp "HUT_OD_Obj_Timestamp";
BA_ "GenSigCycleTime" SG_ 579 HUT_OD_Obj_Timestamp 50;
BA_ "Origin" SG_ 579 HUT_FSD1_distance "fuel,ev";
BA_ "Match" SG_ 579 HUT_FSD1_distance "HUT_FSD1_distance";
BA_ "GenSigCycleTime" SG_ 579 HUT_FSD1_distance 50;
BA_ "Origin" SG_ 579 HUT_FSD2_distance "fuel,ev";
BA_ "Match" SG_ 579 HUT_FSD2_distance "HUT_FSD2_distance";
BA_ "GenSigCycleTime" SG_ 579 HUT_FSD2_distance 50;
BA_ "Origin" SG_ 579 HUT_FSD3_distance "fuel,ev";
BA_ "Match" SG_ 579 HUT_FSD3_distance "HUT_FSD3_distance";
BA_ "GenSigCycleTime" SG_ 579 HUT_FSD3_distance 50;
BA_ "Origin" SG_ 579 HUT_FSD4_distance "fuel,ev";
BA_ "Match" SG_ 579 HUT_FSD4_distance "HUT_FSD4_distance";
BA_ "GenSigCycleTime" SG_ 579 HUT_FSD4_distance 50;
BA_ "Origin" SG_ 579 HUT_FSD5_distance "fuel,ev";
BA_ "Match" SG_ 579 HUT_FSD5_distance "HUT_FSD5_distance";
BA_ "GenSigCycleTime" SG_ 579 HUT_FSD5_distance 50;
BA_ "Origin" SG_ 579 HUT_FSD6_distance "fuel,ev";
BA_ "Match" SG_ 579 HUT_FSD6_distance "HUT_FSD6_distance";
BA_ "GenSigCycleTime" SG_ 579 HUT_FSD6_distance 50;
BA_ "Origin" SG_ 579 HUT_FSD7_distance "fuel,ev";
BA_ "Match" SG_ 579 HUT_FSD7_distance "HUT_FSD7_distance";
BA_ "GenSigCycleTime" SG_ 579 HUT_FSD7_distance 50;
BA_ "Origin" SG_ 579 HUT_FSD8_distance "fuel,ev";
BA_ "Match" SG_ 579 HUT_FSD8_distance "HUT_FSD8_distance";
BA_ "GenSigCycleTime" SG_ 579 HUT_FSD8_distance 50;
BA_ "Origin" SG_ 579 HUT_FSD9_distance "fuel,ev";
BA_ "Match" SG_ 579 HUT_FSD9_distance "HUT_FSD9_distance";
BA_ "GenSigCycleTime" SG_ 579 HUT_FSD9_distance 50;
BA_ "Origin" SG_ 579 HUT_FSD10_distance "fuel,ev";
BA_ "Match" SG_ 579 HUT_FSD10_distance "HUT_FSD10_distance";
BA_ "GenSigCycleTime" SG_ 579 HUT_FSD10_distance 50;
BA_ "Origin" SG_ 579 HUT_FSD11_distance "fuel,ev";
BA_ "Match" SG_ 579 HUT_FSD11_distance "HUT_FSD11_distance";
BA_ "GenSigCycleTime" SG_ 579 HUT_FSD11_distance 50;
BA_ "Origin" SG_ 579 HUT_FSD12_distance "fuel,ev";
BA_ "Match" SG_ 579 HUT_FSD12_distance "HUT_FSD12_distance";
BA_ "GenSigCycleTime" SG_ 579 HUT_FSD12_distance 50;
BA_ "Origin" SG_ 579 HUT_FSD13_distance "fuel,ev";
BA_ "Match" SG_ 579 HUT_FSD13_distance "HUT_FSD13_distance";
BA_ "GenSigCycleTime" SG_ 579 HUT_FSD13_distance 50;
BA_ "Origin" SG_ 579 HUT_FSD14_distance "fuel,ev";
BA_ "Match" SG_ 579 HUT_FSD14_distance "HUT_FSD14_distance";
BA_ "GenSigCycleTime" SG_ 579 HUT_FSD14_distance 50;
BA_ "Origin" SG_ 579 HUT_FSD15_distance "fuel,ev";
BA_ "Match" SG_ 579 HUT_FSD15_distance "HUT_FSD15_distance";
BA_ "GenSigCycleTime" SG_ 579 HUT_FSD15_distance 50;
BA_ "Origin" SG_ 579 HUT_FSD16_distance "fuel,ev";
BA_ "Match" SG_ 579 HUT_FSD16_distance "HUT_FSD16_distance";
BA_ "GenSigCycleTime" SG_ 579 HUT_FSD16_distance 50;
BA_ "Origin" SG_ 579 HUT_FSD17_distance "fuel,ev";
BA_ "Match" SG_ 579 HUT_FSD17_distance "HUT_FSD17_distance";
BA_ "GenSigCycleTime" SG_ 579 HUT_FSD17_distance 50;
BA_ "Origin" SG_ 579 HUT_FSD18_distance "fuel,ev";
BA_ "Match" SG_ 579 HUT_FSD18_distance "HUT_FSD18_distance";
BA_ "GenSigCycleTime" SG_ 579 HUT_FSD18_distance 50;
BA_ "Origin" SG_ 579 NOH_Swt_Req "fuel,ev";
BA_ "Match" SG_ 579 NOH_Swt_Req "NOH_Swt_Req";
BA_ "GenSigCycleTime" SG_ 579 NOH_Swt_Req 50;
BA_ "Origin" SG_ 579 NOH_Act_Req "fuel,ev";
BA_ "Match" SG_ 579 NOH_Act_Req "NOH_Act_Req";
BA_ "GenSigCycleTime" SG_ 579 NOH_Act_Req 50;
BA_ "Origin" SG_ 579 HUT_OD_Obj7_ID "ev";
BA_ "Match" SG_ 579 HUT_OD_Obj7_ID "HUT_OD_Obj7_ID";
BA_ "GenSigCycleTime" SG_ 579 HUT_OD_Obj7_ID 50;
BA_ "Origin" SG_ 579 HUT_OD_Obj7_type "ev";
BA_ "Match" SG_ 579 HUT_OD_Obj7_type "HUT_OD_Obj7_type";
BA_ "GenSigCycleTime" SG_ 579 HUT_OD_Obj7_type 50;
BA_ "Origin" SG_ 579 HUT_OD_Obj7_Confidence "ev";
BA_ "Match" SG_ 579 HUT_OD_Obj7_Confidence "HUT_OD_Obj7_Confidence";
BA_ "GenSigCycleTime" SG_ 579 HUT_OD_Obj7_Confidence 50;
BA_ "Origin" SG_ 579 HUT_OD_Obj7_width "ev";
BA_ "Match" SG_ 579 HUT_OD_Obj7_width "HUT_OD_Obj7_width";
BA_ "GenSigCycleTime" SG_ 579 HUT_OD_Obj7_width 50;
BA_ "Origin" SG_ 579 HUT_OD_Obj7_Ground_Pos_X "ev";
BA_ "Match" SG_ 579 HUT_OD_Obj7_Ground_Pos_X "HUT_OD_Obj7_Ground_Pos_X";
BA_ "GenSigCycleTime" SG_ 579 HUT_OD_Obj7_Ground_Pos_X 50;
BA_ "Origin" SG_ 579 HUT_OD_Obj7_Ground_Pos_Y "ev";
BA_ "Match" SG_ 579 HUT_OD_Obj7_Ground_Pos_Y "HUT_OD_Obj7_Ground_Pos_Y";
BA_ "GenSigCycleTime" SG_ 579 HUT_OD_Obj7_Ground_Pos_Y 50;
BA_ "TransparentInitValue" SG_ 579 HUT_FD3_0x243 "0 0 0 0 0 0 0 0 0 0 0 0 0 0 0 0 0 0 0 0 0 0 0 0 0 0 0 0 0 0 0 0 0 0 0 0 0 0 0 0 0 0 0 0 0 0 0 0 0 0 0 0 0 0 0 0 0 0 0 0 0 0 0 0 ";
BA_ "GenSigCycleTime" SG_ 579 HUT_FD3_0x243 50;
BA_ "Origin" SG_ 580 MenuReturnSwtSts "fuel,ev";
BA_ "Match" SG_ 580 MenuReturnSwtSts "MenuReturnSwtSts";
BA_ "GenSigCycleTime" SG_ 580 MenuReturnSwtSts 50;
BA_ "Origin" SG_ 580 SteerWheelHeatdSts "fuel,ev";
BA_ "Match" SG_ 580 SteerWheelHeatdSts "SteerWheelHeatdSts";
BA_ "GenSigCycleTime" SG_ 580 SteerWheelHeatdSts 50;
BA_ "Origin" SG_ 580 HomeSwtSts "fuel,ev";
BA_ "Match" SG_ 580 HomeSwtSts "HomeSwtSts";
BA_ "GenSigCycleTime" SG_ 580 HomeSwtSts 50;
BA_ "Origin" SG_ 580 MuteSwtSts "fuel,ev";
BA_ "Match" SG_ 580 MuteSwtSts "MuteSwtSts";
BA_ "GenSigCycleTime" SG_ 580 MuteSwtSts 50;
BA_ "Origin" SG_ 580 CustomSwtSts "fuel,ev";
BA_ "Match" SG_ 580 CustomSwtSts "CustomSwtSts";
BA_ "GenSigCycleTime" SG_ 580 CustomSwtSts 50;
BA_ "Origin" SG_ 580 PageUpSwtSts "fuel,ev";
BA_ "Match" SG_ 580 PageUpSwtSts "PageUpSwtSts";
BA_ "GenSigCycleTime" SG_ 580 PageUpSwtSts 50;
BA_ "Origin" SG_ 580 PageDwnSwtSts "fuel,ev";
BA_ "Match" SG_ 580 PageDwnSwtSts "PageDwnSwtSts";
BA_ "GenSigCycleTime" SG_ 580 PageDwnSwtSts 50;
BA_ "Origin" SG_ 580 PageLSwtSts "fuel,ev";
BA_ "Match" SG_ 580 PageLSwtSts "PageLSwtSts";
BA_ "GenSigCycleTime" SG_ 580 PageLSwtSts 50;
BA_ "Origin" SG_ 580 PageRSwtSts "fuel,ev";
BA_ "Match" SG_ 580 PageRSwtSts "PageRSwtSts";
BA_ "GenSigCycleTime" SG_ 580 PageRSwtSts 50;
BA_ "Origin" SG_ 580 SeekUpSwtSts "fuel,ev";
BA_ "Match" SG_ 580 SeekUpSwtSts "SeekUpSwtSts";
BA_ "GenSigCycleTime" SG_ 580 SeekUpSwtSts 50;
BA_ "Origin" SG_ 580 SeekDwnSwtSts "fuel,ev";
BA_ "Match" SG_ 580 SeekDwnSwtSts "SeekDwnSwtSts";
BA_ "GenSigCycleTime" SG_ 580 SeekDwnSwtSts 50;
BA_ "Origin" SG_ 580 AdjVolUpSwtSts "fuel,ev";
BA_ "Match" SG_ 580 AdjVolUpSwtSts "AdjVolUpSwtSts";
BA_ "GenSigCycleTime" SG_ 580 AdjVolUpSwtSts 50;
BA_ "Origin" SG_ 580 AdjVolDwnSwtSts "fuel,ev";
BA_ "Match" SG_ 580 AdjVolDwnSwtSts "AdjVolDwnSwtSts";
BA_ "GenSigCycleTime" SG_ 580 AdjVolDwnSwtSts 50;
BA_ "Origin" SG_ 580 VRSwtSts "fuel,ev";
BA_ "Match" SG_ 580 VRSwtSts "VRSwtSts";
BA_ "GenSigCycleTime" SG_ 580 VRSwtSts 50;
BA_ "Origin" SG_ 580 EnterSwtSts "fuel,ev";
BA_ "Match" SG_ 580 EnterSwtSts "EnterSwtSts";
BA_ "GenSigCycleTime" SG_ 580 EnterSwtSts 50;
BA_ "Origin" SG_ 580 EnterSwtSts_Mmed "fuel,ev";
BA_ "Match" SG_ 580 EnterSwtSts_Mmed "EnterSwtSts_Mmed";
BA_ "GenSigCycleTime" SG_ 580 EnterSwtSts_Mmed 50;
BA_ "Origin" SG_ 580 CustomSwtSts_Mmed "fuel,ev";
BA_ "Match" SG_ 580 CustomSwtSts_Mmed "CustomSwtSts_Mmed";
BA_ "GenSigCycleTime" SG_ 580 CustomSwtSts_Mmed 50;
BA_ "Origin" SG_ 580 IpMenuSwtSts "fuel,ev";
BA_ "Match" SG_ 580 IpMenuSwtSts "IpMenuSwtSts";
BA_ "GenSigCycleTime" SG_ 580 IpMenuSwtSts 50;
BA_ "TransparentInitValue" SG_ 580 CSA3_0x244 "0 0 0 0 0 0 0 0 ";
BA_ "GenSigCycleTime" SG_ 580 CSA3_0x244 50;
BA_ "Origin" SG_ 581 VehLgtAccel "fuel,ev";
BA_ "Match" SG_ 581 VehLgtAccel "VehLgtAccel";
BA_ "GenSigStartValue" SG_ 581 VehLgtAccel 22033;
BA_ "GenSigCycleTime" SG_ 581 VehLgtAccel 20;
BA_ "Origin" SG_ 581 VehLatAccel "fuel,ev";
BA_ "Match" SG_ 581 VehLatAccel "VehLatAccel";
BA_ "GenSigStartValue" SG_ 581 VehLatAccel 22033;
BA_ "GenSigCycleTime" SG_ 581 VehLatAccel 20;
BA_ "Origin" SG_ 581 VehYawRate "fuel,ev";
BA_ "Match" SG_ 581 VehYawRate "VehYawRate";
BA_ "GenSigStartValue" SG_ 581 VehYawRate 8721;
BA_ "GenSigCycleTime" SG_ 581 VehYawRate 20;
BA_ "Origin" SG_ 581 VehLgtAccelVld "fuel,ev";
BA_ "Match" SG_ 581 VehLgtAccelVld "VehLgtAccelVld";
BA_ "GenSigCycleTime" SG_ 581 VehLgtAccelVld 20;
BA_ "Origin" SG_ 581 VehLatAccelVld "fuel,ev";
BA_ "Match" SG_ 581 VehLatAccelVld "VehLatAccelVld";
BA_ "GenSigCycleTime" SG_ 581 VehLatAccelVld 20;
BA_ "Origin" SG_ 581 VehDynYawRateVld "fuel,ev";
BA_ "Match" SG_ 581 VehDynYawRateVld "VehDynYawRateVld";
BA_ "GenSigCycleTime" SG_ 581 VehDynYawRateVld 20;
BA_ "TransparentInitValue" SG_ 581 ABM2_0x245 "0 86 17 86 17 34 17 0 ";
BA_ "GenSigCycleTime" SG_ 581 ABM2_0x245 20;
BA_ "Origin" SG_ 582 RLWheelSpdVld "fuel,ev";
BA_ "Match" SG_ 582 RLWheelSpdVld "RLWheelSpdVld";
BA_ "GenSigCycleTime" SG_ 582 RLWheelSpdVld 20;
BA_ "Origin" SG_ 582 RLWheelSpd "fuel,ev";
BA_ "Match" SG_ 582 RLWheelSpd "RLWheelSpd";
BA_ "GenSigCycleTime" SG_ 582 RLWheelSpd 20;
BA_ "Origin" SG_ 582 RRWheelSpdVld "fuel,ev";
BA_ "Match" SG_ 582 RRWheelSpdVld "RRWheelSpdVld";
BA_ "GenSigCycleTime" SG_ 582 RRWheelSpdVld 20;
BA_ "Origin" SG_ 582 RRWheelSpd "fuel,ev";
BA_ "Match" SG_ 582 RRWheelSpd "RRWheelSpd";
BA_ "GenSigCycleTime" SG_ 582 RRWheelSpd 20;
BA_ "Origin" SG_ 582 RLWheelDriveDirection "fuel,ev";
BA_ "Match" SG_ 582 RLWheelDriveDirection "RLWheelDriveDirection";
BA_ "GenSigCycleTime" SG_ 582 RLWheelDriveDirection 20;
BA_ "Origin" SG_ 582 RRWheelDriveDirection "fuel,ev";
BA_ "Match" SG_ 582 RRWheelDriveDirection "RRWheelDriveDirection";
BA_ "GenSigCycleTime" SG_ 582 RRWheelDriveDirection 20;
BA_ "Origin" SG_ 582 WssRREdgesSum "fuel,ev";
BA_ "Match" SG_ 582 WssRREdgesSum "WssRREdgesSum";
BA_ "GenSigCycleTime" SG_ 582 WssRREdgesSum 20;
BA_ "Origin" SG_ 582 WssRLEdgesSum "fuel,ev";
BA_ "Match" SG_ 582 WssRLEdgesSum "WssRLEdgesSum";
BA_ "GenSigCycleTime" SG_ 582 WssRLEdgesSum 20;
BA_ "Origin" SG_ 582 WssRLEdgesSumVld "fuel,ev";
BA_ "Match" SG_ 582 WssRLEdgesSumVld "WssRLEdgesSumVld";
BA_ "GenSigCycleTime" SG_ 582 WssRLEdgesSumVld 20;
BA_ "Origin" SG_ 582 WssRREdgesSumVld "fuel,ev";
BA_ "Match" SG_ 582 WssRREdgesSumVld "WssRREdgesSumVld";
BA_ "GenSigCycleTime" SG_ 582 WssRREdgesSumVld 20;
BA_ "TransparentInitValue" SG_ 582 ABS2_0x246 "0 0 0 0 0 0 0 0 ";
BA_ "GenSigCycleTime" SG_ 582 ABS2_0x246 20;
BA_ "Origin" SG_ 584 HCU_12VSysErr_1 "fuel,ev";
BA_ "Match" SG_ 584 HCU_12VSysErr_1 "HCU_12VSysErr_1";
BA_ "GenSigCycleTime" SG_ 584 HCU_12VSysErr_1 50;
BA_ "Origin" SG_ 584 HCU_12VSysErr_2 "fuel,ev";
BA_ "Match" SG_ 584 HCU_12VSysErr_2 "HCU_12VSysErr_2";
BA_ "GenSigCycleTime" SG_ 584 HCU_12VSysErr_2 50;
BA_ "Origin" SG_ 584 HCU_HybSysErr_1 "fuel,ev";
BA_ "Match" SG_ 584 HCU_HybSysErr_1 "HCU_HybSysErr_1";
BA_ "GenSigCycleTime" SG_ 584 HCU_HybSysErr_1 50;
BA_ "Origin" SG_ 584 HCU_HybSysErr_2 "fuel,ev";
BA_ "Match" SG_ 584 HCU_HybSysErr_2 "HCU_HybSysErr_2";
BA_ "GenSigCycleTime" SG_ 584 HCU_HybSysErr_2 50;
BA_ "Origin" SG_ 584 HCU_HybSysErr_5 "fuel,ev";
BA_ "Match" SG_ 584 HCU_HybSysErr_5 "HCU_HybSysErr_5";
BA_ "GenSigCycleTime" SG_ 584 HCU_HybSysErr_5 50;
BA_ "Origin" SG_ 584 HCU_HybSysErr_6 "fuel,ev";
BA_ "Match" SG_ 584 HCU_HybSysErr_6 "HCU_HybSysErr_6";
BA_ "GenSigCycleTime" SG_ 584 HCU_HybSysErr_6 50;
BA_ "Origin" SG_ 584 HCU_HybSysErr_7 "fuel,ev";
BA_ "Match" SG_ 584 HCU_HybSysErr_7 "HCU_HybSysErr_7";
BA_ "GenSigCycleTime" SG_ 584 HCU_HybSysErr_7 50;
BA_ "Origin" SG_ 584 HCU_12VSysErrLmpSts "fuel,ev";
BA_ "Match" SG_ 584 HCU_12VSysErrLmpSts "HCU_12VSysErrLmpSts";
BA_ "GenSigCycleTime" SG_ 584 HCU_12VSysErrLmpSts 50;
BA_ "Origin" SG_ 584 HCU_HybSysErrLmpSts "fuel,ev";
BA_ "Match" SG_ 584 HCU_HybSysErrLmpSts "HCU_HybSysErrLmpSts";
BA_ "GenSigCycleTime" SG_ 584 HCU_HybSysErrLmpSts 50;
BA_ "Origin" SG_ 584 HCU_PowerRedWarnLmpCmd "fuel,ev";
BA_ "Match" SG_ 584 HCU_PowerRedWarnLmpCmd "HCU_PowerRedWarnLmpCmd";
BA_ "GenSigCycleTime" SG_ 584 HCU_PowerRedWarnLmpCmd 50;
BA_ "Origin" SG_ 584 HCU_EnrgFlowInd "fuel";
BA_ "Match" SG_ 584 HCU_EnrgFlowInd "HCU_EnrgFlowInd";
BA_ "GenSigCycleTime" SG_ 584 HCU_EnrgFlowInd 50;
BA_ "Origin" SG_ 584 HCU_HybSysErr_3 "fuel,ev";
BA_ "Match" SG_ 584 HCU_HybSysErr_3 "HCU_HybSysErr_3";
BA_ "GenSigCycleTime" SG_ 584 HCU_HybSysErr_3 50;
BA_ "Origin" SG_ 584 HCU_RdyLmpSts "fuel,ev";
BA_ "Match" SG_ 584 HCU_RdyLmpSts "HCU_RdyLmpSts";
BA_ "GenSigCycleTime" SG_ 584 HCU_RdyLmpSts 50;
BA_ "Origin" SG_ 584 CheckSum_HCU_PT7 "ev,ev";
BA_ "Match" SG_ 584 CheckSum_HCU_PT7 "CheckSum_HCU_PT7";
BA_ "GenSigCycleTime" SG_ 584 CheckSum_HCU_PT7 50;
BA_ "Origin" SG_ 584 HCU_HybSysErr_4 "ev,ev";
BA_ "Match" SG_ 584 HCU_HybSysErr_4 "HCU_HybSysErr_4";
BA_ "GenSigCycleTime" SG_ 584 HCU_HybSysErr_4 50;
BA_ "Origin" SG_ 584 HCU_EnrgFlowInd_P2 "ev,ev";
BA_ "Match" SG_ 584 HCU_EnrgFlowInd_P2 "HCU_EnrgFlowInd_P2";
BA_ "GenSigCycleTime" SG_ 584 HCU_EnrgFlowInd_P2 50;
BA_ "Origin" SG_ 584 HCU_12VSysErr_3 "ev,ev";
BA_ "Match" SG_ 584 HCU_12VSysErr_3 "HCU_12VSysErr_3";
BA_ "GenSigCycleTime" SG_ 584 HCU_12VSysErr_3 50;
BA_ "Origin" SG_ 584 HCU_OPDLmpSts "ev,ev";
BA_ "Match" SG_ 584 HCU_OPDLmpSts "HCU_OPDLmpSts";
BA_ "GenSigCycleTime" SG_ 584 HCU_OPDLmpSts 50;
BA_ "Origin" SG_ 584 HCU_OPDSts "ev,ev";
BA_ "Match" SG_ 584 HCU_OPDSts "HCU_OPDSts";
BA_ "GenSigCycleTime" SG_ 584 HCU_OPDSts 50;
BA_ "Origin" SG_ 584 HCU_ModSwtFail "ev,ev";
BA_ "Match" SG_ 584 HCU_ModSwtFail "HCU_ModSwtFail";
BA_ "GenSigCycleTime" SG_ 584 HCU_ModSwtFail 50;
BA_ "Origin" SG_ 584 RollingCounter_HCU_PT7 "ev,ev";
BA_ "Match" SG_ 584 RollingCounter_HCU_PT7 "RollingCounter_HCU_PT7";
BA_ "GenSigCycleTime" SG_ 584 RollingCounter_HCU_PT7 50;
BA_ "TransparentInitValue" SG_ 584 HCU_PT7_0x248 "0 0 0 0 0 0 0 0 ";
BA_ "GenSigCycleTime" SG_ 584 HCU_PT7_0x248 50;
BA_ "Origin" SG_ 589 DrowsnsLvl "fuel,ev";
BA_ "Match" SG_ 589 DrowsnsLvl "DrowsnsLvl";
BA_ "GenSigStartValue" SG_ 589 DrowsnsLvl 7;
BA_ "GenSigCycleTime" SG_ 589 DrowsnsLvl 50;
BA_ "Origin" SG_ 589 DrowsnsLvlQlty "fuel,ev";
BA_ "Match" SG_ 589 DrowsnsLvlQlty "DrowsnsLvlQlty";
BA_ "GenSigStartValue" SG_ 589 DrowsnsLvlQlty 127;
BA_ "GenSigCycleTime" SG_ 589 DrowsnsLvlQlty 50;
BA_ "Origin" SG_ 589 GenderSts "fuel,ev";
BA_ "Match" SG_ 589 GenderSts "GenderSts";
BA_ "GenSigStartValue" SG_ 589 GenderSts 3;
BA_ "GenSigCycleTime" SG_ 589 GenderSts 50;
BA_ "Origin" SG_ 589 GenderStsQlty "fuel,ev";
BA_ "Match" SG_ 589 GenderStsQlty "GenderStsQlty";
BA_ "GenSigStartValue" SG_ 589 GenderStsQlty 127;
BA_ "GenSigCycleTime" SG_ 589 GenderStsQlty 50;
BA_ "Origin" SG_ 589 ExprsnSts "fuel,ev";
BA_ "Match" SG_ 589 ExprsnSts "ExprsnSts";
BA_ "GenSigStartValue" SG_ 589 ExprsnSts 7;
BA_ "GenSigCycleTime" SG_ 589 ExprsnSts 50;
BA_ "Origin" SG_ 589 Checksum_DMS2 "fuel,ev";
BA_ "Match" SG_ 589 Checksum_DMS2 "Checksum_DMS2";
BA_ "GenSigCycleTime" SG_ 589 Checksum_DMS2 50;
BA_ "Origin" SG_ 589 DistrctnLvl_ACC "fuel,ev";
BA_ "Match" SG_ 589 DistrctnLvl_ACC "DistrctnLvl_ACC";
BA_ "GenSigStartValue" SG_ 589 DistrctnLvl_ACC 7;
BA_ "GenSigCycleTime" SG_ 589 DistrctnLvl_ACC 50;
BA_ "Origin" SG_ 589 DistrctnLvlQlty_ACC "fuel,ev";
BA_ "Match" SG_ 589 DistrctnLvlQlty_ACC "DistrctnLvlQlty_ACC";
BA_ "GenSigStartValue" SG_ 589 DistrctnLvlQlty_ACC 127;
BA_ "GenSigCycleTime" SG_ 589 DistrctnLvlQlty_ACC 50;
BA_ "Origin" SG_ 589 DrowsnsLvl_ACC "fuel,ev";
BA_ "Match" SG_ 589 DrowsnsLvl_ACC "DrowsnsLvl_ACC";
BA_ "GenSigStartValue" SG_ 589 DrowsnsLvl_ACC 7;
BA_ "GenSigCycleTime" SG_ 589 DrowsnsLvl_ACC 50;
BA_ "Origin" SG_ 589 DrowsnsLvlQlty_ACC "fuel,ev";
BA_ "Match" SG_ 589 DrowsnsLvlQlty_ACC "DrowsnsLvlQlty_ACC";
BA_ "GenSigStartValue" SG_ 589 DrowsnsLvlQlty_ACC 127;
BA_ "GenSigCycleTime" SG_ 589 DrowsnsLvlQlty_ACC 50;
BA_ "Origin" SG_ 589 RollingCounter_DMS2 "fuel,ev";
BA_ "Match" SG_ 589 RollingCounter_DMS2 "RollingCounter_DMS2";
BA_ "GenSigCycleTime" SG_ 589 RollingCounter_DMS2 50;
BA_ "Origin" SG_ 589 Checksum_DMS3 "fuel,ev";
BA_ "Match" SG_ 589 Checksum_DMS3 "Checksum_DMS3";
BA_ "GenSigCycleTime" SG_ 589 Checksum_DMS3 50;
BA_ "Origin" SG_ 589 HeadPosnX "fuel,ev";
BA_ "Match" SG_ 589 HeadPosnX "HeadPosnX";
BA_ "GenSigStartValue" SG_ 589 HeadPosnX 2047;
BA_ "GenSigCycleTime" SG_ 589 HeadPosnX 50;
BA_ "Origin" SG_ 589 HeadPosnY "fuel,ev";
BA_ "Match" SG_ 589 HeadPosnY "HeadPosnY";
BA_ "GenSigStartValue" SG_ 589 HeadPosnY 2047;
BA_ "GenSigCycleTime" SG_ 589 HeadPosnY 50;
BA_ "Origin" SG_ 589 HeadPosnZ "fuel,ev";
BA_ "Match" SG_ 589 HeadPosnZ "HeadPosnZ";
BA_ "GenSigStartValue" SG_ 589 HeadPosnZ 2047;
BA_ "GenSigCycleTime" SG_ 589 HeadPosnZ 50;
BA_ "Origin" SG_ 589 HeadPosQlty "fuel,ev";
BA_ "Match" SG_ 589 HeadPosQlty "HeadPosQlty";
BA_ "GenSigStartValue" SG_ 589 HeadPosQlty 127;
BA_ "GenSigCycleTime" SG_ 589 HeadPosQlty 50;
BA_ "Origin" SG_ 589 RollingCounter_DMS3 "fuel,ev";
BA_ "Match" SG_ 589 RollingCounter_DMS3 "RollingCounter_DMS3";
BA_ "GenSigCycleTime" SG_ 589 RollingCounter_DMS3 50;
BA_ "Origin" SG_ 589 GazePosnX "fuel,ev";
BA_ "Match" SG_ 589 GazePosnX "GazePosnX";
BA_ "GenSigStartValue" SG_ 589 GazePosnX 2047;
BA_ "GenSigCycleTime" SG_ 589 GazePosnX 50;
BA_ "Origin" SG_ 589 GazePosnY "fuel,ev";
BA_ "Match" SG_ 589 GazePosnY "GazePosnY";
BA_ "GenSigStartValue" SG_ 589 GazePosnY 2047;
BA_ "GenSigCycleTime" SG_ 589 GazePosnY 50;
BA_ "Origin" SG_ 589 GazePosnZ "fuel,ev";
BA_ "Match" SG_ 589 GazePosnZ "GazePosnZ";
BA_ "GenSigStartValue" SG_ 589 GazePosnZ 2047;
BA_ "GenSigCycleTime" SG_ 589 GazePosnZ 50;
BA_ "Origin" SG_ 589 Checksum_DMS5 "fuel,ev";
BA_ "Match" SG_ 589 Checksum_DMS5 "Checksum_DMS5";
BA_ "GenSigCycleTime" SG_ 589 Checksum_DMS5 50;
BA_ "Origin" SG_ 589 DMSSts "fuel,ev";
BA_ "Match" SG_ 589 DMSSts "DMSSts";
BA_ "GenSigStartValue" SG_ 589 DMSSts 7;
BA_ "GenSigCycleTime" SG_ 589 DMSSts 50;
BA_ "Origin" SG_ 589 HeadDetn "fuel,ev";
BA_ "Match" SG_ 589 HeadDetn "HeadDetn";
BA_ "GenSigCycleTime" SG_ 589 HeadDetn 50;
BA_ "Origin" SG_ 589 HeadYawAng "fuel,ev";
BA_ "Match" SG_ 589 HeadYawAng "HeadYawAng";
BA_ "GenSigStartValue" SG_ 589 HeadYawAng 255;
BA_ "GenSigCycleTime" SG_ 589 HeadYawAng 50;
BA_ "Origin" SG_ 589 HeadPitchAng "fuel,ev";
BA_ "Match" SG_ 589 HeadPitchAng "HeadPitchAng";
BA_ "GenSigStartValue" SG_ 589 HeadPitchAng 255;
BA_ "GenSigCycleTime" SG_ 589 HeadPitchAng 50;
BA_ "Origin" SG_ 589 HeadRollAng "fuel,ev";
BA_ "Match" SG_ 589 HeadRollAng "HeadRollAng";
BA_ "GenSigStartValue" SG_ 589 HeadRollAng 255;
BA_ "GenSigCycleTime" SG_ 589 HeadRollAng 50;
BA_ "Origin" SG_ 589 HeadRotAngQlty "fuel,ev";
BA_ "Match" SG_ 589 HeadRotAngQlty "HeadRotAngQlty";
BA_ "GenSigStartValue" SG_ 589 HeadRotAngQlty 127;
BA_ "GenSigCycleTime" SG_ 589 HeadRotAngQlty 50;
BA_ "Origin" SG_ 589 RollingCounter_DMS5 "fuel,ev";
BA_ "Match" SG_ 589 RollingCounter_DMS5 "RollingCounter_DMS5";
BA_ "GenSigCycleTime" SG_ 589 RollingCounter_DMS5 50;
BA_ "Origin" SG_ 589 Checksum_DMS6 "fuel,ev";
BA_ "Match" SG_ 589 Checksum_DMS6 "Checksum_DMS6";
BA_ "GenSigCycleTime" SG_ 589 Checksum_DMS6 50;
BA_ "Origin" SG_ 589 LEyeOpenSts "fuel,ev";
BA_ "Match" SG_ 589 LEyeOpenSts "LEyeOpenSts";
BA_ "GenSigStartValue" SG_ 589 LEyeOpenSts 2;
BA_ "GenSigCycleTime" SG_ 589 LEyeOpenSts 50;
BA_ "Origin" SG_ 589 LEyeOpenStsQlty "fuel,ev";
BA_ "Match" SG_ 589 LEyeOpenStsQlty "LEyeOpenStsQlty";
BA_ "GenSigStartValue" SG_ 589 LEyeOpenStsQlty 100;
BA_ "GenSigCycleTime" SG_ 589 LEyeOpenStsQlty 50;
BA_ "Origin" SG_ 589 REyeOpenSts "fuel,ev";
BA_ "Match" SG_ 589 REyeOpenSts "REyeOpenSts";
BA_ "GenSigStartValue" SG_ 589 REyeOpenSts 2;
BA_ "GenSigCycleTime" SG_ 589 REyeOpenSts 50;
BA_ "Origin" SG_ 589 REyeOpenStsQlty "fuel,ev";
BA_ "Match" SG_ 589 REyeOpenStsQlty "REyeOpenStsQlty";
BA_ "GenSigStartValue" SG_ 589 REyeOpenStsQlty 100;
BA_ "GenSigCycleTime" SG_ 589 REyeOpenStsQlty 50;
BA_ "Origin" SG_ 589 RobustGazeYawAng "fuel,ev";
BA_ "Match" SG_ 589 RobustGazeYawAng "RobustGazeYawAng";
BA_ "GenSigStartValue" SG_ 589 RobustGazeYawAng 255;
BA_ "GenSigCycleTime" SG_ 589 RobustGazeYawAng 50;
BA_ "Origin" SG_ 589 RobustGazePitchAng "fuel,ev";
BA_ "Match" SG_ 589 RobustGazePitchAng "RobustGazePitchAng";
BA_ "GenSigStartValue" SG_ 589 RobustGazePitchAng 255;
BA_ "GenSigCycleTime" SG_ 589 RobustGazePitchAng 50;
BA_ "Origin" SG_ 589 RobustGazeAngQlty "fuel,ev";
BA_ "Match" SG_ 589 RobustGazeAngQlty "RobustGazeAngQlty";
BA_ "GenSigStartValue" SG_ 589 RobustGazeAngQlty 127;
BA_ "GenSigCycleTime" SG_ 589 RobustGazeAngQlty 50;
BA_ "Origin" SG_ 589 DrvBehvSts "fuel,ev";
BA_ "Match" SG_ 589 DrvBehvSts "DrvBehvSts";
BA_ "GenSigStartValue" SG_ 589 DrvBehvSts 7;
BA_ "GenSigCycleTime" SG_ 589 DrvBehvSts 50;
BA_ "Origin" SG_ 589 RollingCounter_DMS6 "fuel,ev";
BA_ "Match" SG_ 589 RollingCounter_DMS6 "RollingCounter_DMS6";
BA_ "GenSigCycleTime" SG_ 589 RollingCounter_DMS6 50;
BA_ "TransparentInitValue" SG_ 589 DMS_FD1_0x24D "0 63 240 0 31 254 0 0 0 254 254 252 0 0 0 0 0 255 255 255 255 255 0 0 0 255 255 255 255 128 0 0 0 255 255 255 254 224 0 0 0 255 255 200 200 254 167 0 0 0 0 0 0 0 0 0 0 0 0 0 0 0 0 0 ";
BA_ "GenSigCycleTime" SG_ 589 DMS_FD1_0x24D 50;
BA_ "Origin" SG_ 593 FuncProtnSts "fuel,ev";
BA_ "Match" SG_ 593 FuncProtnSts "FuncProtnSts";
BA_ "GenSigCycleTime" SG_ 593 FuncProtnSts 20;
BA_ "Origin" SG_ 593 ShiftSysStuInLow "fuel,ev";
BA_ "Match" SG_ 593 ShiftSysStuInLow "ShiftSysStuInLow";
BA_ "GenSigCycleTime" SG_ 593 ShiftSysStuInLow 20;
BA_ "Origin" SG_ 593 SystemOperMod "fuel,ev";
BA_ "Match" SG_ 593 SystemOperMod "SystemOperMod";
BA_ "GenSigCycleTime" SG_ 593 SystemOperMod 20;
BA_ "Origin" SG_ 593 CouplingFaultSts "fuel,ev";
BA_ "Match" SG_ 593 CouplingFaultSts "CouplingFaultSts";
BA_ "GenSigCycleTime" SG_ 593 CouplingFaultSts 20;
BA_ "Origin" SG_ 593 CouplingThermWarning "fuel,ev";
BA_ "Match" SG_ 593 CouplingThermWarning "CouplingThermWarning";
BA_ "GenSigCycleTime" SG_ 593 CouplingThermWarning 20;
BA_ "Origin" SG_ 593 DiagLmpReq "fuel,ev";
BA_ "Match" SG_ 593 DiagLmpReq "DiagLmpReq";
BA_ "GenSigCycleTime" SG_ 593 DiagLmpReq 20;
BA_ "Origin" SG_ 593 ModeShiftTimeout "fuel,ev";
BA_ "Match" SG_ 593 ModeShiftTimeout "ModeShiftTimeout";
BA_ "GenSigCycleTime" SG_ 593 ModeShiftTimeout 20;
BA_ "Origin" SG_ 593 AutoShiftSts "fuel,ev";
BA_ "Match" SG_ 593 AutoShiftSts "AutoShiftSts";
BA_ "GenSigCycleTime" SG_ 593 AutoShiftSts 20;
BA_ "Origin" SG_ 593 EstimatedTorque "fuel,ev";
BA_ "Match" SG_ 593 EstimatedTorque "EstimatedTorque";
BA_ "GenSigCycleTime" SG_ 593 EstimatedTorque 20;
BA_ "TransparentInitValue" SG_ 593 TOD1_0x251 "0 0 0 0 0 0 0 0 ";
BA_ "GenSigCycleTime" SG_ 593 TOD1_0x251 20;
BA_ "Origin" SG_ 604 BLEConnSts "fuel,ev";
BA_ "Match" SG_ 604 BLEConnSts "BLEConnSts";
BA_ "GenSigCycleTime" SG_ 604 BLEConnSts 50;
BA_ "Origin" SG_ 604 BLESecuritySts "fuel,ev";
BA_ "Match" SG_ 604 BLESecuritySts "BLESecuritySts";
BA_ "GenSigCycleTime" SG_ 604 BLESecuritySts 50;
BA_ "TransparentInitValue" SG_ 604 BLE1_0x25C "0 0 0 0 0 0 0 0 ";
BA_ "GenSigCycleTime" SG_ 604 BLE1_0x25C 50;
BA_ "Origin" SG_ 623 CheckSum_HUT32 "fuel,ev";
BA_ "Match" SG_ 623 CheckSum_HUT32 "CheckSum_HUT32";
BA_ "GenSigCycleTime" SG_ 623 CheckSum_HUT32 50;
BA_ "Origin" SG_ 623 ScrnOpSts "fuel,ev";
BA_ "Match" SG_ 623 ScrnOpSts "ScrnOpSts";
BA_ "GenSigCycleTime" SG_ 623 ScrnOpSts 50;
BA_ "Origin" SG_ 623 XLvl "fuel,ev";
BA_ "Match" SG_ 623 XLvl "XLvl";
BA_ "GenSigStartValue" SG_ 623 XLvl 2047;
BA_ "GenSigCycleTime" SG_ 623 XLvl 50;
BA_ "Origin" SG_ 623 YLvl "fuel,ev";
BA_ "Match" SG_ 623 YLvl "YLvl";
BA_ "GenSigStartValue" SG_ 623 YLvl 2047;
BA_ "GenSigCycleTime" SG_ 623 YLvl 50;
BA_ "Origin" SG_ 623 DetVideoLost "fuel,ev";
BA_ "Match" SG_ 623 DetVideoLost "DetVideoLost";
BA_ "GenSigCycleTime" SG_ 623 DetVideoLost 50;
BA_ "Origin" SG_ 623 PrkgCtrlModReqValid "fuel,ev";
BA_ "Match" SG_ 623 PrkgCtrlModReqValid "PrkgCtrlModReqValid";
BA_ "GenSigCycleTime" SG_ 623 PrkgCtrlModReqValid 50;
BA_ "Origin" SG_ 623 PrkgCtrlModReq "fuel,ev";
BA_ "Match" SG_ 623 PrkgCtrlModReq "PrkgCtrlModReq";
BA_ "GenSigCycleTime" SG_ 623 PrkgCtrlModReq 50;
BA_ "Origin" SG_ 623 ContnPrkgReqValid "fuel,ev";
BA_ "Match" SG_ 623 ContnPrkgReqValid "ContnPrkgReqValid";
BA_ "GenSigCycleTime" SG_ 623 ContnPrkgReqValid 50;
BA_ "Origin" SG_ 623 ContnPrkgReq "fuel,ev";
BA_ "Match" SG_ 623 ContnPrkgReq "ContnPrkgReq";
BA_ "GenSigCycleTime" SG_ 623 ContnPrkgReq 50;
BA_ "Origin" SG_ 623 PrkStraightSwtReq_HUT "fuel,ev";
BA_ "Match" SG_ 623 PrkStraightSwtReq_HUT "PrkStraightSwtReq_HUT";
BA_ "GenSigCycleTime" SG_ 623 PrkStraightSwtReq_HUT 50;
BA_ "Origin" SG_ 623 PrkStraightSuspendOrFinishReq_HU "fuel,ev";
BA_ "Match" SG_ 623 PrkStraightSuspendOrFinishReq_HU "PrkStraightSuspendOrFinishReq_HUT";
BA_ "GenSigCycleTime" SG_ 623 PrkStraightSuspendOrFinishReq_HU 50;
BA_ "SystemSignalLongSymbol" SG_ 623 PrkStraightSuspendOrFinishReq_HU "PrkStraightSuspendOrFinishReq_HUT";
BA_ "Origin" SG_ 623 PrkStraightModSel_HUT "fuel,ev";
BA_ "Match" SG_ 623 PrkStraightModSel_HUT "PrkStraightModSel_HUT";
BA_ "GenSigCycleTime" SG_ 623 PrkStraightModSel_HUT 50;
BA_ "Origin" SG_ 623 PrkStraightSts_HUT "fuel,ev";
BA_ "Match" SG_ 623 PrkStraightSts_HUT "PrkStraightSts_HUT";
BA_ "GenSigCycleTime" SG_ 623 PrkStraightSts_HUT 50;
BA_ "Origin" SG_ 623 PrkStraightStrtReq_HUT "fuel,ev";
BA_ "Match" SG_ 623 PrkStraightStrtReq_HUT "PrkStraightStrtReq_HUT";
BA_ "GenSigCycleTime" SG_ 623 PrkStraightStrtReq_HUT 50;
BA_ "Origin" SG_ 623 PrkStraightVehStrtReq_HUT_Valid "fuel,ev";
BA_ "Match" SG_ 623 PrkStraightVehStrtReq_HUT_Valid "PrkStraightVehStrtReq_HUT_Valid";
BA_ "GenSigCycleTime" SG_ 623 PrkStraightVehStrtReq_HUT_Valid 50;
BA_ "Origin" SG_ 623 PrkStraightContinueReq_HUT "fuel,ev";
BA_ "Match" SG_ 623 PrkStraightContinueReq_HUT "PrkStraightContinueReq_HUT";
BA_ "GenSigCycleTime" SG_ 623 PrkStraightContinueReq_HUT 50;
BA_ "Origin" SG_ 623 P2P_PrkgDirSwtReq "fuel,ev";
BA_ "Match" SG_ 623 P2P_PrkgDirSwtReq "P2P_PrkgDirSwtReq";
BA_ "GenSigCycleTime" SG_ 623 P2P_PrkgDirSwtReq 50;
BA_ "Origin" SG_ 623 RainMode_Swt_Req "fuel,ev";
BA_ "Match" SG_ 623 RainMode_Swt_Req "RainMode_Swt_Req";
BA_ "GenSigCycleTime" SG_ 623 RainMode_Swt_Req 50;
BA_ "Origin" SG_ 623 LCMode_Swt_Req "fuel,ev";
BA_ "Match" SG_ 623 LCMode_Swt_Req "LCMode_Swt_Req";
BA_ "GenSigCycleTime" SG_ 623 LCMode_Swt_Req 50;
BA_ "Origin" SG_ 623 NavDecSwtReq "fuel,ev";
BA_ "Match" SG_ 623 NavDecSwtReq "NavDecSwtReq";
BA_ "GenSigCycleTime" SG_ 623 NavDecSwtReq 50;
BA_ "Origin" SG_ 623 RollingCounter_HUT32 "fuel,ev";
BA_ "Match" SG_ 623 RollingCounter_HUT32 "RollingCounter_HUT32";
BA_ "GenSigCycleTime" SG_ 623 RollingCounter_HUT32 50;
BA_ "TransparentInitValue" SG_ 623 HUT32_0x26F "0 0 255 231 255 0 0 0 ";
BA_ "GenSigCycleTime" SG_ 623 HUT32_0x26F 50;
BA_ "Origin" SG_ 625 FuelConsumption "fuel,ev";
BA_ "Match" SG_ 625 FuelConsumption "FuelConsumption";
BA_ "GenSigCycleTime" SG_ 625 FuelConsumption 20;
BA_ "Origin" SG_ 625 TgtCrsVehSpd "fuel,ev";
BA_ "Match" SG_ 625 TgtCrsVehSpd "TgtCrsVehSpd";
BA_ "GenSigCycleTime" SG_ 625 TgtCrsVehSpd 20;
BA_ "Origin" SG_ 625 CruiseCtrlSts "fuel";
BA_ "Match" SG_ 625 CruiseCtrlSts "CruiseCtrlSts";
BA_ "GenSigCycleTime" SG_ 625 CruiseCtrlSts 20;
BA_ "Origin" SG_ 625 AccelPedalPosn "fuel";
BA_ "Match" SG_ 625 AccelPedalPosn "AccelPedalPosn";
BA_ "GenSigCycleTime" SG_ 625 AccelPedalPosn 20;
BA_ "Origin" SG_ 625 AccelPedalPosnVldty "fuel";
BA_ "Match" SG_ 625 AccelPedalPosnVldty "AccelPedalPosnVldty";
BA_ "GenSigStartValue" SG_ 625 AccelPedalPosnVldty 2;
BA_ "GenSigCycleTime" SG_ 625 AccelPedalPosnVldty 20;
BA_ "Origin" SG_ 625 ThrtlPosRatio "fuel,ev";
BA_ "Match" SG_ 625 ThrtlPosRatio "ThrtlPosRatio";
BA_ "GenSigCycleTime" SG_ 625 ThrtlPosRatio 20;
BA_ "Origin" SG_ 625 EngSVSSig "fuel,ev";
BA_ "Match" SG_ 625 EngSVSSig "EngSVSSig";
BA_ "GenSigCycleTime" SG_ 625 EngSVSSig 20;
BA_ "Origin" SG_ 625 MILSts "fuel,ev";
BA_ "Match" SG_ 625 MILSts "MILSts";
BA_ "GenSigCycleTime" SG_ 625 MILSts 20;
BA_ "Origin" SG_ 625 EngState "fuel";
BA_ "Match" SG_ 625 EngState "EngState";
BA_ "GenSigCycleTime" SG_ 625 EngState 20;
BA_ "TransparentInitValue" SG_ 625 ECM2_0x271 "0 0 0 0 0 0 4 0 ";
BA_ "GenSigCycleTime" SG_ 625 ECM2_0x271 20;
BA_ "Origin" SG_ 627 TrailerSts "fuel,ev";
BA_ "Match" SG_ 627 TrailerSts "TrailerSts";
BA_ "GenSigCycleTime" SG_ 627 TrailerSts 50;
BA_ "TransparentInitValue" SG_ 627 Trailer1_0x273 "0 0 0 0 0 0 0 0 ";
BA_ "GenSigCycleTime" SG_ 627 Trailer1_0x273 50;
VAL_ 493 FlaoutUnlockSet 0 "No action" 1 "OFF" 2 "ON" 3 "Reserved" ;
VAL_ 493 PrkInDirChoice 0 "None" 1 "Tail in" 2 "Head in" 3 "Reserved" ;
VAL_ 493 ADASDispSwt 0 "No action" 1 "OFF" 2 "ON" 3 "Reserved" ;
VAL_ 493 NaviDispSwt 0 "No action" 1 "OFF" 2 "ON" 3 "Reserved" ;
VAL_ 493 NaviDispSwt_VR 0 "No action" 1 "OFF" 2 "ON" 3 "Reserved" ;
VAL_ 493 ADASDispSwt_VR 0 "No action" 1 "OFF" 2 "ON" 3 "Reserved" ;
VAL_ 493 ApproachLampSet 0 "No action" 1 "OFF" 2 "ON" 3 "Reserved" ;
VAL_ 493 SuperLockSet 0 "No action" 1 "OFF" 2 "ON" 3 "Reserved" ;
VAL_ 493 ALCMDynModSet 0 "DynModOFF" 1 "DynMod1" 2 "DynMod2" 3 "DynMod3" 4 "DynMod4" 5 "DynMod5" 6 "DynMod6" 7 "DynMod7" ;
VAL_ 493 RLWinSwtReq_VR 0 "No action" 1 "Close" 2 "Open" 3 "Half_Open" 4 "5%_Up" 5 "5%_Down" 6 "13_Open" 7 "Reserved" ;
VAL_ 493 RRWinSwtReq_VR 0 "No action" 1 "Close" 2 "Open" 3 "Half_Open" 4 "5%_Up" 5 "5%_Down" 6 "13_Open" 7 "Reserved" ;
VAL_ 493 DrvWinSwtReq_VR 0 "No action" 1 "Close" 2 "Open" 3 "Half_Open" 4 "5%_Up" 5 "5%_Down" 6 "13_Open" 7 "Reserved" ;
VAL_ 493 PassWinSwtReq_VR 0 "No action" 1 "Close" 2 "Open" 3 "Half_Open" 4 "5%_Up" 5 "5%_Down" 6 "13_Open" 7 "Reserved" ;
VAL_ 493 ChairMemPosnSetSwt 0 "no action" 1 "set memory button 1" 2 "set memory button 2" 3 "set memory button 3" 4 "recall  memory button 1" 5 "recall  memory button 2" 6 "recall  memory button 3" 7 "Reserved" ;
VAL_ 493 PathLrngFinshCmd 0 "No request" 1 "Request" ;
VAL_ 493 PathLrngStartCmd 0 "No request" 1 "Request" ;
VAL_ 493 SelPrkOutDirReq 0 "No selection" 1 "Park out frontvertical head out" 2 "Park out rearvertical tail out" 3 "Park out leftparallel left out" 4 "Park out rightparallel right out" 5 "Reserved" 7 "Reserved" ;
VAL_ 493 StartPrkgPath2Cmd 0 "No request" 1 "Request" ;
VAL_ 493 DeletePath2Cmd 0 "No request" 1 "Request" ;
VAL_ 493 StartPrkgPath1Cmd 0 "No request" 1 "Request" ;
VAL_ 493 DeletePath1Cmd 0 "No request" 1 "Request" ;
VAL_ 493 SelPrkgFctnCmd 0 "No selection" 1 "Select APA parking" 2 "Select P2P parking" 3 "Select Explore Forward" 4 "Select drive back" 5 "Reserved" 7 "Reserved" ;
VAL_ 493 ParkMdlCmd 0 "No request" 1 "Request" ;
VAL_ 493 BackReq_APS 0 "No request" 1 "Request" ;
VAL_ 493 ACFGAEnaReq_TC 0 "No action" 1 "Disable" 2 "Enable" 3 "Reserved" ;
VAL_ 493 ACFGAChanTyp_TC 0 "No action" 1 "OFF" 2 "Channel 1" 3 "Channel 2" 4 "Channel 3" 5 "Reserved" 7 "Reserved" ;
VAL_ 493 ACFGALvlReq_TC 0 "No action" 1 "OFF" 2 "Level1 (Low)" 3 "Level2 (Mid)" 4 "Level3 (High)" 5 "Reserved" 7 "Reserved" ;
VAL_ 493 P2P_PrkgDirectSwtCmd 0 "No Request" 1 "Request" ;
VAL_ 494 SunShadeSwtReq_VR 0 "No action" 1 "Full closed" 2 "10%" 3 "20%" 4 "30%" 5 "40%" 6 "50%" 7 "60%" 8 "70%" 9 "80%" 10 "90%" 11 "full open" 12 "stop" 13 "reserved" 15 "reserved" ;
VAL_ 494 SunRoofSwtReq_VR 0 "No action" 1 "Full closed" 2 "Tilt Up" 3 "10%" 4 "20%" 5 "30%" 6 "40%" 7 "50%" 8 "60%" 9 "70%" 10 "80%" 11 "90%" 12 "full open" 13 "stop" 14 "reserved" 15 "reserved" ;
VAL_ 494 FrntRearACDispSts 0 "No display" 1 "Front AC display" 2 "Rear AC display" 3 "Reserved" ;
VAL_ 494 ACOperMod_TC 0 "No action" 1 "Standard Mode" 2 "Comfort Mode" 3 "Strong Mode" ;
VAL_ 494 ACOperMod_VR 0 "No action" 1 "Standard Mode" 2 "Comfort Mode" 3 "Strong Mode" ;
VAL_ 494 ACDrvSetTempSteplsReq_TC 0 "No action" 1 "Low" 2 "Valid value" 32 "Valid value" 33 "High" 34 "Reserved" 63 "Reserved" ;
VAL_ 494 ACPassSetTempSteplsReq_TC 0 "No action" 1 "Low" 2 "Valid value" 32 "Valid value" 33 "High" 34 "Reserved" 63 "Reserved" ;
VAL_ 494 SDWSwtSet 0 "No Request" 1 "Request" ;
VAL_ 494 APSSwtReq_VR 0 "No action" 1 "off" 2 "on" 3 "Reserved" ;
VAL_ 494 APSPrkgTypSeln 0 "No Select" 1 "Select parallel parking" 2 "Select vertical parking" 3 "Reserved" ;
VAL_ 494 SportModLightSet 0 "OFF" 1 "Flashing&Light" 2 "Flash Only" 3 "Reserved" ;
VAL_ 494 ABSLmpSet 0 "OFF" 1 "ON" ;
VAL_ 494 AutoWshWipSet 0 "short time 300ms" 1 "middle time 500ms" 2 "long time 800ms" 3 "Reserved" ;
VAL_ 494 SeekVehSet 0 "Horn&Light" 1 "HornOnly" 2 "LightOnly" 3 "Reserved" ;
VAL_ 494 SpdAutoLockModSet 0 "OFF" 1 "8kmh" 2 "15kmh" 3 "Reserved" ;
VAL_ 494 ParkLmpSet 0 "OFF" 1 "ON" ;
VAL_ 494 DoorUnlockModSet 0 "All Door" 1 "Driver Door" ;
VAL_ 494 SteerWheelHeatSwtReq 0 "No action" 1 "No request" 2 "Request" 3 "Reserved" ;
VAL_ 494 PASExitSpdSwt 0 "No command" 1 "15kmh" 2 "30kmh" 3 "Reserved" ;
VAL_ 498 TransSts 0 "Success" 1 "Abnormal" 2 "Contact_the_Service_provider" 3 "NoCard" 4 "Reserved" 255 "Reserved" ;
VAL_ 498 EntrAndExitCdn 0 "Reserved" 1 "Enclosed_Manual_Toll_Collection_Entrance" 2 "Enclosed_Manual_Toll_Collection_Exit" 3 "Enclosed_Electronic_Toll_Collection_Entrance" 4 "Enclosed_Electronic_Toll_Collection_Exit" 5 "Open-ended_Manual_Toll_Collection" 6 "Open-ended_Electronic_Toll_Collection" 7 "Reserved" 255 "Reserved" ;
VAL_ 505 ACRLTempSteplsReq_TC 0 "No action" 1 "Low" 2 "Valid value" 32 "Valid value" 33 "High" 34 "Reserved" 63 "Reserved" ;
VAL_ 507 RRDoorALCMClrSet 0 "Colour set 0-63" 63 "Colour set 0-63" 64 "No action" 65 "Reserved" 127 "Reserved" ;
VAL_ 507 LeftPanelALCMClrSet 0 "Colour set 0-63" 63 "Colour set 0-63" 64 "No action" 65 "Reserved" 127 "Reserved" ;
VAL_ 507 RightPanelALCMClrSet 0 "Colour set 0-63" 63 "Colour set 0-63" 64 "No action" 65 "Reserved" 127 "Reserved" ;
VAL_ 507 FootALCMClrSet 0 "Colour set 0-63" 63 "Colour set 0-63" 64 "No action" 65 "Reserved" 127 "Reserved" ;
VAL_ 507 DrvDoorALCMLightLvlSet 0 "No action" 1 "10" 2 "20" 3 "30" 4 "40" 5 "50" 6 "60" 7 "70" 8 "80" 9 "90" 10 "100" 11 "Reserved" 15 "Reserved" ;
VAL_ 507 PassDoorALCMLightLvlSet 0 "No action" 1 "10" 2 "20" 3 "30" 4 "40" 5 "50" 6 "60" 7 "70" 8 "80" 9 "90" 10 "100" 11 "Reserved" 15 "Reserved" ;
VAL_ 507 LRDoorALCMLightLvlSet 0 "No action" 1 "10" 2 "20" 3 "30" 4 "40" 5 "50" 6 "60" 7 "70" 8 "80" 9 "90" 10 "100" 11 "Reserved" 15 "Reserved" ;
VAL_ 507 RRDoorALCMLightLvlSet 0 "No action" 1 "10" 2 "20" 3 "30" 4 "40" 5 "50" 6 "60" 7 "70" 8 "80" 9 "90" 10 "100" 11 "Reserved" 15 "Reserved" ;
VAL_ 507 LeftPanelALCMLightLvlSet 0 "No action" 1 "10" 2 "20" 3 "30" 4 "40" 5 "50" 6 "60" 7 "70" 8 "80" 9 "90" 10 "100" 11 "Reserved" 15 "Reserved" ;
VAL_ 507 RightPanelALCMLightLvlSet 0 "No action" 1 "10" 2 "20" 3 "30" 4 "40" 5 "50" 6 "60" 7 "70" 8 "80" 9 "90" 10 "100" 11 "Reserved" 15 "Reserved" ;
VAL_ 507 FootALCMLightLvlSet 0 "No action" 1 "10" 2 "20" 3 "30" 4 "40" 5 "50" 6 "60" 7 "70" 8 "80" 9 "90" 10 "100" 11 "Reserved" 15 "Reserved" ;
VAL_ 507 ALCMFloSwt 0 "OFF" 1 "ON" ;
VAL_ 507 ALCMBreSwt 0 "OFF" 1 "ON" ;
VAL_ 507 RightPanelALCMSwt 0 "OFF" 1 "ON" ;
VAL_ 507 LRDoorALCMSwt 0 "OFF" 1 "ON" ;
VAL_ 507 RRDoorALCMSwt 0 "OFF" 1 "ON" ;
VAL_ 507 FootALCMSwt 0 "OFF" 1 "ON" ;
VAL_ 507 RoofALCMSwt 0 "OFF" 1 "ON" ;
VAL_ 507 LeftPanelALCMSwt 0 "OFF" 1 "ON" ;
VAL_ 509 RLSeatMassgModSet 0 "No Action" 1 "Wave Mode" 2 "Serpentine Mode" 3 "Catwalk Mode" 4 "Shoulder Mode" 5 "Lumbar Mode" 6 "Soothing Mode" 7 "Butterfly Mode" 8 "Full Body Stretch Mode" 9 "Single Row Mode" 10 "Pulse Mode" 11 "Reserved" 15 "Reserved" ;
VAL_ 509 RRSeatMassgModSet 0 "No Action" 1 "Wave Mode" 2 "Serpentine Mode" 3 "Catwalk Mode" 4 "Shoulder Mode" 5 "Lumbar Mode" 6 "Soothing Mode" 7 "Butterfly Mode" 8 "Full Body Stretch Mode" 9 "Single Row Mode" 10 "Pulse Mode" 11 "Reserved" 15 "Reserved" ;
VAL_ 509 DrvSeatHeatgLvlSet_Nine 0 "No Action" 1 "OFF" 2 "Level1_Low" 3 "Level2" 4 "Level3" 5 "Level4" 6 "Level5" 7 "Level6" 8 "Level7" 9 "Level8" 10 "Level9_High" 11 "Reserved" 15 "Reserved" ;
VAL_ 509 PassSeatHeatgLvlSet_Nine 0 "No Action" 1 "OFF" 2 "Level1_Low" 3 "Level2" 4 "Level3" 5 "Level4" 6 "Level5" 7 "Level6" 8 "Level7" 9 "Level8" 10 "Level9_High" 11 "Reserved" 15 "Reserved" ;
VAL_ 509 RLSeatHeatgLvlSet_Nine 0 "No Action" 1 "OFF" 2 "Level1_Low" 3 "Level2" 4 "Level3" 5 "Level4" 6 "Level5" 7 "Level6" 8 "Level7" 9 "Level8" 10 "Level9_High" 11 "Reserved" 15 "Reserved" ;
VAL_ 509 RRSeatHeatgLvlSet_Nine 0 "No Action" 1 "OFF" 2 "Level1_Low" 3 "Level2" 4 "Level3" 5 "Level4" 6 "Level5" 7 "Level6" 8 "Level7" 9 "Level8" 10 "Level9_High" 11 "Reserved" 15 "Reserved" ;
VAL_ 545 CurrentGearValid 0 "Invalid" 1 "Valid" ;
VAL_ 545 CURRENT_GEAR 0 "Current gear 'N' or 'P'" 1 "Current gear '1'" 2 "Current gear '2'" 3 "Current gear '3'" 4 "Current gear '4'" 5 "Current gear '5'" 6 "Current gear '6'" 7 "Current gear '7'" 8 "Current gear 'R'" 9 "Current gear '8'" 10 "Reserved" 15 "Reserved" ;
VAL_ 545 TGS_LEVER 0 "Select lever in position 'P'" 1 "Reserved" 2 "Reserved" 3 "Reserved" 4 "Reserved" 5 "Select lever in position 'D'" 6 "Select lever in position 'N'" 7 "Select lever in position 'R'" 8 "Select lever in position 'M'" 9 "Reserved" 13 "Reserved" 14 "Intermediate position" 15 "Invalid" ;
VAL_ 545 TRANS_Warning_LAMP 0 "The Warning(Mil) light is off" 1 "The Warning(Mil) light is on" ;
VAL_ 546 IFC_Line01_DxStart 0 "valid value" 20001 "valid value" 20002 "reversed" 32767 "reversed" ;
VAL_ 546 IFC_Line01_DxEnd 0 "valid value" 20001 "valid value" 20002 "reversed" 32767 "reversed" ;
VAL_ 546 IFC_Line01_HeadingAngle 0 "valid value" 401 "valid value" 402 "reversed" 511 "reversed" ;
VAL_ 546 IFC_Line02_HeadingAngle 0 "valid value" 401 "valid value" 402 "reversed" 511 "reversed" ;
VAL_ 546 IFC_Line02_DxStart 0 "valid value" 20001 "valid value" 20002 "reversed" 32767 "reversed" ;
VAL_ 546 IFC_Line02_DxEnd 0 "valid value" 20001 "valid value" 20002 "reversed" 32767 "reversed" ;
VAL_ 546 IFC_Line03_DxStart 0 "valid value" 20001 "valid value" 20002 "reversed" 32767 "reversed" ;
VAL_ 546 IFC_Line03_DxEnd 0 "valid value" 20001 "valid value" 20002 "reversed" 32767 "reversed" ;
VAL_ 546 IFC_Line03_HeadingAngle 0 "valid value" 401 "valid value" 402 "reversed" 511 "reversed" ;
VAL_ 546 IFC_Line04_DxStart 0 "valid value" 20001 "valid value" 20002 "reversed" 32767 "reversed" ;
VAL_ 546 IFC_Line04_HeadingAngle 0 "valid value" 401 "valid value" 402 "reversed" 511 "reversed" ;
VAL_ 546 IFC_Line04_DxEnd 0 "valid value" 20001 "valid value" 20002 "reversed" 32767 "reversed" ;
VAL_ 546 IFC_Roadedge01_DxStart 0 "valid value" 20001 "valid value" 20002 "reversed" 32767 "reversed" ;
VAL_ 546 IFC_Roadedge01_DxEnd 0 "valid value" 20001 "valid value" 20002 "reversed" 32767 "reversed" ;
VAL_ 546 IFC_Roadedge01_HeadingAngle 0 "valid value" 401 "valid value" 402 "reversed" 511 "reversed" ;
VAL_ 546 IFC_Roadedge02_DxStart 0 "valid value" 20001 "valid value" 20002 "reversed" 32767 "reversed" ;
VAL_ 546 IFC_Roadedge02_DxEnd 0 "valid value" 20001 "valid value" 20002 "reversed" 32767 "reversed" ;
VAL_ 546 IFC_Roadedge02_HeadingAngle 0 "valid value" 401 "valid value" 402 "reversed" 511 "reversed" ;
VAL_ 548 ALCMMasterSwt 0 "OFF" 1 "ON" ;
VAL_ 548 ALCMPartitionSwt 0 "OFF" 1 "ON" ;
VAL_ 548 MusicFrq0 0 "63Hz amplitude intensity 0-100" 100 "63Hz amplitude intensity 0-100" 101 "No action" 102 "Reserved" 127 "Reserved" ;
VAL_ 548 MusicFrq1 0 "160Hz amplitude intensity 0-100" 100 "160Hz amplitude intensity 0-100" 101 "No action" 102 "Reserved" 127 "Reserved" ;
VAL_ 548 MusicFrq2 0 "400Hz amplitude intensity 0-100" 100 "400Hz amplitude intensity 0-100" 101 "No action" 102 "Reserved" 127 "Reserved" ;
VAL_ 548 MusicFrq3 0 "1KHz amplitude intensity 0-100" 100 "1KHz amplitude intensity 0-100" 101 "No action" 102 "Reserved" 127 "Reserved" ;
VAL_ 548 MusicFrq4 0 "2.5KHz amplitude intensity 0-100" 100 "2.5KHz amplitude intensity 0-100" 101 "No action" 102 "Reserved" 127 "Reserved" ;
VAL_ 548 MusicFrq5 0 "6.25KHz amplitude intensity 0-100" 100 "6.25KHz amplitude intensity 0-100" 101 "No action" 102 "Reserved" 127 "Reserved" ;
VAL_ 548 MusicFrq6 0 "16KHz amplitude intensity 0-100" 100 "16KHz amplitude intensity 0-100" 101 "No action" 102 "Reserved" 127 "Reserved" ;
VAL_ 551 Checksum_AEB2 0 "Valid value" 255 "Valid value" ;
VAL_ 551 AEB_PedResp 0 "OFF" 1 "ON" ;
VAL_ 551 AEB_VehResp 0 "OFF" 1 "ON" ;
VAL_ 551 FCW_Snvty 0 "Normal" 1 "High sensitivity" 2 "Low sensitivity" 3 "Reserved" ;
VAL_ 551 AEB_JA_Resp 0 "OFF" 1 "ON" ;
VAL_ 551 RollingCounter_AEB2 0 "Valid value" 14 "Valid value" 15 "Invalid value" ;
VAL_ 551 Checksum_AEB3 0 "Valid value" 255 "Valid value" ;
VAL_ 551 AEB_VehTrig 0 "not tirggered" 1 "triggered" ;
VAL_ 551 AEB_PedTrig 0 "not tirggered" 1 "triggered" ;
VAL_ 551 FCW_AEB_VehFctSts 0 "No display" 1 "error" 2 "FCWAEB_V temporarily unavailable" 3 "FCWAEB_V Performance degradation" ;
VAL_ 551 FCW_AEB_PedFctSts 0 "No display" 1 "error" 2 "FCWAEB_P temporarily unavailable" 3 "FCWAEB_P Performance degradation" ;
VAL_ 551 FCW_Warn 0 "No warning" 1 "Latent warning" 2 "warning Level 1" 3 "warning Level 2" ;
VAL_ 551 AEB_JAFuncSts 0 "No display" 1 "error" 2 "FCWAEB_JA temporarily unavailable" 3 "FCWAEB_JA Performance degradation" ;
VAL_ 551 AEB_JA_Warn 0 "No warning" 1 "Warning  for vehicle" 2 "Warning for pedestrian" 3 "reverse" ;
VAL_ 551 AEB_JABrkTrig 0 "Not tirggered" 1 "AEB_JA Function Triggered for vehicle" 2 "AEB_JA Function Triggered for pedestrian" 3 "reverse" ;
VAL_ 551 RollingCounter_AEB3 0 "Valid value" 14 "Valid value" 15 "Invalid value" ;
VAL_ 551 ACC_PotentialTgt_02_Dy 0 "Valid_value" 160 "Valid_value" 161 "Reserved" 255 "Reserved" ;
VAL_ 551 ACC_PotentialTgt_02_Dx 0 "Valid_value" 300 "Valid_value" 301 "Reserved" 511 "Reserved" ;
VAL_ 551 ACC_PotentialTgt_02_Detn 0 "Not_dectected" 1 "Dectected" 2 "Reserved" 3 "Invalid" ;
VAL_ 551 ACC_PotentialTgt_02_Typ 0 "Unkown" 1 "Sedan" 2 "Truck" 3 "Motorcycle" 4 "Pedestrian" 5 "Bicycle" 6 "Traffic_cone" 7 "Obstacle" ;
VAL_ 551 ACC_PotentialTgt_02_fusion 0 "No_fusion" 1 "Fusion" ;
VAL_ 551 ACC_LeTargrt_03_Detn 0 "Not_dectected" 1 "Dectected" 2 "Reserved" 3 "Invalid" ;
VAL_ 551 ACC_LeTgt_03_Typ 0 "Unkown" 1 "Sedan" 2 "Truck" 3 "Motorcycle" 4 "Pedestrian" 5 "Bicycle" 6 "Traffic_cone" 7 "Obstacle" ;
VAL_ 551 ACC_LeTgt_03_fusion 0 "No_fusion" 1 "Fusion" ;
VAL_ 551 ACC_RiTargrt_03_Detn 0 "Not_dectected" 1 "Dectected" 2 "Reserved" 3 "Invalid" ;
VAL_ 551 ACC_RiTgt_03_Typ 0 "Unkown" 1 "Sedan" 2 "Truck" 3 "Motorcycle" 4 "Pedestrian" 5 "Bicycle" 6 "Traffic_cone" 7 "Obstacle" ;
VAL_ 551 ACC_RiTgt_03_fusion 0 "No_fusion" 1 "Fusion" ;
VAL_ 561 FLWheelDriveDirection 0 "Invalid" 1 "Forward" 2 "Backward" 3 "Stop" ;
VAL_ 561 FRWheelDriveDirection 0 "Invalid" 1 "Forward" 2 "Backward" 3 "Stop" ;
VAL_ 561 FLWheelSpd 0 "Valid values" 5333 "Valid values" 5334 "Reserved" 8191 "Reserved" ;
VAL_ 561 FLWheelSpdVld 0 "Invalid" 1 "Valid" ;
VAL_ 561 FRWheelSpdVld 0 "Invalid" 1 "Valid" ;
VAL_ 561 FRWheelSpd 0 "Valid values" 5333 "Valid values" 5334 "Reserved" 8191 "Reserved" ;
VAL_ 561 WssFLEdgesSum 0 "Valid values" 255 "Valid values" ;
VAL_ 561 WssFREdgesSum 0 "Valid Values" 255 "Valid Values" ;
VAL_ 561 WssFLEdgesSumVld 0 "Invalid" 1 "Valid" ;
VAL_ 561 WssFREdgesSumVld 0 "Invalid" 1 "Valid" ;
VAL_ 566 CheckSum_DCT7 0 "Valid values" 255 "Valid values" ;
VAL_ 566 TrsmStNID 0 "Inactive" 1 "Break down powerflow" 2 "CSN or NUN active" 3 "Geneate power flow" 4 "Reserve" 7 "Reserve" ;
VAL_ 566 DCT_RaceModeSts 0 "Inactive" 1 "Active" 2 "Turn Off" 3 "Forbidden" 4 "Reserved (treat as 0x0 inactive)" 7 "Reserved (treat as 0x0 inactive)" ;
VAL_ 566 TRANS_OIL_TEMP 0 "Valid values" 254 "Valid values" 255 "Invalid" ;
VAL_ 566 DCT_PrsBrk_Warn 0 "No warning" 1 "Press brake and Unlock-button to shift" 2 "Press Unlock-button to shift" 3 "Press brake to shift" ;
VAL_ 566 DCT_ShftNotAlwd_Warn 0 "No warning" 1 "Vehicle speed too high, shift not allowed" 2 "Engage P not allowed due to high vehicle speed" 3 "Transmission is in N, park-lock is not locked" ;
VAL_ 566 DCT_ShftRecom_M 0 "No Recommendation" 1 "Up Shift" 2 "Down Shift" 3 "Reserved" ;
VAL_ 566 DrvWarnMsg 0 "No Text" 1 "PressBrake" 2 "TransToo_Hot" 3 "N Lock and unable to shift" 4 "Reserved" 7 "Reserved" ;
VAL_ 566 DrvFaiMsg 0 "No Message" 1 "Transmission Malfunction" 2 "Transmission P engagement fault" 3 "Transmission P disengagement fault" 4 "Atuthentication failure(reserved)" 5 "E-shift faulty" 6 "Reserved" 14 "Reserved" 15 "transmission limit function" ;
VAL_ 566 DrvModDisp 0 "P" 1 "R" 2 "N" 3 "D" 4 "M" 5 "DM" 6 "Reserved" 7 "Reserved" ;
VAL_ 566 DrvModDispSts 0 "BlankNo Display" 1 "On" 2 "Flashing" 3 "Reserved(treat as BlankNo Display)" ;
VAL_ 566 DrvAutoGearDisp 0 "Neutral" 1 "1st Gear" 2 "2nd Gear" 3 "3rd Gear" 4 "4th Gear" 5 "5th Gear" 6 "6th Gear" 7 "7th Gear" 8 "8th Gear" 9 "9th Gear" 10 "Reserved" 15 "Reserved" ;
VAL_ 566 DrvGearDispSts 0 "Blank  No display" 1 "On" 2 "Flashing" 3 "Reserved (treat as BlankNo display)" ;
VAL_ 566 RollingCounter_DCT7 0 "Valid value" 14 "Valid value" 15 "Invalid value" ;
VAL_ 568 SrAntiPinch 0 "Not active" 1 "Active" ;
VAL_ 568 SsPosn_VR_APP 0 "Fully close" 1 "reserved" 9 "reserved" 10 "10%" 11 "reserved" 19 "reserved" 20 "20%" 21 "reserved" 29 "reserved" 30 "30%" 31 "reserved" 39 "reserved" 40 "40%" 41 "reserved" 49 "reserved" 50 "50%" 51 "reserved" 59 "reserved" 60 "60%" 61 "reserved" 69 "reserved" 70 "70%" 71 "reserved" 79 "reserved" 80 "80%" 81 "reserved" 89 "reserved" 90 "90%" 91 "reserved" 99 "reserved" 100 "Fully open" 101 "Reserved" 127 "Reserved" ;
VAL_ 568 SsAntiPinch 0 "Not active" 1 "Active" ;
VAL_ 568 SrPosn_VR_APP 0 "Tilt up" 1 "reserved" 9 "reserved" 10 "10%" 11 "reserved" 19 "reserved" 20 "20%" 21 "reserved" 29 "reserved" 30 "30%" 31 "reserved" 39 "reserved" 40 "40%" 41 "reserved" 49 "reserved" 50 "50%" 51 "reserved" 59 "reserved" 60 "60%" 61 "reserved" 69 "reserved" 70 "70%" 71 "reserved" 79 "reserved" 80 "80%" 81 "reserved" 89 "reserved" 90 "90%" 91 "reserved" 99 "reserved" 100 "Fully open" 101 "Fully close" 102 "Vent area" 103 "reserved" 127 "reserved" ;
VAL_ 568 RLS_IRBrightness 0 "Vaild value" 254 "Vaild value" 255 "Invaild" ;
VAL_ 568 RLS_FwBrightness 0 "Vaild value" 4094 "Vaild value" 4095 "Invaild" ;
VAL_ 568 RLS_AmbBrightness 0 "Vaild value" 4094 "Vaild value" 4095 "Invaild" ;
VAL_ 573 Checksum_IFC3 0 "Valid value" 255 "Valid value" ;
VAL_ 573 LDWResp 0 "OFF" 1 "ON" ;
VAL_ 573 LKAResp 0 "OFF" 1 "ON" ;
VAL_ 573 LCKResp 0 "OFF" 1 "ON" ;
VAL_ 573 ELKResp 0 "OFF" 1 "ON" ;
VAL_ 573 LDW_LKA_Snvty 0 "Normal" 1 "High sensitivity" 2 "Low sensitivity" 3 "Reserved" ;
VAL_ 573 IFCHUTInterface 0 "No response" 1 "Response" ;
VAL_ 573 LSSWarnFormResp 0 "Voice" 1 "Haptic" 2 "Voice+Haptic" 3 "Reserved" ;
VAL_ 573 LSSResp 0 "OFF" 1 "ON" ;
VAL_ 573 AESSts 0 "OFF" 1 "ON" 2 "Reserved" 3 "Reserved" ;
VAL_ 573 ESSSts 0 "OFF" 1 "ON" 2 "Reserved" 3 "Reserved" ;
VAL_ 573 AESErrSts 0 "No Error" 1 "Error" ;
VAL_ 573 ESSErrSts 0 "No Error" 1 "Error" ;
VAL_ 573 RollingCounter_IFC3 0 "Valid value" 14 "Valid value" 15 "Invalid value" ;
VAL_ 573 Checksum_IFC4 0 "Valid value" 255 "Valid value" ;
VAL_ 573 IFC_Handsoffwarn 0 "No warning" 1 "Level1 warning" 2 "Level2 warning" 3 "Level3 warning" 4 "Level4 warning" 5 "Level5 warning" 6 "LKA warning" 7 "Reserved" ;
VAL_ 573 IFCCalibrationSts 0 "Calibration Success" 1 "Calibration In Process" 2 "Calibration Failed" 3 "Reserved" ;
VAL_ 573 CameraBlockageSts 0 "Camera Not Blocked" 1 "Camera Blocked" ;
VAL_ 573 LDW_LKAWarn 0 "No LDW_LKA warning" 1 "LDW_LKA left warning" 2 "LDW_LKA right warning" 3 "Reserved" ;
VAL_ 573 LSSIntervention 0 "No warning and Intervention" 1 "Left warning" 2 "Right warning" 3 "Left Intervention" 4 "Right Intervention" 5 "Both Intervention" 6 "Left warn only reminder" 7 "Right warn only reminder" ;
VAL_ 573 LSSFuncSts 0 "OFF" 1 "LDW on" 2 "LKA on" 3 "LCK ON" 4 "Reserved" 7 "Reserved" ;
VAL_ 573 ELKMainState 0 "ELK-OFF(Ã¥Â…Â³Ã©Â—Â­)" 1 "ELK-Standby(Ã¥Â¼Â€Ã¥ÂÂ¯)" 2 "ELK-Enable(Ã¥Â·Â²Ã¤Â½Â¿Ã¨ÂƒÂ½Ã¯Â¼ÂŒÃ¤Â¸ÂÃ¦Â»Â¡Ã¨Â¶Â³Ã¦Â‰Â­Ã§ÂŸÂ©Ã¤Â»Â‹Ã¥Â…Â¥Ã¦ÂÂ¡Ã¤Â»Â¶)" 3 "ELK-Road edge Active(Ã©ÂÂ“Ã¨Â·Â¯Ã¨Â¾Â¹Ã§Â¼Â˜Ã¦Â‰Â­Ã§ÂŸÂ©Ã¤Â»Â‹Ã¥Â…Â¥)" 4 "ELK-Oncoming ActiveÃ¯Â¼ÂˆoncomingÃ¦Â‰Â­Ã§ÂŸÂ©Ã¤Â»Â‹Ã¥Â…Â¥Ã¯Â¼Â‰" 5 "ELK-Overtaking ActiveÃ¯Â¼ÂˆovertakingÃ¦Â‰Â­Ã§ÂŸÂ©Ã¤Â»Â‹Ã¥Â…Â¥Ã¯Â¼Â‰" 6 "ELK-Failure" 7 "Reserved" ;
VAL_ 573 LaneAvailability 0 "Not Avaliable" 1 "Left Lane Marker Available" 2 "Right Lane Marker Available" 3 "Both Lane Markers Available" ;
VAL_ 573 TJA_FollowSts 0 "No Follow" 1 "Follow Vehicle" 2 "Reserved" 3 "Reserved" ;
VAL_ 573 LSSErrSts 0 "No error" 1 "LDW error" 2 "LKA error" 3 "LCK error" 4 "ELK error" 5 "ESS error" 6 "Reserved" 7 "Reserved" ;
VAL_ 573 AESintervention 0 "No intervention" 1 "Left intervention" 2 "Right intervention" 3 "Reserved" ;
VAL_ 573 ESSintervention 0 "No intervention" 1 "Left intervention" 2 "Right intervention" 3 "Reserved" ;
VAL_ 573 ELKActSts 0 "Inactive" 1 "Left Active" 2 "Right active" 3 "Reserved" ;
VAL_ 573 IntelligentEvaActSts 0 "Inactive" 1 "Left Eva" 2 "Right Eva" 3 "Reserved" ;
VAL_ 573 LCKStsIndcr 0 "No indicator" 1 "Active indicator" 2 "Passive indicator" 3 "Reserved" ;
VAL_ 573 RollingCounter_IFC4 0 "Valid value" 14 "Valid value" 15 "Invalid value" ;
VAL_ 573 Checksum_IFC5 0 "Valid value" 255 "Valid value" ;
VAL_ 573 IFC_LaneCurve 0 "Valid value" 4094 "Valid value" 4095 "Reserved" ;
VAL_ 573 IFC_LeLaneTyp 0 "No display" 1 "Solid lane" 2 "Dashed lane" 3 "Rode edge" 4 "Reserved" 7 "Reserved" ;
VAL_ 573 IFC_RiLaneTyp 0 "No display" 1 "Solid lane" 2 "Dashed lane" 3 "Rode edge" 4 "Reserved" 7 "Reserved" ;
VAL_ 573 IFC_NextLeLaneTyp 0 "No display" 1 "Solid lane" 2 "Dashed lane" 3 "Rode edge" 4 "Reserved" 7 "Reserved" ;
VAL_ 573 IFC_NextRiLaneTyp 0 "No display" 1 "Solid lane" 2 "Dashed lane" 3 "Rode edge" 4 "Reserved" 7 "Reserved" ;
VAL_ 573 IFC_LeLane_dy 0 "Valid value" 4094 "Valid value" 4095 "Invalid value" ;
VAL_ 573 IFC_RiLane_dy 0 "Valid value" 4094 "Valid value" 4095 "Invalid value" ;
VAL_ 573 RollingCounter_IFC5 0 "Valid value" 14 "Valid value" 15 "Invalid value" ;
VAL_ 573 Checksum_IFC6 0 "Valid value" 255 "Valid value" ;
VAL_ 573 IFC_NextLeLane_dy 0 "Valid value" 4094 "Valid value" 4095 "Invalid value" ;
VAL_ 573 IFC_NextRiLane_dy 0 "Valid value" 4094 "Valid value" 4095 "Invalid value" ;
VAL_ 573 RollingCounter_IFC6 0 "Valid value" 14 "Valid value" 15 "Invalid value" ;
VAL_ 573 AESResp 0 "OFF" 1 "ON" ;
VAL_ 573 ESS_Pedresp 0 "OFF" 1 "ON" ;
VAL_ 573 ESS_Vehresp 0 "OFF" 1 "ON" ;
VAL_ 573 IntelligentEvaResp 0 "OFF" 1 "ON" ;
VAL_ 579 AutoSpdSetSwt 0 "OFF" 1 "ON" ;
VAL_ 579 LaneChngCfmSwt 0 "OFF" 1 "ON" ;
VAL_ 579 VoiceBrdcSwt 0 "OFF" 1 "ON" ;
VAL_ 579 UsrManSts 0 "OFF" 1 "Page_1" 2 "Page_2" 3 "Page_3" 4 "Page_4" 5 "Page_5" 6 "Page_6" 7 "Page_7" 8 "Page_8" 9 "Page_9" ;
VAL_ 579 HUT_OD_WorkSts 0 "OFF" 1 "FOD Active" 2 "ROD Active" 3 "Reserved" ;
VAL_ 579 HUT_OD_Obj_Timestamp 0 "Valid values" 65535 "Valid values" ;
VAL_ 579 HUT_FSD1_distance 0 "Valid values" 60 "Valid values" 61 "Invalid values" 63 "Invalid values" ;
VAL_ 579 HUT_FSD2_distance 0 "Valid values" 60 "Valid values" 61 "Invalid values" 63 "Invalid values" ;
VAL_ 579 HUT_FSD3_distance 0 "Valid values" 60 "Valid values" 61 "Invalid values" 63 "Invalid values" ;
VAL_ 579 HUT_FSD4_distance 0 "Valid values" 60 "Valid values" 61 "Invalid values" 63 "Invalid values" ;
VAL_ 579 HUT_FSD5_distance 0 "Valid values" 60 "Valid values" 61 "Invalid values" 63 "Invalid values" ;
VAL_ 579 HUT_FSD6_distance 0 "Valid values" 60 "Valid values" 61 "Invalid values" 63 "Invalid values" ;
VAL_ 579 HUT_FSD7_distance 0 "Valid values" 60 "Valid values" 61 "Invalid values" 63 "Invalid values" ;
VAL_ 579 HUT_FSD8_distance 0 "Valid values" 60 "Valid values" 61 "Invalid values" 63 "Invalid values" ;
VAL_ 579 HUT_FSD9_distance 0 "Valid values" 60 "Valid values" 61 "Invalid values" 63 "Invalid values" ;
VAL_ 579 HUT_FSD10_distance 0 "Valid values" 60 "Valid values" 61 "Invalid values" 63 "Invalid values" ;
VAL_ 579 HUT_FSD11_distance 0 "Valid values" 60 "Valid values" 61 "Invalid values" 63 "Invalid values" ;
VAL_ 579 HUT_FSD12_distance 0 "Valid values" 60 "Valid values" 61 "Invalid values" 63 "Invalid values" ;
VAL_ 579 HUT_FSD13_distance 0 "Valid values" 60 "Valid values" 61 "Invalid values" 63 "Invalid values" ;
VAL_ 579 HUT_FSD14_distance 0 "Valid values" 60 "Valid values" 61 "Invalid values" 63 "Invalid values" ;
VAL_ 579 HUT_FSD15_distance 0 "Valid values" 60 "Valid values" 61 "Invalid values" 63 "Invalid values" ;
VAL_ 579 HUT_FSD16_distance 0 "Valid values" 60 "Valid values" 61 "Invalid values" 63 "Invalid values" ;
VAL_ 579 HUT_FSD17_distance 0 "Valid values" 60 "Valid values" 61 "Invalid values" 63 "Invalid values" ;
VAL_ 579 HUT_FSD18_distance 0 "Valid values" 60 "Valid values" 61 "Invalid values" 63 "Invalid values" ;
VAL_ 579 NOH_Swt_Req 0 "OFF" 1 "ON" ;
VAL_ 579 NOH_Act_Req 0 "deactivate" 1 "activate" ;
VAL_ 579 HUT_OD_Obj7_ID 0 "Valid values" 9 "Valid values" 10 "Invalid values" 15 "Invalid values" ;
VAL_ 579 HUT_OD_Obj7_type 0 "No target" 1 "Pedestrian or Biker" 2 "Vehicle" 3 "Ground Locker or Barrier" 4 "Unknown type" 5 "Invalid values" 7 "Invalid values" ;
VAL_ 579 HUT_OD_Obj7_Confidence 0 "0-1" 10 "0-1" 11 "Invalid values" 15 "Invalid values" ;
VAL_ 579 HUT_OD_Obj7_width 0 "Valid values" 126 "Valid values" 127 "Invalid values" ;
VAL_ 579 HUT_OD_Obj7_Ground_Pos_X 0 "Valid values" 4000 "Valid values" 4001 "Reserved" 4094 "Reserved" 4095 "Invalid values" ;
VAL_ 579 HUT_OD_Obj7_Ground_Pos_Y 0 "Valid values" 4000 "Valid values" 4001 "Reserved" 4094 "Reserved" 4095 "Invalid values" ;
VAL_ 580 MenuReturnSwtSts 0 "Released" 1 "Pressed" 2 "error" 3 "invalidation" ;
VAL_ 580 SteerWheelHeatdSts 0 "Not active" 1 "Active" ;
VAL_ 580 HomeSwtSts 0 "Released" 1 "Pressed" 2 "error" 3 "invalidation" ;
VAL_ 580 MuteSwtSts 0 "Released" 1 "Pressed" 2 "Error" 3 "invalidation" ;
VAL_ 580 CustomSwtSts 0 "Released" 1 "Pressed" 2 "error" 3 "invalidation" ;
VAL_ 580 PageUpSwtSts 0 "Released" 1 "Pressed" 2 "error" 3 "invalid" ;
VAL_ 580 PageDwnSwtSts 0 "Released" 1 "Pressed" 2 "error" 3 "invalidation" ;
VAL_ 580 PageLSwtSts 0 "Released" 1 "Pressed" 2 "error" 3 "invalidation" ;
VAL_ 580 PageRSwtSts 0 "Released" 1 "Pressed" 2 "error" 3 "invalidation" ;
VAL_ 580 SeekUpSwtSts 0 "Released" 1 "Pressed" 2 "error" 3 "invalidation" ;
VAL_ 580 SeekDwnSwtSts 0 "Released" 1 "Pressed" 2 "error" 3 "invalidation" ;
VAL_ 580 AdjVolUpSwtSts 0 "Released" 1 "Pressed" 2 "error" 3 "invalidation" ;
VAL_ 580 AdjVolDwnSwtSts 0 "Released" 1 "Pressed" 2 "error" 3 "invalidation" ;
VAL_ 580 VRSwtSts 0 "Released" 1 "Pressed" 2 "error" 3 "invalidation" ;
VAL_ 580 EnterSwtSts 0 "Released" 1 "Pressed" 2 "error" 3 "invalidation" ;
VAL_ 580 EnterSwtSts_Mmed 0 "Released" 1 "Pressed" 2 "error" 3 "invalidation" ;
VAL_ 580 CustomSwtSts_Mmed 0 "Released" 1 "Pressed" 2 "error" 3 "invalidation" ;
VAL_ 580 IpMenuSwtSts 0 "Released" 1 "Pressed" 2 "Error" 3 "Invalidation" ;
VAL_ 581 VehLgtAccel 0 "Valid Value" 44066 "Valid Value" 44067 "Reserved" 65535 "Reserved" ;
VAL_ 581 VehLatAccel 0 "Valid Value" 44066 "Valid Value" 44067 "Reserved" 65535 "Reserved" ;
VAL_ 581 VehYawRate 0 "Valid Value" 17441 "Valid Value" 17442 "Reserved" 65535 "Reserved" ;
VAL_ 581 VehLgtAccelVld 0 "Invalid" 1 "Valid" ;
VAL_ 581 VehLatAccelVld 0 "Invalid" 1 "Valid" ;
VAL_ 581 VehDynYawRateVld 0 "Invalid" 1 "Valid" ;
VAL_ 582 RLWheelSpdVld 0 "Invalid" 1 "Valid" ;
VAL_ 582 RLWheelSpd 0 "Valid values" 5333 "Valid values" 5334 "Reserved" 8191 "Reserved" ;
VAL_ 582 RRWheelSpdVld 0 "Invalid" 1 "Valid" ;
VAL_ 582 RRWheelSpd 0 "Valid values" 5333 "Valid values" 5334 "Reserved" 8191 "Reserved" ;
VAL_ 582 RLWheelDriveDirection 0 "Invalid" 1 "Forward" 2 "Backward" 3 "Stop" ;
VAL_ 582 RRWheelDriveDirection 0 "Invalid" 1 "Forward" 2 "Backward" 3 "Stop" ;
VAL_ 582 WssRREdgesSum 0 "Valid Values" 255 "Valid Values" ;
VAL_ 582 WssRLEdgesSum 0 "Valid Values" 255 "Valid Values" ;
VAL_ 582 WssRLEdgesSumVld 0 "Invalid" 1 "Valid" ;
VAL_ 582 WssRREdgesSumVld 0 "Invalid" 1 "Valid" ;
VAL_ 584 HCU_12VSysErr_1 0 "Not indicate" 1 "Indicate" ;
VAL_ 584 HCU_12VSysErr_2 0 "Not indicate" 1 "Indicate" ;
VAL_ 584 HCU_HybSysErr_1 0 "Not indicate" 1 "Indicate" ;
VAL_ 584 HCU_HybSysErr_2 0 "Not indicate" 1 "Indicate" ;
VAL_ 584 HCU_HybSysErr_5 0 "Not indicate" 1 "Indicate" ;
VAL_ 584 HCU_HybSysErr_6 0 "Not indicate" 1 "Indicate" ;
VAL_ 584 HCU_HybSysErr_7 0 "Not indicate" 1 "Indicate" ;
VAL_ 584 HCU_12VSysErrLmpSts 0 "OFF" 1 "ON" ;
VAL_ 584 HCU_HybSysErrLmpSts 0 "OFF" 1 "Yellow Light ON" 2 "Red Light ON" 3 "Reserved" ;
VAL_ 584 HCU_PowerRedWarnLmpCmd 0 "Lamp off" 1 "Lamp on" ;
VAL_ 584 HCU_EnrgFlowInd 0 "Mode 0 Vehicle standstill" 1 "Engine running and BSG is a conventional generator" 2 "Boost" 3 "Energy Recovery" 4 "E-Creep" 5 "Pure engine drive" 6 "BSG generate electricity when engine idling" 7 "Engine idling and the BSG doesnÃ¢Â€Â™t generate electricity" 8 "Reserved" 31 "Reserved" ;
VAL_ 584 HCU_HybSysErr_3 0 "Not indicate" 1 "Indicate" ;
VAL_ 584 HCU_RdyLmpSts 0 "OFF" 1 "ON" ;
VAL_ 584 CheckSum_HCU_PT7 0 "Valid values" 255 "Valid values" ;
VAL_ 584 HCU_HybSysErr_4 0 "Not indicate" 1 "Indicate" ;
VAL_ 584 HCU_EnrgFlowInd_P2 0 "Mode 1 Vehicle standstill(P2&P2+P4)" 1 "Mode 2 engine drive , P2M generate electricity and P4M generates electricity(P2+P4)" 2 "Mode 3 engine drive, P2M generate electricity and P4M drive the vehicle(P2+P4)" 3 "Mode 4 engine drive and P2M generate electricity(P2&P2+P4)" 4 "Mode 5 engine drive, P2M don't generate electricity and P4M generate electricity(P2+P4)" 5 "Mode 6 P2M with engine and P4M drive the vehicle at the same time(P2+P4)" 6 "Mode 7 P2M supply boost for engine (P2&P2+P4)" 7 "Mode 8 engine and P4M drive the vehicle at the same time(P2+P4)" 8 "Mode 9 engine drives the vehicle only (P2&P2+P4)" 9 "Mode 10 engine drives P2M to generate electricity,P4M drives the vehicle(P2MÃ£Â€Âbattery supply power)(P2+P4)" 10 "Mode 11 P2M generate electricity when engine idling(P2&P2+P4)" 11 "Mode 12 engine idling and the P2M doesnÃ¢Â€Â™t generate electricity(P2&P2+P4)" 12 "Mode 13 brake recuperation of the front wheels(P2&P2+P4)" 13 "Mode 14 brake recuperation of the rear wheels(P2+P4)" 14 "Mode 15 P2M and P4M drive the vehicle at the same time(P2+P4)" 15 "Mode 16 P4M drive the vehicle,only(P2&P2+P4)  P2M drive the vehicle,only(P2)" 16 "Mode 17 plug-in-charging(P2&P2+P4)" 17 "Mode 18 Charging heating(P2&P2+P4)" 18 "Mode 19 Charging while heating (P2&P2+P4)" 19 "Mode 20 plug-inDC-charging(P2&P2+P4)" 20 "Mode21 engine drive and P2M generate electricity(AWD)(P2&P2+P4)" 21 "Mode22 engine drives the vehicle only (AWD)(P2&P2+P4)" 22 "Mode23 P2M supply boost for engine (AWD)(P2&P2+P4)" 23 "Mode24 brake recuperation of four wheels(AWD)(P2&P2+P4)" 24 "Mode25 V2L discharging(engine stop)" 25 "Mode26 V2L discharging(engine start)" 26 "Reserved" 31 "Reserved" ;
VAL_ 584 HCU_12VSysErr_3 0 "Not indicate" 1 "Indicate" ;
VAL_ 584 HCU_OPDLmpSts 0 "Off" 1 "On" ;
VAL_ 584 HCU_OPDSts 0 "Not active" 1 "Active" 2 "Abnormal quit" 3 "Cannot active" 4 "Have no OPD function" 5 "Reserved" 7 "Reserved" ;
VAL_ 584 HCU_ModSwtFail 0 "Default" 1 "EV not available due to low battery charge" 2 "EV not available due to temporary hybrid system limitations" 3 "SAVE not available due to temporary hybrid system limitations" 4 "AWD not available due to temporary hybrid system limitations" 5 "SPORT not available due to temporary hybrid system limitations" 6 "Manual gear change ,drive mode goes SPORT" 7 "Manual gear change,only SPORT available" 8 "Forced EV mode,battery power low,performance maylimited" 9 "Snow not available due to temporary hybrid system limitations" 10 "Muddy not available due to temporary hybrid system limitations" 11 "Sand not available due to temporary hybrid system limitations" 12 "SPORT Plus Mode not available due to temporary hybrid system limitations" 13 "ECO mode not available due to temporary hybrid system limitations" 14 "EV not available due to engine needs to start" 15 "Reserved" ;
VAL_ 584 RollingCounter_HCU_PT7 0 "Valid value" 14 "Valid value" 15 "Invalid value" ;
VAL_ 589 DrowsnsLvl 0 "No Drowsiness" 1 "Low level Drowsiness" 2 "Middle level Drowsiness" 3 "High level Drowsiness" 4 "Reserved" 6 "Reserved" 7 "Invalid" ;
VAL_ 589 DrowsnsLvlQlty 0 "Valid value" 100 "Valid value" 101 "Reserved" 126 "Reserved" 127 "Invalid" ;
VAL_ 589 GenderSts 0 "Male" 1 "Female" 2 "Reserved" 3 "Invalid" ;
VAL_ 589 GenderStsQlty 0 "Valid value" 100 "Valid value" 101 "Reserved" 126 "Reserved" 127 "Invalid" ;
VAL_ 589 ExprsnSts 0 "No expression" 1 "Smile" 2 "Angry" 3 "Surprise" 4 "Sad" 5 "Calm" 6 "Reserved" 7 "Invalid" ;
VAL_ 589 Checksum_DMS2 0 "Valid values" 255 "Valid values" ;
VAL_ 589 DistrctnLvl_ACC 0 "No distraction" 1 "Low level distraction" 2 "Middle level distraction" 3 "Hi level distraction" 4 "Reserved" 6 "Reserved" 7 "Invalid" ;
VAL_ 589 DistrctnLvlQlty_ACC 0 "Valid value" 100 "Valid value" 101 "Reserved" 126 "Reserved" 127 "Invalid" ;
VAL_ 589 DrowsnsLvl_ACC 0 "No Drowsiness" 1 "Low level Drowsiness" 2 "Middle level Drowsiness" 3 "Hi level Drowsiness" 4 "Reserved" 6 "Reserved" 7 "Invalid" ;
VAL_ 589 DrowsnsLvlQlty_ACC 0 "Valid value" 100 "Valid value" 101 "Reserved" 126 "Reserved" 127 "Invalid" ;
VAL_ 589 RollingCounter_DMS2 0 "Valid value" 14 "Valid value" 15 "Invalid value" ;
VAL_ 589 Checksum_DMS3 0 "Valid values" 255 "Valid values" ;
VAL_ 589 HeadPosnX 0 "Valid value" 1500 "Valid value" 1501 "Reserved" 2046 "Reserved" 2047 "Invalid" ;
VAL_ 589 HeadPosnY 0 "Valid value" 1000 "Valid value" 1001 "Reserved" 2046 "Reserved" 2047 "Invalid" ;
VAL_ 589 HeadPosnZ 0 "Valid value" 1000 "Valid value" 1001 "Reserved" 2046 "Reserved" 2047 "Invalid" ;
VAL_ 589 HeadPosQlty 0 "Valid value" 100 "Valid value" 101 "Reserved" 126 "Reserved" 127 "Invalid" ;
VAL_ 589 RollingCounter_DMS3 0 "Valid value" 14 "Valid value" 15 "Invalid value" ;
VAL_ 589 GazePosnX 0 "Valid value" 1500 "Valid value" 1501 "Reserved" 2046 "Reserved" 2047 "Invalid" ;
VAL_ 589 GazePosnY 0 "Valid value" 1000 "Valid value" 1001 "Reserved" 2046 "Reserved" 2047 "Invalid" ;
VAL_ 589 GazePosnZ 0 "Valid value" 1000 "Valid value" 1001 "Reserved" 2046 "Reserved" 2047 "Invalid" ;
VAL_ 589 Checksum_DMS5 0 "Valid values" 255 "Valid values" ;
VAL_ 589 DMSSts 0 "Blindness" 1 "Error" 2 "Active" 3 "Not active" 4 "Reserved" 6 "Reserved" 7 "Invalid" ;
VAL_ 589 HeadDetn 0 "No" 1 "Yes" ;
VAL_ 589 HeadYawAng 0 "Valid value" 150 "Valid value" 151 "Reserved" 254 "Reserved" 255 "Invalid" ;
VAL_ 589 HeadPitchAng 0 "Valid value" 70 "Valid value" 71 "Reserved" 254 "Reserved" 255 "Invalid" ;
VAL_ 589 HeadRollAng 0 "Valid value" 90 "Valid value" 91 "Reserved" 254 "Reserved" 255 "Invalid" ;
VAL_ 589 HeadRotAngQlty 0 "Valid value" 100 "Valid value" 101 "Reserved" 126 "Reserved" 127 "Invalid" ;
VAL_ 589 RollingCounter_DMS5 0 "Valid value" 14 "Valid value" 15 "Invalid value" ;
VAL_ 589 Checksum_DMS6 0 "Valid values" 255 "Valid values" ;
VAL_ 589 LEyeOpenSts 0 "No" 1 "Yes" 2 "Loss left eye" 3 "Invalid" ;
VAL_ 589 LEyeOpenStsQlty 0 "Valid value" 100 "Valid value" 101 "Reserved" 126 "Reserved" 127 "Invalid" ;
VAL_ 589 REyeOpenSts 0 "No" 1 "Yes" 2 "Loss right eye" 3 "Invalid" ;
VAL_ 589 REyeOpenStsQlty 0 "Valid value" 100 "Valid value" 101 "Reserved" 126 "Reserved" 127 "Invalid" ;
VAL_ 589 RobustGazeYawAng 0 "Valid value" 180 "Valid value" 181 "Reserved" 254 "Reserved" 255 "Invalid" ;
VAL_ 589 RobustGazePitchAng 0 "Valid value" 180 "Valid value" 181 "Reserved" 254 "Reserved" 255 "Invalid" ;
VAL_ 589 RobustGazeAngQlty 0 "Valid value" 100 "Valid value" 101 "Reserved" 126 "Reserved" 127 "Invalid" ;
VAL_ 589 DrvBehvSts 0 "No action" 1 "Smoking" 2 "on the phone" 3 "Drinking" 4 "Reserved" 6 "Reserved" 7 "Invalid" ;
VAL_ 589 RollingCounter_DMS6 0 "Valid value" 14 "Valid value" 15 "Invalid value" ;
VAL_ 593 FuncProtnSts 0 "No fuction demotion" 1 "Fuction demotion" ;
VAL_ 593 ShiftSysStuInLow 0 "Not in low" 1 "Shift System Stuck in Low" ;
VAL_ 593 SystemOperMod 0 "Mode Unknown" 1 "System Fault" 2 "Mode 2WD" 3 "Mode 4WD (Lock)" 4 "Mode Active (AWD)" 5 "Reserved" 6 "Mode 4WD Low Range" 7 "Sport Mode (Active)(Reserved)" 8 "Unused" 15 "Unused" ;
VAL_ 593 CouplingFaultSts 0 "Normal Operating Mode" 1 "Reduced coupling functionality" 2 "Temporary coupling failure" 3 "Permanent coupling failure" ;
VAL_ 593 CouplingThermWarning 0 "No coupling thermal failsafe" 1 "coupling thermal failsafe" ;
VAL_ 593 DiagLmpReq 0 "Lamp is not being requested" 1 "Lamp is being requested" ;
VAL_ 593 ModeShiftTimeout 0 "No timeout" 1 "Timeout" ;
VAL_ 593 AutoShiftSts 0 "No AutoShift" 1 "HiLockTOAuto Active" 2 "Thermal Lock Active" 3 "AutoShift Error" ;
VAL_ 593 EstimatedTorque 0 "Valid value" 12000 "Valid value" 12001 "Reserved" 65534 "Reserved" 65535 "Invalid" ;
VAL_ 604 BLEConnSts 0 "Initial value" 1 "Not connection" 2 "Connection" 3 "Reserved" ;
VAL_ 604 BLESecuritySts 0 "Initial value" 1 "Not in Security certification status" 2 "In security certification status" 3 "Reserved" ;
VAL_ 623 CheckSum_HUT32 0 "Valid value" 255 "Valid value" ;
VAL_ 623 ScrnOpSts 0 "Release" 1 "Pressed" 2 "Hold" 3 "Reserved" ;
VAL_ 623 XLvl 0 "Valid value" 2046 "Valid value" 2047 "Invalid" ;
VAL_ 623 YLvl 0 "Valid value" 2046 "Valid value" 2047 "Invalid" ;
VAL_ 623 DetVideoLost 0 "Nomal" 1 "Video lost" ;
VAL_ 623 PrkgCtrlModReqValid 0 "valid" 1 "invalid" ;
VAL_ 623 PrkgCtrlModReq 0 "No action" 1 "Parking in car" 2 "Remote parking" 3 "Reserved" ;
VAL_ 623 ContnPrkgReqValid 0 "valid" 1 "invalid" ;
VAL_ 623 ContnPrkgReq 2 "cancle parking" 3 "invalid" ;
VAL_ 623 PrkStraightSwtReq_HUT 0 "No request" 1 "Request" ;
VAL_ 623 PrkStraightSuspendOrFinishReq_HU 0 "No request" 1 "Request suspend" 2 "Request finish" 3 "Reserved" ;
VAL_ 623 PrkStraightModSel_HUT 0 "No select" 1 "Front vertical head park straight" 2 "Rear vertical tail park straight" 3 "Reserved" ;
VAL_ 623 PrkStraightSts_HUT 0 "No error" 1 "Error" ;
VAL_ 623 PrkStraightStrtReq_HUT 0 "No request" 1 "Request" ;
VAL_ 623 PrkStraightVehStrtReq_HUT_Valid 0 "Invalid" 1 "Valid" ;
VAL_ 623 PrkStraightContinueReq_HUT 0 "User not continue request" 1 "User continue request" ;
VAL_ 623 P2P_PrkgDirSwtReq 0 "No request" 1 "Request" ;
VAL_ 623 RainMode_Swt_Req 0 "OFF" 1 "ON" ;
VAL_ 623 LCMode_Swt_Req 0 "Normal" 1 "Sport" 2 "Comfort" 3 "Reserve" ;
VAL_ 623 NavDecSwtReq 0 "OFF" 1 "ON" ;
VAL_ 623 RollingCounter_HUT32 0 "Valid value" 14 "Valid value" 15 "Invalid value" ;
VAL_ 625 FuelConsumption 0 "Valid values" 65535 "Valid values" ;
VAL_ 625 TgtCrsVehSpd 0 "Valid values" 255 "Valid values" ;
VAL_ 625 CruiseCtrlSts 0 "Inactive" 1 "Active" 2 "Standby" 3 "error" ;
VAL_ 625 AccelPedalPosn 0 "Valid values" 255 "Valid values" ;
VAL_ 625 AccelPedalPosnVldty 0 "Invalid" 1 "Valid" 2 "Init value" 3 "Reserved" ;
VAL_ 625 ThrtlPosRatio 0 "Valid values" 254 "Valid values" 255 "Invalid" ;
VAL_ 625 EngSVSSig 0 "SVS off" 1 "SVS on" ;
VAL_ 625 MILSts 0 "Off" 1 "On" ;
VAL_ 625 EngState 0 "Stopped" 1 "Cranking" 2 "Running" 3 "Stalling" ;
VAL_ 627 TrailerSts 0 "Trailer off" 1 "Trailer on" ;
SIG_GROUP_ 551 AEB2_AEB_FD2 1 : Checksum_AEB2 AEB_PedResp AEB_VehResp FCW_Snvty AEB_JA_Resp RollingCounter_AEB2;
SIG_GROUP_ 551 AEB3_AEB_FD2 1 : Checksum_AEB3 AEB_VehTrig AEB_PedTrig FCW_AEB_VehFctSts FCW_AEB_PedFctSts FCW_Warn AEB_JAFuncSts AEB_JA_Warn AEB_JABrkTrig RollingCounter_AEB3;
SIG_GROUP_ 566 DCT_FD4 1 : CheckSum_DCT7 DCT_RaceModeSts TRANS_OIL_TEMP DCT_PrsBrk_Warn DCT_ShftNotAlwd_Warn DCT_ShftRecom_M DrvWarnMsg DrvFaiMsg DrvModDisp DrvModDispSts TrsmStNID DrvGearDispSts DrvAutoGearDisp RollingCounter_DCT7;
SIG_GROUP_ 573 IFC3_IFC_FD2 1 : Checksum_IFC3 LDWResp LKAResp LCKResp ELKResp AESResp LDW_LKA_Snvty IFCHUTInterface ESS_Pedresp ESS_Vehresp LSSWarnFormResp LSSResp IntelligentEvaResp AESSts ESSSts AESErrSts ESSErrSts RollingCounter_IFC3;
SIG_GROUP_ 573 IFC4_IFC_FD2 1 : Checksum_IFC4 LDW_LKAWarn LSSIntervention LSSFuncSts ELKMainState LaneAvailability TJA_FollowSts LSSErrSts IFC_Handsoffwarn IFCCalibrationSts CameraBlockageSts ELKActSts IntelligentEvaActSts LCKStsIndcr AESintervention ESSintervention RollingCounter_IFC4;
SIG_GROUP_ 573 IFC5_IFC_FD2 1 : Checksum_IFC5 IFC_LaneCurve IFC_LeLaneTyp IFC_RiLaneTyp IFC_NextLeLaneTyp IFC_NextRiLaneTyp IFC_LeLane_dy IFC_RiLane_dy RollingCounter_IFC5;
SIG_GROUP_ 573 IFC6_IFC_FD2 1 : Checksum_IFC6 IFC_NextLeLane_dy IFC_NextRiLane_dy RollingCounter_IFC6;
SIG_GROUP_ 584 HCU_PT7 1 : CheckSum_HCU_PT7 HCU_HybSysErr_1 HCU_HybSysErr_2 HCU_HybSysErr_3 HCU_HybSysErr_4 HCU_HybSysErr_5 HCU_HybSysErr_6 HCU_HybSysErr_7 HCU_12VSysErrLmpSts HCU_EnrgFlowInd_P2 HCU_HybSysErrLmpSts HCU_PowerRedWarnLmpCmd HCU_12VSysErr_1 HCU_12VSysErr_2 HCU_12VSysErr_3 HCU_RdyLmpSts HCU_OPDLmpSts HCU_OPDSts HCU_ModSwtFail RollingCounter_HCU_PT7;
SIG_GROUP_ 589 DMS2_DMS_FD1 1 : Checksum_DMS2 DistrctnLvlQlty_ACC DrowsnsLvlQlty_ACC DistrctnLvl_ACC DrowsnsLvl_ACC RollingCounter_DMS2;
SIG_GROUP_ 589 DMS3_DMS_FD1 1 : Checksum_DMS3 HeadPosnX HeadPosnY HeadPosnZ HeadPosQlty RollingCounter_DMS3;
SIG_GROUP_ 589 DMS5_DMS_FD1 1 : Checksum_DMS5 HeadYawAng HeadPitchAng HeadRollAng HeadRotAngQlty HeadDetn DMSSts RollingCounter_DMS5;
SIG_GROUP_ 589 DMS6_DMS_FD1 1 : Checksum_DMS6 RobustGazeYawAng RobustGazePitchAng LEyeOpenStsQlty REyeOpenStsQlty RobustGazeAngQlty LEyeOpenSts REyeOpenSts DrvBehvSts RollingCounter_DMS6;
SIG_GROUP_ 623 HUT32 1 : CheckSum_HUT32 ContnPrkgReq PrkgCtrlModReq PrkStraightSwtReq_HUT PrkgCtrlModReqValid DetVideoLost ContnPrkgReqValid XLvl PrkStraightSuspendOrFinishReq_HU YLvl ScrnOpSts PrkStraightStrtReq_HUT PrkStraightVehStrtReq_HUT_Valid PrkStraightContinueReq_HUT P2P_PrkgDirSwtReq RainMode_Swt_Req LCMode_Swt_Req NavDecSwtReq PrkStraightModSel_HUT PrkStraightSts_HUT RollingCounter_HUT32;
