VERSION "created by canmatrix"

NS_ :

BS_:

BU_: CEM HUT GW T_BOX XBOX_D DVR Tester

BO_ 51 T_BOX_FD1: 16 T_BOX
 SG_ T_BOX_RemtDoorLockCtrl : 7|3@0+ (1,0) [0|7] ""  CEM,HUT
 SG_ T_BOX_AudioMuteReq : 9|2@0+ (1,0) [0|3] ""  HUT
 SG_ T_BOX_PM25AirQLvl : 43|4@0+ (1,0) [0|15] ""  HUT
 SG_ T_BOX_PM25Dens : 49|10@0+ (1,0) [0|1023] "ugm^3"  HUT
 SG_ FreshnessValue_T_BOX_FD1 : 71|16@0+ (1,0) [0|65535] ""  GW,HUT
 SG_ MAC_Check_T_BOX_FD1 : 87|48@0+ (1,0) [0|281474976710655] ""  GW,HUT
 SG_ T_BOX_RemtWinCtrl : 2|3@0+ (1,0) [0|7] ""  CEM
 SG_ T_BOX_RemtTrunkCtrl : 4|2@0+ (1,0) [0|3] ""  CEM
 SG_ T_BOX_RemtDrvTempSet : 15|6@0+ (0.5,16) [16.5|31.5] "Ã‚Â°C"  GW,CEM
 SG_ T_BOX_RemtAutoCtrl : 17|2@0+ (1,0) [0|3] ""  GW,CEM
 SG_ T_BOX_RemtPassTempSet : 23|6@0+ (0.5,16) [16.5|31.5] "Ã‚Â°C"  GW,CEM
 SG_ T_BOX_RemtSsCtrl : 27|4@0+ (1,0) [0|15] ""  CEM
 SG_ T_BOX_RemtSrCtrl : 31|4@0+ (1,0) [0|15] ""  CEM
 SG_ T_BOX_RemtDrvSeatVentnLvlSet : 34|3@0+ (1,0) [0|7] ""  CEM
 SG_ T_BOX_RemtPassSeatVentnLvlSet : 37|3@0+ (1,0) [0|7] ""  CEM
 SG_ T_BOX_RemtAIUReq : 39|2@0+ (1,0) [0|3] ""  GW,CEM
 SG_ T_BOX_RemtCarSearch : 45|2@0+ (1,0) [0|3] ""  CEM
 SG_ T_BOX_RemtEngCtrl : 47|2@0+ (1,0) [0|3] ""  CEM
 SG_ T_BOX_RemtDrvSeatHeatgLvlSet : 52|3@0+ (1,0) [0|7] ""  CEM
 SG_ T_BOX_RemtPassSeatHeatgLvlSet : 55|3@0+ (1,0) [0|7] ""  CEM
 SG_ T_BOX_FD1_0x33 : 0|64@1+ (1,0) [0|0] ""  HUT

BO_ 68 HUT7: 8 HUT
 SG_ ALCMStatSwt_OLE : 15|1@0+ (1,0) [0|1] ""  CEM
 SG_ ALCMClrSet_OLE : 14|6@0+ (1,0) [0|63] ""  CEM
 SG_ ALCMDynModSet_OLE : 23|3@0+ (1,0) [0|7] ""  CEM
 SG_ ALCMLightLvlSet_OLE : 3|4@0+ (1,0) [0|15] ""  CEM
 SG_ ALCMRhmSwt_OLE : 8|1@0+ (1,0) [0|1] ""  CEM
 SG_ ALCMBreSwt_OLE : 20|1@0+ (1,0) [0|1] ""  CEM
 SG_ ALCMRdmSwt_OLE : 19|1@0+ (1,0) [0|1] ""  CEM
 SG_ Rdm_SingleColorNr : 31|7@0+ (1,0) [0|127] ""  CEM
 SG_ HUT_VMDRTmpMonFctnSet : 7|2@0+ (1,0) [0|3] ""  GW
 SG_ HUT_VMDRInitAlarmDlySet : 5|2@0+ (1,0) [0|3] ""  GW
 SG_ OTA_UpgrdModReq : 34|3@0+ (1,0) [0|7] ""  CEM
 SG_ HUT7_0x44 : 0|64@1+ (1,0) [0|0] "" Vector__XXX

BO_ 74 HUT6: 8 HUT
 SG_ AUTODefrost_TC : 6|2@0+ (1,0) [0|3] ""  GW,CEM
 SG_ AUTODefrost_VR : 4|2@0+ (1,0) [0|3] ""  GW,CEM
 SG_ LaneCalActvtCmd : 42|1@0+ (1,0) [0|1] ""  GW
 SG_ MODChgReq : 62|1@0+ (1,0) [0|1] ""  GW
 SG_ Radar_DispCmd : 40|1@0+ (1,0) [0|1] ""  GW
 SG_ Guid_Ovl_Display_Cmd : 7|1@0+ (1,0) [0|1] ""  GW
 SG_ Sgl_View_Sel : 36|4@0+ (1,0) [0|15] ""  GW
 SG_ SwToFieldCalRstCmd : 58|1@0+ (1,0) [0|1] ""  GW
 SG_ AutoViewChgCmd : 55|1@0+ (1,0) [0|1] ""  GW
 SG_ MdlColrChgCmd : 53|1@0+ (1,0) [0|1] ""  GW
 SG_ CarMdlTrsprcySwtCmd : 49|1@0+ (1,0) [0|1] ""  GW
 SG_ CarMdlDispCmd : 63|1@0+ (1,0) [0|1] ""  GW
 SG_ AutoAVMSwSet_Cmd : 57|1@0+ (1,0) [0|1] ""  GW
 SG_ FPAS_AutoModSwt : 60|1@0+ (1,0) [0|1] ""  GW
 SG_ MEBSwtSet : 61|1@0+ (1,0) [0|1] ""  GW
 SG_ WshSoftSwt : 56|1@0+ (1,0) [0|1] ""  GW
 SG_ View_SoftswitchCmd : 59|1@0+ (1,0) [0|1] ""  GW
 SG_ HUT6_0x4A : 0|64@1+ (1,0) [0|0] "" Vector__XXX

BO_ 86 GLO_NASS1: 8 GW
 SG_ QuietVoiceReq : 7|1@0+ (1,0) [0|1] ""  HUT
 SG_ E_CALLSts : 2|3@0+ (1,0) [0|5] ""  HUT
 SG_ GLO_NASS1_0x56 : 0|64@1+ (1,0) [0|0] ""  HUT

BO_ 161 CSA2: 8 GW
 SG_ SteerWheelAng : 15|15@0+ (0.1,0) [0|780] "deg"  HUT,T_BOX
 SG_ SteerWheelAngSign : 16|1@0+ (1,0) [0|1] ""  HUT,T_BOX
 SG_ SAS_Sts : 55|2@0+ (1,0) [0|3] ""  HUT,T_BOX
 SG_ CSA2_0xA1 : 0|64@1+ (1,0) [0|0] ""  HUT

BO_ 166 DCT3: 8 GW
 SG_ TgtEngSpdIP : 47|12@0+ (2,0) [0|8190] "RPM"  HUT
 SG_ TgtEngSpdIPValid : 50|1@0+ (1,0) [0|1] ""  HUT
 SG_ DCT3_0xA6 : 0|64@1+ (1,0) [0|0] ""  HUT

BO_ 200 ESP11: 8 GW
 SG_ ESP_HMI_WarningOn : 41|2@0+ (1,0) [0|3] ""  HUT
 SG_ WadeModeWarn : 45|2@0+ (1,0) [0|3] ""  HUT
 SG_ ESP11_0xC8 : 0|64@1+ (1,0) [0|0] ""  HUT

BO_ 241 BMS4: 8 GW
 SG_ BMS_ErrCategory : 62|3@0+ (1,0) [0|7] ""  HUT
 SG_ CheckSum_BMS4 : 7|8@0+ (1,0) [0|255] ""  HUT
 SG_ BMS_PackCurr : 15|14@0+ (0.2,-1000) [-1000|1000] "A"  HUT
 SG_ BMS_PackVolt : 31|8@0+ (2,0) [0|490] "V"  HUT
 SG_ BMS_PowerDownCmplt : 53|1@0+ (1,0) [0|1] ""  HUT
 SG_ BMS_BattPoweErr : 48|2@0+ (1,0) [0|3] ""  HUT
 SG_ RollingCounter_BMS4 : 59|4@0+ (1,0) [0|15] ""  HUT
 SG_ BMS4_0xF1 : 0|64@1+ (1,0) [0|0] ""  HUT

BO_ 265 IFC1: 8 GW
 SG_ IFCTrqOvlCmdProtnValue : 15|14@0+ (1,0) [0|16383] ""  HUT
 SG_ IFCTrqOvlCmdReqValue : 39|11@0+ (0.01,-10.23) [-10.23|10.24] "Nm"  HUT
 SG_ IFC1_0x109 : 0|64@1+ (1,0) [0|0] ""  HUT

BO_ 273 ECM1: 8 GW
 SG_ EMS_AuthenResult : 25|2@0+ (1,0) [0|3] ""  HUT
 SG_ EngSpd : 47|16@0+ (0.125,0) [0|8191.875] "rpm"  HUT,T_BOX
 SG_ EngSpdVldty : 63|2@0+ (1,0) [0|2] ""  HUT,T_BOX
 SG_ EngSpd_PHEV : 47|16@0+ (0.125,0) [0|8191.875] "rpm"  HUT,T_BOX
 SG_ EngSpdVldty_PHEV : 63|2@0+ (1,0) [0|2] ""  HUT,T_BOX
 SG_ ECM1_0x111 : 0|64@1+ (1,0) [0|0] ""  HUT

BO_ 288 Ibooster_FD2: 64 GW
 SG_ IB_Warn : 46|1@0+ (1,0) [0|1] ""  HUT
 SG_ Ibooster_FD2_0x120 : 0|512@1+ (1,0) [0|0] ""  HUT

BO_ 311 ESP_FD2: 64 GW
 SG_ CheckSum_ESP2 : 71|8@0+ (1,0) [0|255] ""  HUT
 SG_ HDCFault : 89|2@0+ (1,0) [0|3] ""  HUT
 SG_ HDCCtrl : 91|2@0+ (1,0) [0|3] ""  HUT
 SG_ AVHErrSts : 99|2@0+ (1,0) [0|3] ""  HUT
 SG_ AVHSts : 101|2@0+ (1,0) [0|3] ""  HUT
 SG_ CDPActv : 103|1@0+ (1,0) [0|1] ""  HUT
 SG_ DrivingModDis : 119|5@0+ (1,0) [0|31] ""  HUT
 SG_ DrivingModReq_ESP : 96|5@0+ (1,0) [0|31] ""  HUT
 SG_ Shift_N_Warn : 114|1@0+ (1,0) [0|1] ""  HUT
 SG_ Over_Spd_Warn : 107|1@0+ (1,0) [0|1] ""  HUT
 SG_ FourL_Warn : 106|1@0+ (1,0) [0|1] ""  HUT
 SG_ TAB_Sts : 113|2@0+ (1,0) [0|3] ""  HUT
 SG_ RollingCounter_ESP2 : 123|4@0+ (1,0) [0|15] ""  HUT
 SG_ CheckSum_ESP1 : 135|8@0+ (1,0) [0|255] ""  HUT
 SG_ ESPFuncOffSts : 140|1@0+ (1,0) [0|1] ""  HUT
 SG_ ESPActvInfoLmp : 141|1@0+ (1,0) [0|1] ""  HUT
 SG_ ESPFailSts : 143|1@0+ (1,0) [0|1] ""  HUT
 SG_ IMC_Actv : 175|1@0+ (1,0) [0|1] ""  HUT
 SG_ RollingCounter_ESP1 : 187|4@0+ (1,0) [0|15] ""  HUT
 SG_ CheckSum_ABS3 : 327|8@0+ (1,0) [0|255] ""  HUT
 SG_ ABSActv : 347|1@0+ (1,0) [0|1] ""  HUT,T_BOX
 SG_ ABSFailSts : 335|1@0+ (1,0) [0|1] ""  HUT,T_BOX
 SG_ EBDFailSts : 334|1@0+ (1,0) [0|1] ""  HUT
 SG_ VehSpdVld : 333|1@0+ (1,0) [0|1] ""  HUT,T_BOX
 SG_ VehSpd : 332|13@0+ (0.05625,0) [0|299.98125] "kph"  HUT,T_BOX
 SG_ VehOdoInfoSts : 346|1@0+ (1,0) [0|1] ""  HUT
 SG_ VehOdoInfo : 345|10@0+ (1,0) [0|999] "m"  HUT
 SG_ RollingCounter_ABS3 : 379|4@0+ (1,0) [0|15] ""  HUT
 SG_ FreshnessValue_ESP_FD2 : 455|16@0+ (1,0) [0|65535] ""  HUT
 SG_ MAC_Check_ESP_FD2 : 471|48@0+ (1,0) [0|281474976710655] ""  HUT
 SG_ ESPBrkLmpCtrl : 142|1@0+ (1,0) [0|1] ""  T_BOX,HUT
 SG_ VDCActv : 148|1@0+ (1,0) [0|1] ""  T_BOX,HUT
 SG_ PTCActv : 150|1@0+ (1,0) [0|1] ""  T_BOX,HUT
 SG_ BTCActv : 151|1@0+ (1,0) [0|1] ""  T_BOX,HUT
 SG_ ESP_FD2_0x137 : 0|448@1+ (1,0) [0|0] ""  HUT

BO_ 327 EPS_FD1: 64 GW
 SG_ CheckSum_EPS1 : 7|8@0+ (1,0) [0|255] ""  HUT
 SG_ EPS_FailSts : 13|2@0+ (1,0) [0|3] ""  HUT
 SG_ EPS_SteerMod : 55|3@0+ (1,0) [0|7] ""  HUT
 SG_ SteerCorrnRmn : 63|2@0+ (1,0) [0|3] ""  HUT
 SG_ SteerCorrnResp : 61|1@0+ (1,0) [0|1] ""  HUT
 SG_ RollingCounter_EPS1 : 59|4@0+ (1,0) [0|15] ""  HUT
 SG_ EPS_FD1_0x147 : 0|512@1+ (1,0) [0|0] ""  HUT

BO_ 338 ELD1: 8 GW
 SG_ FrntELDLckSts : 35|4@0+ (1,0) [0|15] ""  HUT
 SG_ RearELDLckSts : 39|4@0+ (1,0) [0|15] ""  HUT
 SG_ ELD1_0x152 : 0|64@1+ (1,0) [0|0] ""  HUT

BO_ 347 HAP_FD1: 64 GW
 SG_ APS_PrkgMod : 117|2@0+ (1,0) [0|3] ""  HUT
 SG_ APS_ProcBar : 111|7@0+ (1,0) [0|127] "%"  HUT
 SG_ APS_SwtSts : 104|1@0+ (1,0) [0|1] ""  HUT
 SG_ APS_SlotDisp : 76|3@0+ (1,0) [0|7] ""  HUT
 SG_ APS_SysSoundIndcn : 79|3@0+ (1,0) [0|7] ""  HUT
 SG_ APS_PrkgTyp : 119|2@0+ (1,0) [0|3] ""  HUT
 SG_ APS_TextDisp : 103|8@0+ (1,0) [0|255] ""  HUT
 SG_ APS_WorkSts : 146|3@0+ (1,0) [0|7] ""  HUT
 SG_ MEB_AVHReq : 168|1@0+ (1,0) [0|1] ""  HUT
 SG_ APS_ESP_BrkDistance : 167|12@0+ (1,0) [0|4095] "cm"  HUT
 SG_ APS_BrkModSts : 151|3@0+ (1,0) [0|7] ""  HUT
 SG_ APS_BrkCategory : 137|2@0+ (1,0) [0|3] ""  HUT
 SG_ LParaPrkgOutVald : 283|1@0+ (1,0) [0|1] ""  HUT
 SG_ RParaPrkgOutVald : 282|1@0+ (1,0) [0|1] ""  HUT
 SG_ HeadVertPrkgOutVald : 281|1@0+ (1,0) [0|1] ""  HUT
 SG_ TailVertPrkgOutVald : 280|1@0+ (1,0) [0|1] ""  HUT
 SG_ HAP_SwtDispCtrlCmd : 279|3@0+ (1,0) [0|7] ""  HUT
 SG_ HAP_PrkgModCurrSts : 269|4@0+ (1,0) [0|15] ""  HUT
 SG_ APS_MovgDirc : 295|2@0+ (1,0) [0|3] ""  HUT
 SG_ P2P_PahDelSts : 265|2@0+ (1,0) [0|3] ""  HUT
 SG_ P2P_SelfDetErrCode : 276|4@0+ (1,0) [0|15] ""  HUT
 SG_ P2P_SelfDetSts : 287|2@0+ (1,0) [0|3] ""  HUT
 SG_ P2P_Pah1Avail : 272|1@0+ (1,0) [0|1] ""  HUT
 SG_ P2P_Pah2Avail : 285|1@0+ (1,0) [0|1] ""  HUT
 SG_ P2P_PrkgDirectSts : 293|1@0+ (1,0) [0|1] ""  HUT
 SG_ HAVP_WorkSts : 335|4@0+ (1,0) [0|15] ""  HUT
 SG_ PAVP_Status : 343|4@0+ (1,0) [0|15] ""  HUT
 SG_ PAVP_TextDis2 : 359|6@0+ (1,0) [0|63] ""  HUT
 SG_ ParallelSlotBtn_Ena : 367|2@0+ (1,0) [0|3] ""  HUT
 SG_ VerticalSlotBtn_Ena : 365|2@0+ (1,0) [0|3] ""  HUT
 SG_ ClockwiseBtn_Ena : 363|2@0+ (1,0) [0|3] ""  HUT
 SG_ AnticlockwiseBtn_Ena : 361|2@0+ (1,0) [0|3] ""  HUT
 SG_ SlotConfirmBtn_Ena : 375|2@0+ (1,0) [0|3] ""  HUT
 SG_ HAVP_StopBtn_Ena : 329|2@0+ (1,0) [0|3] ""  HUT
 SG_ HAVP_StartBtn_Ena : 331|2@0+ (1,0) [0|3] ""  HUT
 SG_ HAVP_SelfParLotEnding_Ena : 339|2@0+ (1,0) [0|3] ""  HUT
 SG_ PAVP_TextDis : 351|6@0+ (1,0) [0|63] ""  HUT
 SG_ AVP_T_Box_WorkSts : 317|2@0+ (1,0) [0|3] ""  T_BOX
 SG_ HAP_FD1_0x15B : 0|512@1+ (1,0) [0|0] ""  HUT

BO_ 350 CR_FD1: 64 GW
 SG_ CR_FCTA_Resp : 79|1@0+ (1,0) [0|1] ""  HUT
 SG_ CR_FCTB_Resp : 78|1@0+ (1,0) [0|1] ""  HUT
 SG_ CR_BliSts : 86|1@0+ (1,0) [0|1] ""  HUT
 SG_ FCTA_Warn : 75|1@0+ (1,0) [0|1] ""  HUT
 SG_ FCTBTrig : 83|1@0+ (1,0) [0|1] ""  HUT
 SG_ FCTA_B_FuncSts : 77|2@0+ (1,0) [0|3] ""  HUT
 SG_ FCTA_B_TTC : 110|6@0+ (0.1,0) [0|6.3] "s"  HUT
 SG_ CR_FD1_0x15E : 0|512@1+ (1,0) [0|0] ""  HUT

BO_ 357 CSA1: 8 GW
 SG_ LTurnLmpSwtSts : 19|1@0+ (1,0) [0|1] ""  HUT,T_BOX
 SG_ RTurnLmpSwtSts : 20|1@0+ (1,0) [0|1] ""  HUT,T_BOX
 SG_ AutoLmpSwtSts : 28|1@0+ (1,0) [0|1] ""  HUT,T_BOX
 SG_ HornSwtSts : 29|1@0+ (1,0) [0|1] ""  HUT
 SG_ FrntWiprSwtSts : 10|3@0+ (1,0) [0|7] ""  HUT
 SG_ PosnLmpSwtSts : 21|1@0+ (1,0) [0|1] ""  T_BOX
 SG_ FrntFogLmpSwtSts : 22|1@0+ (1,0) [0|1] ""  T_BOX
 SG_ RearFogLmpSwtSts : 23|1@0+ (1,0) [0|1] ""  T_BOX
 SG_ HiBeamSwtSts : 25|1@0+ (1,0) [0|1] ""  T_BOX
 SG_ CSA1_0x165 : 0|64@1+ (1,0) [0|0] ""  HUT

BO_ 363 EPB1: 8 GW
 SG_ CheckSum_EPB1 : 7|8@0+ (1,0) [0|255] ""  HUT
 SG_ EPBErrSts : 27|2@0+ (1,0) [0|3] ""  HUT
 SG_ EPBRedLmpSts : 25|2@0+ (1,0) [0|3] ""  HUT
 SG_ EPBSts : 29|2@0+ (1,0) [0|3] ""  HUT
 SG_ EPBTextDisp : 39|4@0+ (1,0) [0|15] ""  HUT
 SG_ PressBrakePedalPointOut : 17|1@0+ (1,0) [0|1] ""  HUT
 SG_ RollingCounter_EPB1 : 59|4@0+ (1,0) [0|15] ""  HUT
 SG_ EPB1_0x16B : 0|64@1+ (1,0) [0|0] ""  HUT

BO_ 367 RSDS_FD1: 64 GW
 SG_ RSDS_IPSoundReq : 81|2@0+ (1,0) [0|3] ""  HUT
 SG_ RSDS_ErrSts : 119|1@0+ (1,0) [0|1] ""  HUT
 SG_ RSDS_BrkgTrig : 118|1@0+ (1,0) [0|1] ""  HUT
 SG_ RSDS_BliSts : 117|1@0+ (1,0) [0|1] ""  HUT
 SG_ RSDS_TrailerSts : 116|1@0+ (1,0) [0|1] ""  HUT
 SG_ RSDS_LCAResp : 115|1@0+ (1,0) [0|1] ""  HUT
 SG_ RSDS_DOWResp : 114|1@0+ (1,0) [0|1] ""  HUT
 SG_ RSDS_RCWResp : 113|1@0+ (1,0) [0|1] ""  HUT
 SG_ RSDS_RCTAResp : 112|1@0+ (1,0) [0|1] ""  HUT
 SG_ RSDS_RCTABrkResp : 127|1@0+ (1,0) [0|1] ""  HUT
 SG_ RSDS_RCW_Trigger : 105|2@0+ (1,0) [0|3] ""  HUT
 SG_ RSDS_CTA_Actv : 126|1@0+ (1,0) [0|1] ""  HUT
 SG_ BSD_LCA_warningReqRight : 95|2@0+ (1,0) [0|3] ""  HUT
 SG_ BSD_LCA_warningReqleft : 93|2@0+ (1,0) [0|3] ""  HUT
 SG_ DOW_warningReqRight : 91|2@0+ (1,0) [0|3] ""  HUT
 SG_ DOW_warningReqleft : 89|2@0+ (1,0) [0|3] ""  HUT
 SG_ RCTA_warningReqRight : 125|1@0+ (1,0) [0|1] ""  HUT
 SG_ RCTA_warningReqLeft : 124|1@0+ (1,0) [0|1] ""  HUT
 SG_ RSDS_FD1_0x16F : 0|512@1+ (1,0) [0|0] ""  HUT

BO_ 368 ESP8: 8 GW
 SG_ CCO_Warn : 39|2@0+ (1,0) [0|3] ""  HUT
 SG_ CCO_Active : 31|2@0+ (1,0) [0|3] ""  HUT
 SG_ CCO_TgtVel : 36|5@0+ (1,2.6) [2.6|33.6] "kph"  HUT
 SG_ EspFuncOffSts_mode : 24|1@0+ (1,0) [0|1] ""  HUT
 SG_ ESP8_0x170 : 0|64@1+ (1,0) [0|0] ""  HUT

BO_ 395 AEB_FD1: 64 GW
 SG_ AEB_ABA_Level : 79|2@0+ (1,0) [0|3] ""  HUT
 SG_ AEB_ABA_Req : 77|1@0+ (1,0) [0|1] ""  HUT
 SG_ EBA_TgtDecel_Req : 76|1@0+ (1,0) [0|1] ""  HUT
 SG_ AEB_VehHldReq : 75|1@0+ (1,0) [0|1] ""  HUT
 SG_ AEB_TgtDecel_Req : 74|1@0+ (1,0) [0|1] ""  HUT
 SG_ AEB_TgtDecel_ReqValue : 87|16@0+ (0.000488,-16) [-16|16] "ms2"  HUT
 SG_ AEB_AWB_Req : 73|1@0+ (1,0) [0|1] ""  HUT
 SG_ AEB_AWB_Level : 103|4@0+ (1,0) [0|15] ""  HUT
 SG_ AEB_ABP_Req : 72|1@0+ (1,0) [0|1] ""  HUT
 SG_ AEB_BrkReqFunc : 99|3@0+ (1,0) [0|7] ""  HUT
 SG_ AEB_ObjSty : 111|3@0+ (1,0) [0|7] ""  HUT
 SG_ AEB_FD1_0x18B : 0|512@1+ (1,0) [0|0] ""  HUT

BO_ 411 F_PBOX1: 8 CEM
 SG_ FFogLmpSts_F_PBox : 8|1@0+ (1,0) [0|1] ""  HUT,T_BOX
 SG_ HiBeamSts_F_PBox : 13|1@0+ (1,0) [0|1] ""  HUT,T_BOX
 SG_ HoodSts_F_PBox : 21|1@0+ (1,0) [0|1] ""  HUT,T_BOX
 SG_ LasHdLmpSts_F_PBox : 9|1@0+ (1,0) [0|1] ""  HUT
 SG_ LHiBeamFailSts : 20|1@0+ (1,0) [0|1] ""  HUT,T_BOX
 SG_ RHiBeamFailSts : 19|1@0+ (1,0) [0|1] ""  HUT,T_BOX
 SG_ LLowBeamFailSts : 18|1@0+ (1,0) [0|1] ""  HUT,T_BOX
 SG_ LHeadLmpFailSts : 35|1@0+ (1,0) [0|1] ""  HUT
 SG_ RHeadLmpFailSts : 34|1@0+ (1,0) [0|1] ""  HUT
 SG_ RLowBeamFailSts : 17|1@0+ (1,0) [0|1] ""  HUT,T_BOX
 SG_ RLasHdLmpDiagSig : 14|1@0+ (1,0) [0|1] ""  HUT
 SG_ LLasHdLmpDiagSig : 15|1@0+ (1,0) [0|1] ""  HUT
 SG_ LowBeamSts_F_PBox : 12|1@0+ (1,0) [0|1] ""  HUT,T_BOX
 SG_ WhistleSts_F_PBox : 32|1@0+ (1,0) [0|1] ""  HUT,T_BOX
 SG_ FFogLmpFailSts : 23|2@0+ (1,0) [0|3] ""  T_BOX
 SG_ LFPosnLmpSts : 16|1@0+ (1,0) [0|1] "" Vector__XXX
 SG_ RFPosnLmpSts : 31|1@0+ (1,0) [0|1] "" Vector__XXX
 SG_ F_PBOX1_0x19B : 0|64@1+ (1,0) [0|0] ""  HUT

BO_ 412 R_PBOX1: 16 CEM
 SG_ HiPosnBrkLmpFailSts : 15|1@0+ (1,0) [0|1] ""  HUT,T_BOX
 SG_ LBrkLmpFailSts : 13|1@0+ (1,0) [0|1] ""  HUT,T_BOX
 SG_ RFogLmpFailSts_R_PBox : 29|1@0+ (1,0) [0|1] ""  HUT,T_BOX
 SG_ RFogLmpSts_R_PBox : 28|1@0+ (1,0) [0|1] ""  HUT,T_BOX
 SG_ ParkLmpSts_R_PBox : 26|1@0+ (1,0) [0|1] ""  HUT,T_BOX
 SG_ RBrkLmpFailSts : 12|1@0+ (1,0) [0|1] ""  HUT,T_BOX
 SG_ PosnLmpOutpSts_R_PBox : 11|1@0+ (1,0) [0|1] ""  HUT,T_BOX
 SG_ RRPosnLmpFailSts : 10|1@0+ (1,0) [0|1] ""  HUT,T_BOX
 SG_ RvsLmpFailSts : 9|1@0+ (1,0) [0|1] ""  HUT,T_BOX
 SG_ LRPosnLmpFailSts : 8|1@0+ (1,0) [0|1] ""  HUT,T_BOX
 SG_ LTurnLmpSts_R_PBox : 31|1@0+ (1,0) [0|1] ""  HUT,T_BOX
 SG_ RTurnLmpSts_R_PBox : 30|1@0+ (1,0) [0|1] ""  HUT,T_BOX
 SG_ RWinHeatgIconRlyCmd : 21|1@0+ (1,0) [0|1] ""  HUT,T_BOX
 SG_ RWinHeatgFailSts : 20|1@0+ (1,0) [0|1] ""  HUT
 SG_ LicPlateLmpFailSts : 14|1@0+ (1,0) [0|1] ""  HUT,T_BOX
 SG_ RTurnLmpFailSts : 19|2@0+ (1,0) [0|3] ""  HUT,T_BOX
 SG_ LTurnLmpFailSts : 17|2@0+ (1,0) [0|3] ""  HUT,T_BOX
 SG_ LBrkLmpOutpSts_R_PBox : 38|1@0+ (1,0) [0|1] ""  HUT
 SG_ RBrkLmpOutpSts_R_PBox : 24|1@0+ (1,0) [0|1] ""  HUT
 SG_ HiPosnBrkLmpOutpSts_R_PBox : 39|1@0+ (1,0) [0|1] ""  HUT
 SG_ FreshnessValue_R_PBox1 : 71|16@0+ (1,0) [0|65535] ""  HUT,T_BOX
 SG_ MAC_Check_R_PBox1 : 87|48@0+ (1,0) [0|281474976710655] ""  HUT,T_BOX
 SG_ R_PBOX1_0x19C : 0|64@1+ (1,0) [0|0] ""  HUT

BO_ 415 IFC_FD5: 64 GW
 SG_ IFC_Line01_Dy : 15|13@0+ (0.01,-30) [-30|30] "m"  HUT
 SG_ IFC_Line01_Curv : 18|15@0+ (1.6E-005,-0.25) [-0.25|0.25] "1m"  HUT
 SG_ IFC_Line01_CurvChange : 35|20@0+ (5E-008,-0.024) [-0.024|0.024] "1(m*m)"  HUT
 SG_ IFC_Line01_Type : 63|4@0+ (1,0) [0|15] ""  HUT
 SG_ IFC_Line02_Dy : 79|13@0+ (0.01,-30) [-30|30] "m"  HUT
 SG_ IFC_Line02_Curv : 82|15@0+ (1.6E-005,-0.25) [-0.25|0.25] "1m"  HUT
 SG_ IFC_Line02_CurvChange : 99|20@0+ (5E-008,-0.024) [-0.024|0.024] "1(m*m)"  HUT
 SG_ IFC_Line02_Type : 127|4@0+ (1,0) [0|15] ""  HUT
 SG_ IFC_Line03_Dy : 143|13@0+ (0.01,-30) [-30|30] "m"  HUT
 SG_ IFC_Line03_Curv : 146|15@0+ (1.6E-005,-0.25) [-0.25|0.25] "1m"  HUT
 SG_ IFC_Line03_CurvChange : 163|20@0+ (5E-008,-0.024) [-0.024|0.024] "1(m*m)"  HUT
 SG_ IFC_Line03_Type : 191|4@0+ (1,0) [0|15] ""  HUT
 SG_ IFC_Line04_Dy : 207|13@0+ (0.01,-30) [-30|30] "m"  HUT
 SG_ IFC_Line04_Curv : 210|15@0+ (1.6E-005,-0.25) [-0.25|0.25] "1m"  HUT
 SG_ IFC_Line04_CurvChange : 227|20@0+ (5E-008,-0.024) [-0.024|0.024] "1(m*m)"  HUT
 SG_ IFC_Line04_Type : 255|4@0+ (1,0) [0|15] ""  HUT
 SG_ IFC_Roadedge01_Dy : 271|13@0+ (0.01,-30) [-30|30] "m"  HUT
 SG_ IFC_Roadedge01_Curv : 274|15@0+ (1.6E-005,-0.25) [-0.25|0.25] "1m"  HUT
 SG_ IFC_Roadedge01_CurvChange : 291|20@0+ (5E-008,-0.024) [-0.024|0.024] "1(m*m)"  HUT
 SG_ IFC_Roadedge01_Type : 319|4@0+ (1,0) [0|15] ""  HUT
 SG_ IFC_Roadedge02_Dy : 335|13@0+ (0.01,-30) [-30|30] "m"  HUT
 SG_ IFC_Roadedge02_Curv : 338|15@0+ (1.6E-005,-0.25) [-0.25|0.25] "1m"  HUT
 SG_ IFC_Roadedge02_CurvChange : 355|20@0+ (5E-008,-0.024) [-0.024|0.024] "1(m*m)"  HUT
 SG_ IFC_Roadedge02_Type : 383|4@0+ (1,0) [0|15] ""  HUT
 SG_ IFC_FD5_0x19F : 0|512@1+ (1,0) [0|0] ""  HUT

BO_ 465 HUT49: 8 HUT
 SG_ AntiDisIdnResp : 7|32@0+ (1,0) [0|4294967295] ""  GW
 SG_ HUT49_0x1D1 : 0|64@1+ (1,0) [0|0] "" Vector__XXX

BO_ 473 GW_OTA: 8 CEM
 SG_ OTA_UpgrdModErrCode : 14|2@0+ (1,0) [0|3] ""  HUT
 SG_ OTAUpgrdSts : 15|1@0+ (1,0) [0|1] ""  T_BOX
 SG_ GW_OTA_0x1D9 : 0|64@1+ (1,0) [0|0] ""  HUT

BO_ 474 HUT_FD4: 64 HUT
 SG_ SlotNum_VR : 35|4@0+ (1,0) [0|15] ""  GW
 SG_ UserDefinedParkCmd : 44|1@0+ (1,0) [0|1] ""  GW
 SG_ HUT_HAVP_Set_Starting : 10|1@0+ (1,0) [0|1] ""  GW
 SG_ HUT_HAVP_Set_Path_Ending : 21|1@0+ (1,0) [0|1] ""  GW
 SG_ HUT_HAVP_APA_Permit : 43|2@0+ (1,0) [0|3] ""  GW
 SG_ UserDefPrkMenuSelCmd : 18|3@0+ (1,0) [0|1] ""  GW
 SG_ HUT_HAVP_SelfParLot_Ending : 9|1@0+ (1,0) [0|1] ""  GW
 SG_ HUT_HAVP_Return_Btn : 11|1@0+ (1,0) [0|1] ""  GW
 SG_ HUT_HAVP_Comfirm_Btn : 8|1@0+ (1,0) [0|1] ""  GW
 SG_ HUT_HAVP_Path_Select : 27|4@0+ (1,0) [0|15] ""  GW
 SG_ HUT_HAVP_Path_Delete : 31|4@0+ (1,0) [0|15] ""  GW
 SG_ HUT_HAVP_Path_SetTop : 39|4@0+ (1,0) [0|15] ""  GW
 SG_ HUT_PAVP_PathList_Req : 45|1@0+ (1,0) [0|1] ""  GW
 SG_ HUT_FD4_0x1DA : 0|512@1+ (1,0) [0|0] "" Vector__XXX

BO_ 475 HUT_FD5: 64 HUT
 SG_ HUT_ExternalDevice : 7|512@0+ (1,0) [0|3.40282366920938E+038] ""  XBOX_D
 SG_ HUT_FD5_0x1DB : 0|512@1+ (1,0) [0|0] "" Vector__XXX

BO_ 476 HUT45: 8 HUT
 SG_ PassSeatMassgModSet : 11|4@0+ (1,0) [0|15] ""  GW
 SG_ DrvSeatMassgModSet : 15|4@0+ (1,0) [0|15] ""  GW
 SG_ PPMI_P_BSR_SwtSet : 23|2@0+ (1,0) [0|3] "" Vector__XXX
 SG_ RWPC_SwtReq : 17|2@0+ (1,0) [0|3] "" Vector__XXX
 SG_ HUT45_0x1DC : 0|64@1+ (1,0) [0|0] "" Vector__XXX

BO_ 477 HUT46: 8 HUT
 SG_ DrvSeatVentnLvlSet_Nine : 7|4@0+ (1,0) [0|15] ""  CEM
 SG_ PassSeatVentnLvlSet_Nine : 3|4@0+ (1,0) [0|15] ""  CEM
 SG_ RLSeatVentnLvlSet_Nine : 15|4@0+ (1,0) [0|15] ""  CEM
 SG_ RRSeatVentnLvlSet_Nine : 11|4@0+ (1,0) [0|15] ""  CEM
 SG_ ARFSwtReq : 23|2@0+ (1,0) [0|2] ""  GW
 SG_ ASFCSwtReq : 21|2@0+ (1,0) [0|2] ""  GW
 SG_ AGSSwtReq : 19|2@0+ (1,0) [0|2] ""  GW
 SG_ SOCMngmntSwtReq : 17|2@0+ (1,0) [0|2] ""  GW
 SG_ HUT46_0x1DD : 0|64@1+ (1,0) [0|0] "" Vector__XXX

BO_ 479 DOCK2: 64 XBOX_D
 SG_ DOCK_HUT_ExternalDevice_E : 7|512@0+ (1,0) [0|3.40282366920938E+038] ""  HUT
 SG_ DOCK2_0x1DF : 0|512@1+ (1,0) [0|0] ""  HUT

BO_ 481 T_BOX_FD4: 16 T_BOX
 SG_ T_BOX_RemtVideoMonrEnaReq_APP : 41|2@0+ (1,0) [0|3] ""  HUT
 SG_ T_BOX_RemtFrntDefrostCtrl : 19|2@0+ (1,0) [0|3] ""  GW,CEM
 SG_ T_BOX_RemtRearDefrostCtrl : 39|2@0+ (1,0) [0|3] ""  GW
 SG_ T_BOX_RemtCockpitClnReq : 53|2@0+ (1,0) [0|3] ""  GW,CEM
 SG_ RemUpgrdModeCmd : 34|2@0+ (1,0) [0|3] ""  CEM
 SG_ Phone_ChrgnMode : 10|2@0+ (1,0) [0|3] ""  GW
 SG_ T_BOX_RemtSdlMod : 55|2@0+ (1,0) [0|3] ""  GW
 SG_ T_BOX_FD4_0x1E1 : 0|128@1+ (1,0) [0|0] ""  HUT

BO_ 485 HUT35: 8 HUT
 SG_ ACRearTempReq_ETC_VR : 23|5@0+ (1,0) [0|31] "" Vector__XXX
 SG_ ACRearTempSteplsReq_ETC_TC : 31|5@0+ (1,0) [0|31] "" Vector__XXX
 SG_ ACDrvTempDecReq_ETC_TC : 39|2@0+ (1,0) [0|3] "" Vector__XXX
 SG_ ACDrvTempIncReq_ETC_TC : 37|2@0+ (1,0) [0|3] "" Vector__XXX
 SG_ ACRearTempDecReq_ETC_TC : 35|2@0+ (1,0) [0|3] "" Vector__XXX
 SG_ ACRearTempIncReq_ETC_TC : 33|2@0+ (1,0) [0|3] "" Vector__XXX
 SG_ ACRearPowerReq_VR : 47|2@0+ (1,0) [0|3] ""  GW,CEM
 SG_ ACMaxReq_VR : 26|2@0+ (1,0) [0|3] ""  GW,CEM
 SG_ ACMaxReq_TC : 18|2@0+ (1,0) [0|3] ""  GW,CEM
 SG_ FrntWiprCtrl_VR : 63|2@0+ (1,0) [0|3] ""  CEM
 SG_ ACRearAutoModReq_VR : 43|2@0+ (1,0) [0|3] ""  GW,CEM
 SG_ LockWinSet : 49|1@0+ (1,0) [0|1] ""  CEM
 SG_ ACRearLockReq_TC : 45|2@0+ (1,0) [0|3] ""  GW
 SG_ SrSpdCtrlSwt : 16|1@0+ (1,0) [0|1] ""  CEM
 SG_ DPF_Request : 58|2@0+ (1,0) [0|3] ""  GW
 SG_ ColorCategory : 3|2@0+ (1,0) [0|3] ""  CEM
 SG_ SingleColorNr : 14|7@0+ (1,0) [0|64] ""  CEM
 SG_ NozHeatSwt : 61|2@0+ (1,0) [0|3] ""  CEM
 SG_ HUT35_0x1E5 : 0|64@1+ (1,0) [0|0] "" Vector__XXX

BO_ 487 HUT38: 8 HUT
 SG_ ACRLTempDecReq_TC : 7|2@0+ (1,0) [0|3] ""  GW,CEM
 SG_ ACRLTempIncReq_TC : 5|2@0+ (1,0) [0|3] ""  GW,CEM
 SG_ ACRLTempReq_VR : 15|6@0+ (0.5,15.5) [16|32] ""  GW,CEM
 SG_ ACRRTempDecReq_TC : 3|2@0+ (1,0) [0|3] ""  CEM
 SG_ ACRRTempIncReq_TC : 1|2@0+ (1,0) [0|3] ""  CEM
 SG_ ACRRTempReq_VR : 23|6@0+ (0.5,15.5) [16|32] ""  CEM
 SG_ ACRRTempSteplsReq_TC : 17|2@0+ (1,0) [0|3] ""  CEM
 SG_ ACHumidifierReq_VR : 31|2@0+ (1,0) [0|3] ""  CEM
 SG_ ACHumidifierReq_TC : 29|2@0+ (1,0) [0|3] ""  CEM
 SG_ ACOzoneReq_TC : 27|2@0+ (1,0) [0|3] ""  CEM
 SG_ ACOzoneReq_VR : 25|2@0+ (1,0) [0|3] ""  CEM
 SG_ ACUltravioletReq_TC : 39|2@0+ (1,0) [0|3] ""  CEM
 SG_ ACUltravioletReq_VR : 37|2@0+ (1,0) [0|3] ""  CEM
 SG_ ACFrntWinHeatCmd_TC : 35|2@0+ (1,0) [0|3] ""  CEM
 SG_ ACFrntWinHeatCmd_VR : 33|2@0+ (1,0) [0|3] ""  CEM
 SG_ DrvDoorALCMFlashFreq : 47|3@0+ (1,0) [0|7] ""  CEM
 SG_ PassDoorALCMFlashFreq : 44|3@0+ (1,0) [0|7] ""  CEM
 SG_ LRDoorALCMFlashFreq : 41|3@0+ (1,0) [0|7] ""  CEM
 SG_ RRDoorALCMFlashFreq : 54|3@0+ (1,0) [0|7] ""  CEM
 SG_ FootALCMFlashFreq : 51|3@0+ (1,0) [0|7] ""  CEM
 SG_ LeftPanelALCMFlashFreq : 63|3@0+ (1,0) [0|7] ""  CEM
 SG_ RightPanelALCMFlashFreq : 60|3@0+ (1,0) [0|7] ""  CEM
 SG_ ACRearLockReq_VR : 57|2@0+ (1,0) [0|3] ""  GW
 SG_ HUT38_0x1E7 : 0|64@1+ (1,0) [0|0] "" Vector__XXX

BO_ 489 HUT30: 8 HUT
 SG_ HUD_HeightLvlSwt : 12|5@0+ (1,0) [0|31] ""  GW
 SG_ HUD_BrightnessLvlSwt : 31|4@0+ (1,0) [0|15] ""  GW
 SG_ HUD_SwtReq : 25|2@0+ (1,0) [0|3] ""  GW
 SG_ BackReq_AVM : 13|1@0+ (1,0) [0|1] ""  GW,CEM
 SG_ PPMIHWSwtSet : 5|2@0+ (1,0) [0|3] "" Vector__XXX
 SG_ PPMIBSRSwtSet : 3|2@0+ (1,0) [0|3] "" Vector__XXX
 SG_ PPMIHW_SwtSet : 5|2@0+ (1,0) [0|3] "" Vector__XXX
 SG_ PPMIBSR_SwtSet : 3|2@0+ (1,0) [0|3] "" Vector__XXX
 SG_ HUT30_0x1E9 : 0|64@1+ (1,0) [0|0] "" Vector__XXX

BO_ 491 HUT39: 8 HUT
 SG_ ActvEntryLockSet : 7|1@0+ (1,0) [0|1] ""  CEM
 SG_ ActvEntryUnlockSet : 6|1@0+ (1,0) [0|1] ""  CEM
 SG_ LockPromptFunSet : 5|2@0+ (1,0) [0|3] ""  CEM
 SG_ BTAPAEntryLockSet : 3|1@0+ (1,0) [0|1] ""  CEM
 SG_ BTAPALvngUnlockSet : 2|1@0+ (1,0) [0|1] ""  CEM
 SG_ ClsWinSpdSet : 1|2@0+ (1,0) [0|3] ""  CEM
 SG_ DrvSeatMassgLvlSet : 23|3@0+ (1,0) [0|7] ""  GW,CEM
 SG_ PassSeatMassgLvlSet : 20|3@0+ (1,0) [0|7] ""  GW,CEM
 SG_ SeatKeyMemEna : 8|1@0+ (1,0) [0|1] ""  CEM
 SG_ RLSeatMassgLvlSet : 31|3@0+ (1,0) [0|7] ""  GW,CEM
 SG_ RRSeatMassgLvlSet : 28|3@0+ (1,0) [0|7] ""  GW,CEM
 SG_ DrvDoorALCMClrSet : 46|7@0+ (1,0) [0|127] ""  CEM
 SG_ PassDoorALCMClrSet : 55|7@0+ (1,0) [0|127] ""  CEM
 SG_ LRDoorALCMClrSet : 63|7@0+ (1,0) [0|127] ""  CEM
 SG_ DrvDoorALCMSwt : 48|1@0+ (1,0) [0|1] ""  CEM
 SG_ PassDoorALCMSwt : 56|1@0+ (1,0) [0|1] ""  CEM
 SG_ HUT39_0x1EB : 0|64@1+ (1,0) [0|0] "" Vector__XXX

CM_ SG_ 51 T_BOX_RemtDoorLockCtrl "Remote door lock control";
CM_ SG_ 51 T_BOX_AudioMuteReq "Request HUT mute the Audio.";
CM_ SG_ 51 T_BOX_PM25AirQLvl "PM2.5 air quality level";
CM_ SG_ 51 T_BOX_PM25Dens "PM2.5 density";
CM_ SG_ 51 MAC_Check_T_BOX_FD1 "MAC protection mechanism should comply with the GWM MAC Specificatio";
CM_ SG_ 51 T_BOX_RemtWinCtrl "Remote window control";
CM_ SG_ 51 T_BOX_RemtTrunkCtrl "Remote trunk control";
CM_ SG_ 51 T_BOX_RemtDrvTempSet "Remote driver side temperature setBD1-CAN To:AC";
CM_ SG_ 51 T_BOX_RemtAutoCtrl "Remote auto mode controlBD1-CAN To:AC";
CM_ SG_ 51 T_BOX_RemtPassTempSet "Remote passenger side temperature setBD1-CAN To:AC";
CM_ SG_ 51 T_BOX_RemtSsCtrl "Remote sunshade control";
CM_ SG_ 51 T_BOX_RemtSrCtrl "Remote sunroof control";
CM_ SG_ 51 T_BOX_RemtDrvSeatVentnLvlSet "Remote sriver seat ventilation level set";
CM_ SG_ 51 T_BOX_RemtPassSeatVentnLvlSet "Remote passenger seat ventilation level set";
CM_ SG_ 51 T_BOX_RemtAIUReq "Remote  Air Ionizer Unit  requestBD1-CAN To:AC";
CM_ SG_ 51 T_BOX_RemtCarSearch "Remote car search";
CM_ SG_ 51 T_BOX_RemtEngCtrl "Remot enging control";
CM_ SG_ 51 T_BOX_RemtDrvSeatHeatgLvlSet "Remote driver seat heating level  set";
CM_ SG_ 51 T_BOX_RemtPassSeatHeatgLvlSet "Remote passenger seat heating level  set";
CM_ SG_ 68 ALCMStatSwt_OLE "Unlimited ALCM(Ambient Light Control Module) static switch";
CM_ SG_ 68 ALCMClrSet_OLE "Unlimited ALCM(Ambient Light Control Module) colour set";
CM_ SG_ 68 ALCMDynModSet_OLE "Unlimited ALCM(Ambient Light Control Module) dynamic switch";
CM_ SG_ 68 ALCMLightLvlSet_OLE "ALCM(Ambient Light Control Module) Light level set";
CM_ SG_ 68 ALCMRhmSwt_OLE "ALCM(Ambient Light Control Module) rhythm switch";
CM_ SG_ 68 ALCMBreSwt_OLE "ALCM(Ambient Light Control Module) breathing switch";
CM_ SG_ 68 ALCMRdmSwt_OLE "ALCM(Ambient Light Control Module) random switch outline";
CM_ SG_ 68 Rdm_SingleColorNr "Random Single color number";
CM_ SG_ 68 HUT_VMDRTmpMonFctnSet "VMDR Temporary monitoring function setBD1_CAN:To VMDR";
CM_ SG_ 68 HUT_VMDRInitAlarmDlySet "VMDR Initial alarm delay setBD1_CAN:To VMDR";
CM_ SG_ 68 OTA_UpgrdModReq "HUT triggers OTA requests";
CM_ SG_ 74 AUTODefrost_TC "AUTO Defrost Request-Touch ControlBD1-CAN:To AC";
CM_ SG_ 74 AUTODefrost_VR "AUTO Defrost request for AC controlling  (Voice Request)BD1-CAN:To AC";
CM_ SG_ 74 LaneCalActvtCmd "Lane-Calibration Activate CommandADAS-CANFD To:HAP,PAS";
CM_ SG_ 74 MODChgReq "MOD change requestADAS-CANFD To:HAP,PAS";
CM_ SG_ 74 Radar_DispCmd "Used to configure the display mothod of guidance overlayADAS-CANFD To:HAP,PAS";
CM_ SG_ 74 Guid_Ovl_Display_Cmd "Used to configure the display mothod of guidance overlayADAS-CANFD To:HAP,PAS";
CM_ SG_ 74 Sgl_View_Sel "Single View SelectionADAS-CANFD To:HAP,PAS";
CM_ SG_ 74 SwToFieldCalRstCmd "Return to Auto or Manual  Calibration Result commandADAS-CANFD To:HAP,PAS";
CM_ SG_ 74 AutoViewChgCmd "Auto change view function switchADAS-CANFD To:HAP,PAS";
CM_ SG_ 74 MdlColrChgCmd "Switch the color of car modelADAS-CANFD To:HAP,PAS";
CM_ SG_ 74 CarMdlTrsprcySwtCmd "Car Model Transparency Switch CommandADAS-CANFD To:HAP,PAS";
CM_ SG_ 74 CarMdlDispCmd "Change 2D3D display mode commandADAS-CANFD To:HAP,PAS";
CM_ SG_ 74 AutoAVMSwSet_Cmd "Auto Around view swtich command to AVM.ADAS-CANFD To:HAP,PAS";
CM_ SG_ 74 FPAS_AutoModSwt "Front Park Assistant System Automatic mode RequestADAS-CANFD To:HAP,PAS";
CM_ SG_ 74 MEBSwtSet "Maneuver Braking Assistance  switch SetADAS-CANFD To:HAP,PAS,RPAS";
CM_ SG_ 74 WshSoftSwt "Car wash function softswitchADAS-CANFD To:HAP,PAS";
CM_ SG_ 74 View_SoftswitchCmd "View mode SoftswitchADAS-CANFD To:HAP,PAS";
CM_ SG_ 86 QuietVoiceReq "Indicates the quiet voice request states";
CM_ SG_ 86 E_CALLSts "E-CALL Status";
CM_ SG_ 161 SteerWheelAng "angle of steering wheel (raw data)";
CM_ SG_ 161 SteerWheelAngSign "sign of steering wheel angle (+-)
definition according to DIN 70000  ISO 8855
wheel position to left = positive
wheel position to right = negative
wheel position straightforward = 0 (positive)";
CM_ SG_ 161 SAS_Sts "Status of steering angle sensor";
CM_ SG_ 166 TgtEngSpdIP "target engine speed for IPIP Received
Chuan Dong needs this signal for improving sensitivity of IP .";
CM_ SG_ 166 TgtEngSpdIPValid "Valid Flag for target engine speed for IPIP Received
Chuan Dong needs this signal for improving sensitivity of IP .";
CM_ SG_ 200 ESP_HMI_WarningOn "ESP requests the warning lamp in the dashboard";
CM_ SG_ 200 WadeModeWarn "Wade Mode Warn";
CM_ SG_ 241 BMS_ErrCategory "BMS error Category";
CM_ SG_ 241 CheckSum_BMS4 "Use the checksum strategy from document Ã¢Â€ÂœEnd-to-End Communication Protection SpecificationÃ¢Â€ÂSC_CANFD:To HUT";
CM_ SG_ 241 BMS_PackCurr "Pack CurrentIP Received
positive value :discharging
negative value : charging";
CM_ SG_ 241 BMS_PackVolt "Pack VoltageIP Received";
CM_ SG_ 241 BMS_PowerDownCmplt "BMS power down complete .
BMS Inform HCU All Main relay have been open";
CM_ SG_ 241 BMS_BattPoweErr "Battray  Power Error";
CM_ SG_ 241 RollingCounter_BMS4 "Rolling counter BMS4SC_CANFD:To HUT";
CM_ SG_ 265 IFCTrqOvlCmdProtnValue "Lane Keeping Assist Torque overlay Command Protection Value";
CM_ SG_ 265 IFCTrqOvlCmdReqValue "Lane Keeping Assist Torque overlay Command Request ValuePositive means steers left, negative means steers right";
CM_ SG_ 273 EMS_AuthenResult "This signal describes whether the authorisation result is passed or not.IP Received";
CM_ SG_ 273 EngSpd "Engine speedIP Received";
CM_ SG_ 273 EngSpdVldty "Engine speed validity";
CM_ SG_ 273 EngSpd_PHEV "Engine speedIP Received";
CM_ SG_ 273 EngSpdVldty_PHEV "Engine speed validity";
CM_ SG_ 288 IB_Warn "iBooster requests the yellow warning lamp in the dashboard";
CM_ SG_ 311 CheckSum_ESP2 "Use the checksum strategy from document Ã¢Â€ÂœEnd-to-End Communication Protection SpecificationÃ¢Â€Â";
CM_ SG_ 311 HDCFault "HDC FaultIP Received
JustUAES ECM(4B134B154G15B) receive the signal for start-stop function";
CM_ SG_ 311 HDCCtrl "HDC control(OffOn, not active brakingOn, active braking)";
CM_ SG_ 311 AVHErrSts "error status of AVH(Automatic Vehicle Hold) functionIP Received
JustUAES ECM(4B134B154G15B) receive the signal for start-stop function";
CM_ SG_ 311 AVHSts "indicates the status of AVH(Automatic Vehicle Hold)IP Received";
CM_ SG_ 311 CDPActv "CDP(Controlled Deceleration for Parking Brake) is activeIP Received";
CM_ SG_ 311 DrivingModDis "ESP send the ack of the driver mode request signalIP Received
this signal is used for the function of All-Terrain Control . However this function is optional . When non-All-Terrain Control , this signal will be transmitted with the coding of \"0x0:Standard\".";
CM_ SG_ 311 DrivingModReq_ESP "ESP send the driver mode request signal2.this signal is used for the function of All-Terrain Control . However this function is optional . When non-All-Terrain Control , this signal will be transmitted with the coding of \"0x1:standard\".";
CM_ SG_ 311 Shift_N_Warn "If the Gear hasn't shifted to Neutral, when Vehicle will enter 4L mode,ESP will send the warning signalThis signal is only used for all-terrain function, If there is no all-terrain function,this signal will not be send .";
CM_ SG_ 311 Over_Spd_Warn "Over Speed Warn";
CM_ SG_ 311 FourL_Warn "4L_Warn";
CM_ SG_ 311 TAB_Sts "TAB control status";
CM_ SG_ 311 RollingCounter_ESP2 "Rolling Counter_ESP2";
CM_ SG_ 311 CheckSum_ESP1 "Use the checksum strategy from document Ã¢Â€ÂœEnd-to-End Communication Protection SpecificationÃ¢Â€Â";
CM_ SG_ 311 ESPFuncOffSts "ESP Function Off StateÃ¯Â¼ÂŒ
when it is 1, ESP off switch is pressed, and ESP function is offÃ¯Â¼ÂŒESP Off lamp on.
When it is 0,ESP off switch is released, and ESP function is ON, ESP Off lamp off.IP Received";
CM_ SG_ 311 ESPActvInfoLmp "Active information lamp - Indication that ESP system currently performs a brakeengine interventionIP Received";
CM_ SG_ 311 ESPFailSts "ESP fail statusIP Received";
CM_ SG_ 311 IMC_Actv "Intelligent Mode Control active";
CM_ SG_ 311 RollingCounter_ESP1 "Rolling Counter_ESP1";
CM_ SG_ 311 CheckSum_ABS3 "Use the checksum strategy from document Ã¢Â€ÂœEnd-to-End Communication Protection SpecificationÃ¢Â€Â";
CM_ SG_ 311 ABSActv "Indication that ESP system(especially ABS Module) currently performs a brake intervention. Set when ABS Active.";
CM_ SG_ 311 ABSFailSts "ABS system has detected a failure which does no allow a reliable ABS regulation and is therefore switched offIP Received";
CM_ SG_ 311 EBDFailSts "ESP system has detected a failure which does no allow a reliable ESP regulation and is therefore switched offIP Received
Ã¤Â»Â…DHTP2P2+P4Ã©ÂœÂ€T_BOXÃ¦ÂŽÂ¥Ã¦Â”Â¶";
CM_ SG_ 311 VehSpdVld "Qualityfault information to current Vehicle speed information.";
CM_ SG_ 311 VehSpd "Current Vehicle speed information
(when v <0.1 kph, set value to 0)";
CM_ SG_ 311 VehOdoInfoSts "Vehicle odograph information StatusIP Received";
CM_ SG_ 311 VehOdoInfo "Vehicle odograph informationIP Received";
CM_ SG_ 311 RollingCounter_ABS3 "Rolling Counter_ABS3";
CM_ SG_ 311 MAC_Check_ESP_FD2 "MAC protection mechanism should comply with the GWM MAC Specificatio";
CM_ SG_ 311 ESPBrkLmpCtrl "Brake lamp(onoff),come from ESP,HDC,CDP,EPB,AEB,CDD,AVHfunction";
CM_ SG_ 311 VDCActv "Vehicle dynamic control active";
CM_ SG_ 311 PTCActv "PTC(Power Torque Control) is active";
CM_ SG_ 311 BTCActv "Brake torque  Control active";
CM_ SG_ 327 CheckSum_EPS1 "Use the checksum strategy from document Ã¢Â€ÂœEnd-to-End Communication Protection SpecificationÃ¢Â€Â";
CM_ SG_ 327 EPS_FailSts "Electrical steering fail statusIP Received";
CM_ SG_ 327 EPS_SteerMod "EPS steering mode";
CM_ SG_ 327 SteerCorrnRmn "Steering Wheel Correction Reminder";
CM_ SG_ 327 SteerCorrnResp "Steering Correction Reminder Switch Response";
CM_ SG_ 327 RollingCounter_EPS1 "Rolling counter_EPS1";
CM_ SG_ 338 FrntELDLckSts "ELD Front ELock Status";
CM_ SG_ 338 RearELDLckSts "ELD Rear ELock Status";
CM_ SG_ 347 APS_PrkgMod "APS Parking Mode";
CM_ SG_ 347 APS_ProcBar "APS Process bar";
CM_ SG_ 347 APS_SwtSts "APS Switch status";
CM_ SG_ 347 APS_SlotDisp "APS Slot Display";
CM_ SG_ 347 APS_SysSoundIndcn "APS_System Sound IndicationIP Received";
CM_ SG_ 347 APS_PrkgTyp "APS Parking Type";
CM_ SG_ 347 APS_TextDisp "APS Text Display";
CM_ SG_ 347 APS_WorkSts "APS Work statusIP Received";
CM_ SG_ 347 MEB_AVHReq "inform ESP the MEB request Auto Hold";
CM_ SG_ 347 APS_ESP_BrkDistance "inform the ESP the parking target distance";
CM_ SG_ 347 APS_BrkModSts "APS activation brake mode status";
CM_ SG_ 347 APS_BrkCategory "APS Brake Category";
CM_ SG_ 347 LParaPrkgOutVald "Left parallel Parking Out Valid";
CM_ SG_ 347 RParaPrkgOutVald "Right parallel Parking Out Valid";
CM_ SG_ 347 HeadVertPrkgOutVald "Head Vertical Parking Out Valid";
CM_ SG_ 347 TailVertPrkgOutVald "Tail Vertical Parking Out Valid";
CM_ SG_ 347 HAP_SwtDispCtrlCmd "control switch area display mode";
CM_ SG_ 347 HAP_PrkgModCurrSts "show park mode of current parking";
CM_ SG_ 347 APS_MovgDirc "Moving direction of parking";
CM_ SG_ 347 P2P_PahDelSts "P2P function path delete status";
CM_ SG_ 347 P2P_SelfDetErrCode "Point to point self detect error code";
CM_ SG_ 347 P2P_SelfDetSts "Point to Point parking function self detect status";
CM_ SG_ 347 P2P_Pah1Avail "path one is available for rountie play back";
CM_ SG_ 347 P2P_Pah2Avail "path two is available for rountie play back";
CM_ SG_ 347 P2P_PrkgDirectSts "Point to Point Parking Direct Status";
CM_ SG_ 347 HAVP_WorkSts "HAVP working status HAVPÃ¥Â·Â¥Ã¤Â½ÂœÃ§ÂŠÂ¶Ã¦Â€Â";
CM_ SG_ 347 PAVP_Status "PAVP working status PAVPÃ¥ÂŠÂŸÃ¨ÂƒÂ½Ã§ÂŠÂ¶Ã¦Â€Â";
CM_ SG_ 347 PAVP_TextDis2 "PAVP text display HUT BCDÃ¥ÂŒÂºÃ¦Â˜Â¾Ã§Â¤ÂºÃ¥Â†Â…Ã¥Â®Â¹";
CM_ SG_ 347 ParallelSlotBtn_Ena "Parallel Slot button enableÃ¨Â‡ÂªÃ©Â€Â‰Ã¨Â½Â¦Ã¤Â½ÂÃ§Â•ÂŒÃ©ÂÂ¢Ã¦Â°Â´Ã¥Â¹Â³Ã¨Â½Â¦Ã¤Â½ÂÃ¦ÂŒÂ‰Ã©Â”Â®Ã§ÂŠÂ¶Ã¦Â€Â";
CM_ SG_ 347 VerticalSlotBtn_Ena "Vertical Slot button enableÃ¨Â‡ÂªÃ©Â€Â‰Ã¨Â½Â¦Ã¤Â½ÂÃ§Â•ÂŒÃ©ÂÂ¢Ã¥ÂžÂ‚Ã§Â›Â´Ã¨Â½Â¦Ã¤Â½ÂÃ¦ÂŒÂ‰Ã©Â”Â®Ã§ÂŠÂ¶Ã¦Â€Â";
CM_ SG_ 347 ClockwiseBtn_Ena "Clockwise button enableÃ¨Â‡ÂªÃ©Â€Â‰Ã¨Â½Â¦Ã¤Â½ÂÃ§Â•ÂŒÃ©ÂÂ¢Ã©Â¡ÂºÃ¦Â—Â¶Ã©Â’ÂˆÃ¦ÂŒÂ‰Ã©Â”Â®Ã§ÂŠÂ¶Ã¦Â€Â";
CM_ SG_ 347 AnticlockwiseBtn_Ena "Anticlockwise button enableÃ¨Â‡ÂªÃ©Â€Â‰Ã¨Â½Â¦Ã¤Â½ÂÃ§Â•ÂŒÃ©ÂÂ¢Ã©Â€Â†Ã¦Â—Â¶Ã©Â’ÂˆÃ¦ÂŒÂ‰Ã©Â”Â®Ã§ÂŠÂ¶Ã¦Â€Â";
CM_ SG_ 347 SlotConfirmBtn_Ena "Anticlockwise button enableÃ¨Â‡ÂªÃ©Â€Â‰Ã¨Â½Â¦Ã¤Â½ÂÃ§Â•ÂŒÃ©ÂÂ¢Ã§Â¡Â®Ã¨Â®Â¤Ã¨Â½Â¦Ã¤Â½ÂÃ¦ÂŒÂ‰Ã©Â”Â®Ã§ÂŠÂ¶Ã¦Â€Â";
CM_ SG_ 347 HAVP_StopBtn_Ena "Ending button enableÃ¨Â®Â¾Ã§Â½Â®Ã¥Â½Â“Ã¥Â‰ÂÃ¤Â½ÂÃ§Â½Â®Ã¤Â¸ÂºÃ§Â»ÂˆÃ§Â‚Â¹Ã¦ÂŒÂ‰Ã©Â”Â®Ã§ÂŠÂ¶Ã¦Â€Â";
CM_ SG_ 347 HAVP_StartBtn_Ena "Starting button enable
Ã¨Â®Â¾Ã§Â½Â®Ã¥Â½Â“Ã¥Â‰ÂÃ¤Â½ÂÃ§Â½Â®Ã¤Â¸ÂºÃ¨ÂµÂ·Ã§Â‚Â¹Ã¦ÂŒÂ‰Ã©Â”Â®Ã§ÂŠÂ¶Ã¦Â€Â";
CM_ SG_ 347 HAVP_SelfParLotEnding_Ena "Self-selection parking lot for ending poing enable status
Ã¨Â®Â¾Ã§Â½Â®Ã¨Â‡ÂªÃ©Â€Â‰Ã¨Â½Â¦Ã¤Â½ÂÃ¤Â¸ÂºÃ§Â»ÂˆÃ§Â‚Â¹Ã¦ÂŒÂ‰Ã©Â”Â®Ã§ÂŠÂ¶Ã¦Â€Â";
CM_ SG_ 347 PAVP_TextDis "PAVP text display PAVPÃ¤ÂºÂ¤Ã¤ÂºÂ’Ã¦Â˜Â¾Ã§Â¤ÂºÃ¤Â¿Â¡Ã¦ÂÂ¯Ã¦ÂÂÃ©Â†Â’";
CM_ SG_ 347 AVP_T_Box_WorkSts "AVP Work Status to T_Box";
CM_ SG_ 350 CR_FCTA_Resp "Indicate FCTAÃ¯Â¼ÂˆFront Cross Traffic AlertÃ‚Â Ã¯Â¼Â‰ Switch statusL3Ã©ÂœÂ€Ã¨Â¦ÂÃ¥Â¢ÂžÃ¥ÂŠÂ ";
CM_ SG_ 350 CR_FCTB_Resp "Indicate FCTBÃ¯Â¼ÂˆFront Cross Traffic BrakeÃ‚Â Ã¯Â¼Â‰ Switch statusL3Ã©ÂœÂ€Ã¨Â¦ÂÃ¥Â¢ÂžÃ¥ÂŠÂ ";
CM_ SG_ 350 CR_BliSts "indicate Corner Radar blindness StatusL3Ã©ÂœÂ€Ã¨Â¦ÂÃ¥Â¢ÂžÃ¥ÂŠÂ ";
CM_ SG_ 350 FCTA_Warn "indicate FCTA Warning LevelL3Ã©ÂœÂ€Ã¨Â¦ÂÃ¥Â¢ÂžÃ¥ÂŠÂ ";
CM_ SG_ 350 FCTBTrig "indicate Corner Radar brake Status for ESPL3Ã©ÂœÂ€Ã¨Â¦ÂÃ¥Â¢ÂžÃ¥ÂŠÂ ";
CM_ SG_ 350 FCTA_B_FuncSts "Indicate FCTA_B fuction system working statusL3Ã©ÂœÂ€Ã¨Â¦ÂÃ¥Â¢ÂžÃ¥ÂŠÂ ";
CM_ SG_ 350 FCTA_B_TTC "FCTAFCTB TTC";
CM_ SG_ 357 LTurnLmpSwtSts "Left Turn Lamp Switch Status";
CM_ SG_ 357 RTurnLmpSwtSts "Right Turn Lamp Switch Status";
CM_ SG_ 357 AutoLmpSwtSts "Auto lamp switch status
When CSA detected auto light switch logical is ON, then signal is Auto,
When CSA detected light switch is different from auto lamp, then this signal is Non-Auto.Ã§ÂÂ¯Ã¥Â…Â‰Ã¥Â¼Â€Ã¥Â…Â³Ã¦Â˜Â¯Ã¥ÂÂ¦Ã¥Â¤Â„Ã¤ÂºÂŽautoÃ¦Â¡Â£Ã¥Â¼Â€Ã¥Â…Â³Ã¤Â¿Â¡Ã¥ÂÂ·IP Received";
CM_ SG_ 357 HornSwtSts "Horn switch States";
CM_ SG_ 357 FrntWiprSwtSts "Front Wiper Switch Status";
CM_ SG_ 357 PosnLmpSwtSts "position lamp switch status";
CM_ SG_ 357 FrntFogLmpSwtSts "Front Fog Lamp Switch Status";
CM_ SG_ 357 RearFogLmpSwtSts "Rear Fog Lamp Switch Status";
CM_ SG_ 357 HiBeamSwtSts "high beam switch status";
CM_ SG_ 363 CheckSum_EPB1 "Use the checksum strategy from document Ã¢Â€ÂœEnd-to-End Communication Protection SpecificationÃ¢Â€Â";
CM_ SG_ 363 EPBErrSts "error indication of EPB system,and indicated yellow lamp on IP.IP Received";
CM_ SG_ 363 EPBRedLmpSts "indicate the EPB red lamp status to driver for dashboardIP Received";
CM_ SG_ 363 EPBSts "EPB status,indicate calipers status.";
CM_ SG_ 363 EPBTextDisp "EPB system status for text displayIP Received";
CM_ SG_ 363 PressBrakePedalPointOut "When driver want to release EPB with button, the system provides driver a reminder if pedal is not applied.IP Received";
CM_ SG_ 363 RollingCounter_EPB1 "Rolling Counter_EPB1";
CM_ SG_ 367 RSDS_IPSoundReq "IP sound RequestIP Received";
CM_ SG_ 367 RSDS_ErrSts "show the RSDS status of  failureIP Received";
CM_ SG_ 367 RSDS_BrkgTrig "Indicate the CTA Braking function had been triggeredIP Received";
CM_ SG_ 367 RSDS_BliSts "RSDS Blindness StatesIP Received";
CM_ SG_ 367 RSDS_TrailerSts "RSDS Trailer StatesIP Received";
CM_ SG_ 367 RSDS_LCAResp "Indicate LCAÃ¯Â¼ÂˆLane Change AssistÃ‚Â Ã¯Â¼Â‰ Switch statusIP Received";
CM_ SG_ 367 RSDS_DOWResp "Indicate DOW(door open warning) Switch status";
CM_ SG_ 367 RSDS_RCWResp "Indicate RCWÃ¯Â¼ÂˆRear Collision Warning Ã¯Â¼Â‰ Switch status";
CM_ SG_ 367 RSDS_RCTAResp "Indicate CTA  Ã¯Â¼ÂˆCross Traffic Assist Ã¯Â¼Â‰Switch status";
CM_ SG_ 367 RSDS_RCTABrkResp "Indicate CTA _Brake Ã¯Â¼ÂˆCross Traffic Assist With BrakeÃ¯Â¼Â‰Switch status";
CM_ SG_ 367 RSDS_RCW_Trigger "indicate RCW trigger statusIP Received";
CM_ SG_ 367 RSDS_CTA_Actv "show the CTA  Ã¯Â¼ÂˆCross Traffic Assist Ã¯Â¼Â‰statusIP Received";
CM_ SG_ 367 BSD_LCA_warningReqRight "Request BSDLCA right side warning element";
CM_ SG_ 367 BSD_LCA_warningReqleft "Request BSDLCA left side warning element";
CM_ SG_ 367 DOW_warningReqRight "Request DOW right side warning element";
CM_ SG_ 367 DOW_warningReqleft "Request DOW left side warning element";
CM_ SG_ 367 RCTA_warningReqRight "Request RCTA right side warning element";
CM_ SG_ 367 RCTA_warningReqLeft "Request RCTA left side warning element";
CM_ SG_ 368 CCO_Warn "Indicate that the driver should release EPB or slow down";
CM_ SG_ 368 CCO_Active "Indicates that CCO is active (CCO standby or active velocity control)";
CM_ SG_ 368 CCO_TgtVel "The target velocity of CCO function.";
CM_ SG_ 368 EspFuncOffSts_mode "When it is1 , ESP off switch is pressed, and ESP function(TCSVDCDTCRMI) is offÃ¯Â¼ÂŒESP off lamp lights onÃ¯Â¼ÂŒand display Cross-country expert mode in the IP
When it is 0,ESP off switch is released, and ESP function is ON, ESP Off lamp lights off.";
CM_ SG_ 395 AEB_ABA_Level "ABA level to the ESP HBA.";
CM_ SG_ 395 AEB_ABA_Req "Request of the ABA support from ESP.";
CM_ SG_ 395 EBA_TgtDecel_Req "Request of the EBA deceleration control.";
CM_ SG_ 395 AEB_VehHldReq "AEBÃ‚Â Ã‚Â request ESP hold vehicle";
CM_ SG_ 395 AEB_TgtDecel_Req "Request of the AEB deceleration control.";
CM_ SG_ 395 AEB_TgtDecel_ReqValue "Target deceleration value from AEBEBA";
CM_ SG_ 395 AEB_AWB_Req "Request of the brake jerk warning to ESP.";
CM_ SG_ 395 AEB_AWB_Level "Different level request of the brake jerk.";
CM_ SG_ 395 AEB_ABP_Req "Request of the Prefill to ESP.";
CM_ SG_ 395 AEB_BrkReqFunc "Display which Function request ESP Brake.";
CM_ SG_ 395 AEB_ObjSty "Indicate the style of AEB function trigger object";
CM_ SG_ 411 FFogLmpSts_F_PBox "Front fog lamp statusIP Received";
CM_ SG_ 411 HiBeamSts_F_PBox "High beam statusIP Received
HUT_Sub:To HUD";
CM_ SG_ 411 HoodSts_F_PBox "hood statusIP Received";
CM_ SG_ 411 LasHdLmpSts_F_PBox "Laser Head Lamp StatusIP Received";
CM_ SG_ 411 LHiBeamFailSts "Left High beam failure statusIP Received";
CM_ SG_ 411 RHiBeamFailSts "Right High beam failure statusIP Received";
CM_ SG_ 411 LLowBeamFailSts "Left Low beam  failure statusIP Received";
CM_ SG_ 411 LHeadLmpFailSts "Left head lamp failure statusIP Received";
CM_ SG_ 411 RHeadLmpFailSts "Right head lamp failure statusIP Received";
CM_ SG_ 411 RLowBeamFailSts "Right Low beam  failure statusIP Received";
CM_ SG_ 411 RLasHdLmpDiagSig "Right Laser head lamp Diagnose signalIP Received";
CM_ SG_ 411 LLasHdLmpDiagSig "Left Laser head lamp Diagnose signalIP Received";
CM_ SG_ 411 LowBeamSts_F_PBox "Low beam status";
CM_ SG_ 411 WhistleSts_F_PBox "The state of the whistle signal.";
CM_ SG_ 411 FFogLmpFailSts "Front fog lamp failure status";
CM_ SG_ 411 LFPosnLmpSts "Left  front position lamp status";
CM_ SG_ 411 RFPosnLmpSts "Right  front position lamp status";
CM_ SG_ 412 HiPosnBrkLmpFailSts "High position Brake lamp failure statusIP Received";
CM_ SG_ 412 LBrkLmpFailSts "Left  Brake lamp failure stausIP Received";
CM_ SG_ 412 RFogLmpFailSts_R_PBox "Rear fog lamp failure statusIP Received";
CM_ SG_ 412 RFogLmpSts_R_PBox "Rear fog lamp statusIP Received";
CM_ SG_ 412 ParkLmpSts_R_PBox "Park lamp statusIP Received";
CM_ SG_ 412 RBrkLmpFailSts "Right  Brake lamp failure stausIP Received";
CM_ SG_ 412 PosnLmpOutpSts_R_PBox "Position lamp output statusIP Received
HUT_Sub:To HUD";
CM_ SG_ 412 RRPosnLmpFailSts "Right rear  position lamp failure stausIP Received";
CM_ SG_ 412 RvsLmpFailSts "Revers Lamp failure stausIP Received";
CM_ SG_ 412 LRPosnLmpFailSts "Left  rear position lamp failure statusIP Received";
CM_ SG_ 412 LTurnLmpSts_R_PBox "Left turn lamp statusIP Received";
CM_ SG_ 412 RTurnLmpSts_R_PBox "Right turn lamp statusIP Received";
CM_ SG_ 412 RWinHeatgIconRlyCmd "Rear Window Heating Icon RelayCommandthis signal is transferred to CCSM by BCM";
CM_ SG_ 412 RWinHeatgFailSts "Rear Window Heating Status";
CM_ SG_ 412 LicPlateLmpFailSts "License plate lamp fail statusIP Received";
CM_ SG_ 412 RTurnLmpFailSts "Right turn lamp failure status";
CM_ SG_ 412 LTurnLmpFailSts "Left turn lamp failure status";
CM_ SG_ 412 LBrkLmpOutpSts_R_PBox "Left  Brake lamp output status";
CM_ SG_ 412 RBrkLmpOutpSts_R_PBox "Right  Brake lamp output status";
CM_ SG_ 412 HiPosnBrkLmpOutpSts_R_PBox "High position Brake lamp output status";
CM_ SG_ 412 MAC_Check_R_PBox1 "MAC protection mechanism should comply with the GWM MAC Specificatio";
CM_ SG_ 415 IFC_Line01_Dy "Dy at position of DxStart  (not always x=0, because of high values for 2nd segment)";
CM_ SG_ 415 IFC_Line01_Curv "Curvature of the Line, also called kappa";
CM_ SG_ 415 IFC_Line01_CurvChange "Currvature change or alteration of the Line, also called kappaDt";
CM_ SG_ 415 IFC_Line01_Type "Type of the Line";
CM_ SG_ 415 IFC_Line02_Dy "Dy at position of DxStart  (not always x=0, because of high values for 2nd segment)";
CM_ SG_ 415 IFC_Line02_Curv "Curvature of the Line, also called kappa";
CM_ SG_ 415 IFC_Line02_CurvChange "Currvature change or alteration of the Line, also called kappaDt";
CM_ SG_ 415 IFC_Line02_Type "Type of the Line";
CM_ SG_ 415 IFC_Line03_Dy "Dy at position of DxStart  (not always x=0, because of high values for 2nd segment)";
CM_ SG_ 415 IFC_Line03_Curv "Curvature of the Line, also called kappa";
CM_ SG_ 415 IFC_Line03_CurvChange "Currvature change or alteration of the Line, also called kappaDt";
CM_ SG_ 415 IFC_Line03_Type "Type of the Line";
CM_ SG_ 415 IFC_Line04_Dy "Dy at position of DxStart  (not always x=0, because of high values for 2nd segment)";
CM_ SG_ 415 IFC_Line04_Curv "Curvature of the Line, also called kappa";
CM_ SG_ 415 IFC_Line04_CurvChange "Currvature change or alteration of the Line, also called kappaDt";
CM_ SG_ 415 IFC_Line04_Type "Type of the Line";
CM_ SG_ 415 IFC_Roadedge01_Dy "Dy at position of DxStart  (not always x=0, because of high values for 2nd segment)";
CM_ SG_ 415 IFC_Roadedge01_Curv "Curvature of the Line, also called kappa";
CM_ SG_ 415 IFC_Roadedge01_CurvChange "Currvature change or alteration of the Line, also called kappaDt";
CM_ SG_ 415 IFC_Roadedge01_Type "Type of the Line";
CM_ SG_ 415 IFC_Roadedge02_Dy "Dy at position of DxStart  (not always x=0, because of high values for 2nd segment)";
CM_ SG_ 415 IFC_Roadedge02_Curv "Curvature of the Line, also called kappa";
CM_ SG_ 415 IFC_Roadedge02_CurvChange "Currvature change or alteration of the Line, also called kappaDt";
CM_ SG_ 415 IFC_Roadedge02_Type "Type of the Line";
CM_ SG_ 465 AntiDisIdnResp "Anti-dismantle identification responseBD1_CAN:To ETC";
CM_ SG_ 473 OTA_UpgrdModErrCode "Unable to enter the vehicle upgrade mode.";
CM_ SG_ 473 OTAUpgrdSts "Remote upgrade mode";
CM_ SG_ 474 SlotNum_VR "select parking lot through voice controlÃ©ÂÂ¥Ã¦ÂŽÂ§Ã¦ÂÂœÃ§Â´Â¢Ã¨Â½Â¦Ã¤Â½ÂÃ¥ÂŠÂŸÃ¨ÂƒÂ½Ã¥Â¢ÂžÃ¥ÂŠÂ Ã§ÂšÂ„HUTÃ¥ÂÂ‘Ã¥Â‡ÂºÃ§ÂšÂ„Ã¥Â£Â°Ã©ÂŸÂ³Ã¦ÂŽÂ§Ã¥ÂˆÂ¶Ã©Â€Â‰Ã¨Â½Â¦Ã¤Â½ÂÃ¥ÂÂ·Ã¤Â¿Â¡Ã¥ÂÂ·ADAS1_CAN:To ICU1.5";
CM_ SG_ 474 UserDefinedParkCmd "Used to configure the display mothod of guidance overlay
Ã§Â”Â¨Ã¦ÂˆÂ·Ã§Â‚Â¹Ã¥Â‡Â»Ã¨Â‡ÂªÃ©Â€Â‰Ã¨Â½Â¦Ã¤Â½ÂÃ¨Â½Â¯Ã¦ÂŒÂ‰Ã©Â”Â®ADAS1_CAN:To ICU1.5";
CM_ SG_ 474 HUT_HAVP_Set_Starting "Starting point button status
Ã§Â”Â¨Ã¦ÂˆÂ·Ã¦ÂŒÂ‰Ã©Â”Â®Ã¨Â®Â¾Ã§Â½Â®Ã¨ÂµÂ·Ã§Â‚Â¹ADAS1_CAN:To ICU1.5";
CM_ SG_ 474 HUT_HAVP_Set_Path_Ending "Set path ending pointÃ§Â”Â¨Ã¦ÂˆÂ·Ã¦ÂŒÂ‰Ã©Â”Â®Ã¨Â®Â¾Ã§Â½Â®Ã§Â»ÂˆÃ§Â‚Â¹ADAS1_CAN:To ICU1.5";
CM_ SG_ 474 HUT_HAVP_APA_Permit "HAVP auto parking in permitÃ¨Â®Â°Ã¥Â¿Â†Ã¦Â³ÂŠÃ¨Â½Â¦Ã¨Â‡ÂªÃ¥ÂŠÂ¨Ã¦Â³ÂŠÃ¥Â…Â¥Ã¨Â¯Â¢Ã©Â—Â®Ã§Â¡Â®Ã¨Â®Â¤ADAS1_CAN:To ICU1.5";
CM_ SG_ 474 UserDefPrkMenuSelCmd "Used to configure the display mothod of guidance overlay
Ã§Â”Â¨Ã¦ÂˆÂ·Ã¥ÂœÂ¨Ã¨Â‡ÂªÃ©Â€Â‰Ã¨Â½Â¦Ã¤Â½ÂÃ¥ÂŠÂŸÃ¨ÂƒÂ½Ã¤Â¸Â‹Ã©Â€Â‰Ã¦Â‹Â©Ã¦Â°Â´Ã¥Â¹Â³Ã¨Â½Â¦Ã¤Â½ÂÃ£Â€ÂÃ¥Â¹Â³Ã¨Â¡ÂŒÃ¨Â½Â¦Ã¤Â½ÂÃ¦ÂˆÂ–Ã©Â¡ÂºÃ¦Â—Â¶Ã©Â’ÂˆÃ£Â€ÂÃ©Â€Â†Ã¦Â—Â¶Ã©Â’ÂˆÃ¦Â—Â‹Ã¨Â½Â¬ADAS1_CAN:To ICU1.5";
CM_ SG_ 474 HUT_HAVP_SelfParLot_Ending "Set self-select parking lot to endingÃ§Â”Â¨Ã¦ÂˆÂ·Ã¦ÂŒÂ‰Ã©Â”Â®Ã¨Â®Â¾Ã§Â½Â®Ã§Â›Â®Ã¥Â‰ÂÃ¨Â½Â¦Ã¤Â½ÂÃ¤Â¸ÂºÃ§Â»ÂˆÃ§Â‚Â¹ADAS1_CAN:To ICU1.5";
CM_ SG_ 474 HUT_HAVP_Return_Btn "HAVP return button
Ã¨Â½Â¦Ã¦ÂœÂºÃ§Â«Â¯Ã¨Â®Â°Ã¥Â¿Â†Ã¦Â³ÂŠÃ¨Â½Â¦Ã¥ÂŠÂŸÃ¨ÂƒÂ½Ã¨Â¿Â”Ã¥Â›ÂžÃ¦ÂŒÂ‰Ã©Â”Â®ADAS1_CAN:To ICU1.5";
CM_ SG_ 474 HUT_HAVP_Comfirm_Btn "Confirm button for low battaryÃ§Â”ÂµÃ©Â‡ÂÃ¤Â½ÂŽÃ¦Â—Â¶Ã¯Â¼ÂŒÃ§Â”Â¨Ã¦ÂˆÂ·Ã§Â‚Â¹Ã¥Â‡Â»Ã§ÂšÂ„Ã§Â»Â§Ã§Â»Â­Ã¦ÂŒÂ‰Ã©Â”Â®ADAS_CAN:To IDC1.5";
CM_ SG_ 474 HUT_HAVP_Path_Select "The number of selected path
Ã§Â”Â¨Ã¦ÂˆÂ·Ã©Â€Â‰Ã¦Â‹Â©Ã§ÂšÂ„Ã¨Â·Â¯Ã§ÂºÂ¿Ã¥ÂÂ·ADAS_CAN:To IDC1.5";
CM_ SG_ 474 HUT_HAVP_Path_Delete "The number of deleted path
Ã§Â”Â¨Ã¦ÂˆÂ·Ã¥ÂˆÂ Ã©Â™Â¤Ã§ÂšÂ„Ã¨Â·Â¯Ã§ÂºÂ¿Ã¥ÂÂ·ADAS_CAN:To IDC1.5";
CM_ SG_ 474 HUT_HAVP_Path_SetTop "The number of set-top path number
Ã§Â”Â¨Ã¦ÂˆÂ·Ã§Â½Â®Ã©Â¡Â¶Ã§ÂšÂ„Ã¨Â·Â¯Ã§ÂºÂ¿Ã¤Â½ÂÃ§Â½Â®Ã¥ÂÂ·ADAS_CAN:To IDC1.5";
CM_ SG_ 474 HUT_PAVP_PathList_Req "Request HUT show pathlist PAVPÃ¤ÂºÂŒÃ§ÂºÂ§Ã¨ÂÂœÃ¥ÂÂ•Ã¤Â¸Â­Ã¦Â˜Â¾Ã§Â¤ÂºÃ¨Â·Â¯Ã§ÂºÂ¿Ã¥ÂˆÂ—Ã¨Â¡Â¨ADAS_CAN:To IDC1.5";
CM_ SG_ 475 HUT_ExternalDevice "HUT_DOCK External Device";
CM_ SG_ 476 PassSeatMassgModSet "Passenger Seat massage mode setBD_Sub_CAN:To DSC";
CM_ SG_ 476 DrvSeatMassgModSet "Driver Seat massage mode setBD_Sub_CAN:To DSC";
CM_ SG_ 476 PPMI_P_BSR_SwtSet "PPMI_P Belt Slack Reduction switch set";
CM_ SG_ 476 RWPC_SwtReq "RWPC switch request";
CM_ SG_ 477 DrvSeatVentnLvlSet_Nine "Driver Seat ventilation 9 level setTo:DSC HVSM";
CM_ SG_ 477 PassSeatVentnLvlSet_Nine "Passenger Seat ventilation 9 level setTo:DSC HVSM";
CM_ SG_ 477 RLSeatVentnLvlSet_Nine "Rear Left Seat ventilation 9 level set";
CM_ SG_ 477 RRSeatVentnLvlSet_Nine "Rear Right Seat ventilation 9 level set";
CM_ SG_ 477 ARFSwtReq "Adaptive Recuperation function requestPT-CAN To:PDCU";
CM_ SG_ 477 ASFCSwtReq "Adaptive startstop control function requestPT-CAN To:PDCU";
CM_ SG_ 477 AGSSwtReq "Adaptive gear shifting function requestPT-CAN To:PDCU";
CM_ SG_ 477 SOCMngmntSwtReq "Soc management function requestPT-CAN To:PDCU";
CM_ SG_ 479 DOCK_HUT_ExternalDevice_E "DOCK_HUT External Device (Event)";
CM_ SG_ 481 T_BOX_RemtVideoMonrEnaReq_APP "remote video monitor enable request from APP";
CM_ SG_ 481 T_BOX_RemtFrntDefrostCtrl "Remote front defrost controlBD1_CAN:To AC";
CM_ SG_ 481 T_BOX_RemtRearDefrostCtrl "Remote rear defrost controlBD1_CAN:To AC";
CM_ SG_ 481 T_BOX_RemtCockpitClnReq "Remote Cockpit cleaning requestBD1_CAN:To AC";
CM_ SG_ 481 RemUpgrdModeCmd "Remote upgrade mode command";
CM_ SG_ 481 Phone_ChrgnMode "charging mode including Immediate Charging and Delay Charging set on APPHC_CAN:To PDCU";
CM_ SG_ 481 T_BOX_RemtSdlMod "T-Box Remote Schedule mode,HCU receive this signal in order to achieve the function of charging,cooling,heating.HC_CAN:To PDCU";
CM_ SG_ 485 ACRearTempReq_ETC_VR "ETC Rear AC(Air Conditioning) Temperature  Request(Voice Request)";
CM_ SG_ 485 ACRearTempSteplsReq_ETC_TC "ETC Rear AC(Air Conditioning) Temperature Stepless Request-Touch Control";
CM_ SG_ 485 ACDrvTempDecReq_ETC_TC "ETC AC(Air Conditioning) Driver Temperature Decrease Request-Touch Control";
CM_ SG_ 485 ACDrvTempIncReq_ETC_TC "ETC AC(Air Conditioning) Driver Temperature Increase  Request-Touch Control";
CM_ SG_ 485 ACRearTempDecReq_ETC_TC "ETC Rear AC(Air Conditioning) Temperature Decrease Request-Touch Control";
CM_ SG_ 485 ACRearTempIncReq_ETC_TC "ETC Rear AC(Air Conditioning) Temperature Increase Request-Touch Control";
CM_ SG_ 485 ACRearPowerReq_VR "AC rear system power onoff request  for AC controlling  (Voice Request)BD1_CAN:To AC";
CM_ SG_ 485 ACMaxReq_VR "AC(Air Conditioning) Max Request-Voice RequestBD1_CAN:To AC";
CM_ SG_ 485 ACMaxReq_TC "AC(Air Conditioning) Max Request-Touch ControlBD1_CAN:To AC";
CM_ SG_ 485 FrntWiprCtrl_VR "Front Wiper Control (Voice Request)";
CM_ SG_ 485 ACRearAutoModReq_VR "Rear auto mode request for AC(Air Conditioning) controlling  (Voice Request)BD1_CAN:To AC";
CM_ SG_ 485 LockWinSet "Lock Window Set";
CM_ SG_ 485 ACRearLockReq_TC "Rear AC(Air Conditioning) Lock Request by HUT(Head Unit System)-Touch ControlBD1_CAN:To AC";
CM_ SG_ 485 SrSpdCtrlSwt "Sunroof speed control switch";
CM_ SG_ 485 DPF_Request "DPF RequestPT-CAN To:ECM";
CM_ SG_ 485 ColorCategory "Color category";
CM_ SG_ 485 SingleColorNr "Single color number";
CM_ SG_ 485 NozHeatSwt "washer Nozzies Heating Switch
HUTÃ¨Â®Â¾Ã§Â½Â®Ã¥Â–Â·Ã¥Â˜Â´Ã¥ÂŠÂ Ã§ÂƒÂ­Ã¥Â¼Â€Ã¥Â…Â³";
CM_ SG_ 487 ACRLTempDecReq_TC "AC(Air Conditioning) Rear Left Temperature Decrease Request-Touch ControlBD1_CAN:To AC";
CM_ SG_ 487 ACRLTempIncReq_TC "AC(Air Conditioning) Rear Left  Temperature Increase Request-Touch ControlBD1_CAN:To AC";
CM_ SG_ 487 ACRLTempReq_VR "AC(Air Conditioning) Rear Left  Temperature  Request(Voice Request)BD1_CAN:To AC";
CM_ SG_ 487 ACRRTempDecReq_TC "AC(Air Conditioning) Rear Right Temperature Decrease Request-Touch Control";
CM_ SG_ 487 ACRRTempIncReq_TC "AC(Air Conditioning) Rear Right Temperature Increase Request-Touch Control";
CM_ SG_ 487 ACRRTempReq_VR "AC(Air Conditioning) Rear Right Temperature  Request(Voice Request)";
CM_ SG_ 487 ACRRTempSteplsReq_TC "AC(Air Conditioning) Rear Right Temperature Stepless Request-Touch Control";
CM_ SG_ 487 ACHumidifierReq_VR "AC(Air Conditioning) Humidifier Request(Voice Request)";
CM_ SG_ 487 ACHumidifierReq_TC "AC(Air Conditioning) Humidifier Request-Touch Control";
CM_ SG_ 487 ACOzoneReq_TC "AC(Air Conditioning) Air Ozone Unit Request-Touch Control";
CM_ SG_ 487 ACOzoneReq_VR "AC(Air Conditioning) Air Ozone Unit Request(Voice Request)";
CM_ SG_ 487 ACUltravioletReq_TC "AC(Air Conditioning) Ultraviolet Rays Unit request-Touch Control";
CM_ SG_ 487 ACUltravioletReq_VR "AC(Air Conditioning) Ultraviolet Rays Unit request(Voice Request)";
CM_ SG_ 487 ACFrntWinHeatCmd_TC "AC(Air Conditioning) Front Window Heat Command-Touch Control";
CM_ SG_ 487 ACFrntWinHeatCmd_VR "AC(Air Conditioning) Front Window Heat Command(Voice Request)";
CM_ SG_ 487 DrvDoorALCMFlashFreq "Driver door ALCM flash frequency";
CM_ SG_ 487 PassDoorALCMFlashFreq "Passenger door ALCM flash frequency";
CM_ SG_ 487 LRDoorALCMFlashFreq "Left rear door ALCM flash frequency";
CM_ SG_ 487 RRDoorALCMFlashFreq "Right rear door ALCM flash frequency";
CM_ SG_ 487 FootALCMFlashFreq "Foot ALCM flash frequency";
CM_ SG_ 487 LeftPanelALCMFlashFreq "Left panel ALCM flash frequency";
CM_ SG_ 487 RightPanelALCMFlashFreq "Right panel ALCM flash frequency";
CM_ SG_ 487 ACRearLockReq_VR "Rear AC(Air Conditioning) Lock Request by HUT(Head Unit System)-Voice RequestBD1_CAN:To AC";
CM_ SG_ 489 HUD_HeightLvlSwt "HUD Height Level switchBD2-CAN To:HUD";
CM_ SG_ 489 HUD_BrightnessLvlSwt "HUD Brightness Level switchBD2-CAN To:HUD";
CM_ SG_ 489 HUD_SwtReq "HUD switch requestBD2-CAN To:HUD";
CM_ SG_ 489 BackReq_AVM "Exit AVM and back to HUT interface requestADAS1_CAN:To IDC1.5";
CM_ SG_ 489 PPMIHWSwtSet "PPMI Haptic Warning switch set";
CM_ SG_ 489 PPMIBSRSwtSet "PPMI Belt Slack Reduction switch set";
CM_ SG_ 489 PPMIHW_SwtSet "PPMI Haptic Warning switch set";
CM_ SG_ 489 PPMIBSR_SwtSet "PPMI Belt Slack Reduction switch set";
CM_ SG_ 491 ActvEntryLockSet "Active entry lock set";
CM_ SG_ 491 ActvEntryUnlockSet "Active entry unlock set";
CM_ SG_ 491 LockPromptFunSet "Unlock prompt function Settings";
CM_ SG_ 491 BTAPAEntryLockSet "Bluetooth APA entry lock set";
CM_ SG_ 491 BTAPALvngUnlockSet "Bluetooth APA leaving unlock set";
CM_ SG_ 491 ClsWinSpdSet "Close windows speed set";
CM_ SG_ 491 DrvSeatMassgLvlSet "Driver Seat massage level setBD_Sub_CAN:To DSC";
CM_ SG_ 491 PassSeatMassgLvlSet "Passenger Seat massage level setBD_Sub_CAN:To DSC";
CM_ SG_ 491 SeatKeyMemEna "Seat key memory enablement";
CM_ SG_ 491 RLSeatMassgLvlSet "Rear Left Seat massage level setBD_Sub_CAN:To DSC";
CM_ SG_ 491 RRSeatMassgLvlSet "Rear Right Seat massage level setBD_Sub_CAN:To DSC";
CM_ SG_ 491 DrvDoorALCMClrSet "Driver door ALCM color set";
CM_ SG_ 491 PassDoorALCMClrSet "Passenger door ALCM color set";
CM_ SG_ 491 LRDoorALCMClrSet "Left rear door ALCM color set";
CM_ SG_ 491 DrvDoorALCMSwt "Driver door ALCM switch";
CM_ SG_ 491 PassDoorALCMSwt "Passenger door ALCM switch";
BA_DEF_ BO_  "DiagRequest" ENUM  "No","Yes";
BA_DEF_ BO_  "DiagResponse" ENUM  "No","Yes";
BA_DEF_ BO_  "DiagState" ENUM  "No","Yes";
BA_DEF_ BO_  "GenMsgCycleTime" INT 0 65535;
BA_DEF_ BO_  "GenMsgCycleTimeFast" INT 0 65535;
BA_DEF_ BO_  "GenMsgILSupport" ENUM  "No","Yes";
BA_DEF_ BO_  "GenMsgNrOfRepetition" INT 0 65535;
BA_DEF_ BO_  "GenMsgSendType" ENUM  "Cyclic","CyclicAndSpontanX","Event";
BA_DEF_ BO_  "NmAsrMessage" ENUM  "No","Yes";
BA_DEF_ BO_  "OriginFrame" STRING ;
BA_DEF_ BO_  "SCP_AuthInfoTxLength" INT 0 512;
BA_DEF_ BO_  "SCP_DataId" INT 0 65535;
BA_DEF_ BO_  "SCP_FreshnessValueLength" INT 0 512;
BA_DEF_ BO_  "SCP_FreshnessValueTxLength" INT 0 512;
BA_DEF_ BO_  "SC_Message" ENUM  "NO","YES";
BA_DEF_ BO_  "VFrameFormat" ENUM  "StandardCAN","ExtendedCAN","reserved","reserved","reserved","reserved","reserved","reserved","reserved","reserved","reserved","reserved","reserved","reserved","StandardCAN_FD","ExtendedCAN_FD";
BA_DEF_ SG_  "GenSigCycleTime" INT 0 65535;
BA_DEF_ SG_  "GenSigSendType" ENUM  "Cyclic","OnWrite","OnWriteWithRepetition","OnChange","OnChangeWithRepetition","NotUsed","NotUsed","NoSigSendType";
BA_DEF_ SG_  "GenSigStartValue" FLOAT 0 100000000000;
BA_DEF_ SG_  "Match" STRING ;
BA_DEF_ SG_  "Origin" STRING ;
BA_DEF_ SG_  "TransparentInitValue" STRING ;
BA_DEF_ BU_  "NmAsrNode" ENUM  "No","Yes";
BA_DEF_  "BusType" STRING ;
BA_DEF_  "DBName" STRING ;
BA_DEF_  "NmAsrBaseAddress" HEX 1024 536870911;
BA_DEF_  "NmAsrCanMsgCycleTime" INT 1 65535;
BA_DEF_  "NmAsrMessageCount" INT 1 256;
BA_DEF_  "NmAsrRepeatMessageTime" INT 1 65535;
BA_DEF_  "NmAsrTimeoutTime" INT 1 65535;
BA_DEF_  "NmAsrWaitBusSleepTime" INT 1 65535;
BA_DEF_  "NmType" STRING ;
BA_DEF_ SG_  "SystemSignalLongSymbol" STRING ;
BA_DEF_DEF_  "DiagRequest" "No";
BA_DEF_DEF_  "DiagResponse" "No";
BA_DEF_DEF_  "DiagState" "No";
BA_DEF_DEF_  "GenMsgCycleTime" 0;
BA_DEF_DEF_  "GenMsgCycleTimeFast" 0;
BA_DEF_DEF_  "GenMsgILSupport" "No";
BA_DEF_DEF_  "GenMsgNrOfRepetition" 0;
BA_DEF_DEF_  "GenMsgSendType" "Cyclic";
BA_DEF_DEF_  "NmAsrMessage" "No";
BA_DEF_DEF_  "OriginFrame" "";
BA_DEF_DEF_  "SCP_AuthInfoTxLength" 0;
BA_DEF_DEF_  "SCP_DataId" 0;
BA_DEF_DEF_  "SCP_FreshnessValueLength" 0;
BA_DEF_DEF_  "SCP_FreshnessValueTxLength" 0;
BA_DEF_DEF_  "SC_Message" "NO";
BA_DEF_DEF_  "VFrameFormat" "";
BA_DEF_DEF_  "GenSigCycleTime" 0;
BA_DEF_DEF_  "GenSigSendType" "Cyclic";
BA_DEF_DEF_  "GenSigStartValue" 0;
BA_DEF_DEF_  "Match" "";
BA_DEF_DEF_  "Origin" "";
BA_DEF_DEF_  "TransparentInitValue" "";
BA_DEF_DEF_  "NmAsrNode" "Yes";
BA_DEF_DEF_  "BusType" "";
BA_DEF_DEF_  "DBName" "B30_for_SC_CAN_V3_2";
BA_DEF_DEF_  "NmAsrBaseAddress" 1280;
BA_DEF_DEF_  "NmAsrCanMsgCycleTime" 500;
BA_DEF_DEF_  "NmAsrMessageCount" 100;
BA_DEF_DEF_  "NmAsrRepeatMessageTime" 1500;
BA_DEF_DEF_  "NmAsrTimeoutTime" 2000;
BA_DEF_DEF_  "NmAsrWaitBusSleepTime" 5000;
BA_DEF_DEF_  "NmType" "NmAsr";
BA_DEF_DEF_  "SystemSignalLongSymbol" "";
BA_ "BusType" "CAN FD";
BA_ "SC_Message" BO_ 51 1;
BA_ "SCP_FreshnessValueTxLength" BO_ 51 16;
BA_ "SCP_FreshnessValueLength" BO_ 51 64;
BA_ "SCP_DataId" BO_ 51 51;
BA_ "SCP_AuthInfoTxLength" BO_ 51 48;
BA_ "OriginFrame" BO_ 51 "fuel,ev";
BA_ "GenMsgSendType" BO_ 51 2;
BA_ "GenMsgNrOfRepetition" BO_ 51 5;
BA_ "GenMsgILSupport" BO_ 51 1;
BA_ "GenMsgCycleTimeFast" BO_ 51 20;
BA_ "VFrameFormat" BO_ 51 14;
BA_ "OriginFrame" BO_ 68 "fuel,ev";
BA_ "GenMsgSendType" BO_ 68 2;
BA_ "GenMsgNrOfRepetition" BO_ 68 5;
BA_ "GenMsgILSupport" BO_ 68 1;
BA_ "GenMsgCycleTimeFast" BO_ 68 50;
BA_ "VFrameFormat" BO_ 68 14;
BA_ "OriginFrame" BO_ 74 "fuel,ev";
BA_ "GenMsgSendType" BO_ 74 2;
BA_ "GenMsgNrOfRepetition" BO_ 74 5;
BA_ "GenMsgILSupport" BO_ 74 1;
BA_ "GenMsgCycleTimeFast" BO_ 74 50;
BA_ "VFrameFormat" BO_ 74 14;
BA_ "OriginFrame" BO_ 86 "fuel,ev";
BA_ "GenMsgSendType" BO_ 86 2;
BA_ "GenMsgNrOfRepetition" BO_ 86 5;
BA_ "GenMsgILSupport" BO_ 86 1;
BA_ "GenMsgCycleTimeFast" BO_ 86 20;
BA_ "VFrameFormat" BO_ 86 14;
BA_ "OriginFrame" BO_ 161 "fuel,ev";
BA_ "GenMsgILSupport" BO_ 161 1;
BA_ "GenMsgCycleTime" BO_ 161 10;
BA_ "VFrameFormat" BO_ 161 14;
BA_ "OriginFrame" BO_ 166 "fuel,ev";
BA_ "GenMsgILSupport" BO_ 166 1;
BA_ "GenMsgCycleTime" BO_ 166 10;
BA_ "VFrameFormat" BO_ 166 14;
BA_ "OriginFrame" BO_ 200 "fuel,ev";
BA_ "GenMsgILSupport" BO_ 200 1;
BA_ "GenMsgCycleTime" BO_ 200 10;
BA_ "VFrameFormat" BO_ 200 14;
BA_ "OriginFrame" BO_ 241 "fuel,ev";
BA_ "GenMsgILSupport" BO_ 241 1;
BA_ "GenMsgCycleTime" BO_ 241 10;
BA_ "VFrameFormat" BO_ 241 14;
BA_ "OriginFrame" BO_ 265 "fuel,ev";
BA_ "GenMsgILSupport" BO_ 265 1;
BA_ "GenMsgCycleTime" BO_ 265 20;
BA_ "VFrameFormat" BO_ 265 14;
BA_ "OriginFrame" BO_ 273 "fuel,ev";
BA_ "GenMsgILSupport" BO_ 273 1;
BA_ "GenMsgCycleTime" BO_ 273 10;
BA_ "VFrameFormat" BO_ 273 14;
BA_ "OriginFrame" BO_ 288 "fuel,ev";
BA_ "GenMsgILSupport" BO_ 288 1;
BA_ "GenMsgCycleTime" BO_ 288 20;
BA_ "VFrameFormat" BO_ 288 14;
BA_ "SC_Message" BO_ 311 1;
BA_ "SCP_FreshnessValueTxLength" BO_ 311 16;
BA_ "SCP_FreshnessValueLength" BO_ 311 64;
BA_ "SCP_DataId" BO_ 311 311;
BA_ "SCP_AuthInfoTxLength" BO_ 311 48;
BA_ "OriginFrame" BO_ 311 "fuel,ev";
BA_ "GenMsgILSupport" BO_ 311 1;
BA_ "GenMsgCycleTime" BO_ 311 20;
BA_ "VFrameFormat" BO_ 311 14;
BA_ "OriginFrame" BO_ 327 "fuel,ev";
BA_ "GenMsgILSupport" BO_ 327 1;
BA_ "GenMsgCycleTime" BO_ 327 20;
BA_ "VFrameFormat" BO_ 327 14;
BA_ "OriginFrame" BO_ 338 "fuel,ev";
BA_ "GenMsgILSupport" BO_ 338 1;
BA_ "GenMsgCycleTime" BO_ 338 20;
BA_ "VFrameFormat" BO_ 338 14;
BA_ "OriginFrame" BO_ 347 "fuel,ev";
BA_ "GenMsgILSupport" BO_ 347 1;
BA_ "GenMsgCycleTime" BO_ 347 20;
BA_ "VFrameFormat" BO_ 347 14;
BA_ "OriginFrame" BO_ 350 "fuel,ev";
BA_ "GenMsgILSupport" BO_ 350 1;
BA_ "GenMsgCycleTime" BO_ 350 20;
BA_ "VFrameFormat" BO_ 350 14;
BA_ "OriginFrame" BO_ 357 "fuel,ev";
BA_ "GenMsgILSupport" BO_ 357 1;
BA_ "GenMsgCycleTime" BO_ 357 20;
BA_ "VFrameFormat" BO_ 357 14;
BA_ "OriginFrame" BO_ 363 "fuel,ev";
BA_ "GenMsgILSupport" BO_ 363 1;
BA_ "GenMsgCycleTime" BO_ 363 20;
BA_ "VFrameFormat" BO_ 363 14;
BA_ "OriginFrame" BO_ 367 "fuel,ev";
BA_ "GenMsgILSupport" BO_ 367 1;
BA_ "GenMsgCycleTime" BO_ 367 20;
BA_ "VFrameFormat" BO_ 367 14;
BA_ "OriginFrame" BO_ 368 "fuel,ev";
BA_ "GenMsgILSupport" BO_ 368 1;
BA_ "GenMsgCycleTime" BO_ 368 20;
BA_ "VFrameFormat" BO_ 368 14;
BA_ "OriginFrame" BO_ 395 "fuel,ev";
BA_ "GenMsgILSupport" BO_ 395 1;
BA_ "GenMsgCycleTime" BO_ 395 20;
BA_ "VFrameFormat" BO_ 395 14;
BA_ "OriginFrame" BO_ 411 "fuel,ev";
BA_ "GenMsgILSupport" BO_ 411 1;
BA_ "GenMsgCycleTime" BO_ 411 50;
BA_ "VFrameFormat" BO_ 411 14;
BA_ "SC_Message" BO_ 412 1;
BA_ "SCP_FreshnessValueTxLength" BO_ 412 16;
BA_ "SCP_FreshnessValueLength" BO_ 412 64;
BA_ "SCP_DataId" BO_ 412 412;
BA_ "SCP_AuthInfoTxLength" BO_ 412 48;
BA_ "OriginFrame" BO_ 412 "fuel,ev";
BA_ "GenMsgILSupport" BO_ 412 1;
BA_ "GenMsgCycleTime" BO_ 412 50;
BA_ "VFrameFormat" BO_ 412 14;
BA_ "OriginFrame" BO_ 415 "fuel,ev";
BA_ "GenMsgILSupport" BO_ 415 1;
BA_ "GenMsgCycleTime" BO_ 415 50;
BA_ "VFrameFormat" BO_ 415 14;
BA_ "OriginFrame" BO_ 465 "fuel,ev";
BA_ "GenMsgSendType" BO_ 465 2;
BA_ "GenMsgNrOfRepetition" BO_ 465 5;
BA_ "GenMsgILSupport" BO_ 465 1;
BA_ "GenMsgCycleTimeFast" BO_ 465 50;
BA_ "VFrameFormat" BO_ 465 14;
BA_ "OriginFrame" BO_ 473 "fuel,ev";
BA_ "GenMsgSendType" BO_ 473 2;
BA_ "GenMsgNrOfRepetition" BO_ 473 5;
BA_ "GenMsgILSupport" BO_ 473 1;
BA_ "GenMsgCycleTimeFast" BO_ 473 20;
BA_ "VFrameFormat" BO_ 473 14;
BA_ "OriginFrame" BO_ 474 "fuel,ev";
BA_ "GenMsgSendType" BO_ 474 2;
BA_ "GenMsgNrOfRepetition" BO_ 474 5;
BA_ "GenMsgILSupport" BO_ 474 1;
BA_ "GenMsgCycleTimeFast" BO_ 474 50;
BA_ "VFrameFormat" BO_ 474 14;
BA_ "OriginFrame" BO_ 475 "fuel,ev";
BA_ "GenMsgSendType" BO_ 475 2;
BA_ "GenMsgNrOfRepetition" BO_ 475 5;
BA_ "GenMsgILSupport" BO_ 475 1;
BA_ "GenMsgCycleTimeFast" BO_ 475 50;
BA_ "VFrameFormat" BO_ 475 14;
BA_ "OriginFrame" BO_ 476 "fuel,ev";
BA_ "GenMsgSendType" BO_ 476 2;
BA_ "GenMsgNrOfRepetition" BO_ 476 5;
BA_ "GenMsgILSupport" BO_ 476 1;
BA_ "GenMsgCycleTimeFast" BO_ 476 50;
BA_ "VFrameFormat" BO_ 476 14;
BA_ "OriginFrame" BO_ 477 "fuel,ev";
BA_ "GenMsgSendType" BO_ 477 2;
BA_ "GenMsgNrOfRepetition" BO_ 477 5;
BA_ "GenMsgILSupport" BO_ 477 1;
BA_ "GenMsgCycleTimeFast" BO_ 477 50;
BA_ "VFrameFormat" BO_ 477 14;
BA_ "OriginFrame" BO_ 479 "fuel,ev";
BA_ "GenMsgSendType" BO_ 479 2;
BA_ "GenMsgNrOfRepetition" BO_ 479 5;
BA_ "GenMsgILSupport" BO_ 479 1;
BA_ "GenMsgCycleTimeFast" BO_ 479 20;
BA_ "VFrameFormat" BO_ 479 14;
BA_ "OriginFrame" BO_ 481 "fuel,ev";
BA_ "GenMsgSendType" BO_ 481 2;
BA_ "GenMsgNrOfRepetition" BO_ 481 5;
BA_ "GenMsgILSupport" BO_ 481 1;
BA_ "GenMsgCycleTimeFast" BO_ 481 20;
BA_ "VFrameFormat" BO_ 481 14;
BA_ "OriginFrame" BO_ 485 "fuel,ev";
BA_ "GenMsgSendType" BO_ 485 2;
BA_ "GenMsgNrOfRepetition" BO_ 485 5;
BA_ "GenMsgILSupport" BO_ 485 1;
BA_ "GenMsgCycleTimeFast" BO_ 485 50;
BA_ "VFrameFormat" BO_ 485 14;
BA_ "OriginFrame" BO_ 487 "fuel,ev";
BA_ "GenMsgSendType" BO_ 487 2;
BA_ "GenMsgNrOfRepetition" BO_ 487 5;
BA_ "GenMsgILSupport" BO_ 487 1;
BA_ "GenMsgCycleTimeFast" BO_ 487 50;
BA_ "VFrameFormat" BO_ 487 14;
BA_ "OriginFrame" BO_ 489 "fuel,ev";
BA_ "GenMsgSendType" BO_ 489 2;
BA_ "GenMsgNrOfRepetition" BO_ 489 5;
BA_ "GenMsgILSupport" BO_ 489 1;
BA_ "GenMsgCycleTimeFast" BO_ 489 50;
BA_ "VFrameFormat" BO_ 489 14;
BA_ "OriginFrame" BO_ 491 "fuel,ev";
BA_ "GenMsgSendType" BO_ 491 2;
BA_ "GenMsgNrOfRepetition" BO_ 491 5;
BA_ "GenMsgILSupport" BO_ 491 1;
BA_ "GenMsgCycleTimeFast" BO_ 491 50;
BA_ "VFrameFormat" BO_ 491 14;
BA_ "Origin" SG_ 51 T_BOX_RemtDoorLockCtrl "fuel,ev";
BA_ "Match" SG_ 51 T_BOX_RemtDoorLockCtrl "T_BOX_RemtDoorLockCtrl";
BA_ "GenSigSendType" SG_ 51 T_BOX_RemtDoorLockCtrl 2;
BA_ "Origin" SG_ 51 T_BOX_AudioMuteReq "fuel,ev";
BA_ "Match" SG_ 51 T_BOX_AudioMuteReq "T_BOX_AudioMuteReq";
BA_ "GenSigSendType" SG_ 51 T_BOX_AudioMuteReq 2;
BA_ "Origin" SG_ 51 T_BOX_PM25AirQLvl "fuel,ev";
BA_ "Match" SG_ 51 T_BOX_PM25AirQLvl "T_BOX_PM25AirQLvl";
BA_ "GenSigStartValue" SG_ 51 T_BOX_PM25AirQLvl 7;
BA_ "GenSigSendType" SG_ 51 T_BOX_PM25AirQLvl 2;
BA_ "Origin" SG_ 51 T_BOX_PM25Dens "fuel,ev";
BA_ "Match" SG_ 51 T_BOX_PM25Dens "T_BOX_PM25Dens";
BA_ "GenSigStartValue" SG_ 51 T_BOX_PM25Dens 1023;
BA_ "GenSigSendType" SG_ 51 T_BOX_PM25Dens 2;
BA_ "Origin" SG_ 51 FreshnessValue_T_BOX_FD1 "fuel,ev";
BA_ "Match" SG_ 51 FreshnessValue_T_BOX_FD1 "FreshnessValue_T_BOX_FD1";
BA_ "GenSigSendType" SG_ 51 FreshnessValue_T_BOX_FD1 2;
BA_ "Origin" SG_ 51 MAC_Check_T_BOX_FD1 "fuel,ev";
BA_ "Match" SG_ 51 MAC_Check_T_BOX_FD1 "MAC_Check_T_BOX_FD1";
BA_ "GenSigSendType" SG_ 51 MAC_Check_T_BOX_FD1 2;
BA_ "Origin" SG_ 51 T_BOX_RemtWinCtrl "ev";
BA_ "Match" SG_ 51 T_BOX_RemtWinCtrl "T_BOX_RemtWinCtrl";
BA_ "GenSigSendType" SG_ 51 T_BOX_RemtWinCtrl 2;
BA_ "Origin" SG_ 51 T_BOX_RemtTrunkCtrl "ev";
BA_ "Match" SG_ 51 T_BOX_RemtTrunkCtrl "T_BOX_RemtTrunkCtrl";
BA_ "GenSigSendType" SG_ 51 T_BOX_RemtTrunkCtrl 2;
BA_ "Origin" SG_ 51 T_BOX_RemtDrvTempSet "ev";
BA_ "Match" SG_ 51 T_BOX_RemtDrvTempSet "T_BOX_RemtDrvTempSet";
BA_ "GenSigSendType" SG_ 51 T_BOX_RemtDrvTempSet 2;
BA_ "Origin" SG_ 51 T_BOX_RemtAutoCtrl "ev";
BA_ "Match" SG_ 51 T_BOX_RemtAutoCtrl "T_BOX_RemtAutoCtrl";
BA_ "GenSigSendType" SG_ 51 T_BOX_RemtAutoCtrl 2;
BA_ "Origin" SG_ 51 T_BOX_RemtPassTempSet "ev";
BA_ "Match" SG_ 51 T_BOX_RemtPassTempSet "T_BOX_RemtPassTempSet";
BA_ "GenSigSendType" SG_ 51 T_BOX_RemtPassTempSet 2;
BA_ "Origin" SG_ 51 T_BOX_RemtSsCtrl "ev";
BA_ "Match" SG_ 51 T_BOX_RemtSsCtrl "T_BOX_RemtSsCtrl";
BA_ "GenSigSendType" SG_ 51 T_BOX_RemtSsCtrl 2;
BA_ "Origin" SG_ 51 T_BOX_RemtSrCtrl "ev";
BA_ "Match" SG_ 51 T_BOX_RemtSrCtrl "T_BOX_RemtSrCtrl";
BA_ "GenSigSendType" SG_ 51 T_BOX_RemtSrCtrl 2;
BA_ "Origin" SG_ 51 T_BOX_RemtDrvSeatVentnLvlSet "ev";
BA_ "Match" SG_ 51 T_BOX_RemtDrvSeatVentnLvlSet "T_BOX_RemtDrvSeatVentnLvlSet";
BA_ "GenSigSendType" SG_ 51 T_BOX_RemtDrvSeatVentnLvlSet 2;
BA_ "Origin" SG_ 51 T_BOX_RemtPassSeatVentnLvlSet "ev";
BA_ "Match" SG_ 51 T_BOX_RemtPassSeatVentnLvlSet "T_BOX_RemtPassSeatVentnLvlSet";
BA_ "GenSigSendType" SG_ 51 T_BOX_RemtPassSeatVentnLvlSet 2;
BA_ "Origin" SG_ 51 T_BOX_RemtAIUReq "ev";
BA_ "Match" SG_ 51 T_BOX_RemtAIUReq "T_BOX_RemtAIUReq";
BA_ "GenSigSendType" SG_ 51 T_BOX_RemtAIUReq 2;
BA_ "Origin" SG_ 51 T_BOX_RemtCarSearch "ev";
BA_ "Match" SG_ 51 T_BOX_RemtCarSearch "T_BOX_RemtCarSearch";
BA_ "GenSigSendType" SG_ 51 T_BOX_RemtCarSearch 2;
BA_ "Origin" SG_ 51 T_BOX_RemtEngCtrl "ev";
BA_ "Match" SG_ 51 T_BOX_RemtEngCtrl "T_BOX_RemtEngCtrl";
BA_ "GenSigSendType" SG_ 51 T_BOX_RemtEngCtrl 2;
BA_ "Origin" SG_ 51 T_BOX_RemtDrvSeatHeatgLvlSet "ev";
BA_ "Match" SG_ 51 T_BOX_RemtDrvSeatHeatgLvlSet "T_BOX_RemtDrvSeatHeatgLvlSet";
BA_ "GenSigSendType" SG_ 51 T_BOX_RemtDrvSeatHeatgLvlSet 2;
BA_ "Origin" SG_ 51 T_BOX_RemtPassSeatHeatgLvlSet "ev";
BA_ "Match" SG_ 51 T_BOX_RemtPassSeatHeatgLvlSet "T_BOX_RemtPassSeatHeatgLvlSet";
BA_ "GenSigSendType" SG_ 51 T_BOX_RemtPassSeatHeatgLvlSet 2;
BA_ "TransparentInitValue" SG_ 51 T_BOX_FD1_0x33 "0 0 0 0 0 7 3 255 0 0 0 0 0 0 0 0 ";
BA_ "GenSigSendType" SG_ 51 T_BOX_FD1_0x33 2;
BA_ "Origin" SG_ 68 ALCMStatSwt_OLE "fuel";
BA_ "Match" SG_ 68 ALCMStatSwt_OLE "ALCMStatSwt_OLE";
BA_ "GenSigSendType" SG_ 68 ALCMStatSwt_OLE 2;
BA_ "Origin" SG_ 68 ALCMClrSet_OLE "fuel";
BA_ "Match" SG_ 68 ALCMClrSet_OLE "ALCMClrSet_OLE";
BA_ "GenSigSendType" SG_ 68 ALCMClrSet_OLE 2;
BA_ "Origin" SG_ 68 ALCMDynModSet_OLE "fuel";
BA_ "Match" SG_ 68 ALCMDynModSet_OLE "ALCMDynModSet_OLE";
BA_ "GenSigSendType" SG_ 68 ALCMDynModSet_OLE 2;
BA_ "Origin" SG_ 68 ALCMLightLvlSet_OLE "fuel";
BA_ "Match" SG_ 68 ALCMLightLvlSet_OLE "ALCMLightLvlSet_OLE";
BA_ "GenSigStartValue" SG_ 68 ALCMLightLvlSet_OLE 5;
BA_ "GenSigSendType" SG_ 68 ALCMLightLvlSet_OLE 2;
BA_ "Origin" SG_ 68 ALCMRhmSwt_OLE "fuel";
BA_ "Match" SG_ 68 ALCMRhmSwt_OLE "ALCMRhmSwt_OLE";
BA_ "GenSigStartValue" SG_ 68 ALCMRhmSwt_OLE 1;
BA_ "GenSigSendType" SG_ 68 ALCMRhmSwt_OLE 2;
BA_ "Origin" SG_ 68 ALCMBreSwt_OLE "fuel";
BA_ "Match" SG_ 68 ALCMBreSwt_OLE "ALCMBreSwt_OLE";
BA_ "GenSigSendType" SG_ 68 ALCMBreSwt_OLE 2;
BA_ "Origin" SG_ 68 ALCMRdmSwt_OLE "fuel";
BA_ "Match" SG_ 68 ALCMRdmSwt_OLE "ALCMRdmSwt_OLE";
BA_ "GenSigSendType" SG_ 68 ALCMRdmSwt_OLE 2;
BA_ "Origin" SG_ 68 Rdm_SingleColorNr "fuel";
BA_ "Match" SG_ 68 Rdm_SingleColorNr "Rdm_SingleColorNr";
BA_ "GenSigStartValue" SG_ 68 Rdm_SingleColorNr 8;
BA_ "GenSigSendType" SG_ 68 Rdm_SingleColorNr 2;
BA_ "Origin" SG_ 68 HUT_VMDRTmpMonFctnSet "fuel,ev";
BA_ "Match" SG_ 68 HUT_VMDRTmpMonFctnSet "HUT_VMDRTmpMonFctnSet";
BA_ "GenSigSendType" SG_ 68 HUT_VMDRTmpMonFctnSet 2;
BA_ "Origin" SG_ 68 HUT_VMDRInitAlarmDlySet "fuel,ev";
BA_ "Match" SG_ 68 HUT_VMDRInitAlarmDlySet "HUT_VMDRInitAlarmDlySet";
BA_ "GenSigSendType" SG_ 68 HUT_VMDRInitAlarmDlySet 2;
BA_ "Origin" SG_ 68 OTA_UpgrdModReq "fuel,ev";
BA_ "Match" SG_ 68 OTA_UpgrdModReq "OTA_UpgrdModReq";
BA_ "GenSigSendType" SG_ 68 OTA_UpgrdModReq 2;
BA_ "TransparentInitValue" SG_ 68 HUT7_0x44 "5 1 0 16 0 0 0 0 ";
BA_ "GenSigSendType" SG_ 68 HUT7_0x44 2;
BA_ "Origin" SG_ 74 AUTODefrost_TC "fuel,ev";
BA_ "Match" SG_ 74 AUTODefrost_TC "AUTODefrost_TC";
BA_ "GenSigSendType" SG_ 74 AUTODefrost_TC 2;
BA_ "Origin" SG_ 74 AUTODefrost_VR "fuel,ev";
BA_ "Match" SG_ 74 AUTODefrost_VR "AUTODefrost_VR";
BA_ "GenSigSendType" SG_ 74 AUTODefrost_VR 2;
BA_ "Origin" SG_ 74 LaneCalActvtCmd "fuel,ev";
BA_ "Match" SG_ 74 LaneCalActvtCmd "LaneCalActvtCmd";
BA_ "GenSigSendType" SG_ 74 LaneCalActvtCmd 2;
BA_ "Origin" SG_ 74 MODChgReq "fuel,ev";
BA_ "Match" SG_ 74 MODChgReq "MODChgReq";
BA_ "GenSigSendType" SG_ 74 MODChgReq 2;
BA_ "Origin" SG_ 74 Radar_DispCmd "fuel,ev";
BA_ "Match" SG_ 74 Radar_DispCmd "Radar_DispCmd";
BA_ "GenSigSendType" SG_ 74 Radar_DispCmd 2;
BA_ "Origin" SG_ 74 Guid_Ovl_Display_Cmd "fuel,ev";
BA_ "Match" SG_ 74 Guid_Ovl_Display_Cmd "Guid_Ovl_Display_Cmd";
BA_ "GenSigSendType" SG_ 74 Guid_Ovl_Display_Cmd 2;
BA_ "Origin" SG_ 74 Sgl_View_Sel "fuel,ev";
BA_ "Match" SG_ 74 Sgl_View_Sel "Sgl_View_Sel";
BA_ "GenSigSendType" SG_ 74 Sgl_View_Sel 2;
BA_ "Origin" SG_ 74 SwToFieldCalRstCmd "fuel,ev";
BA_ "Match" SG_ 74 SwToFieldCalRstCmd "SwToFieldCalRstCmd";
BA_ "GenSigSendType" SG_ 74 SwToFieldCalRstCmd 2;
BA_ "Origin" SG_ 74 AutoViewChgCmd "fuel,ev";
BA_ "Match" SG_ 74 AutoViewChgCmd "AutoViewChgCmd";
BA_ "GenSigSendType" SG_ 74 AutoViewChgCmd 2;
BA_ "Origin" SG_ 74 MdlColrChgCmd "fuel,ev";
BA_ "Match" SG_ 74 MdlColrChgCmd "MdlColrChgCmd";
BA_ "GenSigSendType" SG_ 74 MdlColrChgCmd 2;
BA_ "Origin" SG_ 74 CarMdlTrsprcySwtCmd "fuel,ev";
BA_ "Match" SG_ 74 CarMdlTrsprcySwtCmd "CarMdlTrsprcySwtCmd";
BA_ "GenSigSendType" SG_ 74 CarMdlTrsprcySwtCmd 2;
BA_ "Origin" SG_ 74 CarMdlDispCmd "fuel,ev";
BA_ "Match" SG_ 74 CarMdlDispCmd "CarMdlDispCmd";
BA_ "GenSigSendType" SG_ 74 CarMdlDispCmd 2;
BA_ "Origin" SG_ 74 AutoAVMSwSet_Cmd "fuel,ev";
BA_ "Match" SG_ 74 AutoAVMSwSet_Cmd "AutoAVMSwSet_Cmd";
BA_ "GenSigSendType" SG_ 74 AutoAVMSwSet_Cmd 2;
BA_ "Origin" SG_ 74 FPAS_AutoModSwt "fuel,ev";
BA_ "Match" SG_ 74 FPAS_AutoModSwt "FPAS_AutoModSwt";
BA_ "GenSigSendType" SG_ 74 FPAS_AutoModSwt 2;
BA_ "Origin" SG_ 74 MEBSwtSet "fuel,ev";
BA_ "Match" SG_ 74 MEBSwtSet "MEBSwtSet";
BA_ "GenSigSendType" SG_ 74 MEBSwtSet 2;
BA_ "Origin" SG_ 74 WshSoftSwt "fuel,ev";
BA_ "Match" SG_ 74 WshSoftSwt "WshSoftSwt";
BA_ "GenSigSendType" SG_ 74 WshSoftSwt 2;
BA_ "Origin" SG_ 74 View_SoftswitchCmd "fuel,ev";
BA_ "Match" SG_ 74 View_SoftswitchCmd "View_SoftswitchCmd";
BA_ "GenSigSendType" SG_ 74 View_SoftswitchCmd 2;
BA_ "TransparentInitValue" SG_ 74 HUT6_0x4A "0 0 0 0 0 0 0 0 ";
BA_ "GenSigSendType" SG_ 74 HUT6_0x4A 2;
BA_ "Origin" SG_ 86 QuietVoiceReq "fuel,ev";
BA_ "Match" SG_ 86 QuietVoiceReq "QuietVoiceReq";
BA_ "GenSigSendType" SG_ 86 QuietVoiceReq 2;
BA_ "Origin" SG_ 86 E_CALLSts "fuel,ev";
BA_ "Match" SG_ 86 E_CALLSts "E_CALLSts";
BA_ "GenSigSendType" SG_ 86 E_CALLSts 2;
BA_ "TransparentInitValue" SG_ 86 GLO_NASS1_0x56 "0 0 0 0 0 0 0 0 ";
BA_ "GenSigSendType" SG_ 86 GLO_NASS1_0x56 2;
BA_ "Origin" SG_ 161 SteerWheelAng "fuel,ev";
BA_ "Match" SG_ 161 SteerWheelAng "SteerWheelAng";
BA_ "GenSigCycleTime" SG_ 161 SteerWheelAng 10;
BA_ "Origin" SG_ 161 SteerWheelAngSign "fuel,ev";
BA_ "Match" SG_ 161 SteerWheelAngSign "SteerWheelAngSign";
BA_ "GenSigCycleTime" SG_ 161 SteerWheelAngSign 10;
BA_ "Origin" SG_ 161 SAS_Sts "fuel,ev";
BA_ "Match" SG_ 161 SAS_Sts "SAS_Sts";
BA_ "GenSigCycleTime" SG_ 161 SAS_Sts 10;
BA_ "TransparentInitValue" SG_ 161 CSA2_0xA1 "0 0 0 0 0 0 0 0 ";
BA_ "GenSigCycleTime" SG_ 161 CSA2_0xA1 10;
BA_ "Origin" SG_ 166 TgtEngSpdIP "fuel,ev";
BA_ "Match" SG_ 166 TgtEngSpdIP "TgtEngSpdIP";
BA_ "GenSigCycleTime" SG_ 166 TgtEngSpdIP 10;
BA_ "Origin" SG_ 166 TgtEngSpdIPValid "fuel,ev";
BA_ "Match" SG_ 166 TgtEngSpdIPValid "TgtEngSpdIPValid";
BA_ "GenSigCycleTime" SG_ 166 TgtEngSpdIPValid 10;
BA_ "TransparentInitValue" SG_ 166 DCT3_0xA6 "0 0 0 0 0 0 0 0 ";
BA_ "GenSigCycleTime" SG_ 166 DCT3_0xA6 10;
BA_ "Origin" SG_ 200 ESP_HMI_WarningOn "fuel,ev";
BA_ "Match" SG_ 200 ESP_HMI_WarningOn "ESP_HMI_WarningOn";
BA_ "GenSigCycleTime" SG_ 200 ESP_HMI_WarningOn 10;
BA_ "Origin" SG_ 200 WadeModeWarn "fuel,ev";
BA_ "Match" SG_ 200 WadeModeWarn "WadeModeWarn";
BA_ "GenSigCycleTime" SG_ 200 WadeModeWarn 10;
BA_ "TransparentInitValue" SG_ 200 ESP11_0xC8 "0 0 0 0 0 0 0 0 ";
BA_ "GenSigCycleTime" SG_ 200 ESP11_0xC8 10;
BA_ "Origin" SG_ 241 BMS_ErrCategory "fuel,ev";
BA_ "Match" SG_ 241 BMS_ErrCategory "BMS_ErrCategory";
BA_ "GenSigCycleTime" SG_ 241 BMS_ErrCategory 10;
BA_ "Origin" SG_ 241 CheckSum_BMS4 "ev,ev";
BA_ "Match" SG_ 241 CheckSum_BMS4 "CheckSum_BMS4";
BA_ "GenSigCycleTime" SG_ 241 CheckSum_BMS4 10;
BA_ "Origin" SG_ 241 BMS_PackCurr "ev,ev";
BA_ "Match" SG_ 241 BMS_PackCurr "BMS_PackCurr";
BA_ "GenSigCycleTime" SG_ 241 BMS_PackCurr 10;
BA_ "Origin" SG_ 241 BMS_PackVolt "ev,ev";
BA_ "Match" SG_ 241 BMS_PackVolt "BMS_PackVolt";
BA_ "GenSigStartValue" SG_ 241 BMS_PackVolt 178;
BA_ "GenSigCycleTime" SG_ 241 BMS_PackVolt 10;
BA_ "Origin" SG_ 241 BMS_PowerDownCmplt "ev,ev";
BA_ "Match" SG_ 241 BMS_PowerDownCmplt "BMS_PowerDownCmplt";
BA_ "GenSigCycleTime" SG_ 241 BMS_PowerDownCmplt 10;
BA_ "Origin" SG_ 241 BMS_BattPoweErr "ev,ev";
BA_ "Match" SG_ 241 BMS_BattPoweErr "BMS_BattPoweErr";
BA_ "GenSigCycleTime" SG_ 241 BMS_BattPoweErr 10;
BA_ "Origin" SG_ 241 RollingCounter_BMS4 "ev,ev";
BA_ "Match" SG_ 241 RollingCounter_BMS4 "RollingCounter_BMS4";
BA_ "GenSigCycleTime" SG_ 241 RollingCounter_BMS4 10;
BA_ "TransparentInitValue" SG_ 241 BMS4_0xF1 "0 0 0 178 0 0 0 0 ";
BA_ "GenSigCycleTime" SG_ 241 BMS4_0xF1 10;
BA_ "Origin" SG_ 265 IFCTrqOvlCmdProtnValue "fuel,ev";
BA_ "Match" SG_ 265 IFCTrqOvlCmdProtnValue "IFCTrqOvlCmdProtnValue";
BA_ "GenSigStartValue" SG_ 265 IFCTrqOvlCmdProtnValue 7169;
BA_ "GenSigCycleTime" SG_ 265 IFCTrqOvlCmdProtnValue 20;
BA_ "Origin" SG_ 265 IFCTrqOvlCmdReqValue "fuel,ev";
BA_ "Match" SG_ 265 IFCTrqOvlCmdReqValue "IFCTrqOvlCmdReqValue";
BA_ "GenSigStartValue" SG_ 265 IFCTrqOvlCmdReqValue 1023;
BA_ "GenSigCycleTime" SG_ 265 IFCTrqOvlCmdReqValue 20;
BA_ "TransparentInitValue" SG_ 265 IFC1_0x109 "0 112 4 0 127 224 0 0 ";
BA_ "GenSigCycleTime" SG_ 265 IFC1_0x109 20;
BA_ "Origin" SG_ 273 EMS_AuthenResult "fuel";
BA_ "Match" SG_ 273 EMS_AuthenResult "EMS_AuthenResult";
BA_ "GenSigCycleTime" SG_ 273 EMS_AuthenResult 10;
BA_ "Origin" SG_ 273 EngSpd "fuel";
BA_ "Match" SG_ 273 EngSpd "EngSpd";
BA_ "GenSigCycleTime" SG_ 273 EngSpd 10;
BA_ "Origin" SG_ 273 EngSpdVldty "fuel";
BA_ "Match" SG_ 273 EngSpdVldty "EngSpdVldty";
BA_ "GenSigStartValue" SG_ 273 EngSpdVldty 2;
BA_ "GenSigCycleTime" SG_ 273 EngSpdVldty 10;
BA_ "Origin" SG_ 273 EngSpd_PHEV "ev";
BA_ "Match" SG_ 273 EngSpd_PHEV "EngSpd_PHEV";
BA_ "GenSigCycleTime" SG_ 273 EngSpd_PHEV 10;
BA_ "Origin" SG_ 273 EngSpdVldty_PHEV "ev";
BA_ "Match" SG_ 273 EngSpdVldty_PHEV "EngSpdVldty_PHEV";
BA_ "GenSigStartValue" SG_ 273 EngSpdVldty_PHEV 2;
BA_ "GenSigCycleTime" SG_ 273 EngSpdVldty_PHEV 10;
BA_ "TransparentInitValue" SG_ 273 ECM1_0x111 "0 0 0 0 0 0 0 128 ";
BA_ "GenSigCycleTime" SG_ 273 ECM1_0x111 10;
BA_ "Origin" SG_ 288 IB_Warn "fuel,ev";
BA_ "Match" SG_ 288 IB_Warn "IB_Warn";
BA_ "GenSigCycleTime" SG_ 288 IB_Warn 20;
BA_ "TransparentInitValue" SG_ 288 Ibooster_FD2_0x120 "0 0 0 0 0 0 0 0 0 0 0 0 0 0 0 0 0 0 0 0 0 0 0 0 0 0 0 0 0 0 0 0 0 0 0 0 0 0 0 0 0 0 0 0 0 0 0 0 0 0 0 0 0 0 0 0 0 0 0 0 0 0 0 0 ";
BA_ "GenSigCycleTime" SG_ 288 Ibooster_FD2_0x120 20;
BA_ "Origin" SG_ 311 CheckSum_ESP2 "fuel,ev";
BA_ "Match" SG_ 311 CheckSum_ESP2 "CheckSum_ESP2";
BA_ "GenSigCycleTime" SG_ 311 CheckSum_ESP2 20;
BA_ "Origin" SG_ 311 HDCFault "fuel,ev";
BA_ "Match" SG_ 311 HDCFault "HDCFault";
BA_ "GenSigCycleTime" SG_ 311 HDCFault 20;
BA_ "Origin" SG_ 311 HDCCtrl "fuel,ev";
BA_ "Match" SG_ 311 HDCCtrl "HDCCtrl";
BA_ "GenSigCycleTime" SG_ 311 HDCCtrl 20;
BA_ "Origin" SG_ 311 AVHErrSts "fuel,ev";
BA_ "Match" SG_ 311 AVHErrSts "AVHErrSts";
BA_ "GenSigCycleTime" SG_ 311 AVHErrSts 20;
BA_ "Origin" SG_ 311 AVHSts "fuel,ev";
BA_ "Match" SG_ 311 AVHSts "AVHSts";
BA_ "GenSigCycleTime" SG_ 311 AVHSts 20;
BA_ "Origin" SG_ 311 CDPActv "fuel,ev";
BA_ "Match" SG_ 311 CDPActv "CDPActv";
BA_ "GenSigCycleTime" SG_ 311 CDPActv 20;
BA_ "Origin" SG_ 311 DrivingModDis "fuel,ev";
BA_ "Match" SG_ 311 DrivingModDis "DrivingModDis";
BA_ "GenSigCycleTime" SG_ 311 DrivingModDis 20;
BA_ "Origin" SG_ 311 DrivingModReq_ESP "fuel,ev";
BA_ "Match" SG_ 311 DrivingModReq_ESP "DrivingModReq_ESP";
BA_ "GenSigStartValue" SG_ 311 DrivingModReq_ESP 1;
BA_ "GenSigCycleTime" SG_ 311 DrivingModReq_ESP 20;
BA_ "Origin" SG_ 311 Shift_N_Warn "fuel,ev";
BA_ "Match" SG_ 311 Shift_N_Warn "Shift_N_Warn";
BA_ "GenSigCycleTime" SG_ 311 Shift_N_Warn 20;
BA_ "Origin" SG_ 311 Over_Spd_Warn "fuel,ev";
BA_ "Match" SG_ 311 Over_Spd_Warn "Over_Spd_Warn";
BA_ "GenSigCycleTime" SG_ 311 Over_Spd_Warn 20;
BA_ "Origin" SG_ 311 FourL_Warn "fuel,ev";
BA_ "Match" SG_ 311 FourL_Warn "FourL_Warn";
BA_ "GenSigCycleTime" SG_ 311 FourL_Warn 20;
BA_ "Origin" SG_ 311 TAB_Sts "fuel,ev";
BA_ "Match" SG_ 311 TAB_Sts "TAB_Sts";
BA_ "GenSigCycleTime" SG_ 311 TAB_Sts 20;
BA_ "Origin" SG_ 311 RollingCounter_ESP2 "fuel,ev";
BA_ "Match" SG_ 311 RollingCounter_ESP2 "RollingCounter_ESP2";
BA_ "GenSigCycleTime" SG_ 311 RollingCounter_ESP2 20;
BA_ "Origin" SG_ 311 CheckSum_ESP1 "fuel,ev";
BA_ "Match" SG_ 311 CheckSum_ESP1 "CheckSum_ESP1";
BA_ "GenSigCycleTime" SG_ 311 CheckSum_ESP1 20;
BA_ "Origin" SG_ 311 ESPFuncOffSts "fuel,ev";
BA_ "Match" SG_ 311 ESPFuncOffSts "ESPFuncOffSts";
BA_ "GenSigCycleTime" SG_ 311 ESPFuncOffSts 20;
BA_ "Origin" SG_ 311 ESPActvInfoLmp "fuel,ev";
BA_ "Match" SG_ 311 ESPActvInfoLmp "ESPActvInfoLmp";
BA_ "GenSigCycleTime" SG_ 311 ESPActvInfoLmp 20;
BA_ "Origin" SG_ 311 ESPFailSts "fuel,ev";
BA_ "Match" SG_ 311 ESPFailSts "ESPFailSts";
BA_ "GenSigCycleTime" SG_ 311 ESPFailSts 20;
BA_ "Origin" SG_ 311 IMC_Actv "fuel,ev";
BA_ "Match" SG_ 311 IMC_Actv "IMC_Actv";
BA_ "GenSigCycleTime" SG_ 311 IMC_Actv 20;
BA_ "Origin" SG_ 311 RollingCounter_ESP1 "fuel,ev";
BA_ "Match" SG_ 311 RollingCounter_ESP1 "RollingCounter_ESP1";
BA_ "GenSigCycleTime" SG_ 311 RollingCounter_ESP1 20;
BA_ "Origin" SG_ 311 CheckSum_ABS3 "fuel,ev";
BA_ "Match" SG_ 311 CheckSum_ABS3 "CheckSum_ABS3";
BA_ "GenSigCycleTime" SG_ 311 CheckSum_ABS3 20;
BA_ "Origin" SG_ 311 ABSActv "fuel,ev";
BA_ "Match" SG_ 311 ABSActv "ABSActv";
BA_ "GenSigCycleTime" SG_ 311 ABSActv 20;
BA_ "Origin" SG_ 311 ABSFailSts "fuel,ev";
BA_ "Match" SG_ 311 ABSFailSts "ABSFailSts";
BA_ "GenSigStartValue" SG_ 311 ABSFailSts 1;
BA_ "GenSigCycleTime" SG_ 311 ABSFailSts 20;
BA_ "Origin" SG_ 311 EBDFailSts "fuel,ev";
BA_ "Match" SG_ 311 EBDFailSts "EBDFailSts";
BA_ "GenSigCycleTime" SG_ 311 EBDFailSts 20;
BA_ "Origin" SG_ 311 VehSpdVld "fuel,ev";
BA_ "Match" SG_ 311 VehSpdVld "VehSpdVld";
BA_ "GenSigCycleTime" SG_ 311 VehSpdVld 20;
BA_ "Origin" SG_ 311 VehSpd "fuel,ev";
BA_ "Match" SG_ 311 VehSpd "VehSpd";
BA_ "GenSigCycleTime" SG_ 311 VehSpd 20;
BA_ "Origin" SG_ 311 VehOdoInfoSts "fuel,ev";
BA_ "Match" SG_ 311 VehOdoInfoSts "VehOdoInfoSts";
BA_ "GenSigStartValue" SG_ 311 VehOdoInfoSts 1;
BA_ "GenSigCycleTime" SG_ 311 VehOdoInfoSts 20;
BA_ "Origin" SG_ 311 VehOdoInfo "fuel,ev";
BA_ "Match" SG_ 311 VehOdoInfo "VehOdoInfo";
BA_ "GenSigCycleTime" SG_ 311 VehOdoInfo 20;
BA_ "Origin" SG_ 311 RollingCounter_ABS3 "fuel,ev";
BA_ "Match" SG_ 311 RollingCounter_ABS3 "RollingCounter_ABS3";
BA_ "GenSigCycleTime" SG_ 311 RollingCounter_ABS3 20;
BA_ "Origin" SG_ 311 FreshnessValue_ESP_FD2 "fuel";
BA_ "Match" SG_ 311 FreshnessValue_ESP_FD2 "FreshnessValue_ESP_FD2";
BA_ "GenSigCycleTime" SG_ 311 FreshnessValue_ESP_FD2 20;
BA_ "Origin" SG_ 311 MAC_Check_ESP_FD2 "fuel";
BA_ "Match" SG_ 311 MAC_Check_ESP_FD2 "MAC_Check_ESP_FD2";
BA_ "GenSigCycleTime" SG_ 311 MAC_Check_ESP_FD2 20;
BA_ "Origin" SG_ 311 ESPBrkLmpCtrl "ev";
BA_ "Match" SG_ 311 ESPBrkLmpCtrl "ESPBrkLmpCtrl";
BA_ "GenSigCycleTime" SG_ 311 ESPBrkLmpCtrl 20;
BA_ "Origin" SG_ 311 VDCActv "ev";
BA_ "Match" SG_ 311 VDCActv "VDCActv";
BA_ "GenSigCycleTime" SG_ 311 VDCActv 20;
BA_ "Origin" SG_ 311 PTCActv "ev";
BA_ "Match" SG_ 311 PTCActv "PTCActv";
BA_ "GenSigCycleTime" SG_ 311 PTCActv 20;
BA_ "Origin" SG_ 311 BTCActv "ev";
BA_ "Match" SG_ 311 BTCActv "BTCActv";
BA_ "GenSigCycleTime" SG_ 311 BTCActv 20;
BA_ "TransparentInitValue" SG_ 311 ESP_FD2_0x137 "0 0 0 0 0 0 0 0 0 0 0 0 0 16 0 0 0 0 0 0 0 0 0 0 0 0 0 0 0 0 0 0 0 0 0 0 0 0 0 0 0 128 0 4 0 0 0 0 0 0 0 0 0 0 0 0 0 0 0 0 0 0 0 0 ";
BA_ "GenSigCycleTime" SG_ 311 ESP_FD2_0x137 20;
BA_ "Origin" SG_ 327 CheckSum_EPS1 "fuel,ev";
BA_ "Match" SG_ 327 CheckSum_EPS1 "CheckSum_EPS1";
BA_ "GenSigCycleTime" SG_ 327 CheckSum_EPS1 20;
BA_ "Origin" SG_ 327 EPS_FailSts "fuel,ev";
BA_ "Match" SG_ 327 EPS_FailSts "EPS_FailSts";
BA_ "GenSigCycleTime" SG_ 327 EPS_FailSts 20;
BA_ "Origin" SG_ 327 EPS_SteerMod "fuel,ev";
BA_ "Match" SG_ 327 EPS_SteerMod "EPS_SteerMod";
BA_ "GenSigCycleTime" SG_ 327 EPS_SteerMod 20;
BA_ "Origin" SG_ 327 SteerCorrnRmn "fuel,ev";
BA_ "Match" SG_ 327 SteerCorrnRmn "SteerCorrnRmn";
BA_ "GenSigCycleTime" SG_ 327 SteerCorrnRmn 20;
BA_ "Origin" SG_ 327 SteerCorrnResp "fuel,ev";
BA_ "Match" SG_ 327 SteerCorrnResp "SteerCorrnResp";
BA_ "GenSigStartValue" SG_ 327 SteerCorrnResp 1;
BA_ "GenSigCycleTime" SG_ 327 SteerCorrnResp 20;
BA_ "Origin" SG_ 327 RollingCounter_EPS1 "fuel,ev";
BA_ "Match" SG_ 327 RollingCounter_EPS1 "RollingCounter_EPS1";
BA_ "GenSigCycleTime" SG_ 327 RollingCounter_EPS1 20;
BA_ "TransparentInitValue" SG_ 327 EPS_FD1_0x147 "0 0 0 0 0 0 0 32 0 0 0 0 0 0 0 0 0 0 0 0 0 0 0 0 0 0 0 0 0 0 0 0 0 0 0 0 0 0 0 0 0 0 0 0 0 0 0 0 0 0 0 0 0 0 0 0 0 0 0 0 0 0 0 0 ";
BA_ "GenSigCycleTime" SG_ 327 EPS_FD1_0x147 20;
BA_ "Origin" SG_ 338 FrntELDLckSts "fuel,ev";
BA_ "Match" SG_ 338 FrntELDLckSts "FrntELDLckSts";
BA_ "GenSigCycleTime" SG_ 338 FrntELDLckSts 20;
BA_ "Origin" SG_ 338 RearELDLckSts "fuel,ev";
BA_ "Match" SG_ 338 RearELDLckSts "RearELDLckSts";
BA_ "GenSigCycleTime" SG_ 338 RearELDLckSts 20;
BA_ "TransparentInitValue" SG_ 338 ELD1_0x152 "0 0 0 0 0 0 0 0 ";
BA_ "GenSigCycleTime" SG_ 338 ELD1_0x152 20;
BA_ "Origin" SG_ 347 APS_PrkgMod "fuel,ev";
BA_ "Match" SG_ 347 APS_PrkgMod "APS_PrkgMod";
BA_ "GenSigCycleTime" SG_ 347 APS_PrkgMod 20;
BA_ "Origin" SG_ 347 APS_ProcBar "fuel,ev";
BA_ "Match" SG_ 347 APS_ProcBar "APS_ProcBar";
BA_ "GenSigStartValue" SG_ 347 APS_ProcBar 127;
BA_ "GenSigCycleTime" SG_ 347 APS_ProcBar 20;
BA_ "Origin" SG_ 347 APS_SwtSts "fuel,ev";
BA_ "Match" SG_ 347 APS_SwtSts "APS_SwtSts";
BA_ "GenSigCycleTime" SG_ 347 APS_SwtSts 20;
BA_ "Origin" SG_ 347 APS_SlotDisp "fuel,ev";
BA_ "Match" SG_ 347 APS_SlotDisp "APS_SlotDisp";
BA_ "GenSigCycleTime" SG_ 347 APS_SlotDisp 20;
BA_ "Origin" SG_ 347 APS_SysSoundIndcn "fuel,ev";
BA_ "Match" SG_ 347 APS_SysSoundIndcn "APS_SysSoundIndcn";
BA_ "GenSigCycleTime" SG_ 347 APS_SysSoundIndcn 20;
BA_ "Origin" SG_ 347 APS_PrkgTyp "fuel,ev";
BA_ "Match" SG_ 347 APS_PrkgTyp "APS_PrkgTyp";
BA_ "GenSigCycleTime" SG_ 347 APS_PrkgTyp 20;
BA_ "Origin" SG_ 347 APS_TextDisp "fuel,ev";
BA_ "Match" SG_ 347 APS_TextDisp "APS_TextDisp";
BA_ "GenSigCycleTime" SG_ 347 APS_TextDisp 20;
BA_ "Origin" SG_ 347 APS_WorkSts "fuel,ev";
BA_ "Match" SG_ 347 APS_WorkSts "APS_WorkSts";
BA_ "GenSigCycleTime" SG_ 347 APS_WorkSts 20;
BA_ "Origin" SG_ 347 MEB_AVHReq "fuel,ev";
BA_ "Match" SG_ 347 MEB_AVHReq "MEB_AVHReq";
BA_ "GenSigCycleTime" SG_ 347 MEB_AVHReq 20;
BA_ "Origin" SG_ 347 APS_ESP_BrkDistance "fuel,ev";
BA_ "Match" SG_ 347 APS_ESP_BrkDistance "APS_ESP_BrkDistance";
BA_ "GenSigCycleTime" SG_ 347 APS_ESP_BrkDistance 20;
BA_ "Origin" SG_ 347 APS_BrkModSts "fuel,ev";
BA_ "Match" SG_ 347 APS_BrkModSts "APS_BrkModSts";
BA_ "GenSigCycleTime" SG_ 347 APS_BrkModSts 20;
BA_ "Origin" SG_ 347 APS_BrkCategory "fuel,ev";
BA_ "Match" SG_ 347 APS_BrkCategory "APS_BrkCategory";
BA_ "GenSigCycleTime" SG_ 347 APS_BrkCategory 20;
BA_ "Origin" SG_ 347 LParaPrkgOutVald "fuel,ev";
BA_ "Match" SG_ 347 LParaPrkgOutVald "LParaPrkgOutVald";
BA_ "GenSigCycleTime" SG_ 347 LParaPrkgOutVald 20;
BA_ "Origin" SG_ 347 RParaPrkgOutVald "fuel,ev";
BA_ "Match" SG_ 347 RParaPrkgOutVald "RParaPrkgOutVald";
BA_ "GenSigCycleTime" SG_ 347 RParaPrkgOutVald 20;
BA_ "Origin" SG_ 347 HeadVertPrkgOutVald "fuel,ev";
BA_ "Match" SG_ 347 HeadVertPrkgOutVald "HeadVertPrkgOutVald";
BA_ "GenSigCycleTime" SG_ 347 HeadVertPrkgOutVald 20;
BA_ "Origin" SG_ 347 TailVertPrkgOutVald "fuel,ev";
BA_ "Match" SG_ 347 TailVertPrkgOutVald "TailVertPrkgOutVald";
BA_ "GenSigCycleTime" SG_ 347 TailVertPrkgOutVald 20;
BA_ "Origin" SG_ 347 HAP_SwtDispCtrlCmd "fuel,ev";
BA_ "Match" SG_ 347 HAP_SwtDispCtrlCmd "HAP_SwtDispCtrlCmd";
BA_ "GenSigCycleTime" SG_ 347 HAP_SwtDispCtrlCmd 20;
BA_ "Origin" SG_ 347 HAP_PrkgModCurrSts "fuel,ev";
BA_ "Match" SG_ 347 HAP_PrkgModCurrSts "HAP_PrkgModCurrSts";
BA_ "GenSigCycleTime" SG_ 347 HAP_PrkgModCurrSts 20;
BA_ "Origin" SG_ 347 APS_MovgDirc "fuel,ev";
BA_ "Match" SG_ 347 APS_MovgDirc "APS_MovgDirc";
BA_ "GenSigCycleTime" SG_ 347 APS_MovgDirc 20;
BA_ "Origin" SG_ 347 P2P_PahDelSts "fuel,ev";
BA_ "Match" SG_ 347 P2P_PahDelSts "P2P_PahDelSts";
BA_ "GenSigCycleTime" SG_ 347 P2P_PahDelSts 20;
BA_ "Origin" SG_ 347 P2P_SelfDetErrCode "fuel,ev";
BA_ "Match" SG_ 347 P2P_SelfDetErrCode "P2P_SelfDetErrCode";
BA_ "GenSigCycleTime" SG_ 347 P2P_SelfDetErrCode 20;
BA_ "Origin" SG_ 347 P2P_SelfDetSts "fuel,ev";
BA_ "Match" SG_ 347 P2P_SelfDetSts "P2P_SelfDetSts";
BA_ "GenSigCycleTime" SG_ 347 P2P_SelfDetSts 20;
BA_ "Origin" SG_ 347 P2P_Pah1Avail "fuel,ev";
BA_ "Match" SG_ 347 P2P_Pah1Avail "P2P_Pah1Avail";
BA_ "GenSigCycleTime" SG_ 347 P2P_Pah1Avail 20;
BA_ "Origin" SG_ 347 P2P_Pah2Avail "fuel,ev";
BA_ "Match" SG_ 347 P2P_Pah2Avail "P2P_Pah2Avail";
BA_ "GenSigCycleTime" SG_ 347 P2P_Pah2Avail 20;
BA_ "Origin" SG_ 347 P2P_PrkgDirectSts "fuel,ev";
BA_ "Match" SG_ 347 P2P_PrkgDirectSts "P2P_PrkgDirectSts";
BA_ "GenSigCycleTime" SG_ 347 P2P_PrkgDirectSts 20;
BA_ "Origin" SG_ 347 HAVP_WorkSts "fuel,ev";
BA_ "Match" SG_ 347 HAVP_WorkSts "HAVP_WorkSts";
BA_ "GenSigCycleTime" SG_ 347 HAVP_WorkSts 20;
BA_ "Origin" SG_ 347 PAVP_Status "fuel,ev";
BA_ "Match" SG_ 347 PAVP_Status "PAVP_Status";
BA_ "GenSigCycleTime" SG_ 347 PAVP_Status 20;
BA_ "Origin" SG_ 347 PAVP_TextDis2 "fuel,ev";
BA_ "Match" SG_ 347 PAVP_TextDis2 "PAVP_TextDis2";
BA_ "GenSigCycleTime" SG_ 347 PAVP_TextDis2 20;
BA_ "Origin" SG_ 347 ParallelSlotBtn_Ena "fuel,ev";
BA_ "Match" SG_ 347 ParallelSlotBtn_Ena "ParallelSlotBtn_Ena";
BA_ "GenSigCycleTime" SG_ 347 ParallelSlotBtn_Ena 20;
BA_ "Origin" SG_ 347 VerticalSlotBtn_Ena "fuel,ev";
BA_ "Match" SG_ 347 VerticalSlotBtn_Ena "VerticalSlotBtn_Ena";
BA_ "GenSigCycleTime" SG_ 347 VerticalSlotBtn_Ena 20;
BA_ "Origin" SG_ 347 ClockwiseBtn_Ena "fuel,ev";
BA_ "Match" SG_ 347 ClockwiseBtn_Ena "ClockwiseBtn_Ena";
BA_ "GenSigCycleTime" SG_ 347 ClockwiseBtn_Ena 20;
BA_ "Origin" SG_ 347 AnticlockwiseBtn_Ena "fuel,ev";
BA_ "Match" SG_ 347 AnticlockwiseBtn_Ena "AnticlockwiseBtn_Ena";
BA_ "GenSigCycleTime" SG_ 347 AnticlockwiseBtn_Ena 20;
BA_ "Origin" SG_ 347 SlotConfirmBtn_Ena "fuel,ev";
BA_ "Match" SG_ 347 SlotConfirmBtn_Ena "SlotConfirmBtn_Ena";
BA_ "GenSigCycleTime" SG_ 347 SlotConfirmBtn_Ena 20;
BA_ "Origin" SG_ 347 HAVP_StopBtn_Ena "fuel,ev";
BA_ "Match" SG_ 347 HAVP_StopBtn_Ena "HAVP_StopBtn_Ena";
BA_ "GenSigCycleTime" SG_ 347 HAVP_StopBtn_Ena 20;
BA_ "Origin" SG_ 347 HAVP_StartBtn_Ena "fuel,ev";
BA_ "Match" SG_ 347 HAVP_StartBtn_Ena "HAVP_StartBtn_Ena";
BA_ "GenSigCycleTime" SG_ 347 HAVP_StartBtn_Ena 20;
BA_ "Origin" SG_ 347 HAVP_SelfParLotEnding_Ena "fuel,ev";
BA_ "Match" SG_ 347 HAVP_SelfParLotEnding_Ena "HAVP_SelfParLotEnding_Ena";
BA_ "GenSigCycleTime" SG_ 347 HAVP_SelfParLotEnding_Ena 20;
BA_ "Origin" SG_ 347 PAVP_TextDis "fuel,ev";
BA_ "Match" SG_ 347 PAVP_TextDis "PAVP_TextDis";
BA_ "GenSigCycleTime" SG_ 347 PAVP_TextDis 20;
BA_ "Origin" SG_ 347 AVP_T_Box_WorkSts "ev";
BA_ "Match" SG_ 347 AVP_T_Box_WorkSts "AVP_T_Box_WorkSts";
BA_ "GenSigCycleTime" SG_ 347 AVP_T_Box_WorkSts 20;
BA_ "TransparentInitValue" SG_ 347 HAP_FD1_0x15B "0 0 0 0 0 0 0 0 0 0 0 0 0 254 0 0 0 0 0 0 0 0 0 0 0 0 0 0 0 0 0 0 0 0 0 0 0 0 0 0 0 0 0 0 0 0 0 0 0 0 0 0 0 0 0 0 0 0 0 0 0 0 0 0 ";
BA_ "GenSigCycleTime" SG_ 347 HAP_FD1_0x15B 20;
BA_ "Origin" SG_ 350 CR_FCTA_Resp "fuel,ev";
BA_ "Match" SG_ 350 CR_FCTA_Resp "CR_FCTA_Resp";
BA_ "GenSigCycleTime" SG_ 350 CR_FCTA_Resp 20;
BA_ "Origin" SG_ 350 CR_FCTB_Resp "fuel,ev";
BA_ "Match" SG_ 350 CR_FCTB_Resp "CR_FCTB_Resp";
BA_ "GenSigCycleTime" SG_ 350 CR_FCTB_Resp 20;
BA_ "Origin" SG_ 350 CR_BliSts "fuel,ev";
BA_ "Match" SG_ 350 CR_BliSts "CR_BliSts";
BA_ "GenSigCycleTime" SG_ 350 CR_BliSts 20;
BA_ "Origin" SG_ 350 FCTA_Warn "fuel,ev";
BA_ "Match" SG_ 350 FCTA_Warn "FCTA_Warn";
BA_ "GenSigCycleTime" SG_ 350 FCTA_Warn 20;
BA_ "Origin" SG_ 350 FCTBTrig "fuel,ev";
BA_ "Match" SG_ 350 FCTBTrig "FCTBTrig";
BA_ "GenSigCycleTime" SG_ 350 FCTBTrig 20;
BA_ "Origin" SG_ 350 FCTA_B_FuncSts "fuel,ev";
BA_ "Match" SG_ 350 FCTA_B_FuncSts "FCTA_B_FuncSts";
BA_ "GenSigCycleTime" SG_ 350 FCTA_B_FuncSts 20;
BA_ "Origin" SG_ 350 FCTA_B_TTC "fuel,ev";
BA_ "Match" SG_ 350 FCTA_B_TTC "FCTA_B_TTC";
BA_ "GenSigCycleTime" SG_ 350 FCTA_B_TTC 20;
BA_ "TransparentInitValue" SG_ 350 CR_FD1_0x15E "0 0 0 0 0 0 0 0 0 0 0 0 0 0 0 0 0 0 0 0 0 0 0 0 0 0 0 0 0 0 0 0 0 0 0 0 0 0 0 0 0 0 0 0 0 0 0 0 0 0 0 0 0 0 0 0 0 0 0 0 0 0 0 0 ";
BA_ "GenSigCycleTime" SG_ 350 CR_FD1_0x15E 20;
BA_ "Origin" SG_ 357 LTurnLmpSwtSts "fuel,ev";
BA_ "Match" SG_ 357 LTurnLmpSwtSts "LTurnLmpSwtSts";
BA_ "GenSigCycleTime" SG_ 357 LTurnLmpSwtSts 20;
BA_ "Origin" SG_ 357 RTurnLmpSwtSts "fuel,ev";
BA_ "Match" SG_ 357 RTurnLmpSwtSts "RTurnLmpSwtSts";
BA_ "GenSigCycleTime" SG_ 357 RTurnLmpSwtSts 20;
BA_ "Origin" SG_ 357 AutoLmpSwtSts "fuel,ev";
BA_ "Match" SG_ 357 AutoLmpSwtSts "AutoLmpSwtSts";
BA_ "GenSigCycleTime" SG_ 357 AutoLmpSwtSts 20;
BA_ "Origin" SG_ 357 HornSwtSts "fuel,ev";
BA_ "Match" SG_ 357 HornSwtSts "HornSwtSts";
BA_ "GenSigCycleTime" SG_ 357 HornSwtSts 20;
BA_ "Origin" SG_ 357 FrntWiprSwtSts "fuel,ev";
BA_ "Match" SG_ 357 FrntWiprSwtSts "FrntWiprSwtSts";
BA_ "GenSigCycleTime" SG_ 357 FrntWiprSwtSts 20;
BA_ "Origin" SG_ 357 PosnLmpSwtSts "ev";
BA_ "Match" SG_ 357 PosnLmpSwtSts "PosnLmpSwtSts";
BA_ "GenSigCycleTime" SG_ 357 PosnLmpSwtSts 20;
BA_ "Origin" SG_ 357 FrntFogLmpSwtSts "ev";
BA_ "Match" SG_ 357 FrntFogLmpSwtSts "FrntFogLmpSwtSts";
BA_ "GenSigCycleTime" SG_ 357 FrntFogLmpSwtSts 20;
BA_ "Origin" SG_ 357 RearFogLmpSwtSts "ev";
BA_ "Match" SG_ 357 RearFogLmpSwtSts "RearFogLmpSwtSts";
BA_ "GenSigCycleTime" SG_ 357 RearFogLmpSwtSts 20;
BA_ "Origin" SG_ 357 HiBeamSwtSts "ev";
BA_ "Match" SG_ 357 HiBeamSwtSts "HiBeamSwtSts";
BA_ "GenSigCycleTime" SG_ 357 HiBeamSwtSts 20;
BA_ "TransparentInitValue" SG_ 357 CSA1_0x165 "0 0 0 0 0 0 0 0 ";
BA_ "GenSigCycleTime" SG_ 357 CSA1_0x165 20;
BA_ "Origin" SG_ 363 CheckSum_EPB1 "fuel,ev";
BA_ "Match" SG_ 363 CheckSum_EPB1 "CheckSum_EPB1";
BA_ "GenSigCycleTime" SG_ 363 CheckSum_EPB1 20;
BA_ "Origin" SG_ 363 EPBErrSts "fuel,ev";
BA_ "Match" SG_ 363 EPBErrSts "EPBErrSts";
BA_ "GenSigCycleTime" SG_ 363 EPBErrSts 20;
BA_ "Origin" SG_ 363 EPBRedLmpSts "fuel,ev";
BA_ "Match" SG_ 363 EPBRedLmpSts "EPBRedLmpSts";
BA_ "GenSigCycleTime" SG_ 363 EPBRedLmpSts 20;
BA_ "Origin" SG_ 363 EPBSts "fuel,ev";
BA_ "Match" SG_ 363 EPBSts "EPBSts";
BA_ "GenSigCycleTime" SG_ 363 EPBSts 20;
BA_ "Origin" SG_ 363 EPBTextDisp "fuel,ev";
BA_ "Match" SG_ 363 EPBTextDisp "EPBTextDisp";
BA_ "GenSigCycleTime" SG_ 363 EPBTextDisp 20;
BA_ "Origin" SG_ 363 PressBrakePedalPointOut "fuel,ev";
BA_ "Match" SG_ 363 PressBrakePedalPointOut "PressBrakePedalPointOut";
BA_ "GenSigCycleTime" SG_ 363 PressBrakePedalPointOut 20;
BA_ "Origin" SG_ 363 RollingCounter_EPB1 "fuel,ev";
BA_ "Match" SG_ 363 RollingCounter_EPB1 "RollingCounter_EPB1";
BA_ "GenSigCycleTime" SG_ 363 RollingCounter_EPB1 20;
BA_ "TransparentInitValue" SG_ 363 EPB1_0x16B "0 0 0 0 0 0 0 0 ";
BA_ "GenSigCycleTime" SG_ 363 EPB1_0x16B 20;
BA_ "Origin" SG_ 367 RSDS_IPSoundReq "fuel,ev";
BA_ "Match" SG_ 367 RSDS_IPSoundReq "RSDS_IPSoundReq";
BA_ "GenSigCycleTime" SG_ 367 RSDS_IPSoundReq 20;
BA_ "Origin" SG_ 367 RSDS_ErrSts "fuel,ev";
BA_ "Match" SG_ 367 RSDS_ErrSts "RSDS_ErrSts";
BA_ "GenSigCycleTime" SG_ 367 RSDS_ErrSts 20;
BA_ "Origin" SG_ 367 RSDS_BrkgTrig "fuel,ev";
BA_ "Match" SG_ 367 RSDS_BrkgTrig "RSDS_BrkgTrig";
BA_ "GenSigCycleTime" SG_ 367 RSDS_BrkgTrig 20;
BA_ "Origin" SG_ 367 RSDS_BliSts "fuel,ev";
BA_ "Match" SG_ 367 RSDS_BliSts "RSDS_BliSts";
BA_ "GenSigCycleTime" SG_ 367 RSDS_BliSts 20;
BA_ "Origin" SG_ 367 RSDS_TrailerSts "fuel,ev";
BA_ "Match" SG_ 367 RSDS_TrailerSts "RSDS_TrailerSts";
BA_ "GenSigCycleTime" SG_ 367 RSDS_TrailerSts 20;
BA_ "Origin" SG_ 367 RSDS_LCAResp "fuel,ev";
BA_ "Match" SG_ 367 RSDS_LCAResp "RSDS_LCAResp";
BA_ "GenSigCycleTime" SG_ 367 RSDS_LCAResp 20;
BA_ "Origin" SG_ 367 RSDS_DOWResp "fuel,ev";
BA_ "Match" SG_ 367 RSDS_DOWResp "RSDS_DOWResp";
BA_ "GenSigCycleTime" SG_ 367 RSDS_DOWResp 20;
BA_ "Origin" SG_ 367 RSDS_RCWResp "fuel,ev";
BA_ "Match" SG_ 367 RSDS_RCWResp "RSDS_RCWResp";
BA_ "GenSigCycleTime" SG_ 367 RSDS_RCWResp 20;
BA_ "Origin" SG_ 367 RSDS_RCTAResp "fuel,ev";
BA_ "Match" SG_ 367 RSDS_RCTAResp "RSDS_RCTAResp";
BA_ "GenSigCycleTime" SG_ 367 RSDS_RCTAResp 20;
BA_ "Origin" SG_ 367 RSDS_RCTABrkResp "fuel,ev";
BA_ "Match" SG_ 367 RSDS_RCTABrkResp "RSDS_RCTABrkResp";
BA_ "GenSigCycleTime" SG_ 367 RSDS_RCTABrkResp 20;
BA_ "Origin" SG_ 367 RSDS_RCW_Trigger "fuel,ev";
BA_ "Match" SG_ 367 RSDS_RCW_Trigger "RSDS_RCW_Trigger";
BA_ "GenSigCycleTime" SG_ 367 RSDS_RCW_Trigger 20;
BA_ "Origin" SG_ 367 RSDS_CTA_Actv "fuel,ev";
BA_ "Match" SG_ 367 RSDS_CTA_Actv "RSDS_CTA_Actv";
BA_ "GenSigCycleTime" SG_ 367 RSDS_CTA_Actv 20;
BA_ "Origin" SG_ 367 BSD_LCA_warningReqRight "fuel,ev";
BA_ "Match" SG_ 367 BSD_LCA_warningReqRight "BSD_LCA_warningReqRight";
BA_ "GenSigCycleTime" SG_ 367 BSD_LCA_warningReqRight 20;
BA_ "Origin" SG_ 367 BSD_LCA_warningReqleft "fuel,ev";
BA_ "Match" SG_ 367 BSD_LCA_warningReqleft "BSD_LCA_warningReqleft";
BA_ "GenSigCycleTime" SG_ 367 BSD_LCA_warningReqleft 20;
BA_ "Origin" SG_ 367 DOW_warningReqRight "fuel,ev";
BA_ "Match" SG_ 367 DOW_warningReqRight "DOW_warningReqRight";
BA_ "GenSigCycleTime" SG_ 367 DOW_warningReqRight 20;
BA_ "Origin" SG_ 367 DOW_warningReqleft "fuel,ev";
BA_ "Match" SG_ 367 DOW_warningReqleft "DOW_warningReqleft";
BA_ "GenSigCycleTime" SG_ 367 DOW_warningReqleft 20;
BA_ "Origin" SG_ 367 RCTA_warningReqRight "fuel,ev";
BA_ "Match" SG_ 367 RCTA_warningReqRight "RCTA_warningReqRight";
BA_ "GenSigCycleTime" SG_ 367 RCTA_warningReqRight 20;
BA_ "Origin" SG_ 367 RCTA_warningReqLeft "fuel,ev";
BA_ "Match" SG_ 367 RCTA_warningReqLeft "RCTA_warningReqLeft";
BA_ "GenSigCycleTime" SG_ 367 RCTA_warningReqLeft 20;
BA_ "TransparentInitValue" SG_ 367 RSDS_FD1_0x16F "0 0 0 0 0 0 0 0 0 0 0 0 0 0 0 0 0 0 0 0 0 0 0 0 0 0 0 0 0 0 0 0 0 0 0 0 0 0 0 0 0 0 0 0 0 0 0 0 0 0 0 0 0 0 0 0 0 0 0 0 0 0 0 0 ";
BA_ "GenSigCycleTime" SG_ 367 RSDS_FD1_0x16F 20;
BA_ "Origin" SG_ 368 CCO_Warn "fuel,ev";
BA_ "Match" SG_ 368 CCO_Warn "CCO_Warn";
BA_ "GenSigCycleTime" SG_ 368 CCO_Warn 20;
BA_ "Origin" SG_ 368 CCO_Active "fuel,ev";
BA_ "Match" SG_ 368 CCO_Active "CCO_Active";
BA_ "GenSigCycleTime" SG_ 368 CCO_Active 20;
BA_ "Origin" SG_ 368 CCO_TgtVel "fuel,ev";
BA_ "Match" SG_ 368 CCO_TgtVel "CCO_TgtVel";
BA_ "GenSigCycleTime" SG_ 368 CCO_TgtVel 20;
BA_ "Origin" SG_ 368 EspFuncOffSts_mode "fuel,ev";
BA_ "Match" SG_ 368 EspFuncOffSts_mode "EspFuncOffSts_mode";
BA_ "GenSigCycleTime" SG_ 368 EspFuncOffSts_mode 20;
BA_ "TransparentInitValue" SG_ 368 ESP8_0x170 "0 0 0 0 0 0 0 0 ";
BA_ "GenSigCycleTime" SG_ 368 ESP8_0x170 20;
BA_ "Origin" SG_ 395 AEB_ABA_Level "fuel,ev";
BA_ "Match" SG_ 395 AEB_ABA_Level "AEB_ABA_Level";
BA_ "GenSigCycleTime" SG_ 395 AEB_ABA_Level 20;
BA_ "Origin" SG_ 395 AEB_ABA_Req "fuel,ev";
BA_ "Match" SG_ 395 AEB_ABA_Req "AEB_ABA_Req";
BA_ "GenSigCycleTime" SG_ 395 AEB_ABA_Req 20;
BA_ "Origin" SG_ 395 EBA_TgtDecel_Req "fuel,ev";
BA_ "Match" SG_ 395 EBA_TgtDecel_Req "EBA_TgtDecel_Req";
BA_ "GenSigCycleTime" SG_ 395 EBA_TgtDecel_Req 20;
BA_ "Origin" SG_ 395 AEB_VehHldReq "fuel,ev";
BA_ "Match" SG_ 395 AEB_VehHldReq "AEB_VehHldReq";
BA_ "GenSigCycleTime" SG_ 395 AEB_VehHldReq 20;
BA_ "Origin" SG_ 395 AEB_TgtDecel_Req "fuel,ev";
BA_ "Match" SG_ 395 AEB_TgtDecel_Req "AEB_TgtDecel_Req";
BA_ "GenSigCycleTime" SG_ 395 AEB_TgtDecel_Req 20;
BA_ "Origin" SG_ 395 AEB_TgtDecel_ReqValue "fuel,ev";
BA_ "Match" SG_ 395 AEB_TgtDecel_ReqValue "AEB_TgtDecel_ReqValue";
BA_ "GenSigCycleTime" SG_ 395 AEB_TgtDecel_ReqValue 20;
BA_ "Origin" SG_ 395 AEB_AWB_Req "fuel,ev";
BA_ "Match" SG_ 395 AEB_AWB_Req "AEB_AWB_Req";
BA_ "GenSigCycleTime" SG_ 395 AEB_AWB_Req 20;
BA_ "Origin" SG_ 395 AEB_AWB_Level "fuel,ev";
BA_ "Match" SG_ 395 AEB_AWB_Level "AEB_AWB_Level";
BA_ "GenSigCycleTime" SG_ 395 AEB_AWB_Level 20;
BA_ "Origin" SG_ 395 AEB_ABP_Req "fuel,ev";
BA_ "Match" SG_ 395 AEB_ABP_Req "AEB_ABP_Req";
BA_ "GenSigCycleTime" SG_ 395 AEB_ABP_Req 20;
BA_ "Origin" SG_ 395 AEB_BrkReqFunc "fuel,ev";
BA_ "Match" SG_ 395 AEB_BrkReqFunc "AEB_BrkReqFunc";
BA_ "GenSigCycleTime" SG_ 395 AEB_BrkReqFunc 20;
BA_ "Origin" SG_ 395 AEB_ObjSty "fuel,ev";
BA_ "Match" SG_ 395 AEB_ObjSty "AEB_ObjSty";
BA_ "GenSigCycleTime" SG_ 395 AEB_ObjSty 20;
BA_ "TransparentInitValue" SG_ 395 AEB_FD1_0x18B "0 0 0 0 0 0 0 0 0 0 0 0 0 0 0 0 0 0 0 0 0 0 0 0 0 0 0 0 0 0 0 0 0 0 0 0 0 0 0 0 0 0 0 0 0 0 0 0 0 0 0 0 0 0 0 0 0 0 0 0 0 0 0 0 ";
BA_ "GenSigCycleTime" SG_ 395 AEB_FD1_0x18B 20;
BA_ "Origin" SG_ 411 FFogLmpSts_F_PBox "fuel,ev";
BA_ "Match" SG_ 411 FFogLmpSts_F_PBox "FFogLmpSts_F_PBox";
BA_ "GenSigCycleTime" SG_ 411 FFogLmpSts_F_PBox 50;
BA_ "Origin" SG_ 411 HiBeamSts_F_PBox "fuel,ev";
BA_ "Match" SG_ 411 HiBeamSts_F_PBox "HiBeamSts_F_PBox";
BA_ "GenSigCycleTime" SG_ 411 HiBeamSts_F_PBox 50;
BA_ "Origin" SG_ 411 HoodSts_F_PBox "fuel,ev";
BA_ "Match" SG_ 411 HoodSts_F_PBox "HoodSts_F_PBox";
BA_ "GenSigCycleTime" SG_ 411 HoodSts_F_PBox 50;
BA_ "Origin" SG_ 411 LasHdLmpSts_F_PBox "fuel,ev";
BA_ "Match" SG_ 411 LasHdLmpSts_F_PBox "LasHdLmpSts_F_PBox";
BA_ "GenSigCycleTime" SG_ 411 LasHdLmpSts_F_PBox 50;
BA_ "Origin" SG_ 411 LHiBeamFailSts "fuel,ev";
BA_ "Match" SG_ 411 LHiBeamFailSts "LHiBeamFailSts";
BA_ "GenSigCycleTime" SG_ 411 LHiBeamFailSts 50;
BA_ "Origin" SG_ 411 RHiBeamFailSts "fuel,ev";
BA_ "Match" SG_ 411 RHiBeamFailSts "RHiBeamFailSts";
BA_ "GenSigCycleTime" SG_ 411 RHiBeamFailSts 50;
BA_ "Origin" SG_ 411 LLowBeamFailSts "fuel,ev";
BA_ "Match" SG_ 411 LLowBeamFailSts "LLowBeamFailSts";
BA_ "GenSigCycleTime" SG_ 411 LLowBeamFailSts 50;
BA_ "Origin" SG_ 411 LHeadLmpFailSts "fuel,ev";
BA_ "Match" SG_ 411 LHeadLmpFailSts "LHeadLmpFailSts";
BA_ "GenSigCycleTime" SG_ 411 LHeadLmpFailSts 50;
BA_ "Origin" SG_ 411 RHeadLmpFailSts "fuel,ev";
BA_ "Match" SG_ 411 RHeadLmpFailSts "RHeadLmpFailSts";
BA_ "GenSigCycleTime" SG_ 411 RHeadLmpFailSts 50;
BA_ "Origin" SG_ 411 RLowBeamFailSts "fuel,ev";
BA_ "Match" SG_ 411 RLowBeamFailSts "RLowBeamFailSts";
BA_ "GenSigCycleTime" SG_ 411 RLowBeamFailSts 50;
BA_ "Origin" SG_ 411 RLasHdLmpDiagSig "fuel,ev";
BA_ "Match" SG_ 411 RLasHdLmpDiagSig "RLasHdLmpDiagSig";
BA_ "GenSigCycleTime" SG_ 411 RLasHdLmpDiagSig 50;
BA_ "Origin" SG_ 411 LLasHdLmpDiagSig "fuel,ev";
BA_ "Match" SG_ 411 LLasHdLmpDiagSig "LLasHdLmpDiagSig";
BA_ "GenSigCycleTime" SG_ 411 LLasHdLmpDiagSig 50;
BA_ "Origin" SG_ 411 LowBeamSts_F_PBox "fuel,ev";
BA_ "Match" SG_ 411 LowBeamSts_F_PBox "LowBeamSts_F_PBox";
BA_ "GenSigCycleTime" SG_ 411 LowBeamSts_F_PBox 50;
BA_ "Origin" SG_ 411 WhistleSts_F_PBox "fuel,ev";
BA_ "Match" SG_ 411 WhistleSts_F_PBox "WhistleSts_F_PBox";
BA_ "GenSigCycleTime" SG_ 411 WhistleSts_F_PBox 50;
BA_ "Origin" SG_ 411 FFogLmpFailSts "ev";
BA_ "Match" SG_ 411 FFogLmpFailSts "FFogLmpFailSts";
BA_ "GenSigCycleTime" SG_ 411 FFogLmpFailSts 50;
BA_ "Origin" SG_ 411 LFPosnLmpSts "ev";
BA_ "Match" SG_ 411 LFPosnLmpSts "LFPosnLmpSts";
BA_ "GenSigCycleTime" SG_ 411 LFPosnLmpSts 50;
BA_ "Origin" SG_ 411 RFPosnLmpSts "ev";
BA_ "Match" SG_ 411 RFPosnLmpSts "RFPosnLmpSts";
BA_ "GenSigCycleTime" SG_ 411 RFPosnLmpSts 50;
BA_ "TransparentInitValue" SG_ 411 F_PBOX1_0x19B "0 0 0 0 0 0 0 0 ";
BA_ "GenSigCycleTime" SG_ 411 F_PBOX1_0x19B 50;
BA_ "Origin" SG_ 412 HiPosnBrkLmpFailSts "fuel,ev";
BA_ "Match" SG_ 412 HiPosnBrkLmpFailSts "HiPosnBrkLmpFailSts";
BA_ "GenSigCycleTime" SG_ 412 HiPosnBrkLmpFailSts 50;
BA_ "Origin" SG_ 412 LBrkLmpFailSts "fuel,ev";
BA_ "Match" SG_ 412 LBrkLmpFailSts "LBrkLmpFailSts";
BA_ "GenSigCycleTime" SG_ 412 LBrkLmpFailSts 50;
BA_ "Origin" SG_ 412 RFogLmpFailSts_R_PBox "fuel,ev";
BA_ "Match" SG_ 412 RFogLmpFailSts_R_PBox "RFogLmpFailSts_R_PBox";
BA_ "GenSigCycleTime" SG_ 412 RFogLmpFailSts_R_PBox 50;
BA_ "Origin" SG_ 412 RFogLmpSts_R_PBox "fuel,ev";
BA_ "Match" SG_ 412 RFogLmpSts_R_PBox "RFogLmpSts_R_PBox";
BA_ "GenSigCycleTime" SG_ 412 RFogLmpSts_R_PBox 50;
BA_ "Origin" SG_ 412 ParkLmpSts_R_PBox "fuel,ev";
BA_ "Match" SG_ 412 ParkLmpSts_R_PBox "ParkLmpSts_R_PBox";
BA_ "GenSigCycleTime" SG_ 412 ParkLmpSts_R_PBox 50;
BA_ "Origin" SG_ 412 RBrkLmpFailSts "fuel,ev";
BA_ "Match" SG_ 412 RBrkLmpFailSts "RBrkLmpFailSts";
BA_ "GenSigCycleTime" SG_ 412 RBrkLmpFailSts 50;
BA_ "Origin" SG_ 412 PosnLmpOutpSts_R_PBox "fuel,ev";
BA_ "Match" SG_ 412 PosnLmpOutpSts_R_PBox "PosnLmpOutpSts_R_PBox";
BA_ "GenSigCycleTime" SG_ 412 PosnLmpOutpSts_R_PBox 50;
BA_ "Origin" SG_ 412 RRPosnLmpFailSts "fuel,ev";
BA_ "Match" SG_ 412 RRPosnLmpFailSts "RRPosnLmpFailSts";
BA_ "GenSigCycleTime" SG_ 412 RRPosnLmpFailSts 50;
BA_ "Origin" SG_ 412 RvsLmpFailSts "fuel,ev";
BA_ "Match" SG_ 412 RvsLmpFailSts "RvsLmpFailSts";
BA_ "GenSigCycleTime" SG_ 412 RvsLmpFailSts 50;
BA_ "Origin" SG_ 412 LRPosnLmpFailSts "fuel,ev";
BA_ "Match" SG_ 412 LRPosnLmpFailSts "LRPosnLmpFailSts";
BA_ "GenSigCycleTime" SG_ 412 LRPosnLmpFailSts 50;
BA_ "Origin" SG_ 412 LTurnLmpSts_R_PBox "fuel,ev";
BA_ "Match" SG_ 412 LTurnLmpSts_R_PBox "LTurnLmpSts_R_PBox";
BA_ "GenSigCycleTime" SG_ 412 LTurnLmpSts_R_PBox 50;
BA_ "Origin" SG_ 412 RTurnLmpSts_R_PBox "fuel,ev";
BA_ "Match" SG_ 412 RTurnLmpSts_R_PBox "RTurnLmpSts_R_PBox";
BA_ "GenSigCycleTime" SG_ 412 RTurnLmpSts_R_PBox 50;
BA_ "Origin" SG_ 412 RWinHeatgIconRlyCmd "fuel,ev";
BA_ "Match" SG_ 412 RWinHeatgIconRlyCmd "RWinHeatgIconRlyCmd";
BA_ "GenSigCycleTime" SG_ 412 RWinHeatgIconRlyCmd 50;
BA_ "Origin" SG_ 412 RWinHeatgFailSts "fuel,ev";
BA_ "Match" SG_ 412 RWinHeatgFailSts "RWinHeatgFailSts";
BA_ "GenSigCycleTime" SG_ 412 RWinHeatgFailSts 50;
BA_ "Origin" SG_ 412 LicPlateLmpFailSts "fuel,ev";
BA_ "Match" SG_ 412 LicPlateLmpFailSts "LicPlateLmpFailSts";
BA_ "GenSigCycleTime" SG_ 412 LicPlateLmpFailSts 50;
BA_ "Origin" SG_ 412 RTurnLmpFailSts "fuel,ev";
BA_ "Match" SG_ 412 RTurnLmpFailSts "RTurnLmpFailSts";
BA_ "GenSigCycleTime" SG_ 412 RTurnLmpFailSts 50;
BA_ "Origin" SG_ 412 LTurnLmpFailSts "fuel,ev";
BA_ "Match" SG_ 412 LTurnLmpFailSts "LTurnLmpFailSts";
BA_ "GenSigCycleTime" SG_ 412 LTurnLmpFailSts 50;
BA_ "Origin" SG_ 412 LBrkLmpOutpSts_R_PBox "fuel,ev";
BA_ "Match" SG_ 412 LBrkLmpOutpSts_R_PBox "LBrkLmpOutpSts_R_PBox";
BA_ "GenSigCycleTime" SG_ 412 LBrkLmpOutpSts_R_PBox 50;
BA_ "Origin" SG_ 412 RBrkLmpOutpSts_R_PBox "fuel,ev";
BA_ "Match" SG_ 412 RBrkLmpOutpSts_R_PBox "RBrkLmpOutpSts_R_PBox";
BA_ "GenSigCycleTime" SG_ 412 RBrkLmpOutpSts_R_PBox 50;
BA_ "Origin" SG_ 412 HiPosnBrkLmpOutpSts_R_PBox "fuel,ev";
BA_ "Match" SG_ 412 HiPosnBrkLmpOutpSts_R_PBox "HiPosnBrkLmpOutpSts_R_PBox";
BA_ "GenSigCycleTime" SG_ 412 HiPosnBrkLmpOutpSts_R_PBox 50;
BA_ "Origin" SG_ 412 FreshnessValue_R_PBox1 "fuel,ev";
BA_ "Match" SG_ 412 FreshnessValue_R_PBox1 "FreshnessValue_R_PBox1";
BA_ "GenSigCycleTime" SG_ 412 FreshnessValue_R_PBox1 50;
BA_ "Origin" SG_ 412 MAC_Check_R_PBox1 "fuel,ev";
BA_ "Match" SG_ 412 MAC_Check_R_PBox1 "MAC_Check_R_PBox1";
BA_ "GenSigCycleTime" SG_ 412 MAC_Check_R_PBox1 50;
BA_ "TransparentInitValue" SG_ 412 R_PBOX1_0x19C "0 0 0 0 0 0 0 0 0 0 0 0 0 0 0 0 ";
BA_ "GenSigCycleTime" SG_ 412 R_PBOX1_0x19C 50;
BA_ "Origin" SG_ 415 IFC_Line01_Dy "fuel,ev";
BA_ "Match" SG_ 415 IFC_Line01_Dy "IFC_Line01_Dy";
BA_ "GenSigStartValue" SG_ 415 IFC_Line01_Dy 2825;
BA_ "GenSigCycleTime" SG_ 415 IFC_Line01_Dy 50;
BA_ "Origin" SG_ 415 IFC_Line01_Curv "fuel,ev";
BA_ "Match" SG_ 415 IFC_Line01_Curv "IFC_Line01_Curv";
BA_ "GenSigStartValue" SG_ 415 IFC_Line01_Curv 15625;
BA_ "GenSigCycleTime" SG_ 415 IFC_Line01_Curv 50;
BA_ "Origin" SG_ 415 IFC_Line01_CurvChange "fuel,ev";
BA_ "Match" SG_ 415 IFC_Line01_CurvChange "IFC_Line01_CurvChange";
BA_ "GenSigStartValue" SG_ 415 IFC_Line01_CurvChange 480000;
BA_ "GenSigCycleTime" SG_ 415 IFC_Line01_CurvChange 50;
BA_ "Origin" SG_ 415 IFC_Line01_Type "fuel,ev";
BA_ "Match" SG_ 415 IFC_Line01_Type "IFC_Line01_Type";
BA_ "GenSigCycleTime" SG_ 415 IFC_Line01_Type 50;
BA_ "Origin" SG_ 415 IFC_Line02_Dy "fuel,ev";
BA_ "Match" SG_ 415 IFC_Line02_Dy "IFC_Line02_Dy";
BA_ "GenSigStartValue" SG_ 415 IFC_Line02_Dy 2825;
BA_ "GenSigCycleTime" SG_ 415 IFC_Line02_Dy 50;
BA_ "Origin" SG_ 415 IFC_Line02_Curv "fuel,ev";
BA_ "Match" SG_ 415 IFC_Line02_Curv "IFC_Line02_Curv";
BA_ "GenSigStartValue" SG_ 415 IFC_Line02_Curv 15625;
BA_ "GenSigCycleTime" SG_ 415 IFC_Line02_Curv 50;
BA_ "Origin" SG_ 415 IFC_Line02_CurvChange "fuel,ev";
BA_ "Match" SG_ 415 IFC_Line02_CurvChange "IFC_Line02_CurvChange";
BA_ "GenSigStartValue" SG_ 415 IFC_Line02_CurvChange 480000;
BA_ "GenSigCycleTime" SG_ 415 IFC_Line02_CurvChange 50;
BA_ "Origin" SG_ 415 IFC_Line02_Type "fuel,ev";
BA_ "Match" SG_ 415 IFC_Line02_Type "IFC_Line02_Type";
BA_ "GenSigCycleTime" SG_ 415 IFC_Line02_Type 50;
BA_ "Origin" SG_ 415 IFC_Line03_Dy "fuel,ev";
BA_ "Match" SG_ 415 IFC_Line03_Dy "IFC_Line03_Dy";
BA_ "GenSigStartValue" SG_ 415 IFC_Line03_Dy 2825;
BA_ "GenSigCycleTime" SG_ 415 IFC_Line03_Dy 50;
BA_ "Origin" SG_ 415 IFC_Line03_Curv "fuel,ev";
BA_ "Match" SG_ 415 IFC_Line03_Curv "IFC_Line03_Curv";
BA_ "GenSigStartValue" SG_ 415 IFC_Line03_Curv 15625;
BA_ "GenSigCycleTime" SG_ 415 IFC_Line03_Curv 50;
BA_ "Origin" SG_ 415 IFC_Line03_CurvChange "fuel,ev";
BA_ "Match" SG_ 415 IFC_Line03_CurvChange "IFC_Line03_CurvChange";
BA_ "GenSigStartValue" SG_ 415 IFC_Line03_CurvChange 480000;
BA_ "GenSigCycleTime" SG_ 415 IFC_Line03_CurvChange 50;
BA_ "Origin" SG_ 415 IFC_Line03_Type "fuel,ev";
BA_ "Match" SG_ 415 IFC_Line03_Type "IFC_Line03_Type";
BA_ "GenSigCycleTime" SG_ 415 IFC_Line03_Type 50;
BA_ "Origin" SG_ 415 IFC_Line04_Dy "fuel,ev";
BA_ "Match" SG_ 415 IFC_Line04_Dy "IFC_Line04_Dy";
BA_ "GenSigStartValue" SG_ 415 IFC_Line04_Dy 2825;
BA_ "GenSigCycleTime" SG_ 415 IFC_Line04_Dy 50;
BA_ "Origin" SG_ 415 IFC_Line04_Curv "fuel,ev";
BA_ "Match" SG_ 415 IFC_Line04_Curv "IFC_Line04_Curv";
BA_ "GenSigStartValue" SG_ 415 IFC_Line04_Curv 15625;
BA_ "GenSigCycleTime" SG_ 415 IFC_Line04_Curv 50;
BA_ "Origin" SG_ 415 IFC_Line04_CurvChange "fuel,ev";
BA_ "Match" SG_ 415 IFC_Line04_CurvChange "IFC_Line04_CurvChange";
BA_ "GenSigStartValue" SG_ 415 IFC_Line04_CurvChange 480000;
BA_ "GenSigCycleTime" SG_ 415 IFC_Line04_CurvChange 50;
BA_ "Origin" SG_ 415 IFC_Line04_Type "fuel,ev";
BA_ "Match" SG_ 415 IFC_Line04_Type "IFC_Line04_Type";
BA_ "GenSigCycleTime" SG_ 415 IFC_Line04_Type 50;
BA_ "Origin" SG_ 415 IFC_Roadedge01_Dy "fuel,ev";
BA_ "Match" SG_ 415 IFC_Roadedge01_Dy "IFC_Roadedge01_Dy";
BA_ "GenSigStartValue" SG_ 415 IFC_Roadedge01_Dy 2825;
BA_ "GenSigCycleTime" SG_ 415 IFC_Roadedge01_Dy 50;
BA_ "Origin" SG_ 415 IFC_Roadedge01_Curv "fuel,ev";
BA_ "Match" SG_ 415 IFC_Roadedge01_Curv "IFC_Roadedge01_Curv";
BA_ "GenSigStartValue" SG_ 415 IFC_Roadedge01_Curv 15625;
BA_ "GenSigCycleTime" SG_ 415 IFC_Roadedge01_Curv 50;
BA_ "Origin" SG_ 415 IFC_Roadedge01_CurvChange "fuel,ev";
BA_ "Match" SG_ 415 IFC_Roadedge01_CurvChange "IFC_Roadedge01_CurvChange";
BA_ "GenSigStartValue" SG_ 415 IFC_Roadedge01_CurvChange 480000;
BA_ "GenSigCycleTime" SG_ 415 IFC_Roadedge01_CurvChange 50;
BA_ "Origin" SG_ 415 IFC_Roadedge01_Type "fuel,ev";
BA_ "Match" SG_ 415 IFC_Roadedge01_Type "IFC_Roadedge01_Type";
BA_ "GenSigCycleTime" SG_ 415 IFC_Roadedge01_Type 50;
BA_ "Origin" SG_ 415 IFC_Roadedge02_Dy "fuel,ev";
BA_ "Match" SG_ 415 IFC_Roadedge02_Dy "IFC_Roadedge02_Dy";
BA_ "GenSigStartValue" SG_ 415 IFC_Roadedge02_Dy 2825;
BA_ "GenSigCycleTime" SG_ 415 IFC_Roadedge02_Dy 50;
BA_ "Origin" SG_ 415 IFC_Roadedge02_Curv "fuel,ev";
BA_ "Match" SG_ 415 IFC_Roadedge02_Curv "IFC_Roadedge02_Curv";
BA_ "GenSigStartValue" SG_ 415 IFC_Roadedge02_Curv 15625;
BA_ "GenSigCycleTime" SG_ 415 IFC_Roadedge02_Curv 50;
BA_ "Origin" SG_ 415 IFC_Roadedge02_CurvChange "fuel,ev";
BA_ "Match" SG_ 415 IFC_Roadedge02_CurvChange "IFC_Roadedge02_CurvChange";
BA_ "GenSigStartValue" SG_ 415 IFC_Roadedge02_CurvChange 480000;
BA_ "GenSigCycleTime" SG_ 415 IFC_Roadedge02_CurvChange 50;
BA_ "Origin" SG_ 415 IFC_Roadedge02_Type "fuel,ev";
BA_ "Match" SG_ 415 IFC_Roadedge02_Type "IFC_Roadedge02_Type";
BA_ "GenSigCycleTime" SG_ 415 IFC_Roadedge02_Type 50;
BA_ "TransparentInitValue" SG_ 415 IFC_FD5_0x19F "0 88 75 208 151 83 0 0 0 88 75 208 151 83 0 0 0 88 75 208 151 83 0 0 0 88 75 208 151 83 0 0 0 88 75 208 151 83 0 0 0 88 75 208 151 83 0 0 0 0 0 0 0 0 0 0 0 0 0 0 0 0 0 0 ";
BA_ "GenSigCycleTime" SG_ 415 IFC_FD5_0x19F 50;
BA_ "Origin" SG_ 465 AntiDisIdnResp "fuel,ev";
BA_ "Match" SG_ 465 AntiDisIdnResp "AntiDisIdnResp";
BA_ "GenSigSendType" SG_ 465 AntiDisIdnResp 2;
BA_ "TransparentInitValue" SG_ 465 HUT49_0x1D1 "0 0 0 0 0 0 0 0 ";
BA_ "GenSigSendType" SG_ 465 HUT49_0x1D1 2;
BA_ "Origin" SG_ 473 OTA_UpgrdModErrCode "fuel,ev";
BA_ "Match" SG_ 473 OTA_UpgrdModErrCode "OTA_UpgrdModErrCode";
BA_ "GenSigSendType" SG_ 473 OTA_UpgrdModErrCode 2;
BA_ "Origin" SG_ 473 OTAUpgrdSts "ev";
BA_ "Match" SG_ 473 OTAUpgrdSts "OTAUpgrdSts";
BA_ "GenSigSendType" SG_ 473 OTAUpgrdSts 2;
BA_ "TransparentInitValue" SG_ 473 GW_OTA_0x1D9 "0 0 0 0 0 0 0 0 ";
BA_ "GenSigSendType" SG_ 473 GW_OTA_0x1D9 2;
BA_ "Origin" SG_ 474 SlotNum_VR "fuel,ev";
BA_ "Match" SG_ 474 SlotNum_VR "SlotNum_VR";
BA_ "GenSigSendType" SG_ 474 SlotNum_VR 2;
BA_ "Origin" SG_ 474 UserDefinedParkCmd "fuel,ev";
BA_ "Match" SG_ 474 UserDefinedParkCmd "UserDefinedParkCmd";
BA_ "GenSigSendType" SG_ 474 UserDefinedParkCmd 2;
BA_ "Origin" SG_ 474 HUT_HAVP_Set_Starting "fuel,ev";
BA_ "Match" SG_ 474 HUT_HAVP_Set_Starting "HUT_HAVP_Set_Starting";
BA_ "GenSigSendType" SG_ 474 HUT_HAVP_Set_Starting 2;
BA_ "Origin" SG_ 474 HUT_HAVP_Set_Path_Ending "fuel,ev";
BA_ "Match" SG_ 474 HUT_HAVP_Set_Path_Ending "HUT_HAVP_Set_Path_Ending";
BA_ "GenSigSendType" SG_ 474 HUT_HAVP_Set_Path_Ending 2;
BA_ "Origin" SG_ 474 HUT_HAVP_APA_Permit "fuel,ev";
BA_ "Match" SG_ 474 HUT_HAVP_APA_Permit "HUT_HAVP_APA_Permit";
BA_ "GenSigSendType" SG_ 474 HUT_HAVP_APA_Permit 2;
BA_ "Origin" SG_ 474 UserDefPrkMenuSelCmd "fuel,ev";
BA_ "Match" SG_ 474 UserDefPrkMenuSelCmd "UserDefPrkMenuSelCmd";
BA_ "GenSigSendType" SG_ 474 UserDefPrkMenuSelCmd 2;
BA_ "Origin" SG_ 474 HUT_HAVP_SelfParLot_Ending "fuel,ev";
BA_ "Match" SG_ 474 HUT_HAVP_SelfParLot_Ending "HUT_HAVP_SelfParLot_Ending";
BA_ "GenSigSendType" SG_ 474 HUT_HAVP_SelfParLot_Ending 2;
BA_ "Origin" SG_ 474 HUT_HAVP_Return_Btn "fuel,ev";
BA_ "Match" SG_ 474 HUT_HAVP_Return_Btn "HUT_HAVP_Return_Btn";
BA_ "GenSigSendType" SG_ 474 HUT_HAVP_Return_Btn 2;
BA_ "Origin" SG_ 474 HUT_HAVP_Comfirm_Btn "ev";
BA_ "Match" SG_ 474 HUT_HAVP_Comfirm_Btn "HUT_HAVP_Comfirm_Btn";
BA_ "GenSigSendType" SG_ 474 HUT_HAVP_Comfirm_Btn 2;
BA_ "Origin" SG_ 474 HUT_HAVP_Path_Select "ev";
BA_ "Match" SG_ 474 HUT_HAVP_Path_Select "HUT_HAVP_Path_Select";
BA_ "GenSigSendType" SG_ 474 HUT_HAVP_Path_Select 2;
BA_ "Origin" SG_ 474 HUT_HAVP_Path_Delete "ev";
BA_ "Match" SG_ 474 HUT_HAVP_Path_Delete "HUT_HAVP_Path_Delete";
BA_ "GenSigSendType" SG_ 474 HUT_HAVP_Path_Delete 2;
BA_ "Origin" SG_ 474 HUT_HAVP_Path_SetTop "ev";
BA_ "Match" SG_ 474 HUT_HAVP_Path_SetTop "HUT_HAVP_Path_SetTop";
BA_ "GenSigSendType" SG_ 474 HUT_HAVP_Path_SetTop 2;
BA_ "Origin" SG_ 474 HUT_PAVP_PathList_Req "ev";
BA_ "Match" SG_ 474 HUT_PAVP_PathList_Req "HUT_PAVP_PathList_Req";
BA_ "GenSigSendType" SG_ 474 HUT_PAVP_PathList_Req 2;
BA_ "TransparentInitValue" SG_ 474 HUT_FD4_0x1DA "0 0 0 0 0 0 0 0 0 0 0 0 0 0 0 0 0 0 0 0 0 0 0 0 0 0 0 0 0 0 0 0 0 0 0 0 0 0 0 0 0 0 0 0 0 0 0 0 0 0 0 0 0 0 0 0 0 0 0 0 0 0 0 0 ";
BA_ "GenSigSendType" SG_ 474 HUT_FD4_0x1DA 2;
BA_ "Origin" SG_ 475 HUT_ExternalDevice "fuel,ev";
BA_ "Match" SG_ 475 HUT_ExternalDevice "HUT_ExternalDevice";
BA_ "GenSigSendType" SG_ 475 HUT_ExternalDevice 2;
BA_ "TransparentInitValue" SG_ 475 HUT_FD5_0x1DB "0 0 0 0 0 0 0 0 0 0 0 21 52 37 39 249 10 68 134 150 127 70 176 154 255 134 213 53 100 13 161 153 243 161 137 31 182 171 68 165 97 120 148 239 83 164 20 180 0 0 0 0 0 0 0 0 0 0 0 0 0 0 0 0 ";
BA_ "GenSigSendType" SG_ 475 HUT_FD5_0x1DB 2;
BA_ "Origin" SG_ 476 PassSeatMassgModSet "fuel,ev";
BA_ "Match" SG_ 476 PassSeatMassgModSet "PassSeatMassgModSet";
BA_ "GenSigSendType" SG_ 476 PassSeatMassgModSet 2;
BA_ "Origin" SG_ 476 DrvSeatMassgModSet "fuel,ev";
BA_ "Match" SG_ 476 DrvSeatMassgModSet "DrvSeatMassgModSet";
BA_ "GenSigSendType" SG_ 476 DrvSeatMassgModSet 2;
BA_ "Origin" SG_ 476 PPMI_P_BSR_SwtSet "fuel,ev";
BA_ "Match" SG_ 476 PPMI_P_BSR_SwtSet "PPMI_P_BSR_SwtSet";
BA_ "GenSigStartValue" SG_ 476 PPMI_P_BSR_SwtSet 2;
BA_ "GenSigSendType" SG_ 476 PPMI_P_BSR_SwtSet 2;
BA_ "Origin" SG_ 476 RWPC_SwtReq "fuel,ev";
BA_ "Match" SG_ 476 RWPC_SwtReq "RWPC_SwtReq";
BA_ "GenSigStartValue" SG_ 476 RWPC_SwtReq 1;
BA_ "GenSigSendType" SG_ 476 RWPC_SwtReq 2;
BA_ "TransparentInitValue" SG_ 476 HUT45_0x1DC "0 0 129 0 0 0 0 0 ";
BA_ "GenSigSendType" SG_ 476 HUT45_0x1DC 2;
BA_ "Origin" SG_ 477 DrvSeatVentnLvlSet_Nine "fuel";
BA_ "Match" SG_ 477 DrvSeatVentnLvlSet_Nine "DrvSeatVentnLvlSet_Nine";
BA_ "GenSigSendType" SG_ 477 DrvSeatVentnLvlSet_Nine 2;
BA_ "Origin" SG_ 477 PassSeatVentnLvlSet_Nine "fuel";
BA_ "Match" SG_ 477 PassSeatVentnLvlSet_Nine "PassSeatVentnLvlSet_Nine";
BA_ "GenSigSendType" SG_ 477 PassSeatVentnLvlSet_Nine 2;
BA_ "Origin" SG_ 477 RLSeatVentnLvlSet_Nine "fuel";
BA_ "Match" SG_ 477 RLSeatVentnLvlSet_Nine "RLSeatVentnLvlSet_Nine";
BA_ "GenSigSendType" SG_ 477 RLSeatVentnLvlSet_Nine 2;
BA_ "Origin" SG_ 477 RRSeatVentnLvlSet_Nine "fuel";
BA_ "Match" SG_ 477 RRSeatVentnLvlSet_Nine "RRSeatVentnLvlSet_Nine";
BA_ "GenSigSendType" SG_ 477 RRSeatVentnLvlSet_Nine 2;
BA_ "Origin" SG_ 477 ARFSwtReq "ev";
BA_ "Match" SG_ 477 ARFSwtReq "ARFSwtReq";
BA_ "GenSigSendType" SG_ 477 ARFSwtReq 2;
BA_ "Origin" SG_ 477 ASFCSwtReq "ev";
BA_ "Match" SG_ 477 ASFCSwtReq "ASFCSwtReq";
BA_ "GenSigSendType" SG_ 477 ASFCSwtReq 2;
BA_ "Origin" SG_ 477 AGSSwtReq "ev";
BA_ "Match" SG_ 477 AGSSwtReq "AGSSwtReq";
BA_ "GenSigSendType" SG_ 477 AGSSwtReq 2;
BA_ "Origin" SG_ 477 SOCMngmntSwtReq "ev";
BA_ "Match" SG_ 477 SOCMngmntSwtReq "SOCMngmntSwtReq";
BA_ "GenSigSendType" SG_ 477 SOCMngmntSwtReq 2;
BA_ "TransparentInitValue" SG_ 477 HUT46_0x1DD "0 0 0 0 0 0 0 0 ";
BA_ "GenSigSendType" SG_ 477 HUT46_0x1DD 2;
BA_ "Origin" SG_ 479 DOCK_HUT_ExternalDevice_E "fuel,ev";
BA_ "Match" SG_ 479 DOCK_HUT_ExternalDevice_E "DOCK_HUT_ExternalDevice_E";
BA_ "GenSigSendType" SG_ 479 DOCK_HUT_ExternalDevice_E 2;
BA_ "TransparentInitValue" SG_ 479 DOCK2_0x1DF "0 0 0 0 0 0 0 0 0 0 0 21 52 37 39 249 10 68 134 150 127 70 176 154 255 134 213 53 100 13 161 153 243 161 137 31 182 171 68 165 97 120 148 239 83 164 20 180 0 0 0 0 0 0 0 0 0 0 0 0 0 0 0 0 ";
BA_ "GenSigSendType" SG_ 479 DOCK2_0x1DF 2;
BA_ "Origin" SG_ 481 T_BOX_RemtVideoMonrEnaReq_APP "fuel,ev";
BA_ "Match" SG_ 481 T_BOX_RemtVideoMonrEnaReq_APP "T_BOX_RemtVideoMonrEnaReq_APP";
BA_ "GenSigSendType" SG_ 481 T_BOX_RemtVideoMonrEnaReq_APP 2;
BA_ "Origin" SG_ 481 T_BOX_RemtFrntDefrostCtrl "ev";
BA_ "Match" SG_ 481 T_BOX_RemtFrntDefrostCtrl "T_BOX_RemtFrntDefrostCtrl";
BA_ "GenSigSendType" SG_ 481 T_BOX_RemtFrntDefrostCtrl 2;
BA_ "Origin" SG_ 481 T_BOX_RemtRearDefrostCtrl "ev";
BA_ "Match" SG_ 481 T_BOX_RemtRearDefrostCtrl "T_BOX_RemtRearDefrostCtrl";
BA_ "GenSigSendType" SG_ 481 T_BOX_RemtRearDefrostCtrl 2;
BA_ "Origin" SG_ 481 T_BOX_RemtCockpitClnReq "ev";
BA_ "Match" SG_ 481 T_BOX_RemtCockpitClnReq "T_BOX_RemtCockpitClnReq";
BA_ "GenSigSendType" SG_ 481 T_BOX_RemtCockpitClnReq 2;
BA_ "Origin" SG_ 481 RemUpgrdModeCmd "ev";
BA_ "Match" SG_ 481 RemUpgrdModeCmd "RemUpgrdModeCmd";
BA_ "GenSigSendType" SG_ 481 RemUpgrdModeCmd 2;
BA_ "Origin" SG_ 481 Phone_ChrgnMode "ev";
BA_ "Match" SG_ 481 Phone_ChrgnMode "Phone_ChrgnMode";
BA_ "GenSigSendType" SG_ 481 Phone_ChrgnMode 2;
BA_ "Origin" SG_ 481 T_BOX_RemtSdlMod "ev";
BA_ "Match" SG_ 481 T_BOX_RemtSdlMod "T_BOX_RemtSdlMod";
BA_ "GenSigStartValue" SG_ 481 T_BOX_RemtSdlMod 3;
BA_ "GenSigSendType" SG_ 481 T_BOX_RemtSdlMod 2;
BA_ "TransparentInitValue" SG_ 481 T_BOX_FD4_0x1E1 "0 0 0 0 0 0 192 0 0 0 0 0 0 0 0 0 ";
BA_ "GenSigSendType" SG_ 481 T_BOX_FD4_0x1E1 2;
BA_ "Origin" SG_ 485 ACRearTempReq_ETC_VR "fuel,ev";
BA_ "Match" SG_ 485 ACRearTempReq_ETC_VR "ACRearTempReq_ETC_VR";
BA_ "GenSigSendType" SG_ 485 ACRearTempReq_ETC_VR 2;
BA_ "Origin" SG_ 485 ACRearTempSteplsReq_ETC_TC "fuel,ev";
BA_ "Match" SG_ 485 ACRearTempSteplsReq_ETC_TC "ACRearTempSteplsReq_ETC_TC";
BA_ "GenSigSendType" SG_ 485 ACRearTempSteplsReq_ETC_TC 2;
BA_ "Origin" SG_ 485 ACDrvTempDecReq_ETC_TC "fuel,ev";
BA_ "Match" SG_ 485 ACDrvTempDecReq_ETC_TC "ACDrvTempDecReq_ETC_TC";
BA_ "GenSigSendType" SG_ 485 ACDrvTempDecReq_ETC_TC 2;
BA_ "Origin" SG_ 485 ACDrvTempIncReq_ETC_TC "fuel,ev";
BA_ "Match" SG_ 485 ACDrvTempIncReq_ETC_TC "ACDrvTempIncReq_ETC_TC";
BA_ "GenSigSendType" SG_ 485 ACDrvTempIncReq_ETC_TC 2;
BA_ "Origin" SG_ 485 ACRearTempDecReq_ETC_TC "fuel,ev";
BA_ "Match" SG_ 485 ACRearTempDecReq_ETC_TC "ACRearTempDecReq_ETC_TC";
BA_ "GenSigSendType" SG_ 485 ACRearTempDecReq_ETC_TC 2;
BA_ "Origin" SG_ 485 ACRearTempIncReq_ETC_TC "fuel,ev";
BA_ "Match" SG_ 485 ACRearTempIncReq_ETC_TC "ACRearTempIncReq_ETC_TC";
BA_ "GenSigSendType" SG_ 485 ACRearTempIncReq_ETC_TC 2;
BA_ "Origin" SG_ 485 ACRearPowerReq_VR "fuel,ev";
BA_ "Match" SG_ 485 ACRearPowerReq_VR "ACRearPowerReq_VR";
BA_ "GenSigSendType" SG_ 485 ACRearPowerReq_VR 2;
BA_ "Origin" SG_ 485 ACMaxReq_VR "fuel,ev";
BA_ "Match" SG_ 485 ACMaxReq_VR "ACMaxReq_VR";
BA_ "GenSigSendType" SG_ 485 ACMaxReq_VR 2;
BA_ "Origin" SG_ 485 ACMaxReq_TC "fuel,ev";
BA_ "Match" SG_ 485 ACMaxReq_TC "ACMaxReq_TC";
BA_ "GenSigSendType" SG_ 485 ACMaxReq_TC 2;
BA_ "Origin" SG_ 485 FrntWiprCtrl_VR "fuel,ev";
BA_ "Match" SG_ 485 FrntWiprCtrl_VR "FrntWiprCtrl_VR";
BA_ "GenSigSendType" SG_ 485 FrntWiprCtrl_VR 2;
BA_ "Origin" SG_ 485 ACRearAutoModReq_VR "fuel,ev";
BA_ "Match" SG_ 485 ACRearAutoModReq_VR "ACRearAutoModReq_VR";
BA_ "GenSigSendType" SG_ 485 ACRearAutoModReq_VR 2;
BA_ "Origin" SG_ 485 LockWinSet "fuel,ev";
BA_ "Match" SG_ 485 LockWinSet "LockWinSet";
BA_ "GenSigSendType" SG_ 485 LockWinSet 2;
BA_ "Origin" SG_ 485 ACRearLockReq_TC "fuel,ev";
BA_ "Match" SG_ 485 ACRearLockReq_TC "ACRearLockReq_TC";
BA_ "GenSigSendType" SG_ 485 ACRearLockReq_TC 2;
BA_ "Origin" SG_ 485 SrSpdCtrlSwt "fuel";
BA_ "Match" SG_ 485 SrSpdCtrlSwt "SrSpdCtrlSwt";
BA_ "GenSigSendType" SG_ 485 SrSpdCtrlSwt 2;
BA_ "Origin" SG_ 485 DPF_Request "fuel,ev";
BA_ "Match" SG_ 485 DPF_Request "DPF_Request";
BA_ "GenSigSendType" SG_ 485 DPF_Request 2;
BA_ "Origin" SG_ 485 ColorCategory "fuel";
BA_ "Match" SG_ 485 ColorCategory "ColorCategory";
BA_ "GenSigSendType" SG_ 485 ColorCategory 2;
BA_ "Origin" SG_ 485 SingleColorNr "fuel";
BA_ "Match" SG_ 485 SingleColorNr "SingleColorNr";
BA_ "GenSigStartValue" SG_ 485 SingleColorNr 8;
BA_ "GenSigSendType" SG_ 485 SingleColorNr 2;
BA_ "Origin" SG_ 485 NozHeatSwt "fuel,ev";
BA_ "Match" SG_ 485 NozHeatSwt "NozHeatSwt";
BA_ "GenSigSendType" SG_ 485 NozHeatSwt 2;
BA_ "TransparentInitValue" SG_ 485 HUT35_0x1E5 "0 8 0 0 0 0 0 0 ";
BA_ "GenSigSendType" SG_ 485 HUT35_0x1E5 2;
BA_ "Origin" SG_ 487 ACRLTempDecReq_TC "fuel,ev";
BA_ "Match" SG_ 487 ACRLTempDecReq_TC "ACRLTempDecReq_TC";
BA_ "GenSigSendType" SG_ 487 ACRLTempDecReq_TC 2;
BA_ "Origin" SG_ 487 ACRLTempIncReq_TC "fuel,ev";
BA_ "Match" SG_ 487 ACRLTempIncReq_TC "ACRLTempIncReq_TC";
BA_ "GenSigSendType" SG_ 487 ACRLTempIncReq_TC 2;
BA_ "Origin" SG_ 487 ACRLTempReq_VR "fuel,ev";
BA_ "Match" SG_ 487 ACRLTempReq_VR "ACRLTempReq_VR";
BA_ "GenSigSendType" SG_ 487 ACRLTempReq_VR 2;
BA_ "Origin" SG_ 487 ACRRTempDecReq_TC "fuel,ev";
BA_ "Match" SG_ 487 ACRRTempDecReq_TC "ACRRTempDecReq_TC";
BA_ "GenSigSendType" SG_ 487 ACRRTempDecReq_TC 2;
BA_ "Origin" SG_ 487 ACRRTempIncReq_TC "fuel,ev";
BA_ "Match" SG_ 487 ACRRTempIncReq_TC "ACRRTempIncReq_TC";
BA_ "GenSigSendType" SG_ 487 ACRRTempIncReq_TC 2;
BA_ "Origin" SG_ 487 ACRRTempReq_VR "fuel,ev";
BA_ "Match" SG_ 487 ACRRTempReq_VR "ACRRTempReq_VR";
BA_ "GenSigSendType" SG_ 487 ACRRTempReq_VR 2;
BA_ "Origin" SG_ 487 ACRRTempSteplsReq_TC "fuel,ev";
BA_ "Match" SG_ 487 ACRRTempSteplsReq_TC "ACRRTempSteplsReq_TC";
BA_ "GenSigSendType" SG_ 487 ACRRTempSteplsReq_TC 2;
BA_ "Origin" SG_ 487 ACHumidifierReq_VR "fuel,ev";
BA_ "Match" SG_ 487 ACHumidifierReq_VR "ACHumidifierReq_VR";
BA_ "GenSigSendType" SG_ 487 ACHumidifierReq_VR 2;
BA_ "Origin" SG_ 487 ACHumidifierReq_TC "fuel,ev";
BA_ "Match" SG_ 487 ACHumidifierReq_TC "ACHumidifierReq_TC";
BA_ "GenSigSendType" SG_ 487 ACHumidifierReq_TC 2;
BA_ "Origin" SG_ 487 ACOzoneReq_TC "fuel,ev";
BA_ "Match" SG_ 487 ACOzoneReq_TC "ACOzoneReq_TC";
BA_ "GenSigSendType" SG_ 487 ACOzoneReq_TC 2;
BA_ "Origin" SG_ 487 ACOzoneReq_VR "fuel,ev";
BA_ "Match" SG_ 487 ACOzoneReq_VR "ACOzoneReq_VR";
BA_ "GenSigSendType" SG_ 487 ACOzoneReq_VR 2;
BA_ "Origin" SG_ 487 ACUltravioletReq_TC "fuel,ev";
BA_ "Match" SG_ 487 ACUltravioletReq_TC "ACUltravioletReq_TC";
BA_ "GenSigSendType" SG_ 487 ACUltravioletReq_TC 2;
BA_ "Origin" SG_ 487 ACUltravioletReq_VR "fuel,ev";
BA_ "Match" SG_ 487 ACUltravioletReq_VR "ACUltravioletReq_VR";
BA_ "GenSigSendType" SG_ 487 ACUltravioletReq_VR 2;
BA_ "Origin" SG_ 487 ACFrntWinHeatCmd_TC "fuel,ev";
BA_ "Match" SG_ 487 ACFrntWinHeatCmd_TC "ACFrntWinHeatCmd_TC";
BA_ "GenSigSendType" SG_ 487 ACFrntWinHeatCmd_TC 2;
BA_ "Origin" SG_ 487 ACFrntWinHeatCmd_VR "fuel,ev";
BA_ "Match" SG_ 487 ACFrntWinHeatCmd_VR "ACFrntWinHeatCmd_VR";
BA_ "GenSigSendType" SG_ 487 ACFrntWinHeatCmd_VR 2;
BA_ "Origin" SG_ 487 DrvDoorALCMFlashFreq "fuel,ev";
BA_ "Match" SG_ 487 DrvDoorALCMFlashFreq "DrvDoorALCMFlashFreq";
BA_ "GenSigSendType" SG_ 487 DrvDoorALCMFlashFreq 2;
BA_ "Origin" SG_ 487 PassDoorALCMFlashFreq "fuel,ev";
BA_ "Match" SG_ 487 PassDoorALCMFlashFreq "PassDoorALCMFlashFreq";
BA_ "GenSigSendType" SG_ 487 PassDoorALCMFlashFreq 2;
BA_ "Origin" SG_ 487 LRDoorALCMFlashFreq "fuel,ev";
BA_ "Match" SG_ 487 LRDoorALCMFlashFreq "LRDoorALCMFlashFreq";
BA_ "GenSigSendType" SG_ 487 LRDoorALCMFlashFreq 2;
BA_ "Origin" SG_ 487 RRDoorALCMFlashFreq "fuel,ev";
BA_ "Match" SG_ 487 RRDoorALCMFlashFreq "RRDoorALCMFlashFreq";
BA_ "GenSigSendType" SG_ 487 RRDoorALCMFlashFreq 2;
BA_ "Origin" SG_ 487 FootALCMFlashFreq "fuel";
BA_ "Match" SG_ 487 FootALCMFlashFreq "FootALCMFlashFreq";
BA_ "GenSigSendType" SG_ 487 FootALCMFlashFreq 2;
BA_ "Origin" SG_ 487 LeftPanelALCMFlashFreq "fuel,ev";
BA_ "Match" SG_ 487 LeftPanelALCMFlashFreq "LeftPanelALCMFlashFreq";
BA_ "GenSigSendType" SG_ 487 LeftPanelALCMFlashFreq 2;
BA_ "Origin" SG_ 487 RightPanelALCMFlashFreq "fuel,ev";
BA_ "Match" SG_ 487 RightPanelALCMFlashFreq "RightPanelALCMFlashFreq";
BA_ "GenSigSendType" SG_ 487 RightPanelALCMFlashFreq 2;
BA_ "Origin" SG_ 487 ACRearLockReq_VR "fuel,ev";
BA_ "Match" SG_ 487 ACRearLockReq_VR "ACRearLockReq_VR";
BA_ "GenSigSendType" SG_ 487 ACRearLockReq_VR 2;
BA_ "TransparentInitValue" SG_ 487 HUT38_0x1E7 "0 0 0 0 0 0 0 0 ";
BA_ "GenSigSendType" SG_ 487 HUT38_0x1E7 2;
BA_ "Origin" SG_ 489 HUD_HeightLvlSwt "fuel,ev";
BA_ "Match" SG_ 489 HUD_HeightLvlSwt "HUD_HeightLvlSwt";
BA_ "GenSigSendType" SG_ 489 HUD_HeightLvlSwt 2;
BA_ "Origin" SG_ 489 HUD_BrightnessLvlSwt "fuel,ev";
BA_ "Match" SG_ 489 HUD_BrightnessLvlSwt "HUD_BrightnessLvlSwt";
BA_ "GenSigSendType" SG_ 489 HUD_BrightnessLvlSwt 2;
BA_ "Origin" SG_ 489 HUD_SwtReq "fuel,ev";
BA_ "Match" SG_ 489 HUD_SwtReq "HUD_SwtReq";
BA_ "GenSigSendType" SG_ 489 HUD_SwtReq 2;
BA_ "Origin" SG_ 489 BackReq_AVM "fuel,ev";
BA_ "Match" SG_ 489 BackReq_AVM "BackReq_AVM";
BA_ "GenSigSendType" SG_ 489 BackReq_AVM 2;
BA_ "Origin" SG_ 489 PPMIHWSwtSet "fuel";
BA_ "Match" SG_ 489 PPMIHWSwtSet "PPMIHWSwtSet";
BA_ "GenSigStartValue" SG_ 489 PPMIHWSwtSet 2;
BA_ "GenSigSendType" SG_ 489 PPMIHWSwtSet 2;
BA_ "Origin" SG_ 489 PPMIBSRSwtSet "fuel";
BA_ "Match" SG_ 489 PPMIBSRSwtSet "PPMIBSRSwtSet";
BA_ "GenSigStartValue" SG_ 489 PPMIBSRSwtSet 2;
BA_ "GenSigSendType" SG_ 489 PPMIBSRSwtSet 2;
BA_ "Origin" SG_ 489 PPMIHW_SwtSet "ev";
BA_ "Match" SG_ 489 PPMIHW_SwtSet "PPMIHW_SwtSet";
BA_ "GenSigStartValue" SG_ 489 PPMIHW_SwtSet 2;
BA_ "GenSigSendType" SG_ 489 PPMIHW_SwtSet 2;
BA_ "Origin" SG_ 489 PPMIBSR_SwtSet "ev";
BA_ "Match" SG_ 489 PPMIBSR_SwtSet "PPMIBSR_SwtSet";
BA_ "GenSigStartValue" SG_ 489 PPMIBSR_SwtSet 2;
BA_ "GenSigSendType" SG_ 489 PPMIBSR_SwtSet 2;
BA_ "TransparentInitValue" SG_ 489 HUT30_0x1E9 "40 0 0 0 0 0 0 0 ";
BA_ "GenSigSendType" SG_ 489 HUT30_0x1E9 2;
BA_ "Origin" SG_ 491 ActvEntryLockSet "fuel,ev";
BA_ "Match" SG_ 491 ActvEntryLockSet "ActvEntryLockSet";
BA_ "GenSigSendType" SG_ 491 ActvEntryLockSet 2;
BA_ "Origin" SG_ 491 ActvEntryUnlockSet "fuel,ev";
BA_ "Match" SG_ 491 ActvEntryUnlockSet "ActvEntryUnlockSet";
BA_ "GenSigSendType" SG_ 491 ActvEntryUnlockSet 2;
BA_ "Origin" SG_ 491 LockPromptFunSet "fuel,ev";
BA_ "Match" SG_ 491 LockPromptFunSet "LockPromptFunSet";
BA_ "GenSigSendType" SG_ 491 LockPromptFunSet 2;
BA_ "Origin" SG_ 491 BTAPAEntryLockSet "fuel,ev";
BA_ "Match" SG_ 491 BTAPAEntryLockSet "BTAPAEntryLockSet";
BA_ "GenSigSendType" SG_ 491 BTAPAEntryLockSet 2;
BA_ "Origin" SG_ 491 BTAPALvngUnlockSet "fuel,ev";
BA_ "Match" SG_ 491 BTAPALvngUnlockSet "BTAPALvngUnlockSet";
BA_ "GenSigSendType" SG_ 491 BTAPALvngUnlockSet 2;
BA_ "Origin" SG_ 491 ClsWinSpdSet "fuel,ev";
BA_ "Match" SG_ 491 ClsWinSpdSet "ClsWinSpdSet";
BA_ "GenSigSendType" SG_ 491 ClsWinSpdSet 2;
BA_ "Origin" SG_ 491 DrvSeatMassgLvlSet "fuel,ev";
BA_ "Match" SG_ 491 DrvSeatMassgLvlSet "DrvSeatMassgLvlSet";
BA_ "GenSigSendType" SG_ 491 DrvSeatMassgLvlSet 2;
BA_ "Origin" SG_ 491 PassSeatMassgLvlSet "fuel,ev";
BA_ "Match" SG_ 491 PassSeatMassgLvlSet "PassSeatMassgLvlSet";
BA_ "GenSigSendType" SG_ 491 PassSeatMassgLvlSet 2;
BA_ "Origin" SG_ 491 SeatKeyMemEna "fuel,ev";
BA_ "Match" SG_ 491 SeatKeyMemEna "SeatKeyMemEna";
BA_ "GenSigSendType" SG_ 491 SeatKeyMemEna 2;
BA_ "Origin" SG_ 491 RLSeatMassgLvlSet "fuel,ev";
BA_ "Match" SG_ 491 RLSeatMassgLvlSet "RLSeatMassgLvlSet";
BA_ "GenSigSendType" SG_ 491 RLSeatMassgLvlSet 2;
BA_ "Origin" SG_ 491 RRSeatMassgLvlSet "fuel,ev";
BA_ "Match" SG_ 491 RRSeatMassgLvlSet "RRSeatMassgLvlSet";
BA_ "GenSigSendType" SG_ 491 RRSeatMassgLvlSet 2;
BA_ "Origin" SG_ 491 DrvDoorALCMClrSet "fuel,ev";
BA_ "Match" SG_ 491 DrvDoorALCMClrSet "DrvDoorALCMClrSet";
BA_ "GenSigStartValue" SG_ 491 DrvDoorALCMClrSet 64;
BA_ "GenSigSendType" SG_ 491 DrvDoorALCMClrSet 2;
BA_ "Origin" SG_ 491 PassDoorALCMClrSet "fuel,ev";
BA_ "Match" SG_ 491 PassDoorALCMClrSet "PassDoorALCMClrSet";
BA_ "GenSigStartValue" SG_ 491 PassDoorALCMClrSet 64;
BA_ "GenSigSendType" SG_ 491 PassDoorALCMClrSet 2;
BA_ "Origin" SG_ 491 LRDoorALCMClrSet "fuel,ev";
BA_ "Match" SG_ 491 LRDoorALCMClrSet "LRDoorALCMClrSet";
BA_ "GenSigStartValue" SG_ 491 LRDoorALCMClrSet 64;
BA_ "GenSigSendType" SG_ 491 LRDoorALCMClrSet 2;
BA_ "Origin" SG_ 491 DrvDoorALCMSwt "fuel,ev";
BA_ "Match" SG_ 491 DrvDoorALCMSwt "DrvDoorALCMSwt";
BA_ "GenSigSendType" SG_ 491 DrvDoorALCMSwt 2;
BA_ "Origin" SG_ 491 PassDoorALCMSwt "fuel,ev";
BA_ "Match" SG_ 491 PassDoorALCMSwt "PassDoorALCMSwt";
BA_ "GenSigSendType" SG_ 491 PassDoorALCMSwt 2;
BA_ "TransparentInitValue" SG_ 491 HUT39_0x1EB "0 0 0 0 0 64 128 128 ";
BA_ "GenSigSendType" SG_ 491 HUT39_0x1EB 2;
VAL_ 51 T_BOX_RemtDoorLockCtrl 0 "No Action" 1 "Driver door unlock" 2 "All doors unlock" 3 "Lock" 4 "Invalid" 5 "reserved" 7 "reserved" ;
VAL_ 51 T_BOX_AudioMuteReq 0 "No action" 1 "Request mute" 2 "Request unmute" 3 "Reserved" ;
VAL_ 51 T_BOX_PM25AirQLvl 0 "Level 1" 1 "Level 2" 2 "Level 3" 3 "Level 4" 4 "Level 5" 5 "Level 6" 6 "Reserved" 7 "TSP return error" 8 "Current city no information" 9 "No network signal" 10 "Reserved" 15 "Reserved" ;
VAL_ 51 T_BOX_PM25Dens 0 "PM2.5 density" 999 "PM2.5 density" 1000 "Current city no information" 1001 "No network signal" 1002 "Reserved" 1022 "Reserved" 1023 "Invalid" ;
VAL_ 51 T_BOX_RemtWinCtrl 0 "No Action" 1 "Close" 2 "Open(Reserved)" 3 "Half_Open(Reserved)" 4 "Reserved" 7 "Reserved" ;
VAL_ 51 T_BOX_RemtTrunkCtrl 0 "No action" 1 "Open" 2 "Close" 3 "Reserved" ;
VAL_ 51 T_BOX_RemtDrvTempSet 0 "No action" 1 "Valid Value(Phys = 0.5 * raw + 16)" 31 "Valid Value(Phys = 0.5 * raw + 16)" 32 "Reserved" 63 "Reserved" ;
VAL_ 51 T_BOX_RemtAutoCtrl 0 "No action" 1 "OFF" 2 "ON" 3 "Reserved" ;
VAL_ 51 T_BOX_RemtPassTempSet 0 "No action" 1 "Valid Value(Phys = 0.5 * raw + 16)" 31 "Valid Value(Phys = 0.5 * raw + 16)" 32 "Reserved" 63 "Reserved" ;
VAL_ 51 T_BOX_RemtSsCtrl 0 "No action" 1 "Full closed" 2 "10%" 3 "20%" 4 "30%" 5 "40%" 6 "50%" 7 "60%" 8 "70%" 9 "80%" 10 "90%" 11 "Full open" 12 "Stop" 13 "Reserved" 15 "Reserved" ;
VAL_ 51 T_BOX_RemtSrCtrl 0 "No action" 1 "Full closed" 2 "Tile Up" 3 "10%" 4 "20%" 5 "30%" 6 "40%" 7 "50%" 8 "60%" 9 "70%" 10 "80%" 11 "90%" 12 "Full open" 13 "Stop" 14 "Reserved" 15 "Reserved" ;
VAL_ 51 T_BOX_RemtDrvSeatVentnLvlSet 0 "No Action" 1 "OFF" 2 "Level1_Low" 3 "Level2_Middle" 4 "Level3_High" 5 "Reserved" 7 "Reserved" ;
VAL_ 51 T_BOX_RemtPassSeatVentnLvlSet 0 "No Action" 1 "OFF" 2 "Level1_Low" 3 "Level2_Middle" 4 "Level3_High" 5 "Reserved" 7 "Reserved" ;
VAL_ 51 T_BOX_RemtAIUReq 0 "No action" 1 "Inactive" 2 "Active" 3 "Reserved" ;
VAL_ 51 T_BOX_RemtCarSearch 0 "No action" 1 "Whistle" 2 "Light" 3 "Light+Whistle" ;
VAL_ 51 T_BOX_RemtEngCtrl 0 "No Action" 1 "Start" 2 "Stop" 3 "InValid" ;
VAL_ 51 T_BOX_RemtDrvSeatHeatgLvlSet 0 "No Action" 1 "OFF" 2 "Level1_Low" 3 "Level2_Middle" 4 "Level3_High" 5 "Reserved" 7 "Reserved" ;
VAL_ 51 T_BOX_RemtPassSeatHeatgLvlSet 0 "No Action" 1 "OFF" 2 "Level1_Low" 3 "Level2_Middle" 4 "Level3_High" 5 "Reserved" 7 "Reserved" ;
VAL_ 68 ALCMStatSwt_OLE 0 "Off" 1 "On" ;
VAL_ 68 ALCMClrSet_OLE 0 "Colour set 0-63" 63 "Colour set 0-63" ;
VAL_ 68 ALCMDynModSet_OLE 0 "DynModOFF" 1 "DynMod1" 2 "DynMod2" 3 "DynMod3" 4 "DynMod4" 5 "DynMod5" 6 "DynMod6" 7 "DynMod7" ;
VAL_ 68 ALCMLightLvlSet_OLE 0 "Reserved" 1 "10" 2 "20" 3 "30" 4 "40" 5 "50" 6 "60" 7 "70" 8 "80" 9 "90" 10 "100" 11 "Reserved" 15 "Reserved" ;
VAL_ 68 ALCMRhmSwt_OLE 0 "Off" 1 "On" ;
VAL_ 68 ALCMBreSwt_OLE 0 "OFF" 1 "ON" ;
VAL_ 68 ALCMRdmSwt_OLE 0 "OFF" 1 "ON" ;
VAL_ 68 Rdm_SingleColorNr 0 "No command" 1 "Valid" 64 "Valid" 65 "Reserved" 127 "Reserved" ;
VAL_ 68 HUT_VMDRTmpMonFctnSet 0 "NO action" 1 "Disable" 2 "Enable" 3 "Reserved" ;
VAL_ 68 HUT_VMDRInitAlarmDlySet 0 "NO action" 1 "Disable" 2 "Enable" 3 "Reserved" ;
VAL_ 68 OTA_UpgrdModReq 0 "No_Action" 1 "Enter_the_Remote_upgrade_mode" 2 "Enter_the_Immediately_upgrade_mode" 3 "End_upgrade_mode_via_HUT" 4 "Powertrain_ON_upgrade_mode" 5 "Powertrain_OFF_upgrade_mode" 6 "Reserved" 7 "Reserved" ;
VAL_ 74 AUTODefrost_TC 0 "No action" 1 "Pressed" 2 "Reserved" 3 "Reserved" ;
VAL_ 74 AUTODefrost_VR 0 "No action" 1 "Not active" 2 "Active" 3 "Reserved" ;
VAL_ 74 LaneCalActvtCmd 0 "Off" 1 "On" ;
VAL_ 74 MODChgReq 0 "No request" 1 "Request" ;
VAL_ 74 Radar_DispCmd 0 "No Request" 1 "Request" ;
VAL_ 74 Guid_Ovl_Display_Cmd 0 "No Request" 1 "Request" ;
VAL_ 74 Sgl_View_Sel 0 "No Commands" 1 "Touch 2D Front Button" 2 "Touch 2D Rear Button" 3 "Touch 2D Left Button" 4 "Touch 2D Right Button" 5 "Touch 2D Left Front  Button" 6 "Touch 2D Right Front Button" 7 "Touch 2D Left Back Button" 8 "Touch 2D Right Back Button" 9 "Touch return Button" 10 "Touch Engine Room Button" 11 "Reserved" 15 "Reserved" ;
VAL_ 74 SwToFieldCalRstCmd 0 "Off" 1 "On" ;
VAL_ 74 AutoViewChgCmd 0 "No Request" 1 "Request" ;
VAL_ 74 MdlColrChgCmd 0 "No Request" 1 "Request" ;
VAL_ 74 CarMdlTrsprcySwtCmd 0 "No Request" 1 "Request" ;
VAL_ 74 CarMdlDispCmd 0 "No Request" 1 "Request" ;
VAL_ 74 AutoAVMSwSet_Cmd 0 "No Request" 1 "Request" ;
VAL_ 74 FPAS_AutoModSwt 0 "No Request" 1 "Request" ;
VAL_ 74 MEBSwtSet 0 "No Request" 1 "Request" ;
VAL_ 74 WshSoftSwt 0 "No request" 1 "Request" ;
VAL_ 74 View_SoftswitchCmd 0 "No request" 1 "Request" ;
VAL_ 86 QuietVoiceReq 0 "OFF" 1 "ON" ;
VAL_ 86 E_CALLSts 0 "No Action" 1 "Dialing in" 2 "Dialing out" 3 "On call" 4 "Hang up" 5 "Build failed" ;
VAL_ 161 SteerWheelAng 0 "Valid value" 7800 "Valid value" 7801 "Reserved" 32766 "Reserved" 32767 "Invalid" ;
VAL_ 161 SteerWheelAngSign 0 "Left (Positive)" 1 "Right (Negative)" ;
VAL_ 161 SAS_Sts 0 "SAS Angle And Speed Correct" 1 "SAS Not Calibrated" 2 "Intermittent Error Detected" 3 "Permanent Error Detected" ;
VAL_ 166 TgtEngSpdIP 0 "Valid values" 4095 "Valid values" ;
VAL_ 166 TgtEngSpdIPValid 0 "Invalid" 1 "valid" ;
VAL_ 200 ESP_HMI_WarningOn 0 "No warning lamp" 1 "Yellow Lamp" 2 "Red Lamp" 3 "reserved" ;
VAL_ 200 WadeModeWarn 0 "No_Warn" 1 "Please_slow_down" 2 "Please_pay_attention_to_the_surrounding_conditions_ignition_caution" 3 "Please_press_on_the_brake_gently_to_test_the_brake_performance" ;
VAL_ 241 BMS_ErrCategory 0 "No Error" 1 "Warning" 2 "Derating" 3 "Reserved" 4 "Reserved" 5 "Error" 6 "Reserved" 7 "Emergency Open" ;
VAL_ 241 CheckSum_BMS4 0 "Valid value" 255 "Valid value" ;
VAL_ 241 BMS_PackCurr 0 "Valid value" 10000 "Valid value" 10001 "Reserved" 16382 "Reserved" 16383 "Invalid" ;
VAL_ 241 BMS_PackVolt 0 "Valid value" 245 "Valid value" 246 "Reserved" 254 "Reserved" 255 "Invalid" ;
VAL_ 241 BMS_PowerDownCmplt 0 "Not complete" 1 "Complete" ;
VAL_ 241 BMS_BattPoweErr 0 "No Error" 1 "TM power unavailable" 2 "P2M power unavailable" 3 "OBC power unavailable" ;
VAL_ 241 RollingCounter_BMS4 0 "Valid value" 14 "Valid value" 15 "Invalid value" ;
VAL_ 265 IFCTrqOvlCmdProtnValue 0 "Valid value" 16383 "Valid value" ;
VAL_ 265 IFCTrqOvlCmdReqValue 0 "Valid value" 2047 "Valid value" ;
VAL_ 273 EMS_AuthenResult 0 "Nothing" 1 "Authentication failure" 2 "Authentication success" 3 "Reserved" ;
VAL_ 273 EngSpd 0 "Valid values" 65535 "Valid values" ;
VAL_ 273 EngSpdVldty 0 "Invalid" 1 "Valid" 2 "Initial value" 3 "Reserved" ;
VAL_ 273 EngSpd_PHEV 0 "Valid values" 65535 "Valid values" ;
VAL_ 273 EngSpdVldty_PHEV 0 "Invalid" 1 "Valid" 2 "Initial value" 3 "Reserved" ;
VAL_ 288 IB_Warn 0 "Warning lamp off" 1 "Warning lamp on" ;
VAL_ 311 CheckSum_ESP2 0 "Valid values" 255 "Valid values" ;
VAL_ 311 HDCFault 0 "No failure" 1 "Failure when HDC is on need" 2 "Failure when is not on need" 3 "Reserved" ;
VAL_ 311 HDCCtrl 0 "OFF" 1 "On active braking" 2 "On not active braking" 3 "Reserved" ;
VAL_ 311 AVHErrSts 0 "No failure" 1 "Failure when AVH is on need" 2 "Failure when is not on need" 3 "Reserved" ;
VAL_ 311 AVHSts 0 "Off" 1 "Standby" 2 "active" 3 "Reserved" ;
VAL_ 311 CDPActv 0 "Not active" 1 "Active" ;
VAL_ 311 DrivingModDis 0 "Standard" 1 "Sport" 2 "Snow" 3 "Mud" 4 "Sand" 5 "4L" 6 "Economic" 7 "Mode_Unkown" 8 "AUTO" 9 "Sport+" 10 "Off_road" 11 "Stand_2H" 12 "Expert" 13 "Stand_4H" 14 "Failed" 15 "Invalid_Value" 16 "Snow_4H" 17 "Normal_4L" 18 "Rock_4L" 19 "Pothle_4L" 20 "MudSand_4L" 21 "Mountain_4L" 22 "reserved" 23 "Race" 24 "Reserved" 25 "Reserved" 26 "Wade_4H" 27 "Wade_4L" 28 "Reserved" 29 "4H" 31 "Reserved" ;
VAL_ 311 DrivingModReq_ESP 0 "No_Terrain_Control" 1 "Standard" 2 "Sport" 3 "Snow_Nex" 4 "Expert" 5 "Deep_Mud" 6 "Reserved" 7 "Soft_sand" 8 "4H" 9 "4L" 10 "Economic" 11 "Reserved" 12 "Snow_TOD" 13 "Off_road" 14 "Sport+" 15 "Invalid_Value" 16 "Standard_2H" 17 "Reserved" 18 "Standard_4H" 19 "Snow_4H" 20 "Normal_4L" 21 "Rock_4L" 22 "Pothole_4L" 23 "MudSand_4L" 24 "Mountain_4L" 25 "Reserved" 26 "Race" 27 "Reserved" 28 "Reserved" 29 "Wade_4H" 30 "Wade_4L" 31 "Reserved" ;
VAL_ 311 Shift_N_Warn 0 "Shift_N" 1 "No_shift_N" ;
VAL_ 311 Over_Spd_Warn 0 "No_warn" 1 "Warn" ;
VAL_ 311 FourL_Warn 0 "No_warn" 1 "Warn" ;
VAL_ 311 TAB_Sts 0 "Function OFF" 1 "Standby" 2 "Active" 3 "Failure" ;
VAL_ 311 RollingCounter_ESP2 0 "Valid value" 14 "Valid value" 15 "Invalid value" ;
VAL_ 311 CheckSum_ESP1 0 "Valid values" 255 "Valid values" ;
VAL_ 311 ESPFuncOffSts 0 "AvailableOn" 1 "UnavailableOff" ;
VAL_ 311 ESPActvInfoLmp 0 "Not active" 1 "Active" ;
VAL_ 311 ESPFailSts 0 "No failure" 1 "Failure" ;
VAL_ 311 IMC_Actv 0 "Not active" 1 "Active" ;
VAL_ 311 RollingCounter_ESP1 0 "Valid value" 14 "Valid value" 15 "Invalid value" ;
VAL_ 311 CheckSum_ABS3 0 "Valid values" 255 "Valid values" ;
VAL_ 311 ABSActv 0 "Not active" 1 "Active" ;
VAL_ 311 ABSFailSts 0 "No failure" 1 "Failure" ;
VAL_ 311 EBDFailSts 0 "No failure" 1 "Failure" ;
VAL_ 311 VehSpdVld 0 "Invalid" 1 "Valid" ;
VAL_ 311 VehSpd 0 "Valid values" 5333 "Valid values" 5334 "Reserved" 8191 "Reserved" ;
VAL_ 311 VehOdoInfoSts 0 "Invalid" 1 "Valid" ;
VAL_ 311 VehOdoInfo 0 "Valid values" 999 "Valid values" 1000 "Reserved" 1023 "Reserved" ;
VAL_ 311 RollingCounter_ABS3 0 "Valid value" 14 "Valid value" 15 "Invalid value" ;
VAL_ 311 ESPBrkLmpCtrl 0 "Brake light off" 1 "Brake light on" ;
VAL_ 311 VDCActv 0 "Not active" 1 "Active" ;
VAL_ 311 PTCActv 0 "Not active" 1 "Active" ;
VAL_ 311 BTCActv 0 "Not active" 1 "Active" ;
VAL_ 327 CheckSum_EPS1 0 "Valid values" 255 "Valid values" ;
VAL_ 327 EPS_FailSts 0 "No fault" 1 "Permanent Error Detected" 2 "Intermittent Error Detected" 3 "Reserved" ;
VAL_ 327 EPS_SteerMod 0 "Comfort Mode" 1 "sport mode" 2 "Handiness Mode" 3 "Reserved" 7 "Reserved" ;
VAL_ 327 SteerCorrnRmn 0 "No Tip" 1 "Tip return finish" 2 "Tip return R" 3 "Tip return L" ;
VAL_ 327 SteerCorrnResp 0 "OFF" 1 "ON" ;
VAL_ 327 RollingCounter_EPS1 0 "Valid value" 14 "Valid value" 15 "Invalid value" ;
VAL_ 338 FrntELDLckSts 0 "UnLocked" 1 "Locked" 2 "Over-Speed Warning" 3 "Reserved" 4 "Lock Request Deny" 5 "Reserved" 13 "Reserved" 14 "Fault" 15 "Invalid" ;
VAL_ 338 RearELDLckSts 0 "UnLocked" 1 "Locked" 2 "Over-Speed Warning" 3 "Driving Mode Select Error" 4 "Lock Request Deny" 5 "Reserved" 13 "Reserved" 14 "Fault" 15 "Invalid" ;
VAL_ 347 APS_PrkgMod 0 "None" 1 "Parking in" 2 "Parking out" 3 "Reserved" ;
VAL_ 347 APS_ProcBar 0 "0-100" 100 "0-100" 101 "Reserved" 126 "Reserved" 127 "No Display" ;
VAL_ 347 APS_SwtSts 0 "no press" 1 "press" ;
VAL_ 347 APS_SlotDisp 0 "No parking slot" 1 "Left parallel parking slot" 2 "Left vertical parking slot" 3 "Left T-shape parking slot" 4 "Right parallel parking slot" 5 "Right vertical parking slot" 6 "Right T-shape parking slot" 7 "Reserved" ;
VAL_ 347 APS_SysSoundIndcn 0 "Tone 0 - No Warning" 1 "Tone 1 - APS failed tone" 2 "Tone 2 - APS successful tone" 3 "Tone 3 - APS warning tone" 4 "Tone 4 - APS request tone" 5 "Reserved" 7 "Reserved" ;
VAL_ 347 APS_PrkgTyp 0 "None" 1 "Parallel parking" 2 "Vertical parking" 3 "Reserved" ;
VAL_ 347 APS_TextDisp 0 "No Request" 1 "Wrong gear position to start parking" 2 "Turn D to search for slot" 3 "Please close the trunk" 4 "Please close the door" 5 "Please fasten the seat belt" 6 "Please unfold the Mirror" 7 "Speed is too high,need <23kmh" 8 "System error Parking sys exits" 9 "control unit error parking sys exits" 10 "Please brake" 11 "please select parking mode" 12 "please select internal parking" 13 "please select Slot and parking mode" 14 "please select Slot and internal parking" 15 "Please keep braking" 16 "Hands off the steering wheel" 17 "Release the brake,parking start" 18 "Auto parking,be ready to brake" 19 "parking suspended,close trunk" 20 "parking suspended,close door" 21 "parking suspended,fasten seat belt" 22 "Obstacles Detected" 23 "brake recovered,confirm to continue" 24 "Parking quited" 25 "parking   finished" 26 "interfered by driver parking quited" 27 "too many parking times parking sys exits" 28 "Parking time too long Parking sys exits" 29 "Too Small Slot Parking sys exits" 30 "Please Clean the Camera" 31 "Select the parking mode(APA3)" 32 "Searching the right slot" 33 "Searching the left slot" 34 "Please turn D to search for parking slot" 35 "Speed is too high,need <30kmh" 36 "Speed is too high,sys exits" 37 "Select parking type" 38 "Long press switch 2s to enter auto parking" 39 "Parking suspended,Please release the gas pedal" 40 "Please brake,And long press switch 2s to continue auto parking" 41 "Parking is not available" 42 "Please select the parking direction by turning the turn switch" 43 "Please brake,And long press switch 2s to enter_POC_left" 44 "Parking sys exits" 45 "Parking suspended,fold the Mirror" 46 "Too Small Slot Please select another direction" 47 "Driving Mode not supported" 48 "Path is smooth" 49 "Please select park out" 50 "Please select park out direction" 51 "Please get off the car with keys to start remote parking" 52 "Please confirm to start parking" 53 "Remote Parking in exit" 54 "Parking suspended,Remote connection error" 55 "System error,Parking sys can not start" 56 "Control unit error,Parking sys can not start" 57 "Please Turn P and Apply EPB Remote parking sys not Running" 58 "Select Remote parking out type" 59 "Please brake,And long press switch 2s to enter_POC_Right" 60 "Please release switch to en-ter guidance" 61 "Slope over ,system exits" 62 "Please select Summon Path" 63 "Reserved" 64 "Path study begin please drive the car" 65 "Path studying" 66 "Confirm study finished" 67 "Path studying failed caused by Path too long" 68 "Path studying failed caused by Speed too high" 69 "Path studying failed caused by communication error" 70 "Path studying failed caused by Path error" 71 "Path studying failed caused by learn time too long" 72 "Path studying failed caused by internal error" 73 "Path studying failed caused by Path too short" 74 "Path studying failed caused by Path backward too long" 75 "Path studying failed caused by shift gear too many times" 76 "Speed is too high,need <5kmh" 77 "Speed is too high,need <10kmh" 78 "Speed is too high,need <15kmh" 79 "Reserved" 80 "Path saving" 81 "Path saving Succeed" 82 "Path saving failed caused by Path too short" 83 "Path saving failed caused by communication error" 84 "Path saving failed caused by Path error" 85 "Path saving failed caused by Path error limit storage room" 86 "Path saving failed caused by internal error" 87 "Reserved" 95 "Reserved" 96 "Please drive to path start point" 97 "Path matche please stop" 98 "Please select play back mode" 99 "Path match failed caused by communication error" 100 "Path match failed caused by path error" 101 "Path match failed caused by long time no action" 102 "Path match failed caused by internal error" 103 "Reserved" 111 "Reserved" 112 "No save distance,RADS sys esits" 113 "RADS running,be ready to brake" 114 "Near the bourn" 115 "Arrive at the bourn" 116 "Release the brake" 117 "Trunk open,RADS sys exits" 118 "Door open,RADS sys exits" 119 "Seat belt drop,RADS sys exits" 120 "Mirror fold,RADS sys exits" 121 "Obstacles Detected,RADS sys exits" 122 "No continue driving Parking quited" 123 "Please turn to R" 124 "Release the brake,Driving assistance start" 125 "Please turn to D" 126 "Reserved for RADS" 127 "Reserved for RADS" 128 "FADS running,be ready to brake" 129 "Trunk open,FADS sys exits" 130 "Door open,FADS sys exits" 131 "Seat belt drop,FADS sys exits" 132 "Mirror fold,FADS sys exits" 133 "Obstacles Detected,FADS sys exits" 134 "Vehicle can not move,FADS sys exits" 135 "Remote control straight Search" 136 "Over limit search distance" 137 "Please select suitable parking slot icon" 138 "Please drag the parking slot to suitable place and adjust the angle" 139 "Move over 25m,system exits" 140 "Move over 5m,system exits" 142 "Reserved" 255 "Reserved" ;
VAL_ 347 APS_WorkSts 0 "Disable" 1 "Standby" 2 "Searching" 3 "Guidance" 4 "Failed" 5 "Wait for Engine restart" 6 "Reserved" 7 "Reserved" ;
VAL_ 347 MEB_AVHReq 0 "No Request" 1 "Request" ;
VAL_ 347 APS_ESP_BrkDistance 0 "Valid value" 4095 "Valid value" ;
VAL_ 347 APS_BrkModSts 0 "ParkAssist_Int" 1 "ParkAssist_Standby" 2 "ParkAssist_Active" 3 "ParkAssist_ManeuverFinished" 4 "ParkAssist_Suspend (Reserved)" 5 "ParkAssist_Abort" 6 "Reserved" 7 "Reserved" ;
VAL_ 347 APS_BrkCategory 0 "ParkAssist_Idle" 1 "ParkAssist_Comfort" 2 "ParkAssist_Emergency" 3 "Reserved" ;
VAL_ 347 LParaPrkgOutVald 0 "valid" 1 "Invalid" ;
VAL_ 347 RParaPrkgOutVald 0 "valid" 1 "Invalid" ;
VAL_ 347 HeadVertPrkgOutVald 0 "valid" 1 "Invalid" ;
VAL_ 347 TailVertPrkgOutVald 0 "valid" 1 "Invalid" ;
VAL_ 347 HAP_SwtDispCtrlCmd 0 "no display" 1 "park out direction Select menu" 2 "continue park menu" 3 "Study finish button" 4 "RDAS distance arrow" 5 "RDAS active distance arrow steering" 6 "Reserved" 7 "Reserved" ;
VAL_ 347 HAP_PrkgModCurrSts 0 "No display" 1 "Left parallel park in" 2 "Right parallel park in" 3 "Left vert park in" 4 "Right vert park in" 5 "Left Tshape park in" 6 "Right Tshape park in" 7 "Left parallel park out" 8 "Right parallel park out" 9 "Front vert park out" 10 "Rear vert park out" 11 "P2P Summon" 12 "Reserved" 15 "Reserved" ;
VAL_ 347 APS_MovgDirc 0 "No Display" 1 "Moving forward" 2 "Moving backward" 3 "Reserved" ;
VAL_ 347 P2P_PahDelSts 0 "No Action" 1 "detecting" 2 "successed" 3 "failed" ;
VAL_ 347 P2P_SelfDetErrCode 0 "No Error" 1 "HAP Error" 2 "tyre pressure error" 3 "door open" 4 "trunk open" 5 "vehicle moving" 6 "environment error" 7 "Camera is smudgy" 8 "Seat belt not fastened" 9 "Mirror is folded" 10 "Associated system error" 11 "reserved" 15 "reserved" ;
VAL_ 347 P2P_SelfDetSts 0 "No Action" 1 "Detecting" 2 "Successed" 3 "Failed" ;
VAL_ 347 P2P_Pah1Avail 0 "Not avalible" 1 "Avalible" ;
VAL_ 347 P2P_Pah2Avail 0 "Not avalible" 1 "Avalible" ;
VAL_ 347 P2P_PrkgDirectSts 0 "P2P Park in" 1 "P2P Summon" ;
VAL_ 347 HAVP_WorkSts 0 "Off" 1 "Standby" 2 "Position" 3 "Preactive" 4 "Restore Cruising" 5 "Summon Crusing" 6 "Parking" 7 "Outing" 8 "Completed" 9 "Suspend" 10 "Abort" 11 "Failure" 12 "Disable" 13 "Study" 14 "Reserved" 15 "Reserved" ;
VAL_ 347 PAVP_Status 0 "Off" 1 "Standby" 2 "Position" 3 "Preactive" 4 "Restore Cruising" 5 "Summon Crusing" 6 "Parking" 7 "Outing" 8 "Completed" 9 "Suspend" 10 "Abort" 11 "Failure" 12 "Disable" 13 "Reserved" 15 "Reserved" ;
VAL_ 347 PAVP_TextDis2 0 "No tex" 1 "Drop-off area picture request" 2 "Path-list showing request" 3 "Reserved" 63 "Reserved" ;
VAL_ 347 ParallelSlotBtn_Ena 0 "No Display" 1 "Disable" 2 "Enable" 3 "Active" ;
VAL_ 347 VerticalSlotBtn_Ena 0 "No Display" 1 "Disable" 2 "Enable" 3 "Active" ;
VAL_ 347 ClockwiseBtn_Ena 0 "No Display" 1 "Disable" 2 "Enable" 3 "Active" ;
VAL_ 347 AnticlockwiseBtn_Ena 0 "No Display" 1 "Disable" 2 "Enable" 3 "Active" ;
VAL_ 347 SlotConfirmBtn_Ena 0 "No Display" 1 "Disable" 2 "Enable" 3 "Active" ;
VAL_ 347 HAVP_StopBtn_Ena 0 "No Display" 1 "Disable" 2 "Enable" 3 "Active" ;
VAL_ 347 HAVP_StartBtn_Ena 0 "No Display" 1 "Disable" 2 "Enable" 3 "Active" ;
VAL_ 347 HAVP_SelfParLotEnding_Ena 0 "No Display" 1 "Disable" 2 "Enable" 3 "Active" ;
VAL_ 347 PAVP_TextDis 0 "No tex" 1 "Selfchecking" 2 "AVP unavailable" 3 "Map update failed" 4 "Wrong position" 5 "Req_Close_Door_all doors" 6 "Req_Close_Hood_door" 7 "Req_Close_Trunk_door" 8 "Req_Gear_P_EPB" 9 "Path download failed" 10 "Power off failed" 11 "Pick-up location" 12 "Drop-off area" 13 "No parking lot" 14 "Parking in inprocess" 15 "Parking in complete" 16 "Task failed" 17 "Parking out in process" 18 "Cruising" 19 "Parking out complete" 20 "Req_Quit_System failure" 21 "Req_Suspend_User Req" 22 "Req_Quit_EPS failure" 23 "Req_Quit_ESP failure" 24 "Req_Abort_Terminate_Button_Pressed_HMI_Cancel_RD_Cancel" 25 "Req_Abort_Steering Wheel Intervention" 26 "Req_Abort_Gear Intervention" 27 "Req_Abort_EPB Intervention" 28 "Req_Abort_Function Activation" 29 "Reserved" 31 "Reserved" 32 "Req_Abort_Parking Timeout" 33 "Req_Abort_Speed high" 34 "Req_Abort_Parking Too Many Times" 35 "Req_Abort_Hood Open" 36 "Req_Abort_Trunk Open" 37 "Req_Abort_Door Open" 38 "Req_Abort_Deficient Space" 39 "Req_Abort_Network Disconnection" 40 "Req_Abort_Path Invalid" 41 "Req_Abort_Parking Lot Invalid" 42 "Req_Abort_Rear Mirror Fold" 43 "Req_Abort_ODD Dissatisfied" 44 "Req_Abort_Suspend Too Many Times" 45 "Req_Abort_Suspend Timeout" 46 "Req_Abort_Tire Pressure" 47 "Req_Abort_TBOX Err" 48 "Network fault" 49 "No parking area" 50 "Reserved" 63 "Reserved" ;
VAL_ 347 AVP_T_Box_WorkSts 0 "OFF" 1 "HAVP ON" 2 "PAVP ON" 3 "Failure" ;
VAL_ 350 CR_FCTA_Resp 0 "OFF" 1 "ON" ;
VAL_ 350 CR_FCTB_Resp 0 "OFF" 1 "ON" ;
VAL_ 350 CR_BliSts 0 "No Blindness" 1 "Blindness" ;
VAL_ 350 FCTA_Warn 0 "No warning" 1 "Warning" ;
VAL_ 350 FCTBTrig 0 "Not tirggered" 1 "tirggered" ;
VAL_ 350 FCTA_B_FuncSts 0 "No display" 1 "error" 2 "FCTA_B temporarily unavailable" 3 "FCTA_B Performance degradation" ;
VAL_ 350 FCTA_B_TTC 0 "No Display" 1 "valid value" 63 "valid value" ;
VAL_ 357 LTurnLmpSwtSts 0 "OFF" 1 "ON" ;
VAL_ 357 RTurnLmpSwtSts 0 "OFF" 1 "ON" ;
VAL_ 357 AutoLmpSwtSts 0 "Non-Auto" 1 "Auto" ;
VAL_ 357 HornSwtSts 0 "OFF" 1 "ON" ;
VAL_ 357 FrntWiprSwtSts 0 "Wiper Off" 1 "Wiper Auto Or Intermittent" 2 "Low Speed" 3 "High Speed" 4 "reserved" 6 "reserved" 7 "Error" ;
VAL_ 357 PosnLmpSwtSts 0 "OFF" 1 "ON" ;
VAL_ 357 FrntFogLmpSwtSts 0 "OFF" 1 "ON" ;
VAL_ 357 RearFogLmpSwtSts 0 "OFF" 1 "ON" ;
VAL_ 357 HiBeamSwtSts 0 "OFF" 1 "ON" ;
VAL_ 363 CheckSum_EPB1 0 "Valid values" 255 "Valid values" ;
VAL_ 363 EPBErrSts 0 "Undefined" 1 "No Error" 2 "Error" 3 "Diagnosis" ;
VAL_ 363 EPBRedLmpSts 0 "Lamp off" 1 "Lamp on" 2 "Lamp flash" 3 "Reserved" ;
VAL_ 363 EPBSts 0 "Released" 1 "Closed" 2 "In progress" 3 "unknown" ;
VAL_ 363 EPBTextDisp 0 "No_Display" 1 "Gradient_Too_High" 2 "Park_Brake_Force_Not_Enough" 3 "Park_Brake_System_Overheated" 4 "Remind_Driver_To_Apply_Safety_Belt" 5 "Park_Brake_Maintenance_Mode" 6 "Roller_Bench_Mode" 7 "Please_Release_EPB" 8 "Please_Release_Rear_ELD" 9 "Switch_To_Non_P_and_Release_The_Parking" 10 "Please_Quit_TAB" 11 "Reserved" 15 "Reserved" ;
VAL_ 363 PressBrakePedalPointOut 0 "No reminder" 1 "Pedal needs to be applied" ;
VAL_ 363 RollingCounter_EPB1 0 "Valid value" 14 "Valid value" 15 "Invalid value" ;
VAL_ 367 RSDS_IPSoundReq 0 "No warning" 1 "Warning level 1Ã¯Â¼Âˆ2HzÃ¥Â£Â°Ã©ÂŸÂ³Ã¯Â¼Â‰" 2 "Warning level 2Ã¯Â¼Âˆ4HzÃ¥Â£Â°Ã©ÂŸÂ³Ã¯Â¼Â‰" 3 "Warning level 3Ã¯Â¼ÂˆÃ¥Â¸Â¸Ã¥Â“ÂÃ¯Â¼Â‰" ;
VAL_ 367 RSDS_ErrSts 0 "No Error" 1 "Error" ;
VAL_ 367 RSDS_BrkgTrig 0 "Not tirggered" 1 "Triggered" ;
VAL_ 367 RSDS_BliSts 0 "No Blindness" 1 "Blindness" ;
VAL_ 367 RSDS_TrailerSts 0 "None" 1 "Trailer" ;
VAL_ 367 RSDS_LCAResp 0 "OFF" 1 "ON" ;
VAL_ 367 RSDS_DOWResp 0 "OFF" 1 "ON" ;
VAL_ 367 RSDS_RCWResp 0 "OFF" 1 "ON" ;
VAL_ 367 RSDS_RCTAResp 0 "OFF" 1 "ON" ;
VAL_ 367 RSDS_RCTABrkResp 0 "OFF" 1 "ON" ;
VAL_ 367 RSDS_RCW_Trigger 0 "No warning" 1 "RCW level 1" 2 "RCW level 2" 3 "Reserved" ;
VAL_ 367 RSDS_CTA_Actv 0 "Not active" 1 "Active" ;
VAL_ 367 BSD_LCA_warningReqRight 0 "No warning" 1 "Warning level 1" 2 "Warning level 2" 3 "Reserved" ;
VAL_ 367 BSD_LCA_warningReqleft 0 "No warning" 1 "Warning level 1" 2 "Warning level 2" 3 "Reserved" ;
VAL_ 367 DOW_warningReqRight 0 "No warning" 1 "Warning level 1" 2 "Warning level 2" 3 "Reserved" ;
VAL_ 367 DOW_warningReqleft 0 "No warning" 1 "Warning level 1" 2 "Warning level 2" 3 "Reserved" ;
VAL_ 367 RCTA_warningReqRight 0 "No warning" 1 "Warning level 2" ;
VAL_ 367 RCTA_warningReqLeft 0 "No warning" 1 "Warning level 2" ;
VAL_ 368 CCO_Warn 0 "No Warn" 1 "Please Release EPB" 2 "Please  slow down" 3 "Reserved" ;
VAL_ 368 CCO_Active 0 "Not Active" 1 "Active" 2 "Stand by" 3 "Failed" ;
VAL_ 368 CCO_TgtVel 0 "Valid values" 31 "Valid values" ;
VAL_ 368 EspFuncOffSts_mode 0 "AvailableOn" 1 "Cross-country expert mode" ;
VAL_ 395 AEB_ABA_Level 0 "Level 0" 1 "Level 1" 2 "Level 2" 3 "Level 3" ;
VAL_ 395 AEB_ABA_Req 0 "No Request" 1 "Request" ;
VAL_ 395 EBA_TgtDecel_Req 0 "No Request" 1 "Request" ;
VAL_ 395 AEB_VehHldReq 0 "No Request" 1 "Request" ;
VAL_ 395 AEB_TgtDecel_Req 0 "No Request" 1 "Request" ;
VAL_ 395 AEB_TgtDecel_ReqValue 0 "Valid value" 65534 "Valid value" 65535 "Invalid" ;
VAL_ 395 AEB_AWB_Req 0 "No Request" 1 "Request" ;
VAL_ 395 AEB_AWB_Level 0 "No level" 1 "Level 1" 2 "Level 2" 3 "Level 3" 4 "Level 4" 5 "Resvered" 15 "Resvered" ;
VAL_ 395 AEB_ABP_Req 0 "No Request" 1 "Request" ;
VAL_ 395 AEB_BrkReqFunc 0 "No Request" 1 "AEB-V" 2 "AEB-VRU" 3 "AEB-JA" 4 "Reserved" 5 "AEB-FCTB" 6 "Reserved" 7 "Reserved" ;
VAL_ 395 AEB_ObjSty 0 "No Object" 1 "Vehicle" 2 "Pedestrian" 3 "Cyclist" 4 "unknown" 5 "Resvered" 7 "Resvered" ;
VAL_ 411 FFogLmpSts_F_PBox 0 "Off" 1 "On" ;
VAL_ 411 HiBeamSts_F_PBox 0 "Off" 1 "On" ;
VAL_ 411 HoodSts_F_PBox 0 "Closed" 1 "Open" ;
VAL_ 411 LasHdLmpSts_F_PBox 0 "Off" 1 "On" ;
VAL_ 411 LHiBeamFailSts 0 "No failure" 1 "failure" ;
VAL_ 411 RHiBeamFailSts 0 "No failure" 1 "failure" ;
VAL_ 411 LLowBeamFailSts 0 "No failure" 1 "failure" ;
VAL_ 411 LHeadLmpFailSts 0 "No failure" 1 "failure" ;
VAL_ 411 RHeadLmpFailSts 0 "No failure" 1 "failure" ;
VAL_ 411 RLowBeamFailSts 0 "No failure" 1 "failure" ;
VAL_ 411 RLasHdLmpDiagSig 0 "No failure" 1 "failure" ;
VAL_ 411 LLasHdLmpDiagSig 0 "No failure" 1 "failure" ;
VAL_ 411 LowBeamSts_F_PBox 0 "Off" 1 "On" ;
VAL_ 411 WhistleSts_F_PBox 0 "Off" 1 "On" ;
VAL_ 411 FFogLmpFailSts 0 "No failure" 1 "Left front side failure" 2 "Right front side failure" 3 "both front side failure" ;
VAL_ 411 LFPosnLmpSts 0 "Off" 1 "On" ;
VAL_ 411 RFPosnLmpSts 0 "Off" 1 "On" ;
VAL_ 412 HiPosnBrkLmpFailSts 0 "No failure" 1 "failure" ;
VAL_ 412 LBrkLmpFailSts 0 "No failure" 1 "failure" ;
VAL_ 412 RFogLmpFailSts_R_PBox 0 "No failure" 1 "failure" ;
VAL_ 412 RFogLmpSts_R_PBox 0 "Off" 1 "On" ;
VAL_ 412 ParkLmpSts_R_PBox 0 "Off" 1 "On" ;
VAL_ 412 RBrkLmpFailSts 0 "No failure" 1 "failure" ;
VAL_ 412 PosnLmpOutpSts_R_PBox 0 "OFF" 1 "ON" ;
VAL_ 412 RRPosnLmpFailSts 0 "No failure" 1 "failure" ;
VAL_ 412 RvsLmpFailSts 0 "No failure" 1 "failure" ;
VAL_ 412 LRPosnLmpFailSts 0 "No failure" 1 "failure" ;
VAL_ 412 LTurnLmpSts_R_PBox 0 "Off" 1 "On" ;
VAL_ 412 RTurnLmpSts_R_PBox 0 "Off" 1 "On" ;
VAL_ 412 RWinHeatgIconRlyCmd 0 "Not active" 1 "Active" ;
VAL_ 412 RWinHeatgFailSts 0 "No Failure" 1 "Failure" ;
VAL_ 412 LicPlateLmpFailSts 0 "No failure" 1 "failure" ;
VAL_ 412 RTurnLmpFailSts 0 "No failure" 1 "Short circuit" 2 "Open circuit" 3 "Reserved" ;
VAL_ 412 LTurnLmpFailSts 0 "No failure" 1 "Short circuit" 2 "Open circuit" 3 "Reserved" ;
VAL_ 412 LBrkLmpOutpSts_R_PBox 0 "Off" 1 "On" ;
VAL_ 412 RBrkLmpOutpSts_R_PBox 0 "Off" 1 "On" ;
VAL_ 412 HiPosnBrkLmpOutpSts_R_PBox 0 "Off" 1 "On" ;
VAL_ 415 IFC_Line01_Dy 0 "Valid value" 6001 "Valid value" 6002 "Reversed" 8191 "Reversed" ;
VAL_ 415 IFC_Line01_Curv 0 "Valid value" 31250 "Valid value" 31251 "Reversed" 32767 "Reversed" ;
VAL_ 415 IFC_Line01_CurvChange 0 "Valid value" 960000 "Valid value" 960001 "Reversed" 1048575 "Reversed" ;
VAL_ 415 IFC_Line01_Type 0 "undecided" 1 "solid" 2 "dashed" 3 "double solid dashed" 4 "double dashed solid" 5 "double solid solid" 6 "double dashed dashed" 7 "botts" 8 "deceleration" 9 "hov_lane" 10 "road edge" 11 "elevated_structure" 12 "curb" 13 "cones_poles" ;
VAL_ 415 IFC_Line02_Dy 0 "Valid value" 6001 "Valid value" 6002 "Reversed" 8191 "Reversed" ;
VAL_ 415 IFC_Line02_Curv 0 "Valid value" 31250 "Valid value" 31251 "Reversed" 32767 "Reversed" ;
VAL_ 415 IFC_Line02_CurvChange 0 "Valid value" 960000 "Valid value" 960001 "Reversed" 1048575 "Reversed" ;
VAL_ 415 IFC_Line02_Type 0 "undecided" 1 "solid" 2 "dashed" 3 "double solid dashed" 4 "double dashed solid" 5 "double solid solid" 6 "double dashed dashed" 7 "botts" 8 "deceleration" 9 "hov_lane" 10 "road edge" 11 "elevated_structure" 12 "curb" 13 "cones_poles" ;
VAL_ 415 IFC_Line03_Dy 0 "valid value" 6001 "valid value" 6002 "reversed" 8191 "reversed" ;
VAL_ 415 IFC_Line03_Curv 0 "valid value" 31250 "valid value" 31251 "reversed" 32767 "reversed" ;
VAL_ 415 IFC_Line03_CurvChange 0 "valid value" 960000 "valid value" 960001 "reversed" 1048575 "reversed" ;
VAL_ 415 IFC_Line03_Type 0 "undecided" 1 "solid" 2 "dashed" 3 "double solid dashed" 4 "double dashed solid" 5 "double solid solid" 6 "double dashed dashed" 7 "botts" 8 "deceleration" 9 "hov_lane" 10 "road edge" 11 "elevated_structure" 12 "curb" 13 "cones_poles" ;
VAL_ 415 IFC_Line04_Dy 0 "valid value" 6001 "valid value" 6002 "reversed" 8191 "reversed" ;
VAL_ 415 IFC_Line04_Curv 0 "valid value" 31250 "valid value" 31251 "reversed" 32767 "reversed" ;
VAL_ 415 IFC_Line04_CurvChange 0 "valid value" 960000 "valid value" 960001 "reversed" 1048575 "reversed" ;
VAL_ 415 IFC_Line04_Type 0 "undecided" 1 "solid" 2 "dashed" 3 "double solid dashed" 4 "double dashed solid" 5 "double solid solid" 6 "double dashed dashed" 7 "botts" 8 "deceleration" 9 "hov_lane" 10 "road edge" 11 "elevated_structure" 12 "curb" 13 "cones_poles" ;
VAL_ 415 IFC_Roadedge01_Dy 0 "valid value" 6001 "valid value" 6002 "reversed" 8191 "reversed" ;
VAL_ 415 IFC_Roadedge01_Curv 0 "valid value" 31250 "valid value" 31251 "reversed" 32767 "reversed" ;
VAL_ 415 IFC_Roadedge01_Type 0 "undecided" 1 "solid" 2 "dashed" 3 "double solid dashed" 4 "double dashed solid" 5 "double solid solid" 6 "double dashed dashed" 7 "botts" 8 "deceleration" 9 "hov_lane" 10 "road edge" 11 "elevated_structure" 12 "curb" 13 "cones_poles" ;
VAL_ 415 IFC_Roadedge02_Dy 0 "valid value" 6001 "valid value" 6002 "reversed" 8191 "reversed" ;
VAL_ 415 IFC_Roadedge02_Curv 0 "valid value" 31250 "valid value" 31251 "reversed" 32767 "reversed" ;
VAL_ 415 IFC_Roadedge02_CurvChange 0 "valid value" 960000 "valid value" 960001 "reversed" 1048575 "reversed" ;
VAL_ 415 IFC_Roadedge02_Type 0 "undecided" 1 "solid" 2 "dashed" 3 "double solid dashed" 4 "double dashed solid" 5 "double solid solid" 6 "double dashed dashed" 7 "botts" 8 "deceleration" 9 "hov_lane" 10 "road edge" 11 "elevated_structure" 12 "curb" 13 "cones_poles" ;
VAL_ 473 OTA_UpgrdModErrCode 0 "No_Action" 1 "ota_mode_enter_error" 2 "Reserved" 3 "Reserved" ;
VAL_ 473 OTAUpgrdSts 0 "NO action" 1 "End the Remote upgrade mode" ;
VAL_ 474 SlotNum_VR 0 "Valid values" 6 "Invalid" 15 "Invalid" ;
VAL_ 474 UserDefinedParkCmd 0 "No Request" 1 "Request" ;
VAL_ 474 HUT_HAVP_Set_Starting 0 "No Request" 1 "Request" ;
VAL_ 474 HUT_HAVP_Set_Path_Ending 0 "No request" 1 "Request" ;
VAL_ 474 HUT_HAVP_APA_Permit 0 "Idle" 1 "NO" 2 "YES" 3 "Reserved" ;
VAL_ 474 UserDefPrkMenuSelCmd 0 "No Request" 1 "Parallel Slot Selected" 2 "Vertical Slot Selected" 3 "Reserved" 4 "Reserved" 5 "Clock wise Selected" 6 "Anticlock wise Selected" 7 "Reserved" ;
VAL_ 474 HUT_HAVP_SelfParLot_Ending 0 "No Request" 1 "Request" ;
VAL_ 474 HUT_HAVP_Return_Btn 0 "No Request" 1 "Request" ;
VAL_ 474 HUT_HAVP_Comfirm_Btn 0 "No Request" 1 "Request" ;
VAL_ 474 HUT_HAVP_Path_Select 0 "No Request" 1 "Valid values" 10 "Valid values" 11 "Reserved" 15 "Reserved" ;
VAL_ 474 HUT_HAVP_Path_Delete 0 "No Request" 1 "Valid values" 10 "Valid values" 11 "Reserved" 15 "Reserved" ;
VAL_ 474 HUT_HAVP_Path_SetTop 0 "No Request" 1 "Valid values" 10 "Valid values" 11 "Reserved" 15 "Reserved" ;
VAL_ 474 HUT_PAVP_PathList_Req 0 "No request" 1 "Request" ;
VAL_ 476 PassSeatMassgModSet 0 "No Action" 1 "Wave Mode" 2 "Serpentine Mode" 3 "Catwalk Mode" 4 "Shoulder Mode" 5 "Lumbar Mode" 6 "Soothing Mode" 7 "Butterfly Mode" 8 "Full Body Stretch Mode" 9 "Single Row Mode" 10 "Pulse Mode" 11 "Reserved" 15 "Reserved" ;
VAL_ 476 DrvSeatMassgModSet 0 "No Action" 1 "Wave Mode" 2 "Serpentine Mode" 3 "Catwalk Mode" 4 "Shoulder Mode" 5 "Lumbar Mode" 6 "Soothing Mode" 7 "Butterfly Mode" 8 "Full Body Stretch Mode" 9 "Single Row Mode" 10 "Pulse Mode" 11 "Reserved" 15 "Reserved" ;
VAL_ 476 PPMI_P_BSR_SwtSet 0 "No action" 1 "OFF" 2 "ON" 3 "Reserved" ;
VAL_ 476 RWPC_SwtReq 0 "No action" 1 "Initial Value" 2 "Close" 3 "Open" ;
VAL_ 477 DrvSeatVentnLvlSet_Nine 0 "No Action" 1 "OFF" 2 "Level1_Low" 3 "Level2" 4 "Level3" 5 "Level4" 6 "Level5" 7 "Level6" 8 "Level7" 9 "Level8" 10 "Level9_High" 11 "Reserved" 15 "Reserved" ;
VAL_ 477 PassSeatVentnLvlSet_Nine 0 "No Action" 1 "OFF" 2 "Level1_Low" 3 "Level2" 4 "Level3" 5 "Level4" 6 "Level5" 7 "Level6" 8 "Level7" 9 "Level8" 10 "Level9_High" 11 "Reserved" 15 "Reserved" ;
VAL_ 477 RLSeatVentnLvlSet_Nine 0 "No Action" 1 "OFF" 2 "Level1_Low" 3 "Level2" 4 "Level3" 5 "Level4" 6 "Level5" 7 "Level6" 8 "Level7" 9 "Level8" 10 "Level9_High" 11 "Reserved" 15 "Reserved" ;
VAL_ 477 RRSeatVentnLvlSet_Nine 0 "No Action" 1 "OFF" 2 "Level1_Low" 3 "Level2" 4 "Level3" 5 "Level4" 6 "Level5" 7 "Level6" 8 "Level7" 9 "Level8" 10 "Level9_High" 11 "Reserved" 15 "Reserved" ;
VAL_ 477 ARFSwtReq 0 "No_action" 1 "OFF" 2 "ON" ;
VAL_ 477 ASFCSwtReq 0 "No_action" 1 "OFF" 2 "ON" ;
VAL_ 477 AGSSwtReq 0 "No_action" 1 "OFF" 2 "ON" ;
VAL_ 477 SOCMngmntSwtReq 0 "No_action" 1 "OFF" 2 "ON" ;
VAL_ 481 T_BOX_RemtVideoMonrEnaReq_APP 0 "No action" 1 "Disable" 2 "Enable" 3 "Reserved" ;
VAL_ 481 T_BOX_RemtFrntDefrostCtrl 0 "No action" 1 "OFF" 2 "ON" 3 "Reserved" ;
VAL_ 481 T_BOX_RemtRearDefrostCtrl 0 "No action" 1 "OFF" 2 "ON" 3 "Reserved" ;
VAL_ 481 T_BOX_RemtCockpitClnReq 0 "No action" 1 "Open" 2 "Reserved" 3 "Reserved" ;
VAL_ 481 RemUpgrdModeCmd 0 "NO action" 1 "Enter the Remote upgrade mode" 2 "End the Remote upgrade mode" 3 "Reserved" ;
VAL_ 481 Phone_ChrgnMode 0 "Immediate Charging" 1 "Delay Charging" 2 "Invalid" 3 "No action" ;
VAL_ 481 T_BOX_RemtSdlMod 0 "Charging" 1 "AC ON" 2 "Intelligent Engine Idle Charging start" 3 "No action" ;
VAL_ 485 ACRearTempReq_ETC_VR 0 "Initial value" 1 "Level 1(Low)_17(Hi)" 17 "Level 1(Low)_17(Hi)" 18 "Reserved" 31 "Reserved" ;
VAL_ 485 ACRearTempSteplsReq_ETC_TC 0 "Initial value" 1 "Level 1(Low)_17(Hi)" 17 "Level 1(Low)_17(Hi)" 18 "Reserved" 31 "Reserved" ;
VAL_ 485 ACDrvTempDecReq_ETC_TC 0 "No action" 1 "Pressed" 2 "Reserved" 3 "Reserved" ;
VAL_ 485 ACDrvTempIncReq_ETC_TC 0 "No action" 1 "Pressed" 2 "Reserved" 3 "Reserved" ;
VAL_ 485 ACRearTempDecReq_ETC_TC 0 "No action" 1 "Pressed" 2 "Reserved" 3 "Reserved" ;
VAL_ 485 ACRearTempIncReq_ETC_TC 0 "No action" 1 "Pressed" 2 "Reserved" 3 "Reserved" ;
VAL_ 485 ACRearPowerReq_VR 0 "No action" 1 "Inactive" 2 "Active" 3 "Reserved" ;
VAL_ 485 ACMaxReq_VR 0 "No action" 1 "Not active" 2 "Active" 3 "Reserved" ;
VAL_ 485 ACMaxReq_TC 0 "No action" 1 "Pressed" 2 "Reserved" 3 "Reserved" ;
VAL_ 485 FrntWiprCtrl_VR 0 "No action" 1 "Off" 2 "On" 3 "Reserved" ;
VAL_ 485 ACRearAutoModReq_VR 0 "No action" 1 "Not active_reserved" 2 "Active" 3 "Reserved" ;
VAL_ 485 LockWinSet 0 "Close" 1 "Open" ;
VAL_ 485 ACRearLockReq_TC 0 "No action" 1 "Pressed" 2 "Reserved" 3 "Reserved" ;
VAL_ 485 SrSpdCtrlSwt 0 "OFF" 1 "ON" ;
VAL_ 485 DPF_Request 0 "No action" 1 "Active" 2 "No Active" 3 "Reserved" ;
VAL_ 485 ColorCategory 0 "Single color" 1 "Multi color" 2 "Reserved" 3 "Reserved" ;
VAL_ 485 SingleColorNr 0 "No command" 1 "Valid" 64 "Valid" 65 "Reserved" 127 "Reserved" ;
VAL_ 485 NozHeatSwt 0 "No_action" 1 "OFF" 2 "ON" 3 "AUTO" ;
VAL_ 487 ACRLTempDecReq_TC 0 "No action" 1 "Pressed" 2 "Reserved" 3 "Reserved" ;
VAL_ 487 ACRLTempIncReq_TC 0 "No action" 1 "Pressed" 2 "Reserved" 3 "Reserved" ;
VAL_ 487 ACRLTempReq_VR 0 "No action" 1 "Low" 2 "valid value(phys=0.5 * raw + 15.5)" 32 "valid value(phys=0.5 * raw + 15.5)" 33 "High" 34 "Reserved" 63 "Reserved" ;
VAL_ 487 ACRRTempDecReq_TC 0 "No action" 1 "Pressed" 2 "Reserved" 3 "Reserved" ;
VAL_ 487 ACRRTempIncReq_TC 0 "No action" 1 "Pressed" 2 "Reserved" 3 "Reserved" ;
VAL_ 487 ACRRTempReq_VR 0 "No action" 1 "Low" 2 "valid value(phys=0.5 * raw + 15.5)" 32 "valid value(phys=0.5 * raw + 15.5)" 33 "High" 34 "Reserved" 63 "Reserved" ;
VAL_ 487 ACRRTempSteplsReq_TC 0 "No action" 1 "Pressed" 2 "Reserved" 3 "Reserved" ;
VAL_ 487 ACHumidifierReq_VR 0 "No action" 1 "Inactive" 2 "Active" 3 "Reserved" ;
VAL_ 487 ACHumidifierReq_TC 0 "No action" 1 "Inactive" 2 "Active" 3 "Reserved" ;
VAL_ 487 ACOzoneReq_TC 0 "No action" 1 "Inactive" 2 "Active" 3 "Reserved" ;
VAL_ 487 ACOzoneReq_VR 0 "No action" 1 "Inactive" 2 "Active" 3 "Reserved" ;
VAL_ 487 ACUltravioletReq_TC 0 "No action" 1 "Inactive" 2 "Active" 3 "Reserved" ;
VAL_ 487 ACUltravioletReq_VR 0 "No action" 1 "Inactive" 2 "Active" 3 "Reserved" ;
VAL_ 487 ACFrntWinHeatCmd_TC 0 "No action" 1 "Pressed" 2 "Reserved" 3 "Reserved" ;
VAL_ 487 ACFrntWinHeatCmd_VR 0 "No action" 1 "Close" 2 "Open" 3 "Reserved" ;
VAL_ 487 DrvDoorALCMFlashFreq 0 "No action" 1 "1Hz" 2 "2Hz" 3 "4Hz" 4 "OFF" 5 "Reserved" 7 "Reserved" ;
VAL_ 487 PassDoorALCMFlashFreq 0 "No action" 1 "1Hz" 2 "2Hz" 3 "4Hz" 4 "OFF" 5 "Reserved" 7 "Reserved" ;
VAL_ 487 LRDoorALCMFlashFreq 0 "No action" 1 "1Hz" 2 "2Hz" 3 "4Hz" 4 "OFF" 5 "Reserved" 7 "Reserved" ;
VAL_ 487 RRDoorALCMFlashFreq 0 "No action" 1 "1Hz" 2 "2Hz" 3 "4Hz" 4 "OFF" 5 "Reserved" 7 "Reserved" ;
VAL_ 487 FootALCMFlashFreq 0 "No action" 1 "1Hz" 2 "2Hz" 3 "4Hz" 4 "OFF" 5 "Reserved" 7 "Reserved" ;
VAL_ 487 LeftPanelALCMFlashFreq 0 "No action" 1 "1Hz" 2 "2Hz" 3 "4Hz" 4 "OFF" 5 "Reserved" 7 "Reserved" ;
VAL_ 487 RightPanelALCMFlashFreq 0 "No action" 1 "1Hz" 2 "2Hz" 3 "4Hz" 4 "OFF" 5 "Reserved" 7 "Reserved" ;
VAL_ 487 ACRearLockReq_VR 0 "No_Action" 1 "Not_Active" 2 "Active" 3 "Reserved" ;
VAL_ 489 HUD_HeightLvlSwt 0 "No action" 1 "Level 1_Low" 2 "Level 2" 3 "Level 3" 4 "Level 4" 5 "Level 5" 6 "Level 6" 7 "Level 7" 8 "Level 8" 9 "Level 9" 10 "Level 10" 11 "Level 11_Middle" 12 "Level 12" 13 "Level 13" 14 "Level 14" 15 "Level 15" 16 "Level 16" 17 "Level 17" 18 "Level 18" 19 "Level 19" 20 "Level 20" 21 "Level 21_High" 22 "Reserved" 31 "Reserved" ;
VAL_ 489 HUD_BrightnessLvlSwt 0 "No action" 1 "Level 1_Low" 2 "Level 2" 3 "Level 3" 4 "Level 4" 5 "Level 5_Middle" 6 "Level 6" 7 "Level 7" 8 "Level 8" 9 "Level 9_High" 10 "Reserved" 15 "Reserved" ;
VAL_ 489 HUD_SwtReq 0 "No action" 1 "OFF" 2 "ON" 3 "Reserved" ;
VAL_ 489 BackReq_AVM 0 "No request" 1 "Request" ;
VAL_ 489 PPMIHWSwtSet 0 "No action" 1 "OFF" 2 "ON" 3 "Reserved" ;
VAL_ 489 PPMIBSRSwtSet 0 "No action" 1 "OFF" 2 "ON" 3 "Reserved" ;
VAL_ 489 PPMIHW_SwtSet 0 "No action" 1 "OFF" 2 "ON" 3 "Reserved" ;
VAL_ 489 PPMIBSR_SwtSet 0 "No action" 1 "OFF" 2 "ON" 3 "Reserved" ;
VAL_ 491 ActvEntryLockSet 0 "OFF" 1 "ON" ;
VAL_ 491 ActvEntryUnlockSet 0 "OFF" 1 "ON" ;
VAL_ 491 LockPromptFunSet 0 "Horn&Light" 1 "HornOnly" 2 "LightOnly" 3 "Reserved" ;
VAL_ 491 BTAPAEntryLockSet 0 "OFF" 1 "ON" ;
VAL_ 491 BTAPALvngUnlockSet 0 "OFF" 1 "ON" ;
VAL_ 491 ClsWinSpdSet 0 "Close" 1 "60kmh" 2 "80kmh" 3 "100kmh" ;
VAL_ 491 DrvSeatMassgLvlSet 0 "OFF" 1 "Level1_Low" 2 "Level2_Middle" 3 "Level3_High" 4 "No Action" 5 "Reserved" 7 "Reserved" ;
VAL_ 491 PassSeatMassgLvlSet 0 "OFF" 1 "Level1_Low" 2 "Level2_Middle" 3 "Level3_High" 4 "No Action" 5 "Reserved" 7 "Reserved" ;
VAL_ 491 SeatKeyMemEna 0 "Disable" 1 "Enable" ;
VAL_ 491 RLSeatMassgLvlSet 0 "OFF" 1 "Level1_Low" 2 "Level2_Middle" 3 "Level3_High" 4 "No Action" 5 "reserved" 7 "reserved" ;
VAL_ 491 RRSeatMassgLvlSet 0 "OFF" 1 "Level1_Low" 2 "Level2_Middle" 3 "Level3_High" 4 "No Action" 5 "Reserved" 7 "Reserved" ;
VAL_ 491 DrvDoorALCMClrSet 0 "Colour set 0-63" 63 "Colour set 0-63" 64 "No action" 65 "Reserved" 127 "Reserved" ;
VAL_ 491 PassDoorALCMClrSet 0 "Colour set 0-63" 63 "Colour set 0-63" 64 "No action" 65 "Reserved" 127 "Reserved" ;
VAL_ 491 LRDoorALCMClrSet 0 "Colour set 0-63" 63 "Colour set 0-63" 64 "No action" 65 "Reserved" 127 "Reserved" ;
VAL_ 491 DrvDoorALCMSwt 0 "OFF" 1 "ON" ;
VAL_ 491 PassDoorALCMSwt 0 "OFF" 1 "ON" ;
SIG_GROUP_ 241 BMS4 1 : CheckSum_BMS4 BMS_PackCurr BMS_PackVolt BMS_PowerDownCmplt BMS_BattPoweErr BMS_ErrCategory RollingCounter_BMS4;
SIG_GROUP_ 311 ESP2_ESP_FD2 1 : CheckSum_ESP2 HDCCtrl HDCFault CDPActv AVHSts AVHErrSts DrivingModReq_ESP Over_Spd_Warn FourL_Warn DrivingModDis Shift_N_Warn TAB_Sts RollingCounter_ESP2;
SIG_GROUP_ 311 ESP1_ESP_FD2 1 : CheckSum_ESP1 ESPFailSts ESPActvInfoLmp ESPFuncOffSts IMC_Actv RollingCounter_ESP1;
SIG_GROUP_ 311 ABS3_ESP_FD2 1 : CheckSum_ABS3 ABSFailSts EBDFailSts VehSpdVld VehSpd ABSActv VehOdoInfoSts VehOdoInfo RollingCounter_ABS3;
SIG_GROUP_ 327 EPS_FD1 1 : CheckSum_EPS1 EPS_FailSts EPS_SteerMod SteerCorrnRmn SteerCorrnResp RollingCounter_EPS1;
SIG_GROUP_ 363 EPB1 1 : CheckSum_EPB1 PressBrakePedalPointOut EPBSts EPBErrSts EPBRedLmpSts EPBTextDisp RollingCounter_EPB1;
