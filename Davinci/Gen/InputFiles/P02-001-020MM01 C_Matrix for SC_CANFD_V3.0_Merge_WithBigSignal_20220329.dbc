VERSION "created by canmatrix"

NS_ :

BS_:

BU_: CEM HUT GW T_BOX XBOX_D DVR Tester

BO_ 796 HUT13: 8 HUT
 SG_ AudioMuteSts : 15|2@0+ (1,0) [0|3] ""  T_BOX
 SG_ OrvmPosnEnaSts : 13|3@0+ (1,0) [0|7] ""  CEM
 SG_ ORVMFoldSwt_HUT : 23|2@0+ (1,0) [0|3] ""  CEM
 SG_ ORVMLensAdjmt_HUT : 31|4@0+ (1,0) [0|15] ""  CEM
 SG_ DrvSeatAdjmt_HUT : 27|4@0+ (1,0) [0|15] ""  CEM
 SG_ DrivingModReq_VR : 39|4@0+ (1,0) [0|15] "" Vector__XXX
 SG_ DWD_WorkCmd : 60|1@0+ (1,0) [0|1] ""  GW
 SG_ DampgDrvModeReq : 55|2@0+ (1,0) [0|3] "" Vector__XXX
 SG_ VSGSwtSet : 8|1@0+ (1,0) [0|1] ""  GW
 SG_ HUT13_0x31C : 0|64@1+ (1,0) [0|0] "" Vector__XXX

BO_ 805 HUD1: 8 GW
 SG_ HUD_SwtSts : 8|1@0+ (1,0) [0|1] ""  HUT
 SG_ HUD_BrightnessLvl : 15|4@0+ (1,0) [0|15] ""  HUT
 SG_ HUD_HeightLvl : 22|5@0+ (1,0) [0|31] ""  HUT
 SG_ HUD_UIMod : 60|1@0+ (1,0) [0|1] ""  HUT
 SG_ HUD_UIModVld : 61|1@0+ (1,0) [0|1] ""  HUT
 SG_ HUD_Manufactor : 47|3@0+ (1,0) [0|7] ""  HUT
 SG_ HUD_ReslType : 44|3@0+ (1,0) [0|7] ""  HUT
 SG_ HUD_UIModDefd : 34|3@0+ (1,0) [0|7] ""  HUT
 SG_ HUD1_0x325 : 0|64@1+ (1,0) [0|0] ""  HUT

BO_ 816 HCM_R2: 8 GW
 SG_ Checksum_HCM_R2 : 7|8@0+ (1,0) [0|255] ""  HUT
 SG_ RightLightShowSts : 15|5@0+ (1,0) [0|31] ""  HUT
 SG_ FRMusicLightShowSts : 10|2@0+ (1,0) [0|3] ""  HUT,T_BOX
 SG_ RollingCounter_HCM_R2 : 59|4@0+ (1,0) [0|15] ""  HUT
 SG_ HCM_R2_0x330 : 0|64@1+ (1,0) [0|0] ""  HUT

BO_ 817 HUT10: 8 HUT
 SG_ ACDualReq_VR : 11|2@0+ (1,0) [0|3] ""  GW,CEM
 SG_ ACAQSReq_VR : 9|2@0+ (1,0) [0|3] ""  GW,CEM
 SG_ ACRearDefrstReq_VR : 41|2@0+ (1,0) [0|3] ""  GW,CEM
 SG_ ACPassTempReq_VR : 53|6@0+ (0.5,15.5) [16|32] "Ã‚Â°C"  GW,CEM
 SG_ ACAIUReq_VR : 57|2@0+ (1,0) [0|3] ""  GW,CEM
 SG_ ALCMStatSwt : 47|1@0+ (1,0) [0|1] ""  CEM
 SG_ ALCMDynSwt : 46|1@0+ (1,0) [0|1] ""  CEM
 SG_ ALCMClrSet : 37|6@0+ (1,0) [0|63] ""  CEM
 SG_ ALCMRhmSwt : 24|1@0+ (1,0) [0|1] ""  CEM
 SG_ IPVolSet : 63|6@0+ (1,0) [0|63] ""  GW
 SG_ PASSwtReq_VR : 55|2@0+ (1,0) [0|3] ""  CEM
 SG_ HUT_BeanIDReq : 43|2@0+ (1,0) [0|3] ""  GW
 SG_ HUT_EgyRecvrySet : 5|2@0+ (1,0) [0|3] ""  GW
 SG_ HUT10_0x331 : 0|64@1+ (1,0) [0|0] "" Vector__XXX

BO_ 818 RFCM_L1: 8 GW
 SG_ RFLLightShowSts : 23|5@0+ (1,0) [0|31] ""  HUT,T_BOX
 SG_ RFCM_L1_0x332 : 0|64@1+ (1,0) [0|0] ""  HUT

BO_ 819 RFCM_R1: 8 GW
 SG_ RFRLightShowSts : 23|5@0+ (1,0) [0|31] ""  HUT,T_BOX
 SG_ RFCM_R1_0x333 : 0|64@1+ (1,0) [0|0] ""  HUT

BO_ 825 HUT25: 8 HUT
 SG_ HUT_RemtEngCtrl : 27|2@0+ (1,0) [0|3] ""  T_BOX
 SG_ ACDrvSetTempReq_ETC_VR : 43|5@0+ (1,0) [0|31] "" Vector__XXX
 SG_ ACDrvSetTempSteplsReq_ETC_TC : 54|5@0+ (1,0) [0|31] "" Vector__XXX
 SG_ HUT_ChrgnMode : 29|2@0+ (1,0) [0|3] ""  GW
 SG_ HUT_BattKeepTemp : 25|2@0+ (1,0) [0|3] ""  GW
 SG_ HUT_IntelEngIdlChrgnSet : 49|2@0+ (1,0) [0|3] ""  GW
 SG_ HUT_IntelBattTempMagSet : 57|2@0+ (1,0) [0|3] ""  GW
 SG_ HUT_BattSOCLim : 63|3@0+ (1,0) [0|7] ""  GW
 SG_ HUT25_0x339 : 0|64@1+ (1,0) [0|0] "" Vector__XXX

BO_ 827 HUT17: 8 HUT
 SG_ BackgroundLightLvlSet : 39|4@0+ (1,0) [0|15] ""  CEM
 SG_ ManCmpSet : 35|4@0+ (1,0) [0|15] "" Vector__XXX
 SG_ DispModSet : 47|2@0+ (1,0) [0|3] "" Vector__XXX
 SG_ WPC_SwtReq : 23|2@0+ (1,0) [0|3] ""  GW
 SG_ AVMSwtReq : 19|1@0+ (1,0) [0|1] ""  GW
 SG_ NaviMediaVolLvlReq : 31|4@0+ (1,0) [0|15] ""  GW
 SG_ AVMMediaVolLvlReq : 27|4@0+ (1,0) [0|15] ""  GW
 SG_ FPASChanSwtReq : 18|1@0+ (1,0) [0|1] ""  GW
 SG_ RPASChanSwtReq : 17|1@0+ (1,0) [0|1] ""  GW
 SG_ ACRearBlwrSpdReq_VR : 3|4@0+ (1,0) [0|15] ""  GW,CEM
 SG_ ACRearBlwrsteplsSpdReq_TC : 7|4@0+ (1,0) [0|15] ""  GW,CEM
 SG_ PLGReq_VR : 55|2@0+ (1,0) [0|3] ""  CEM
 SG_ ACRearAirDistribModReq_VR : 42|3@0+ (1,0) [0|7] ""  GW,CEM
 SG_ ACZoneReq_VR : 9|2@0+ (1,0) [0|3] ""  GW,CEM
 SG_ OPDSwtSts : 53|2@0+ (1,0) [0|3] ""  GW
 SG_ HUT17_0x33B : 0|64@1+ (1,0) [0|0] "" Vector__XXX

BO_ 833 TPMS1: 16 CEM
 SG_ FLTirePressIndSts : 15|3@0+ (1,0) [0|7] ""  HUT,T_BOX
 SG_ FRTirePressIndSts : 12|3@0+ (1,0) [0|7] ""  HUT,T_BOX
 SG_ TirePressSysFailrIndcn : 9|2@0+ (1,0) [0|3] ""  HUT,T_BOX
 SG_ RLTirePressIndSts : 23|3@0+ (1,0) [0|7] ""  HUT,T_BOX
 SG_ RRTirePressIndSts : 20|3@0+ (1,0) [0|7] ""  HUT,T_BOX
 SG_ FLTireTempSts : 31|2@0+ (1,0) [0|3] ""  HUT,T_BOX
 SG_ FRTireTempSts : 29|2@0+ (1,0) [0|3] ""  HUT,T_BOX
 SG_ RLTireTempSts : 27|2@0+ (1,0) [0|3] ""  HUT,T_BOX
 SG_ RRTireTempSts : 25|2@0+ (1,0) [0|3] ""  HUT,T_BOX
 SG_ FreshnessValue_TPMS1 : 71|16@0+ (1,0) [0|65535] ""  HUT,T_BOX
 SG_ MAC_Check_TPMS1 : 87|48@0+ (1,0) [0|281474976710655] ""  HUT,T_BOX
 SG_ TPMS_AutoLoctSts : 39|4@0+ (1,0) [0|5] ""  T_BOX
 SG_ TPMS1_0x341 : 0|64@1+ (1,0) [0|0] ""  HUT

BO_ 836 ETC3: 8 GW
 SG_ AntiDisIdnResult : 7|2@0+ (1,0) [0|3] ""  HUT
 SG_ SelfChkSts : 5|2@0+ (1,0) [0|3] ""  HUT
 SG_ ActvdSts : 3|2@0+ (1,0) [0|3] ""  HUT
 SG_ ETC3_0x344 : 0|64@1+ (1,0) [0|0] ""  HUT

BO_ 837 BCM3: 16 CEM
 SG_ LasHdLmpSts : 35|1@0+ (1,0) [0|1] ""  HUT
 SG_ AntitheftSts : 15|2@0+ (1,0) [0|3] ""  HUT,T_BOX
 SG_ DrvDoorLockSts : 34|1@0+ (1,0) [0|1] ""  HUT,T_BOX
 SG_ DoorLockSts : 13|2@0+ (1,0) [0|3] ""  HUT,T_BOX
 SG_ HiLowBeamSts : 33|2@0+ (1,0) [0|2] ""  HUT
 SG_ FreshnessValue_BCM3 : 71|16@0+ (1,0) [0|65535] ""  HUT,T_BOX
 SG_ MAC_Check_BCM3 : 87|48@0+ (1,0) [0|281474976710655] ""  HUT,T_BOX
 SG_ RLDoorLockSts : 11|1@0+ (1,0) [0|1] ""  T_BOX
 SG_ PassDoorLockSts : 10|1@0+ (1,0) [0|1] ""  T_BOX
 SG_ RRDoorLockSts : 9|1@0+ (1,0) [0|1] ""  T_BOX
 SG_ HazardLmpSwtSts : 8|1@0+ (1,0) [0|1] ""  T_BOX
 SG_ LRPosnLmpSts : 19|1@0+ (1,0) [0|1] ""  T_BOX
 SG_ RRPosnLmpSts : 18|1@0+ (1,0) [0|1] ""  T_BOX
 SG_ BCM3_0x345 : 0|64@1+ (1,0) [0|0] ""  HUT

BO_ 840 HUT16: 8 HUT
 SG_ PowerSet : 39|1@0+ (1,0) [0|1] ""  GW
 SG_ HUT_CallSts_Dialing : 38|1@0+ (1,0) [0|1] "" Vector__XXX
 SG_ HUT_CallSts_IncomingCall : 37|1@0+ (1,0) [0|1] "" Vector__XXX
 SG_ HUT_CallSts_ongoing : 36|1@0+ (1,0) [0|1] "" Vector__XXX
 SG_ HUT_CallTime : 15|24@0+ (1,0) [0|359999] "" Vector__XXX
 SG_ HUT16_0x348 : 0|64@1+ (1,0) [0|0] "" Vector__XXX

BO_ 842 IP3: 16 HUT
 SG_ IP_RemainDistance : 15|12@0+ (1,0) [0|2000] "km"  T_BOX
 SG_ IP_InstFuelConsUnit : 19|1@0+ (1,0) [0|1] "" Vector__XXX
 SG_ IP_EBDFailSts : 18|1@0+ (1,0) [0|1] "" Vector__XXX
 SG_ IP_AvgFuelCons : 31|12@0+ (0.01,0) [0|29.99] "L100km"  T_BOX
 SG_ IP_InstFuelCons : 35|14@0+ (0.01,0) [0|99.99] "L100km"  T_BOX
 SG_ IP3_0x34A : 0|128@1+ (1,0) [0|0] "" Vector__XXX

BO_ 845 BCM18: 8 CEM
 SG_ ColMemPosnSetSwtFB : 15|3@0+ (1,0) [0|7] ""  HUT
 SG_ BCM18_0x34D : 0|64@1+ (1,0) [0|0] ""  HUT

BO_ 849 ABM1: 16 GW
 SG_ CheckSum_ABM1 : 7|8@0+ (1,0) [0|255] ""  HUT
 SG_ SecRowLSBR : 14|1@0+ (1,0) [0|1] ""  HUT
 SG_ AirbFailLmpCmd : 13|1@0+ (1,0) [0|1] ""  HUT
 SG_ SecRowMidSBR : 12|1@0+ (1,0) [0|1] ""  HUT
 SG_ DrvSBR : 11|1@0+ (1,0) [0|1] ""  HUT
 SG_ SecRowRSBR : 10|1@0+ (1,0) [0|1] ""  HUT
 SG_ PassSBR : 9|1@0+ (1,0) [0|1] ""  HUT
 SG_ PassSBR_Visual : 27|2@0+ (1,0) [0|3] ""  HUT
 SG_ DrvSBR_Visual : 25|2@0+ (1,0) [0|3] ""  HUT
 SG_ SecRowLSBR_Visual : 29|2@0+ (1,0) [0|3] ""  HUT
 SG_ SecRowMidSBR_Visual : 31|2@0+ (1,0) [0|3] ""  HUT
 SG_ SecRowRSBR_Visual : 33|2@0+ (1,0) [0|3] ""  HUT
 SG_ CrashOutputSts : 23|8@0+ (1,0) [0|18] ""  HUT,T_BOX
 SG_ RollingCounter_ABM1 : 59|4@0+ (1,0) [0|15] ""  HUT
 SG_ FreshnessValue_ABM1 : 71|16@0+ (1,0) [0|65535] ""  HUT
 SG_ MAC_Check_ABM1 : 87|48@0+ (1,0) [0|281474976710655] ""  HUT
 SG_ ABM1_0x351 : 0|64@1+ (1,0) [0|0] ""  HUT

BO_ 862 CP1: 8 CEM
 SG_ RoofModFb : 8|1@0+ (1,0) [0|1] ""  HUT
 SG_ AllTerrainDislFb : 9|1@0+ (1,0) [0|1] ""  HUT
 SG_ ElecSideStepSysFb : 10|1@0+ (1,0) [0|1] ""  HUT
 SG_ CP1_0x35E : 0|64@1+ (1,0) [0|0] ""  HUT

BO_ 871 HUT1: 8 HUT
 SG_ DomeLmpDlyTimSet : 7|3@0+ (1,0) [0|7] ""  CEM
 SG_ FolwMeHomeDlyTimSet : 3|3@0+ (1,0) [0|7] ""  CEM
 SG_ TranPMode_Req : 15|1@0+ (1,0) [0|1] ""  GW,CEM
 SG_ RearviewFoldModSet : 14|1@0+ (1,0) [0|1] ""  CEM
 SG_ BattSaveDelayTimeSet : 13|2@0+ (1,0) [0|3] ""  CEM
 SG_ ACDualReq_TC : 21|2@0+ (1,0) [0|3] ""  GW
 SG_ ACAutoModReq_TC : 19|2@0+ (1,0) [0|3] ""  GW
 SG_ ACAirInletReq_TC : 17|2@0+ (1,0) [0|3] ""  GW
 SG_ ACFrntHMIDis_TC : 33|1@0+ (1,0) [0|1] ""  GW
 SG_ ACRearHMIDis_TC : 32|1@0+ (1,0) [0|1] ""  GW
 SG_ ACAQSReq_TC : 31|2@0+ (1,0) [0|3] ""  GW
 SG_ ACCmprReq_TC : 29|2@0+ (1,0) [0|3] ""  GW
 SG_ ACFrntDefrstReq_TC : 27|2@0+ (1,0) [0|3] ""  GW
 SG_ ACFrntBlwrSpdDecReq_TC : 25|2@0+ (1,0) [0|3] ""  GW
 SG_ ACRearBlwrSpdDecReq_TC : 23|1@0+ (1,0) [0|1] ""  GW
 SG_ ACRearBlwrSpdIncReq_TC : 22|1@0+ (1,0) [0|1] ""  GW
 SG_ DrvDrowsnsDetnSet : 36|1@0+ (1,0) [0|1] ""  CEM
 SG_ ACFrntBlwrSpdIncReq_TC : 47|2@0+ (1,0) [0|3] ""  GW
 SG_ ACDrvAirDistribModReq_TC : 45|3@0+ (1,0) [0|7] ""  GW
 SG_ ACDrvTempDecReq_TC : 42|2@0+ (1,0) [0|3] ""  GW
 SG_ ChairMemPosnEna : 40|1@0+ (1,0) [0|1] ""  CEM
 SG_ ACDrvTempIncReq_TC : 55|2@0+ (1,0) [0|3] ""  GW
 SG_ ACFrntPassTempDecReq_TC : 53|2@0+ (1,0) [0|3] ""  GW
 SG_ ACFrntPassTempIncReq_TC : 51|2@0+ (1,0) [0|3] ""  GW
 SG_ ACAIUReq_TC : 48|1@0+ (1,0) [0|1] ""  GW
 SG_ ACOffReq_TC : 63|2@0+ (1,0) [0|3] ""  GW
 SG_ ACBlwrsteplsSpdReq_TC : 59|4@0+ (1,0) [0|15] ""  GW
 SG_ ACZoneReq_TC : 4|1@0+ (1,0) [0|1] ""  GW
 SG_ HUT1_0x367 : 0|64@1+ (1,0) [0|0] "" Vector__XXX

BO_ 873 HUT2: 8 HUT
 SG_ RearWinHeatCmd_TC : 41|2@0+ (1,0) [0|3] ""  GW
 SG_ AMP_MediaCallSourceSet : 7|4@0+ (1,0) [0|15] ""  GW
 SG_ AMP_NaviSourceSet : 39|3@0+ (1,0) [0|7] ""  GW
 SG_ AMP_BeepSourceSet : 2|3@0+ (1,0) [0|7] ""  GW
 SG_ AMP_LRAudioBalanceSet : 15|5@0+ (1,0) [0|20] ""  GW
 SG_ AMP_AudioVolVSCModReq : 9|2@0+ (1,0) [0|3] ""  GW
 SG_ AMP_FRAudioFaderSet : 23|5@0+ (1,0) [0|20] ""  GW
 SG_ AMP_LRDrvSideSet : 17|1@0+ (1,0) [0|1] ""  GW
 SG_ AMP_LowFrqAudioSet : 31|5@0+ (1,0) [0|20] ""  GW
 SG_ AMP_MuteSet : 25|1@0+ (1,0) [0|1] ""  GW
 SG_ AMP_MidFrqAudioSet : 47|5@0+ (1,0) [0|20] ""  GW
 SG_ AMP_HighFrqAudioSet : 55|5@0+ (1,0) [0|20] ""  GW
 SG_ T_box_ECallSet : 50|1@0+ (1,0) [0|1] ""  GW
 SG_ QLISurroundSet : 49|1@0+ (1,0) [0|1] ""  GW
 SG_ ANCSwtSet : 36|1@0+ (1,0) [0|1] ""  GW
 SG_ FrntWinHeatSwt : 42|1@0+ (1,0) [0|1] ""  CEM
 SG_ HUT2_0x369 : 0|64@1+ (1,0) [0|0] "" Vector__XXX

BO_ 875 HUT3: 8 HUT
 SG_ AMP_HFMVolSet : 7|6@0+ (1,0) [0|39] ""  GW
 SG_ AMP_TTSVolSet_VR : 15|6@0+ (1,0) [0|39] ""  GW
 SG_ AMP_NaviVolSet : 23|6@0+ (1,0) [0|39] ""  GW
 SG_ AMP_MainVolSet : 31|6@0+ (1,0) [0|39] ""  GW
 SG_ AMP_GetSWInfoReq : 33|1@0+ (1,0) [0|1] ""  GW
 SG_ AMP_GetHWInfoReq : 32|1@0+ (1,0) [0|1] ""  GW
 SG_ AMP_GetTempInfoReq : 41|1@0+ (1,0) [0|1] ""  GW
 SG_ AMP_GetIntVoltInfoReq : 40|1@0+ (1,0) [0|1] ""  GW
 SG_ AMP_GetDTCInfoReq : 49|1@0+ (1,0) [0|1] ""  GW
 SG_ IESS_MdlSwtReq : 35|2@0+ (1,0) [0|3] ""  GW
 SG_ IESS_MdlInfoReq : 1|1@0+ (1,0) [0|1] ""  GW
 SG_ AMP_BestListegPosnReq : 39|3@0+ (1,0) [0|7] ""  GW
 SG_ AMP_Clari_FiReq : 43|1@0+ (1,0) [0|1] ""  GW
 SG_ HUT3_0x36B : 0|64@1+ (1,0) [0|0] "" Vector__XXX

BO_ 877 HUT4: 8 HUT
 SG_ DrvSeatVentnLvlSet : 9|2@0+ (1,0) [0|3] ""  CEM
 SG_ PassSeatVentnLvlSet : 23|2@0+ (1,0) [0|3] ""  CEM
 SG_ ACAutoModReq_VR : 25|2@0+ (1,0) [0|3] ""  GW
 SG_ ACCmprReq_VR : 39|2@0+ (1,0) [0|3] ""  GW
 SG_ ACPowerReq_VR : 37|2@0+ (1,0) [0|3] ""  GW
 SG_ ACBlwrSpdReq_VR : 35|4@0+ (1,0) [0|15] ""  GW
 SG_ ACDrvTempReq_VR : 47|6@0+ (0.5,15.5) [16|32] "Ã‚Â°C"  GW
 SG_ ACFrntDefrostReq_VR : 41|2@0+ (1,0) [0|3] ""  GW
 SG_ ACDrvAirDistribModReq_VR : 55|3@0+ (1,0) [0|7] ""  GW
 SG_ ACAirInletReq_VR : 52|2@0+ (1,0) [0|3] ""  GW
 SG_ ACModReq_HUT : 63|2@0+ (1,0) [0|3] "" Vector__XXX
 SG_ ElecSideSteppingSysSet : 21|1@0+ (1,0) [0|1] ""  CEM
 SG_ RoofModSet : 18|1@0+ (1,0) [0|1] ""  CEM
 SG_ AllTerrainDislSet : 29|1@0+ (1,0) [0|1] ""  CEM
 SG_ RemUpgrdSts : 56|1@0+ (1,0) [0|1] ""  CEM,T_BOX
 SG_ ACRearAutoModReq_TC : 13|1@0+ (1,0) [0|1] ""  GW,CEM
 SG_ DrvSeatSupportLvlSet : 7|3@0+ (1,0) [0|7] ""  CEM
 SG_ PassSeatSupportLvlSet : 2|3@0+ (1,0) [0|7] ""  CEM
 SG_ ACRearOffReq_TC : 10|1@0+ (1,0) [0|3] ""  GW,CEM
 SG_ ACRearAirDistribModReq_TC : 50|3@0+ (1,0) [0|7] ""  GW,CEM
 SG_ RLSeatVentnLvlSet : 20|2@0+ (1,0) [0|3] ""  CEM
 SG_ RRSeatVentnLvlSet : 17|2@0+ (1,0) [0|3] ""  CEM
 SG_ DrvSeatHeatgLvlSet : 15|2@0+ (1,0) [0|3] ""  CEM
 SG_ PassSeatHeatgLvlSet : 12|2@0+ (1,0) [0|3] ""  CEM
 SG_ HUT4_0x36D : 0|64@1+ (1,0) [0|0] "" Vector__XXX

BO_ 880 HUT34: 8 HUT
 SG_ TimeMod : 16|1@0+ (1,0) [0|1] ""  GW,CEM
 SG_ TimeIndcn : 17|1@0+ (1,0) [0|1] ""  GW,CEM
 SG_ Time_Hour : 15|5@0+ (1,0) [0|31] ""  GW,CEM,XBOX_D,T_BOX
 SG_ Time_Minutes : 23|6@0+ (1,0) [0|63] ""  GW,CEM,XBOX_D,T_BOX
 SG_ Time_Second : 31|6@0+ (1,0) [0|63] ""  GW,CEM,XBOX_D,T_BOX
 SG_ Time_Year_Left : 39|4@0+ (1,0) [0|15] ""  GW,CEM,XBOX_D,T_BOX
 SG_ Time_Year_Right : 35|4@0+ (1,0) [0|15] ""  GW,CEM,XBOX_D,T_BOX
 SG_ Time_Month : 47|4@0+ (1,0) [0|15] ""  GW,CEM,XBOX_D,T_BOX
 SG_ Time_Day : 55|5@0+ (1,0) [0|31] ""  GW,CEM,XBOX_D,T_BOX
 SG_ HUT_TgtSOCSet : 50|6@0+ (1,30) [30|80] ""  GW
 SG_ HUT34_0x370 : 0|64@1+ (1,0) [0|0] "" Vector__XXX

BO_ 881 ECM3: 8 GW
 SG_ BaroPressure : 15|8@0+ (0.59,0) [0|149.86] "kPa"  HUT
 SG_ EngCoolantTemp : 31|8@0+ (0.75,-48) [-48|143.25] "Deg C"  HUT,T_BOX
 SG_ GPF_Warning : 47|2@0+ (1,0) [0|3] ""  HUT
 SG_ GentrWarnLmpSts : 45|1@0+ (1,0) [0|1] ""  HUT
 SG_ EngClntTempWarn : 40|1@0+ (1,0) [0|1] ""  HUT,T_BOX
 SG_ EngClntTempVldty : 55|2@0+ (1,0) [0|2] ""  HUT,T_BOX
 SG_ SS_Screen_tip : 61|1@0+ (1,0) [0|1] ""  HUT
 SG_ SSSSetSts : 44|1@0+ (1,0) [0|1] ""  HUT
 SG_ SS_Enable_Lamp : 43|1@0+ (1,0) [0|1] ""  HUT
 SG_ SS_Fault_Lamp : 42|1@0+ (1,0) [0|1] ""  HUT
 SG_ MaxEngTrqNorm : 23|8@0+ (5,0) [0|650] "Nm"  HUT
 SG_ AGS_Failure : 49|1@0+ (1,0) [0|1] ""  HUT
 SG_ ECM3_0x371 : 0|64@1+ (1,0) [0|0] ""  HUT

BO_ 901 AC2: 8 GW
 SG_ ACFrntDefrstSts : 40|1@0+ (1,0) [0|1] ""  HUT,T_BOX
 SG_ ACHMIDispCmd : 13|2@0+ (1,0) [0|3] ""  HUT,T_BOX
 SG_ ACFrntBlwrSpd : 11|4@0+ (1,0) [0|15] ""  HUT,T_BOX
 SG_ ACOpenSts : 14|1@0+ (1,0) [0|1] ""  HUT,T_BOX
 SG_ ACDualModEnaSts : 39|1@0+ (1,0) [0|1] ""  HUT
 SG_ ACDrvTemp_ATC : 38|6@0+ (0.5,16) [16|32] "Ã‚Â°C"  HUT,T_BOX
 SG_ ACAmbTemp : 23|8@0+ (0.5,-40) [-40|86.5] "Ã‚Â°C"  HUT
 SG_ ACAirInletSts : 42|2@0+ (1,0) [0|3] ""  HUT
 SG_ ACFrntPasstTemp_ATC : 53|6@0+ (0.5,16) [16|32] "Ã‚Â°C"  HUT,T_BOX
 SG_ ACAutoModEnaSts : 32|1@0+ (1,0) [0|1] ""  HUT,T_BOX
 SG_ ACCmprEnaSts : 43|1@0+ (1,0) [0|1] ""  HUT
 SG_ ACRearWinHeatSts : 15|1@0+ (1,0) [0|1] ""  HUT,T_BOX
 SG_ ACAutoDefrstModEnaSts : 63|1@0+ (1,0) [0|1] ""  HUT
 SG_ AC2_0x385 : 0|64@1+ (1,0) [0|0] ""  HUT

BO_ 917 TPMS2: 16 CEM
 SG_ FLTirePress : 7|8@0+ (1.3725,0) [0|348.615] "kPa"  HUT,T_BOX
 SG_ FLTireTemp : 15|8@0+ (1,-50) [-50|204] "Ã‚Â°C"  HUT,T_BOX
 SG_ FRTirePress : 23|8@0+ (1.3725,0) [0|348.615] "kPa"  HUT,T_BOX
 SG_ FRTireTemp : 31|8@0+ (1,-50) [-50|204] "Ã‚Â°C"  HUT,T_BOX
 SG_ RLTirePress : 39|8@0+ (1.3725,0) [0|348.615] "kPa"  HUT,T_BOX
 SG_ RLTireTemp : 47|8@0+ (1,-50) [-50|204] "Ã‚Â°C"  HUT,T_BOX
 SG_ RRTirePress : 55|8@0+ (1.3725,0) [0|348.615] "kPa"  HUT,T_BOX
 SG_ RRTireTemp : 63|8@0+ (1,-50) [-50|204] "Ã‚Â°C"  HUT,T_BOX
 SG_ FreshnessValue_TPMS2 : 71|16@0+ (1,0) [0|65535] ""  HUT,T_BOX
 SG_ MAC_Check_TPMS2 : 87|48@0+ (1,0) [0|281474976710655] ""  HUT,T_BOX
 SG_ TPMS2_0x395 : 0|64@1+ (1,0) [0|0] ""  HUT

BO_ 943 HUT12: 8 HUT
 SG_ WeatherCdn : 39|7@0+ (1,0) [0|127] "" Vector__XXX
 SG_ PitchAng : 23|7@0+ (1,0) [0|90] ""  GW
 SG_ PitchAngSign : 31|1@0+ (1,0) [0|1] ""  GW
 SG_ HUT12_0x3AF : 0|64@1+ (1,0) [0|0] "" Vector__XXX

BO_ 949 ECM19: 8 GW
 SG_ ECM_VIN : 7|64@0+ (1,0) [0|1.84467440737096E+019] ""  HUT
 SG_ ECM19_0x3B5 : 0|64@1+ (1,0) [0|0] ""  HUT

BO_ 951 ECM20: 8 GW
 SG_ ECM_VehDstBackup : 7|24@0+ (0.1,0) [0|999999.9] "Km"  HUT
 SG_ ECM20_0x3B7 : 0|64@1+ (1,0) [0|0] ""  HUT

BO_ 962 HCU_HC7: 8 GW
 SG_ HCU_RecupPwr : 25|10@0+ (10,0) [0|10230] "Wh"  HUT
 SG_ HCU_HiVoltInterlockSts_RM : 53|1@0+ (1,0) [0|1] ""  T_BOX
 SG_ HCU_EVContnsDistance : 23|8@0+ (1,0) [0|254] "Km"  HUT,T_BOX
 SG_ HCU_EVContnsDistanceVld : 52|1@0+ (1,0) [0|1] ""  HUT
 SG_ HCU_EgyUsed : 47|10@0+ (0.01,0) [0|10.23] "KWh"  HUT
 SG_ HCU_HC7_0x3C2 : 0|64@1+ (1,0) [0|0] ""  HUT

BO_ 993 AMP1: 8 GW
 SG_ AMP_SWVersion : 7|16@0+ (1,0) [0|65535] ""  HUT
 SG_ AMP_HWVersion : 23|16@0+ (1,0) [0|65535] ""  HUT
 SG_ AMP_Chan1DTCInfo : 39|1@0+ (1,0) [0|1] ""  HUT
 SG_ AMP_Chan2DTCInfo : 38|1@0+ (1,0) [0|1] ""  HUT
 SG_ AMP_Chan3DTCInfo : 37|1@0+ (1,0) [0|1] ""  HUT
 SG_ AMP_Chan4DTCInfo : 36|1@0+ (1,0) [0|1] ""  HUT
 SG_ AMP_Chan5DTCInfo : 35|1@0+ (1,0) [0|1] ""  HUT
 SG_ AMP_Chan6DTCInfo : 34|1@0+ (1,0) [0|1] ""  HUT
 SG_ AMP_Chan7DTCInfo : 33|1@0+ (1,0) [0|1] ""  HUT
 SG_ AMP_Chan8DTCInfo : 32|1@0+ (1,0) [0|1] ""  HUT
 SG_ AMP_TempValue : 47|8@0+ (1,-50) [-50|204] ""  HUT
 SG_ AMP_TempSts : 55|2@0+ (1,0) [0|3] ""  HUT
 SG_ AMP_VolValue : 63|8@0+ (0.1,0) [0|25.5] ""  HUT
 SG_ BestListegPosnResp : 52|3@0+ (1,0) [0|7] ""  HUT
 SG_ Clari_FiResp : 53|1@0+ (1,0) [0|1] ""  HUT
 SG_ AMP1_0x3E1 : 0|64@1+ (1,0) [0|0] ""  HUT

BO_ 995 AMP2: 16 GW
 SG_ MediaCallSourceState : 7|4@0+ (1,0) [0|15] ""  HUT
 SG_ BeepSourceSts : 2|3@0+ (1,0) [0|7] ""  HUT
 SG_ BalanceSetState : 15|5@0+ (1,0) [0|20] ""  HUT
 SG_ VSCModeState : 9|2@0+ (1,0) [0|3] ""  HUT
 SG_ FadeSetState : 23|5@0+ (1,0) [0|20] ""  HUT
 SG_ DriveSideSts : 17|1@0+ (1,0) [0|1] ""  HUT
 SG_ BassSetState : 31|5@0+ (1,0) [0|20] ""  HUT
 SG_ MuteState : 25|1@0+ (1,0) [0|1] ""  HUT
 SG_ NaviSourceState : 39|3@0+ (1,0) [0|7] ""  HUT
 SG_ MidrangeSetState : 47|5@0+ (1,0) [0|20] ""  HUT
 SG_ T_box_ECallSts : 42|1@0+ (1,0) [0|1] ""  HUT
 SG_ GetHUTInfoSts : 41|1@0+ (1,0) [0|1] ""  HUT
 SG_ TrebleSetState : 55|5@0+ (1,0) [0|20] ""  HUT
 SG_ QLISurroundSetSt : 49|1@0+ (1,0) [0|1] ""  HUT
 SG_ AVMStResp : 3|1@0+ (1,0) [0|1] ""  HUT
 SG_ NaviMediaVolLvlResp : 63|4@0+ (1,0) [0|15] ""  HUT
 SG_ AVMMediaVolLvlResp : 59|4@0+ (1,0) [0|15] ""  HUT
 SG_ FPASChStResp : 10|1@0+ (1,0) [0|1] ""  HUT
 SG_ RPASChStResp : 18|1@0+ (1,0) [0|1] ""  HUT
 SG_ FreshnessValue_AMP2 : 71|16@0+ (1,0) [0|65535] ""  HUT
 SG_ MAC_Check_AMP2 : 87|48@0+ (1,0) [0|281474976710655] ""  HUT
 SG_ AMP2_0x3E3 : 0|64@1+ (1,0) [0|0] ""  HUT

BO_ 997 AMP3: 8 GW
 SG_ HFMVolSetSts : 7|6@0+ (1,0) [0|39] ""  HUT
 SG_ VR_TTSVolSetSts : 15|6@0+ (1,0) [0|39] ""  HUT
 SG_ NaviVolumeSetState : 23|6@0+ (1,0) [0|39] ""  HUT
 SG_ MainVolumeSetState : 31|6@0+ (1,0) [0|39] ""  HUT
 SG_ AMPPowerSts : 42|1@0+ (1,0) [0|1] ""  HUT
 SG_ IPVolSetSts : 39|6@0+ (1,0) [0|39] ""  HUT
 SG_ AMP3_0x3E5 : 0|64@1+ (1,0) [0|0] ""  HUT

BO_ 1001 T_BOX_FD3: 16 T_BOX
 SG_ T_BOX_SysErrSts : 7|5@0+ (1,0) [0|31] ""  GW,HUT
 SG_ T_BOX_SWUpdSts : 18|3@0+ (1,0) [0|7] ""  HUT
 SG_ FreshnessValue_T_BOX_FD3 : 71|16@0+ (1,0) [0|65535] ""  GW,HUT
 SG_ MAC_Check_T_BOX_FD3 : 87|48@0+ (1,0) [0|281474976710655] ""  GW,HUT
 SG_ T_BOX_FD3_0x3E9 : 0|64@1+ (1,0) [0|0] ""  HUT

BO_ 1045 HUT19: 8 HUT
 SG_ ADAS_Meta_MsgTyp : 7|3@0+ (1,0) [0|7] ""  GW
 SG_ ADAS_Meta_MapProvider : 4|3@0+ (1,0) [0|7] ""  GW
 SG_ ADAS_Meta_CountryCode : 1|10@0+ (1,0) [0|1023] ""  GW
 SG_ ADAS_Meta_CycCnt : 23|2@0+ (1,0) [0|3] ""  GW
 SG_ ADAS_Meta_ProtVer_Major : 21|2@0+ (1,0) [0|3] ""  GW
 SG_ ADAS_Meta_ProtVer_MinorSub : 19|3@0+ (1,0) [0|7] ""  GW
 SG_ ADAS_Meta_HwVer : 16|9@0+ (1,0) [0|511] ""  GW
 SG_ ADAS_Meta_DrvSide : 39|1@0+ (1,0) [0|1] ""  GW
 SG_ ADAS_Meta_RegionCode : 38|15@0+ (1,0) [0|32767] ""  GW
 SG_ ADAS_Meta_MapVerQtr : 55|2@0+ (1,0) [0|3] ""  GW
 SG_ ADAS_Meta_MapVerYear : 53|6@0+ (1,0) [0|63] ""  GW
 SG_ ADAS_Meta_SpdUnits : 60|1@0+ (1,0) [0|1] ""  GW
 SG_ ADAS_Meta_ProtVer_Minor : 59|4@0+ (1,0) [0|15] ""  GW
 SG_ HUT19_0x415 : 0|64@1+ (1,0) [0|0] "" Vector__XXX

BO_ 1888 DiagFuncReq: 8 Tester
 SG_ DiagFuncReq : 7|64@0+ (1,0) [0|1.84467440737096E+019] ""  GW,CEM,T_BOX,XBOX_D,DVR,HUT

BO_ 1889 GW_Phy_Req: 8 Tester
 SG_ GW_Phy_Req : 7|64@0+ (1,0) [0|1.84467440737096E+019] ""  GW

BO_ 1918 T_Box_Phy_Req: 8 Tester
 SG_ T_Box_Phy_Req : 7|64@0+ (1,0) [0|1.84467440737096E+019] ""  GW,T_BOX

BO_ 1843 XBOX_D_Phy_Req: 8 Tester
 SG_ XBOX_D_Phy_Req : 7|64@0+ (1,0) [0|1.84467440737096E+019] ""  GW,XBOX_D

BO_ 1907 HUT_Phy_Req: 8 Tester
 SG_ HUT_Phy_Req : 7|64@0+ (1,0) [0|1.84467440737096E+019] ""  GW,HUT

BO_ 1953 GW_Phy_Resp: 8 GW
 SG_ GW_Phy_Resp : 7|64@0+ (1,0) [0|1.84467440737096E+019] ""  Tester

BO_ 1982 T_Box_Phy_Resp: 8 T_BOX
 SG_ T_Box_Phy_Resp : 7|64@0+ (1,0) [0|1.84467440737096E+019] ""  GW,Tester

BO_ 1844 XBOX_D_Phy_Resp: 8 XBOX_D
 SG_ XBOX_D_Phy_Resp : 7|64@0+ (1,0) [0|1.84467440737096E+019] ""  GW,Tester

BO_ 1971 HUT_Phy_Resp: 8 HUT
 SG_ HUT_Phy_Resp : 7|64@0+ (1,0) [0|1.84467440737096E+019] ""  GW,Tester

BO_ 1290 T_Box_NM: 8 T_BOX
 SG_ Destination_T_Box_NM : 7|8@0+ (1,0) [0|255] ""  CEM,XBOX_D,DVR,HUT
 SG_ OpCode_T_Box_NM : 15|8@0+ (1,0) [0|255] ""  CEM,XBOX_D,DVR,HUT

BO_ 1289 HUT_NM: 8 HUT
 SG_ Destination_HUT_NM : 7|8@0+ (1,0) [0|255] ""  CEM,T_BOX,XBOX_D,DVR
 SG_ OpCode_HUT_NM : 15|8@0+ (1,0) [0|255] ""  CEM,T_BOX,XBOX_D,DVR

BO_ 1334 XBOX_D_NM: 8 XBOX_D
 SG_ Destination_XBOX_D_NM : 7|8@0+ (1,0) [0|255] ""  CEM,T_BOX,DVR,HUT
 SG_ OpCode_XBOX_D_NM : 15|8@0+ (1,0) [0|255] ""  CEM,T_BOX,DVR,HUT

BO_ 1281 CEM_NM: 8 CEM
 SG_ Destination_CEM_NM : 7|8@0+ (1,0) [0|255] ""  T_BOX,XBOX_D,DVR,HUT
 SG_ OpCode_CEM_NM : 15|8@0+ (1,0) [0|255] ""  T_BOX,XBOX_D,DVR,HUT

BO_ 1122 HUT_Sync_Req: 16 HUT
 SG_ SyncRequestMessageId : 7|8@0+ (1,0) [0|0] ""  GW
 SG_ SyncRequstReseverData : 15|56@0+ (1,0) [0|0] ""  GW

BO_ 1121 GW_Sync_Req: 16 GW
 SG_ ResetCount : 31|16@0+ (1,0) [0|0] ""  HUT
 SG_ CMACMessageInfo : 47|88@0+ (1,0) [0|0] ""  HUT
 SG_ TripCount : 7|24@0+ (1,0) [0|0] ""  HUT

BO_ 53 PEPS5: 8 CEM
 SG_ PEPS_T_BOXAuth1 : 7|64@0+ (1,0) [0|1.84467440737095E+019] ""  T_BOX

BO_ 54 T_BOX_FD2: 16 T_BOX
 SG_ T_BOX_PEPSAuth1 : 7|64@0+ (1,0) [0|1.84467440737096E+019] ""  CEM

BO_ 70 PEPS11: 8 CEM
 SG_ PEPS_T_BOXAuth2 : 7|64@0+ (1,0) [0|1.84467440737096E+019] ""  T_BOX

BO_ 72 T_BOX_FD7: 16 T_BOX
 SG_ T_BOX_PEPSAuth2 : 7|64@0+ (1,0) [0|1.84467440737096E+019] ""  CEM

BO_ 96 HCU_FD1: 64 GW
 SG_ HCU_BrkPedalSts : 87|2@0+ (1,0) [0|3] ""  T_BOX
 SG_ HCU_BrkPedalStsValid : 84|1@0+ (1,0) [0|1] ""  T_BOX
 SG_ HCU_AccelPedalPosn_Diag : 79|8@0+ (0.3937,0) [0|100.395] "%"  HUT
 SG_ HCU_AccelPedalPosn_DiagValid : 85|1@0+ (1,0) [0|1] ""  HUT
 SG_ HCU_PowertrainSts_0x60 : 303|5@0+ (1,0) [0|31] ""  HUT,XBOX_D,T_BOX
 SG_ HCU_RaceLaunchSts_0x60 : 319|3@0+ (1,0) [0|7] ""  HUT
 SG_ HCU_RaceLaunchAvail_0x60 : 287|2@0+ (1,0) [0|3] ""  HUT
 SG_ HCU_AccelPedalPosn : 103|8@0+ (0.3937,0) [0|100.395] "%"  HUT
 SG_ HCU_AccelPedalPosnValid : 127|1@0+ (1,0) [0|1] ""  HUT
 SG_ HCU_CruiseCtrlSts : 367|4@0+ (1,0) [0|15] ""  HUT
 SG_ HCU_TgtCrsVehSpd : 359|8@0+ (1,0) [0|255] "kphmph"  HUT
 SG_ HCU_TgtCrsVehSpdvalid : 363|1@0+ (1,0) [0|1] ""  HUT
 SG_ HCU_FD1_0x60 : 0|512@1+ (1,0) [0|0] ""  HUT

BO_ 142 ECM_PT5: 8 GW
 SG_ EngTrqCrankshaftLvl : 27|12@0+ (0.25,-224) [-224|799.75] "Nm"  HUT
 SG_ EngTrqCrankshaftLvlValid : 61|1@0+ (1,0) [0|1] ""  HUT
 SG_ ECM_PT5_0x8E : 0|64@1+ (1,0) [0|0] ""  HUT

BO_ 172 P2M1: 8 GW
 SG_ P2M_ActTrq : 38|14@0+ (0.1,-819) [-819|819.1] "Nm"  HUT
 SG_ P2M1_0xAC : 0|64@1+ (1,0) [0|0] ""  HUT

BO_ 190 P2M3: 8 GW
 SG_ P2M_ActSpd : 43|16@0+ (1,-2000) [-2000|10286] "rpm"  HUT,T_BOX
 SG_ P2M_ActHvDcVolt : 15|12@0+ (0.25,0) [0|1023.25] "V"  HUT
 SG_ P2M3_0xBE : 0|64@1+ (1,0) [0|0] ""  HUT

BO_ 249 HCU_HP8: 8 GW
 SG_ HCU_TrqLimMax_Norm : 16|9@0+ (2,0) [0|800] "Nm"  HUT
 SG_ HCU_HP8_0xF9 : 0|64@1+ (1,0) [0|0] ""  HUT

BO_ 279 ECM_PT7: 8 GW
 SG_ EngState_PHEV : 31|3@0+ (1,0) [0|7] ""  HUT,T_BOX
 SG_ CruiseCtrlSts_PHEV : 55|4@0+ (1,0) [0|15] ""  HUT
 SG_ ECM_PT7_0x117 : 0|64@1+ (1,0) [0|0] ""  HUT

BO_ 282 HCU_HP6: 8 GW
 SG_ HCU_GearSts : 36|4@0+ (1,0) [0|15] ""  T_BOX
 SG_ HCU_HybMod : 28|2@0+ (1,0) [0|3] ""  HUT
 SG_ HCU_HybFctnMod : 26|2@0+ (1,0) [0|3] ""  HUT
 SG_ HCU_HP6_0x11A : 0|64@1+ (1,0) [0|0] ""  HUT

BO_ 301 EBOOSTER_FD1: 64 GW
 SG_ EB_AEBIBActv : 13|1@0+ (1,0) [0|1] ""  T_BOX
 SG_ EB_AEBBAActv : 12|1@0+ (1,0) [0|1] ""  T_BOX
 SG_ EB_AEBAvailable : 11|1@0+ (1,0) [0|1] ""  T_BOX
 SG_ EB_TgtRcprtnTrqSts : 145|2@0+ (1,0) [0|3] ""  HUT
 SG_ EBOOSTER_FD1_0x12D : 0|512@1+ (1,0) [0|0] ""  HUT

BO_ 330 HCU_PT5: 8 GW
 SG_ HCUImmoAuthRes : 21|2@0+ (1,0) [0|3] ""  HUT
 SG_ HCU_EVLmpSts : 16|1@0+ (1,0) [0|1] ""  HUT
 SG_ HCU_ECODrvHabit_Indcn : 31|8@0+ (0.1,-10) [-10|10] ""  HUT
 SG_ HCU_TotDrvReqPower_0x14a : 39|8@0+ (1,-100) [-100|100] "%"  HUT
 SG_ HCU_AvailPower_TM : 55|8@0+ (0.5,0) [0|100] "%"  HUT
 SG_ HCU_DrvMod : 15|4@0+ (1,0) [0|15] ""  HUT
 SG_ HCU_PT5_0x14A : 0|64@1+ (1,0) [0|0] ""  HUT

BO_ 448 HCU_PT8: 8 GW
 SG_ HCU_ChrgSysLmpSts : 18|3@0+ (1,0) [0|7] ""  HUT
 SG_ HCU_ChrgSysErr_1 : 31|1@0+ (1,0) [0|1] ""  HUT
 SG_ HCU_ChrgSysErr_2 : 30|1@0+ (1,0) [0|1] ""  HUT
 SG_ HCU_ChrgSysErr_3 : 29|1@0+ (1,0) [0|1] ""  HUT
 SG_ HCU_ChrgSysErr_4 : 28|1@0+ (1,0) [0|1] ""  HUT
 SG_ HCU_ChrgSysErr_5 : 27|1@0+ (1,0) [0|1] ""  HUT
 SG_ HCU_ChrgSysErr_6 : 26|1@0+ (1,0) [0|1] ""  HUT
 SG_ HCU_ChrgSysErr_7 : 25|1@0+ (1,0) [0|1] ""  HUT
 SG_ HCU_ChrgSysErr_8 : 24|1@0+ (1,0) [0|1] ""  HUT
 SG_ HCU_DrvModDisp : 47|4@0+ (1,0) [0|15] ""  HUT
 SG_ HCU_PT8_0x1C0 : 0|64@1+ (1,0) [0|0] ""  HUT

CM_ SG_ 796 AudioMuteSts "Audio Mute Status.";
CM_ SG_ 796 OrvmPosnEnaSts "Outside rear view mirror position set enable ststus";
CM_ SG_ 796 ORVMFoldSwt_HUT "Outside rear-view mirror folding switch";
CM_ SG_ 796 ORVMLensAdjmt_HUT "Lens adjustment for Outside rear-view mirror";
CM_ SG_ 796 DrvSeatAdjmt_HUT "Driver seat adjustment";
CM_ SG_ 796 DrivingModReq_VR "Drive mode voice request
Ã©Â©Â¾Ã©Â©Â¶Ã¦Â¨Â¡Ã¥Â¼ÂÃ¨Â¯Â­Ã©ÂŸÂ³Ã¦ÂŽÂ§Ã¥ÂˆÂ¶Ã¨Â¯Â·Ã¦Â±Â‚Ã¤Â¿Â¡Ã¥ÂÂ·";
CM_ SG_ 796 DWD_WorkCmd "DWD work commandBD1_CAN:To DWD";
CM_ SG_ 796 DampgDrvModeReq "damping drive mode request";
CM_ SG_ 796 VSGSwtSet "Control VSG switch onoff setHC_CAN:To PDCU";
CM_ SG_ 805 HUD_SwtSts "Status of HUD Switch";
CM_ SG_ 805 HUD_BrightnessLvl "Brightness Level of HUD";
CM_ SG_ 805 HUD_HeightLvl "Height Level of HUD";
CM_ SG_ 805 HUD_UIMod "UI Mode of HUD";
CM_ SG_ 805 HUD_UIModVld "UI Mode Valid of HUD";
CM_ SG_ 805 HUD_Manufactor "HUD manufactor";
CM_ SG_ 805 HUD_ReslType "Resolution type of HUD";
CM_ SG_ 805 HUD_UIModDefd "UI Mode Defined of HUD";
CM_ SG_ 816 Checksum_HCM_R2 "Use the checksum strategy from document Ã¢Â€ÂœEnd-to-End Communication Protection SpecificationÃ¢Â€Â";
CM_ SG_ 816 RightLightShowSts "Light show processstatus";
CM_ SG_ 816 FRMusicLightShowSts "Front Right Light show processstatus";
CM_ SG_ 816 RollingCounter_HCM_R2 "Rolling Counter";
CM_ SG_ 817 ACDualReq_VR "AC(Air Conditioning) Dual Request(Voice Request)BD1-CAN To:AC";
CM_ SG_ 817 ACAQSReq_VR "AC(Air Conditioning) AQS(air quality sensor) Request(Voice Request)BD1-CAN To:AC";
CM_ SG_ 817 ACRearDefrstReq_VR "AC(Air Conditioning) Rear Defrost request(Voice Request)BD1-CAN To:AC";
CM_ SG_ 817 ACPassTempReq_VR "AC(Air Conditioning) Front Passenger Temperature Requset(Voice Request)BD1-CAN To:AC";
CM_ SG_ 817 ACAIUReq_VR "AC(Air Conditioning) Control Air Ionizer Unit Request(Voice Request)BD1-CAN To:AC";
CM_ SG_ 817 ALCMStatSwt "Unlimited ALCM(Ambient Light Control Module) static switch";
CM_ SG_ 817 ALCMDynSwt "Unlimited ALCM(Ambient Light Control Module) dynamic switch";
CM_ SG_ 817 ALCMClrSet "Unlimited ALCM(Ambient Light Control Module) colour set";
CM_ SG_ 817 ALCMRhmSwt "ALCM(Ambient Light Control Module) rhythm switch";
CM_ SG_ 817 IPVolSet "IP Volume SetBD2-CAN To:AMP";
CM_ SG_ 817 PASSwtReq_VR "Radar switch Request(Voice Request)";
CM_ SG_ 817 HUT_BeanIDReq "Bluetooth bean ID request by HUTBD1-CAN To:BLE";
CM_ SG_ 817 HUT_EgyRecvrySet "HUT energy recovery setHC_CAN:To PDCU";
CM_ SG_ 818 RFLLightShowSts "Rear fender left light show processstatus";
CM_ SG_ 819 RFRLightShowSts "Rear fender right light show processstatus";
CM_ SG_ 825 HUT_RemtEngCtrl "Remote engine control";
CM_ SG_ 825 ACDrvSetTempReq_ETC_VR "ETC AC(Air Conditioning) Driver Set Temperature Request(Voice Request)";
CM_ SG_ 825 ACDrvSetTempSteplsReq_ETC_TC "ETC AC(Air Conditioning) Driver Set Temperature Stepless Request-Touch Control";
CM_ SG_ 825 HUT_ChrgnMode "Charging mode including Immediate Charging and Delay Charging set on HUTHC_CAN:To PDCU";
CM_ SG_ 825 HUT_BattKeepTemp "Setting Battery Keep Temperature by user on  HUTHC_CAN:To PDCU";
CM_ SG_ 825 HUT_IntelEngIdlChrgnSet "Intelligent  Engine Idle Charging for BMS Setting on HUTHC_CAN:To PDCU";
CM_ SG_ 825 HUT_IntelBattTempMagSet "Intelligent Battery Temperature Management Setting on HUTHC_CAN:To PDCU";
CM_ SG_ 825 HUT_BattSOCLim "Setting external charging level for SOCHC_CAN:To PDCU";
CM_ SG_ 827 BackgroundLightLvlSet "Back ground Light level Set";
CM_ SG_ 827 ManCmpSet "Manual compensation setÃ§Â‹Â¬Ã§Â«Â‹AMP";
CM_ SG_ 827 DispModSet "Display Mode SetÃ§Â‹Â¬Ã§Â«Â‹AMP";
CM_ SG_ 827 WPC_SwtReq "Request of WPC(Wireless Power Charger) SwitchBD1-CAN To:WPC";
CM_ SG_ 827 AVMSwtReq "AVM(Around View Monitoring) switch requestBD2_CAN:To AMP";
CM_ SG_ 827 NaviMediaVolLvlReq "Navigation Media Volume Level RequestBD2_CAN:To AMP";
CM_ SG_ 827 AVMMediaVolLvlReq "AVM(Around View Monitoring) Media Volume Level RequestBD2_CAN:To AMP";
CM_ SG_ 827 FPASChanSwtReq "Front  Park Assistant System channel Status RequestBD2_CAN:To AMP";
CM_ SG_ 827 RPASChanSwtReq "Rear Park Assistant System channel Status RequestBD2_CAN:To AMP";
CM_ SG_ 827 ACRearBlwrSpdReq_VR "Blower speed request  for rear AC(Air Conditioning) controlling(Voice Request)BD1-CAN:To AC";
CM_ SG_ 827 ACRearBlwrsteplsSpdReq_TC "Blower Stepless speed request for rear AC(Air Conditioning) controlling-Touch ControlBD1-CAN:To AC";
CM_ SG_ 827 PLGReq_VR "Power Lift Gate Module request by HUT(Voice Request)";
CM_ SG_ 827 ACRearAirDistribModReq_VR "AC(Air Conditioning) Rear Air Distribution Mode Request-Touch ControlBD1-CAN:To AC";
CM_ SG_ 827 ACZoneReq_VR "AC(Air Conditioning) Zone Request(Voice Request)BD1-CAN:To AC";
CM_ SG_ 827 OPDSwtSts "One Pedal driving Switch StatusPT-CANFD To:PDCU";
CM_ SG_ 833 FLTirePressIndSts "Front left tire pressure Indicator statusIP Received";
CM_ SG_ 833 FRTirePressIndSts "Front right  tire pressure Indicator statusIP Received";
CM_ SG_ 833 TirePressSysFailrIndcn "Tire pressure system failure indicationIP Received";
CM_ SG_ 833 RLTirePressIndSts "Rear left  tire pressure Indicator statusIP Received";
CM_ SG_ 833 RRTirePressIndSts "Rear right tire pressure Indicator statusIP Received";
CM_ SG_ 833 FLTireTempSts "Front left tire tempperature statusIP Received";
CM_ SG_ 833 FRTireTempSts "Front right tire tempperature statusIP Received";
CM_ SG_ 833 RLTireTempSts "Rear left tire tempperature statusIP Received";
CM_ SG_ 833 RRTireTempSts "Rear right tire tempperature statusIP Received";
CM_ SG_ 833 MAC_Check_TPMS1 "MAC protection mechanism should comply with the GWM MAC Specificatio";
CM_ SG_ 833 TPMS_AutoLoctSts "TPMS system Auto-Locate status";
CM_ SG_ 836 AntiDisIdnResult "Anti-dismantle identification result";
CM_ SG_ 836 SelfChkSts "Status of Self-Check";
CM_ SG_ 836 ActvdSts "Status of Activation of the ESAM";
CM_ SG_ 837 LasHdLmpSts "Laser Head Lamp Status";
CM_ SG_ 837 AntitheftSts "Vehicle antitheft status";
CM_ SG_ 837 DrvDoorLockSts "The status of the driver door lock  statusIP Received";
CM_ SG_ 837 DoorLockSts "Door lock status";
CM_ SG_ 837 HiLowBeamSts "High Low Beam StatusIP Received";
CM_ SG_ 837 MAC_Check_BCM3 "MAC protection mechanism should comply with the GWM MAC Specificatio";
CM_ SG_ 837 RLDoorLockSts "The status of the RL door lock status";
CM_ SG_ 837 PassDoorLockSts "The status of the Passenger door lock status";
CM_ SG_ 837 RRDoorLockSts "The status of the RR door lock status";
CM_ SG_ 837 HazardLmpSwtSts "Hazard lamp switch status.";
CM_ SG_ 837 LRPosnLmpSts "Left  rear position lamp status";
CM_ SG_ 837 RRPosnLmpSts "Right rear position lamp status";
CM_ SG_ 840 PowerSet "AMP power set. When the systerm power mode (from PEPS or BCM)change to OFF,the bluetooh communication should't be interrupted ,so AMP need this signal to turn off.BD2_CAN:To AMP";
CM_ SG_ 840 HUT_CallSts_Dialing "Call_Status(Dialing)";
CM_ SG_ 840 HUT_CallSts_IncomingCall "Call_Status(Incoming Call)";
CM_ SG_ 840 HUT_CallSts_ongoing "Call_Status(ongoing Call)";
CM_ SG_ 840 HUT_CallTime "Call Duration";
CM_ SG_ 842 IP_RemainDistance "the value was calculated by IPÃ¯Â¼ÂŒwhen Remain Distance<50km,IP will send value \"0xFFF\"display";
CM_ SG_ 842 IP_InstFuelConsUnit "the unit  of instant fuel consumption";
CM_ SG_ 842 IP_EBDFailSts "the Brake System Fault status";
CM_ SG_ 842 IP_AvgFuelCons "the value of average fuel consumption";
CM_ SG_ 842 IP_InstFuelCons "the value  of instant fuel consumption - when the unit is L100kmÃ¯Â¼ÂŒmax value 29.99,when  unit is LhÃ¯Â¼ÂŒmax value 99.99When the vehicle is idling,the unit of this signal is Lh.
When the vehicle is runing,the unit of this signal is Lkm";
CM_ SG_ 845 ColMemPosnSetSwtFB "Column Memory Position Set Switch FeedBack";
CM_ SG_ 849 CheckSum_ABM1 "Use the checksum strategy from document Ã¢Â€ÂœEnd-to-End Communication Protection SpecificationÃ¢Â€Â";
CM_ SG_ 849 SecRowLSBR "Second row Left Seat Belt Reminder.";
CM_ SG_ 849 AirbFailLmpCmd "Indicates the Airbag system lamp commandIP Received";
CM_ SG_ 849 SecRowMidSBR "Second row Middle Seat Belt Reminder.";
CM_ SG_ 849 DrvSBR "Driver Seat Belt Reminder";
CM_ SG_ 849 SecRowRSBR "Second row Right Seat Belt Reminder.";
CM_ SG_ 849 PassSBR "Passenger Seat Belt Reminder";
CM_ SG_ 849 PassSBR_Visual "Passenger Seat Belt Reminder with Visual.IP Received";
CM_ SG_ 849 DrvSBR_Visual "Driver Seat Belt Reminder with Visual.IP Received";
CM_ SG_ 849 SecRowLSBR_Visual "Second row Left  Seat Belt Reminder with Visual.IP Received";
CM_ SG_ 849 SecRowMidSBR_Visual "Second row Middle Seat Belt Reminder with Visual.IP Received";
CM_ SG_ 849 SecRowRSBR_Visual "Second row Right  Seat Belt Reminder with Visual.IP Received";
CM_ SG_ 849 CrashOutputSts "Normal status message period is defined as 500ms.If any crash event is recognized and deploy decision sentÃ¯Â¼ÂŒ the message is sent immediatelyÃ¯Â¼ÂŒthe period is 10ms lasted for 20 times, this message is defined as crash status. After 20 times, recovery to normal status. If another deploy decision is sent during last crash status message output period, the new crash out message will not be sent, except the depoy decision out of the last crash out message course.
0x00   Startup  Default
0x03 0x11 0x12 acts asÃ¢Â€ÂœReservedÃ¢Â€Â.
Receiver: If the signal's value is reserved, the Receiver will use no crash.";
CM_ SG_ 849 RollingCounter_ABM1 "Rolling counter_ABM1";
CM_ SG_ 849 MAC_Check_ABM1 "MAC protection mechanism should comply with the GWM MAC Specificatio";
CM_ SG_ 862 RoofModFb "Feedback of RoofMod";
CM_ SG_ 862 AllTerrainDislFb "Feedback of AllTerrainDisl";
CM_ SG_ 862 ElecSideStepSysFb "Feedback of ElecSideStepSys";
CM_ SG_ 871 DomeLmpDlyTimSet "Dome lamp delay time set:3s 10s2030s.";
CM_ SG_ 871 FolwMeHomeDlyTimSet "Follow me home delay time set:0s 30s60s90s.";
CM_ SG_ 871 TranPMode_Req "Transport Mode Switch";
CM_ SG_ 871 RearviewFoldModSet "Rearview mirror fold mode set";
CM_ SG_ 871 BattSaveDelayTimeSet "Battery saver delay time set:2m5m8m.";
CM_ SG_ 871 ACDualReq_TC "AC(Air Conditioning) Dual Request-Touch ControlBD1-CAN To:AC";
CM_ SG_ 871 ACAutoModReq_TC "AC(Air Conditioning) Auto Mode Request-Touch ControlBD1-CAN To:AC";
CM_ SG_ 871 ACAirInletReq_TC "AC(Air Conditioning) FreshRecirculation mode request-Touch ControlBD1-CAN To:AC";
CM_ SG_ 871 ACFrntHMIDis_TC "Front HMI display -Touch ControlBD1-CAN To:AC";
CM_ SG_ 871 ACRearHMIDis_TC "Rear HMI display -Touch ControlBD1-CAN To:AC";
CM_ SG_ 871 ACAQSReq_TC "AC(Air Conditioning) AQS(air quality sensor)  Request-Touch ControlBD1-CAN To:AC";
CM_ SG_ 871 ACCmprReq_TC "AC(Air Conditioning) Compressor request -Touch ControlBD1-CAN To:AC";
CM_ SG_ 871 ACFrntDefrstReq_TC "AC(Air Conditioning) Front Defrost OnOff  request-Touch ControlBD1-CAN To:AC";
CM_ SG_ 871 ACFrntBlwrSpdDecReq_TC "AC(Air Conditioning) Front Blower Speed Decrease request -Touch ControlBD1-CAN To:AC";
CM_ SG_ 871 ACRearBlwrSpdDecReq_TC "AC(Air Conditioning) Rear Blower Speed Decrease request -Touch ControlBD1-CAN To:AC";
CM_ SG_ 871 ACRearBlwrSpdIncReq_TC "AC(Air Conditioning) Rear Blower Speed Increase  Request-Touch ControlBD1-CAN To:AC";
CM_ SG_ 871 DrvDrowsnsDetnSet "DMS(Driver Monitoring System) Driver drowsiness detection set";
CM_ SG_ 871 ACFrntBlwrSpdIncReq_TC "AC(Air Conditioning) Front Blower Speed Increase  Request-Touch ControlBD1-CAN To:AC";
CM_ SG_ 871 ACDrvAirDistribModReq_TC "AC(Air Conditioning) Driver Air Distribution Mode Request-Touch ControlBD1-CAN To:AC";
CM_ SG_ 871 ACDrvTempDecReq_TC "AC(Air Conditioning) Driver Temperature Decrease Request-Touch ControlBD1-CAN To:AC";
CM_ SG_ 871 ChairMemPosnEna "Chair  memory position enable";
CM_ SG_ 871 ACDrvTempIncReq_TC "AC(Air Conditioning) Driver Temperature Increase  Request-Touch ControlBD1-CAN To:AC";
CM_ SG_ 871 ACFrntPassTempDecReq_TC "AC(Air Conditioning) Front passenger Temperature Decrease Request-Touch ControlBD1-CAN To:AC";
CM_ SG_ 871 ACFrntPassTempIncReq_TC "AC(Air Conditioning) Front passenger Temperature Increase Request-Touch ControlBD1-CAN To:AC";
CM_ SG_ 871 ACAIUReq_TC "Control AC(Air Conditioning) Air Ionizer Unit Request-Touch ControlBD1-CAN To:AC";
CM_ SG_ 871 ACOffReq_TC "Turn Off AC(Air Conditioning) Request by HUT(Head Unit System)-Touch ControlBD1-CAN To:AC";
CM_ SG_ 871 ACBlwrsteplsSpdReq_TC "Blower Stepless speed request for AC(Air Conditioning) controlling-Touch ControlBD1-CAN To:AC";
CM_ SG_ 871 ACZoneReq_TC "Zone Request-Touch ControlBD1-CAN To:AC";
CM_ SG_ 873 RearWinHeatCmd_TC "Rear Window Heating OnOff request-Touch ControlBD1-CAN To:AC";
CM_ SG_ 873 AMP_MediaCallSourceSet "MediaCall Source SetBD2-CAN To:AMP";
CM_ SG_ 873 AMP_NaviSourceSet "Navigation source set.BD2-CAN To:AMP";
CM_ SG_ 873 AMP_BeepSourceSet "Beep source set.BD2-CAN To:AMP";
CM_ SG_ 873 AMP_LRAudioBalanceSet "LeftRight Audio Balance setBD2-CAN To:AMP";
CM_ SG_ 873 AMP_AudioVolVSCModReq "Audio volume Vehicle Speed Compensation mode(onoff) request.BD2-CAN To:AMP";
CM_ SG_ 873 AMP_FRAudioFaderSet "Frontrear audio fader setBD2-CAN To:AMP";
CM_ SG_ 873 AMP_LRDrvSideSet "Drive side set(Left helm drive or right helm drive).BD2-CAN To:AMP";
CM_ SG_ 873 AMP_LowFrqAudioSet "Low frequency audio setBD2-CAN To:AMP";
CM_ SG_ 873 AMP_MuteSet "Mute all speakersBD2-CAN To:AMP";
CM_ SG_ 873 AMP_MidFrqAudioSet "Mid frequency audio setBD2-CAN To:AMP";
CM_ SG_ 873 AMP_HighFrqAudioSet "Middle frequency audio setBD2-CAN To:AMP";
CM_ SG_ 873 T_box_ECallSet "T_box Ecall(emergency call)  set (mute all speakers).When T_Box Ecall occurred,HUT sent this signal to AMP mute all speakers,off is not mute,on is mute.BD2-CAN To:AMP";
CM_ SG_ 873 QLISurroundSet "quantum logic surround or Stereo set.BD2-CAN To:AMP";
CM_ SG_ 873 ANCSwtSet "ANC(Active Noise Control) function switch set.BD2-CAN To:AMP";
CM_ SG_ 873 FrntWinHeatSwt "Front Window Heating Switch";
CM_ SG_ 875 AMP_HFMVolSet "HFM(Hand Free Mode), RT(Ring Tone) and Tbox-IBcall(InformationBreakdown call) volume set.BD2-CAN To:AMP";
CM_ SG_ 875 AMP_TTSVolSet_VR "TTS(text to sound) volume set.(Voice Request)BD2-CAN To:AMP";
CM_ SG_ 875 AMP_NaviVolSet "Navigation volume set.BD2-CAN To:AMP";
CM_ SG_ 875 AMP_MainVolSet "Main volume set.BD2-CAN To:AMP";
CM_ SG_ 875 AMP_GetSWInfoReq "Get Amplifier Software Information RequestBD2-CAN To:AMP";
CM_ SG_ 875 AMP_GetHWInfoReq "Get Amplifier Hardware Information RequestBD2-CAN To:AMP";
CM_ SG_ 875 AMP_GetTempInfoReq "Get Amplifier temperature Value requestBD2-CAN To:AMP";
CM_ SG_ 875 AMP_GetIntVoltInfoReq "Get Amplifier internal voltage information request.BD2-CAN To:AMP";
CM_ SG_ 875 AMP_GetDTCInfoReq "Get Amplifier DTC(Diagnostic Trouble Code) information request.BD2-CAN To:AMP";
CM_ SG_ 875 IESS_MdlSwtReq "IESS(Internal Electronic Sound Synthesis)  Model requestBD2-CAN To:AMP";
CM_ SG_ 875 IESS_MdlInfoReq "IESS(Internal Electronic Sound Synthesis) Model information requestBD2-CAN To:AMP";
CM_ SG_ 875 AMP_BestListegPosnReq "Best listenting Position request.BD2-CAN To:AMP";
CM_ SG_ 875 AMP_Clari_FiReq "Clari_Fi request.Ã¯Â¼ÂˆAudio source repair Technology Request)BD2-CAN To:AMP";
CM_ SG_ 877 DrvSeatVentnLvlSet "Driver Seat ventilation level set";
CM_ SG_ 877 PassSeatVentnLvlSet "Passenger Seat ventilation level set";
CM_ SG_ 877 ACAutoModReq_VR "Auto mode request for AC(Air Conditioning) controlling  (Voice Request)BD1-CAN To:AC";
CM_ SG_ 877 ACCmprReq_VR "Compressor Request  for AC(Air Conditioning) controlling(Voice Request)BD1-CAN To:AC";
CM_ SG_ 877 ACPowerReq_VR "AC system power onoff request  for AC controlling  (Voice Request)BD1-CAN To:AC";
CM_ SG_ 877 ACBlwrSpdReq_VR "Blower speed request  for AC(Air Conditioning) controlling  (Voice Request)BD1-CAN To:AC";
CM_ SG_ 877 ACDrvTempReq_VR "Driver side temperature request  for AC(Air Conditioning) controlling  (Voice Request)BD1-CAN To:AC";
CM_ SG_ 877 ACFrntDefrostReq_VR "Front defrost request  for AC(Air Conditioning) controlling  (Voice Request)BD1-CAN To:AC";
CM_ SG_ 877 ACDrvAirDistribModReq_VR "Driver Air Distribution Mode Request for AC(Air Conditioning) controlling  (Voice Request)BD1-CAN To:AC";
CM_ SG_ 877 ACAirInletReq_VR "Air Conditioning FreshRecirculation mode request for AC controlling  (Voice Request)BD1-CAN To:AC";
CM_ SG_ 877 ACModReq_HUT "AC mode request by HUT(Head Unit System)";
CM_ SG_ 877 ElecSideSteppingSysSet "Electric side stepping system set";
CM_ SG_ 877 RoofModSet "Roof mode set";
CM_ SG_ 877 AllTerrainDislSet "All terrain disable set";
CM_ SG_ 877 RemUpgrdSts "Remote upgrade mode";
CM_ SG_ 877 ACRearAutoModReq_TC "Rear AC(Air Conditioning) Auto Mode Request-Touch ControlBD1-CAN:To AC";
CM_ SG_ 877 DrvSeatSupportLvlSet "Driver Seat supporting level set";
CM_ SG_ 877 PassSeatSupportLvlSet "Passenger Seat supporting level set";
CM_ SG_ 877 ACRearOffReq_TC "Rear Off AC Request  by HUT-Touch ControlBD1-CAN:To AC";
CM_ SG_ 877 ACRearAirDistribModReq_TC "AC(Air Conditioning) Rear Air Distribution Mode Request-Touch ControlBD1-CAN:To AC";
CM_ SG_ 877 RLSeatVentnLvlSet "Rear Left Seat ventilation level set";
CM_ SG_ 877 RRSeatVentnLvlSet "Rear Right Seat ventilation level set";
CM_ SG_ 877 DrvSeatHeatgLvlSet "Driver Seat Heating level  set";
CM_ SG_ 877 PassSeatHeatgLvlSet "Passenger Seat Heating level set";
CM_ SG_ 880 TimeMod "Time ModeBD1-CAN To:WPC,AC,BLE
BD2-CAN To:ABM,AMP,SVM,ELD,TOD
PT_CAN:EDC
ADAS-CANFD To:IFC,HAP,PAS,IDC_L2
HC_CAN:To DCDC,BSG,BMS
BD_Sub_CAN:To DDCM,PDCM,DSC,HVSM,CP,RHVSM";
CM_ SG_ 880 TimeIndcn "Indicaion for  time :am or pmBD1-CAN To:WPC,AC,BLE
BD2-CAN To:ABM,AMP,SVM,ELD,TOD
PT_CAN:EDC
ADAS-CANFD To:IFC,HAP,PAS,IDC_L2
HC_CAN:To DCDC,BSG,BMS
BD_Sub_CAN:To DDCM,PDCM,DSC,HVSM,CP,RHVSM";
CM_ SG_ 880 Time_Hour "The value for hoursBD1-CAN To:CSA,ESCL,WPC,AC,BLE
BD2-CAN To:ABM,HUD,AMP,PPMI_D,PPMI_P,SBWM,SVM,ELD,TOD
PT_CAN To:ECM,ESP,TCU,Ibooster,EDC,EPS
ADAS-CANFD To:IFC,RSDS_R,RSDS_L,HAP,PAS,RPAS,CR_L,CR_R,ALS,IDC_L2
HC_CAN:To DCDC,BSG,BMS
BD_Sub_CAN:To DDCM,PDCM,DSC,HVSM,CP,RHVSM";
CM_ SG_ 880 Time_Minutes "The value for minutesBD1-CAN To:CSA,ESCL,WPC,AC,BLE
BD2-CAN To:ABM,HUD,AMP,PPMI_D,PPMI_P,SBWM,SVM,ELD,TOD
PT_CAN To:ECM,ESP,TCU,Ibooster,EDC,EPS
ADAS-CANFD To:IFC,RSDS_R,RSDS_L,HAP,PAS,RPAS,CR_L,CR_R,ALS,IDC_L2
HC_CAN:To DCDC,BSG,BMS
BD_Sub_CAN:To DDCM,PDCM,DSC,HVSM,CP,RHVSM";
CM_ SG_ 880 Time_Second "The value for secondsBD1-CAN To:AC
BD2-CAN To:ABM,HUD,AMP,SVM,ELD,TOD
PT_CAN To:TCU,Ibooster,EDC
ADAS-CANFD To:IFC,RSDS_R,RSDS_L,HAP,PAS,RPAS,CR_L,CR_R,ALS,IDC_L2
HC_CAN:To DCDC,BSG,BMS
BD_Sub_CAN:To DDCM,PDCM,DSC,HVSM,CP,RHVSM";
CM_ SG_ 880 Time_Year_Left "The value for yearsBD1-CAN To:CSA,ESCL,WPC,AC,BLE
BD2-CAN To:ABM,AMP,PPMI_D,PPMI_P,SBWM,SVM,ELD,TOD
PT_CAN To:ECM,ESP,TCU,Ibooster,EDC,EPS
ADAS-CANFD To:IFC,RSDS_R,RSDS_L,HAP,PAS,RPAS,CR_L,CR_R,ALS,IDC_L2
HC_CAN:To DCDC,BSG,BMS
BD_Sub_CAN:To DDCM,PDCM,DSC,HVSM,CP,RHVSM";
CM_ SG_ 880 Time_Year_Right "The value for yearsBD1-CAN To:CSA,ESCL,WPC,AC,BLE
BD2-CAN To:ABM,HUD,AMP,PPMI_D,PPMI_P,SBWM,SVM,ELD,TOD
PT_CAN To:ECM,ESP,TCU,Ibooster,EDC,EPS
ADAS-CANFD To:IFC,RSDS_R,RSDS_L,HAP,PAS,RPAS,CR_L,CR_R,ALS,IDC_L2
HC_CAN:To DCDC,BSG,BMS
BD_Sub_CAN:To DDCM,PDCM,DSC,HVSM,CP,RHVSM";
CM_ SG_ 880 Time_Month "The value for monthsBD1-CAN To:CSA,ESCL,WPC,AC,BLE
BD2-CAN To:ABM,HUD,AMP,PPMI_D,PPMI_P,SBWM,SVM,ELD,TOD
PT_CAN To:ECM,ESP,TCU,Ibooster,EDC,EPS
ADAS-CANFD To:IFC,RSDS_R,RSDS_L,HAP,PAS,RPAS,CR_L,CR_R,ALS,IDC_L2
HC_CAN:To DCDC,BSG,BMS
BD_Sub_CAN:To DDCM,PDCM,DSC,HVSM,CP,RHVSM";
CM_ SG_ 880 Time_Day "The value for daysBD1-CAN To:CSA,ESCL,WPC,AC,BLE
BD2-CAN To:ABM,HUD,AMP,PPMI_D,PPMI_P,SBWM,SVM,ELD,TOD
PT_CAN To:ECM,ESP,TCU,Ibooster,EDC,EPS
ADAS-CANFD To:IFC,RSDS_R,RSDS_L,HAP,PAS,RPAS,CR_L,CR_R,ALS,IDC_L2
HC_CAN:To DCDC,BSG,BMS
BD_Sub_CAN:To DDCM,PDCM,DSC,HVSM,CP,RHVSM";
CM_ SG_ 880 HUT_TgtSOCSet "Target value for custom SOC setPT-CAN To:PDCU";
CM_ SG_ 881 BaroPressure "Barometer pressure";
CM_ SG_ 881 EngCoolantTemp "Engine coolant temperatureIP Received";
CM_ SG_ 881 GPF_Warning "This signal is used to display the warning information of GPF on IP.IP Received";
CM_ SG_ 881 GentrWarnLmpSts "Generator Warning Lamp StateIP Received
This signal will be used only in project  with LIN-Interface generator regulator. This signal will set 1-ON when engine not running or fault detected of generator system. This signal will set 0-OFF when generator system works normally.";
CM_ SG_ 881 EngClntTempWarn "Engine coolant temperature warning flagIP Received";
CM_ SG_ 881 EngClntTempVldty "Engine coolant temperature validityIP Received";
CM_ SG_ 881 SS_Screen_tip "Indicate the driver manual start the engine when the engine can not autostart.IP Received";
CM_ SG_ 881 SSSSetSts "Feedback Start_stop status to HUT";
CM_ SG_ 881 SS_Enable_Lamp "Enable StartStop FunctionÃ¯Â¼ÂˆGreen LampÃ¯Â¼Â‰IP Received";
CM_ SG_ 881 SS_Fault_Lamp "StartStop fault lampÃ¯Â¼ÂˆYellow LampÃ¯Â¼Â‰IP Received";
CM_ SG_ 881 MaxEngTrqNorm "Maximum Nornal
This value has to be set by Car Maker basing on Engine characteristics, Any other Torque value transmitted or received in the CAN BUS is expressed as a percentage of MaxEngTorqueNorm. It's a constant value during the communicaton life.";
CM_ SG_ 881 AGS_Failure "Used for instrument display when active intake grille failure.";
CM_ SG_ 901 ACFrntDefrstSts "Front Defrost status";
CM_ SG_ 901 ACHMIDispCmd "Display ACHMI on HUT command";
CM_ SG_ 901 ACFrntBlwrSpd "Front Blower Speed";
CM_ SG_ 901 ACOpenSts "AC open status";
CM_ SG_ 901 ACDualModEnaSts "AC dual mode enable status";
CM_ SG_ 901 ACDrvTemp_ATC "ATCÃ¯Â¼ÂˆAuto Touch ConditionÃ¯Â¼Â‰ Driver side Temperature";
CM_ SG_ 901 ACAmbTemp "Ambient display strategy:
1. In the Power mode = OFFÃ¯Â¼ÂŒ ACC, or Crank: Ambient Temperature = ini.
2. In the Power mode = Run:
Initial ambient temperature is depending on the EEPROM data and vehicle soak time(Soak time is <= 1min or =>60 min, it will show the raw data from ambient temperature sensor; 1min < Soak time < 60min, it will show the data from EEPROM, stored in last ignition cycle.);
The ambient temperature will be updated ACCording the raw data from sensor, vehicle speed, and timeIP Received";
CM_ SG_ 901 ACAirInletSts "AC airinlet status";
CM_ SG_ 901 ACFrntPasstTemp_ATC "Front Passenger Temperature";
CM_ SG_ 901 ACAutoModEnaSts "AC Auto mode enable status";
CM_ SG_ 901 ACCmprEnaSts "Compressor enable status";
CM_ SG_ 901 ACRearWinHeatSts "Rear Window Heating status";
CM_ SG_ 901 ACAutoDefrstModEnaSts "Auto defrost mode enable status";
CM_ SG_ 917 FLTirePress "Left front tire pressureIP Received";
CM_ SG_ 917 FLTireTemp "Left front tire temperatureIP Received";
CM_ SG_ 917 FRTirePress "Right front tire pressureIP Received";
CM_ SG_ 917 FRTireTemp "Right front tire temperatureIP Received";
CM_ SG_ 917 RLTirePress "Left rear tire pressureIP Received";
CM_ SG_ 917 RLTireTemp "Left rear tire temperatureIP Received";
CM_ SG_ 917 RRTirePress "Right rear tire pressureIP Received";
CM_ SG_ 917 RRTireTemp "Right rear tire temperatureIP Received";
CM_ SG_ 917 MAC_Check_TPMS2 "MAC protection mechanism should comply with the GWM MAC Specificatio";
CM_ SG_ 943 WeatherCdn "Weather Condition";
CM_ SG_ 943 PitchAng "Pitch AngleBD1_CAN:To DWD";
CM_ SG_ 943 PitchAngSign "Pitch Angle SignBD1_CAN:To DWD";
CM_ SG_ 949 ECM_VIN "The last 8 bytes of VIN stored in ECM.IP Received";
CM_ SG_ 951 ECM_VehDstBackup "Vehicle total distance backup signal to IP.IP Received";
CM_ SG_ 962 HCU_RecupPwr "Accumulated electric energy the vehicle recuperated since ig on,
Energy quantity counter overflow is allowed.";
CM_ SG_ 962 HCU_HiVoltInterlockSts_RM "HVIL error status";
CM_ SG_ 962 HCU_EVContnsDistance "Electric continuous distance.IP Received";
CM_ SG_ 962 HCU_EVContnsDistanceVld "Electric continuous distance valid.IP Received";
CM_ SG_ 962 HCU_EgyUsed "Accumulated electric energy the vehicle usd since ig on,Energyquantity counter overflow is allowed.";
CM_ SG_ 993 AMP_SWVersion "Software version Information";
CM_ SG_ 993 AMP_HWVersion "Hardware version Information";
CM_ SG_ 993 AMP_Chan1DTCInfo "Amplifier output channel 1 DTC information";
CM_ SG_ 993 AMP_Chan2DTCInfo "Amplifier output channel 2 DTC information";
CM_ SG_ 993 AMP_Chan3DTCInfo "Amplifier output channel 3 DTC information";
CM_ SG_ 993 AMP_Chan4DTCInfo "Amplifier output channel 4 DTC information";
CM_ SG_ 993 AMP_Chan5DTCInfo "Amplifier output channel 5 DTC information";
CM_ SG_ 993 AMP_Chan6DTCInfo "Amplifier output channel 6 DTC information";
CM_ SG_ 993 AMP_Chan7DTCInfo "Amplifier output channel 7 DTC information";
CM_ SG_ 993 AMP_Chan8DTCInfo "Amplifier output channel 8 DTC information";
CM_ SG_ 993 AMP_TempValue "Amplifier internal temperature";
CM_ SG_ 993 AMP_TempSts "The value of AMP temperature status";
CM_ SG_ 993 AMP_VolValue "Amplifier internal voltage";
CM_ SG_ 993 BestListegPosnResp "Best listenting Position respond.";
CM_ SG_ 993 Clari_FiResp "Clari-Fi respond.";
CM_ SG_ 995 MediaCallSourceState "MediaCall Source State";
CM_ SG_ 995 BeepSourceSts "Beep source status.";
CM_ SG_ 995 BalanceSetState "Balance setting";
CM_ SG_ 995 VSCModeState "Vehicle Speed Compensation onoff";
CM_ SG_ 995 FadeSetState "Fade setting";
CM_ SG_ 995 DriveSideSts "Drive side state.";
CM_ SG_ 995 BassSetState "Low frequency audio setting";
CM_ SG_ 995 MuteState "MuteUnmute all speakers";
CM_ SG_ 995 NaviSourceState "Navi prompt onoff state imformation";
CM_ SG_ 995 MidrangeSetState "Mid frequency audio setting";
CM_ SG_ 995 T_box_ECallSts "T_box Ecall(emergency call) status (mute all speakers).";
CM_ SG_ 995 GetHUTInfoSts "Get HUT Information.";
CM_ SG_ 995 TrebleSetState "High frequency audio setting";
CM_ SG_ 995 QLISurroundSetSt "Stereo or surround state.";
CM_ SG_ 995 AVMStResp "AVM Status Response";
CM_ SG_ 995 NaviMediaVolLvlResp "Navigation Media Volume Level Response";
CM_ SG_ 995 AVMMediaVolLvlResp "AVM Media Volume Level Response";
CM_ SG_ 995 FPASChStResp "Front  Park Assistant System channel Status Response";
CM_ SG_ 995 RPASChStResp "Rear Park Assistant System channel Status Response";
CM_ SG_ 995 MAC_Check_AMP2 "MAC protection mechanism should comply with the GWM MAC Specificatio";
CM_ SG_ 997 HFMVolSetSts "HFM(hand free mode), RT(ring tone) and Tbox-IB call volume set status.";
CM_ SG_ 997 VR_TTSVolSetSts "VRTTS(text to sound) volume set state.";
CM_ SG_ 997 NaviVolumeSetState "Navi volume adjustment";
CM_ SG_ 997 MainVolumeSetState "Main volume step";
CM_ SG_ 997 AMPPowerSts "AMP feedback Power
Status to HUT";
CM_ SG_ 997 IPVolSetSts "IP Volume Set State";
CM_ SG_ 1001 T_BOX_SysErrSts "System error statusADAS-CANFD To:IFC,IDC_L2";
CM_ SG_ 1001 T_BOX_SWUpdSts "Software update status";
CM_ SG_ 1001 FreshnessValue_T_BOX_FD3 "ADAS-CANFD To:IDC_L2";
CM_ SG_ 1001 MAC_Check_T_BOX_FD3 "MAC protection mechanism should comply with the GWM MAC SpecificatioADAS-CANFD To:IDC_L2";
CM_ SG_ 1045 ADAS_Meta_MsgTyp "Identify type of messageADAS-CANFD To:PAS,RPAS";
CM_ SG_ 1045 ADAS_Meta_MapProvider "Provider mapADAS-CANFD To:PAS,RPAS";
CM_ SG_ 1045 ADAS_Meta_CountryCode "CountryCodeADAS-CANFD To:PAS,RPAS";
CM_ SG_ 1045 ADAS_Meta_CycCnt "Message rollingcounterADAS-CANFD To:PAS,RPAS";
CM_ SG_ 1045 ADAS_Meta_ProtVer_Major "Main protocol versionADAS-CANFD To:PAS,RPAS";
CM_ SG_ 1045 ADAS_Meta_ProtVer_MinorSub "Minor protocol versionADAS-CANFD To:PAS,RPAS";
CM_ SG_ 1045 ADAS_Meta_HwVer "Hardwar version or software versionADAS-CANFD To:PAS,RPAS";
CM_ SG_ 1045 ADAS_Meta_DrvSide "Driving directionADAS-CANFD To:PAS,RPAS";
CM_ SG_ 1045 ADAS_Meta_RegionCode "Region CodeADAS-CANFD To:PAS,RPAS";
CM_ SG_ 1045 ADAS_Meta_MapVerQtr "Map version quarterlyADAS-CANFD To:PAS,RPAS";
CM_ SG_ 1045 ADAS_Meta_MapVerYear "Map version yearADAS-CANFD To:PAS,RPAS";
CM_ SG_ 1045 ADAS_Meta_SpdUnits "speed limit unitADAS-CANFD To:PAS,RPAS";
CM_ SG_ 1045 ADAS_Meta_ProtVer_Minor "Minor protocol versionADAS-CANFD To:PAS,RPAS";
CM_ SG_ 53 PEPS_T_BOXAuth1 "PEPS anti-theft related signals,PEPS send to T_box";
CM_ SG_ 54 T_BOX_PEPSAuth1 "T_BOX_PEPS anti-theft authentication signals,T_box send to PEPS";
CM_ SG_ 70 PEPS_T_BOXAuth2 "Anti-theft authentication related signals,PEPSKBCMTBK send to T_Box";
CM_ SG_ 72 T_BOX_PEPSAuth2 "Anti-theft authentication related signals,T_BOX send to PEPSKBCMTBK";
CM_ SG_ 96 HCU_BrkPedalSts "indicates the brake pedal is pressed or not or incorrect for
plausibility check.";
CM_ SG_ 96 HCU_BrkPedalStsValid "BrkPedalSts  valid";
CM_ SG_ 96 HCU_AccelPedalPosn_Diag "Physical acceleration pedal position.
it represents the physical value of acceleration pedal even in CCACC case, in which case normal acceleration pedal is replaced by virtual pedal position.IP Received";
CM_ SG_ 96 HCU_AccelPedalPosn_DiagValid "Flag: Physical acceleration pedal position validIP Received";
CM_ SG_ 96 HCU_PowertrainSts_0x60 "Powertrain Status.";
CM_ SG_ 96 HCU_RaceLaunchSts_0x60 "Race Launch function is active or deactivateIP Received";
CM_ SG_ 96 HCU_RaceLaunchAvail_0x60 "HCU Race Launch AvailIP Received";
CM_ SG_ 96 HCU_AccelPedalPosn "Acceleration pedal position
shall represent real physical pedal position or in case of CCACCHDCCCOAPA active a pedal value calculated from the torque request";
CM_ SG_ 96 HCU_AccelPedalPosnValid "Flag: Accelerator pedal value valid<accelerator pedal actual position validity>";
CM_ SG_ 96 HCU_CruiseCtrlSts "Cruise control status";
CM_ SG_ 96 HCU_TgtCrsVehSpd "Target cruise speed";
CM_ SG_ 96 HCU_TgtCrsVehSpdvalid "Target cruise speed validity";
CM_ SG_ 142 EngTrqCrankshaftLvl "Actual engine torque at crankshaft level (fast path)HUT_sub:TO AMP";
CM_ SG_ 142 EngTrqCrankshaftLvlValid "Actual engine torque at crankshaft level (fast path) ValidityHUT_sub:TO AMP";
CM_ SG_ 172 P2M_ActTrq "Actual torque at EM(Electric Motor) shaftHUT_sub:To AMP";
CM_ SG_ 190 P2M_ActSpd "Actual mechanical speed of EM(Electric Motor)PT_CAN:To ECM DCT
SC_CANFD:To HUT,T_BOX,VIMS,DVR";
CM_ SG_ 190 P2M_ActHvDcVolt "Actual HV DC(High Voltage Direct Current link) voltage";
CM_ SG_ 249 HCU_TrqLimMax_Norm "Torque Normalization value which reflect 100% torque on CAN bus,Current value is 550Nm.HUT_sub:To AMP";
CM_ SG_ 279 EngState_PHEV "Engine status.HUT";
CM_ SG_ 279 CruiseCtrlSts_PHEV "Cruise control statusIP";
CM_ SG_ 282 HCU_GearSts "the actual gear selector lever position";
CM_ SG_ 282 HCU_HybMod "Represents currently active dhybrid mode.";
CM_ SG_ 282 HCU_HybFctnMod "Represents currently battery SOC management mode and currently sport plus mode";
CM_ SG_ 301 EB_AEBIBActv "AEB eBis active (in deceleration)";
CM_ SG_ 301 EB_AEBBAActv "AEB BA is active (in deceleration)";
CM_ SG_ 301 EB_AEBAvailable "AEB(Automatic Emergency Brake) is available";
CM_ SG_ 301 EB_TgtRcprtnTrqSts "Status of Target Recuperation torque of Generator";
CM_ SG_ 330 HCUImmoAuthRes "Immo authorisation resultIP";
CM_ SG_ 330 HCU_EVLmpSts "EV lamp signalIP";
CM_ SG_ 330 HCU_ECODrvHabit_Indcn "Economic Indication of driving habitsIP";
CM_ SG_ 330 HCU_TotDrvReqPower_0x14a "total driver request PowerIP";
CM_ SG_ 330 HCU_AvailPower_TM "rear emotor available powerIP";
CM_ SG_ 330 HCU_DrvMod "Represents currently active driving mode. It is also used to transmit terrain response modes (sand mud snow)HUT_sub:TO AMP";
CM_ SG_ 448 HCU_ChrgSysLmpSts "Charge system indicate lamp statusIP Received";
CM_ SG_ 448 HCU_ChrgSysErr_1 "Charge system error indicate word:On board charger errorÃ¯Â¼ÂŒ go to the service piont.IP Received";
CM_ SG_ 448 HCU_ChrgSysErr_2 "Charge system error indicate word: Charge system errorÃ¯Â¼ÂŒ charging stoppedIP Received";
CM_ SG_ 448 HCU_ChrgSysErr_3 "Charge system error indicate word:  Charging stopped due to insuff power supply lowIP Received";
CM_ SG_ 448 HCU_ChrgSysErr_4 "Charge system error indicate word:  Charging stopped due to charger over temperatureIP Received";
CM_ SG_ 448 HCU_ChrgSysErr_5 "Charge system error indicate word:  Charging stopped due to battery over temperatureIP Received";
CM_ SG_ 448 HCU_ChrgSysErr_6 "Charge system error indicate word:  Charging stopped due to  battery temperature lowIP Received";
CM_ SG_ 448 HCU_ChrgSysErr_7 "Charge system error indicate word:  Charger output power  lowIP Received";
CM_ SG_ 448 HCU_ChrgSysErr_8 "Charge system error indicate word:  Charging stopped due to charge line not connect rightIP Received";
CM_ SG_ 448 HCU_DrvModDisp "Represents currently active driving mode to HUTFrom HCU_FD4";
BA_DEF_ BO_  "DiagRequest" ENUM  "No","Yes";
BA_DEF_ BO_  "DiagResponse" ENUM  "No","Yes";
BA_DEF_ BO_  "DiagState" ENUM  "No","Yes";
BA_DEF_ BO_  "GenMsgCycleTime" INT 0 65535;
BA_DEF_ BO_  "GenMsgCycleTimeFast" INT 0 65535;
BA_DEF_ BO_  "GenMsgILSupport" ENUM  "No","Yes";
BA_DEF_ BO_  "GenMsgNrOfRepetition" INT 0 65535;
BA_DEF_ BO_  "GenMsgSendType" ENUM  "Cyclic","CyclicAndSpontanX","Event";
BA_DEF_ BO_  "NmAsrMessage" ENUM  "No","Yes";
BA_DEF_ BO_  "OriginFrame" STRING ;
BA_DEF_ BO_  "SCP_AuthInfoTxLength" INT 0 512;
BA_DEF_ BO_  "SCP_DataId" INT 0 65535;
BA_DEF_ BO_  "SCP_FreshnessValueLength" INT 0 512;
BA_DEF_ BO_  "SCP_FreshnessValueTxLength" INT 0 512;
BA_DEF_ BO_  "SC_Message" ENUM  "NO","YES";
BA_DEF_ BO_  "VFrameFormat" ENUM  "StandardCAN","ExtendedCAN","reserved","reserved","reserved","reserved","reserved","reserved","reserved","reserved","reserved","reserved","reserved","reserved","StandardCAN_FD","ExtendedCAN_FD";
BA_DEF_ SG_  "GenSigCycleTime" INT 0 65535;
BA_DEF_ SG_  "GenSigSendType" ENUM  "Cyclic","OnWrite","OnWriteWithRepetition","OnChange","OnChangeWithRepetition","NotUsed","NotUsed","NoSigSendType";
BA_DEF_ SG_  "GenSigStartValue" FLOAT 0 100000000000;
BA_DEF_ SG_  "Match" STRING ;
BA_DEF_ SG_  "Origin" STRING ;
BA_DEF_ SG_  "TransparentInitValue" STRING ;
BA_DEF_ SG_  "SystemSignalLongSymbol" STRING ;
BA_DEF_DEF_  "DiagRequest" "No";
BA_DEF_DEF_  "DiagResponse" "No";
BA_DEF_DEF_  "DiagState" "No";
BA_DEF_DEF_  "GenMsgCycleTime" 0;
BA_DEF_DEF_  "GenMsgCycleTimeFast" 0;
BA_DEF_DEF_  "GenMsgILSupport" "No";
BA_DEF_DEF_  "GenMsgNrOfRepetition" 0;
BA_DEF_DEF_  "GenMsgSendType" "Cyclic";
BA_DEF_DEF_  "NmAsrMessage" "No";
BA_DEF_DEF_  "OriginFrame" "";
BA_DEF_DEF_  "SCP_AuthInfoTxLength" 0;
BA_DEF_DEF_  "SCP_DataId" 0;
BA_DEF_DEF_  "SCP_FreshnessValueLength" 0;
BA_DEF_DEF_  "SCP_FreshnessValueTxLength" 0;
BA_DEF_DEF_  "SC_Message" "NO";
BA_DEF_DEF_  "VFrameFormat" "";
BA_DEF_DEF_  "GenSigCycleTime" 0;
BA_DEF_DEF_  "GenSigSendType" "Cyclic";
BA_DEF_DEF_  "GenSigStartValue" 0;
BA_DEF_DEF_  "Match" "";
BA_DEF_DEF_  "Origin" "";
BA_DEF_DEF_  "TransparentInitValue" "";
BA_DEF_DEF_  "SystemSignalLongSymbol" "";
BA_ "OriginFrame" BO_ 796 "fuel,ev";
BA_ "GenMsgILSupport" BO_ 796 1;
BA_ "GenMsgCycleTime" BO_ 796 100;
BA_ "VFrameFormat" BO_ 796 14;
BA_ "OriginFrame" BO_ 805 "fuel,ev";
BA_ "GenMsgILSupport" BO_ 805 1;
BA_ "GenMsgCycleTime" BO_ 805 200;
BA_ "VFrameFormat" BO_ 805 14;
BA_ "OriginFrame" BO_ 816 "fuel,ev";
BA_ "GenMsgILSupport" BO_ 816 1;
BA_ "GenMsgCycleTime" BO_ 816 200;
BA_ "VFrameFormat" BO_ 816 14;
BA_ "OriginFrame" BO_ 817 "fuel,ev";
BA_ "GenMsgSendType" BO_ 817 2;
BA_ "GenMsgNrOfRepetition" BO_ 817 5;
BA_ "GenMsgILSupport" BO_ 817 1;
BA_ "GenMsgCycleTimeFast" BO_ 817 60;
BA_ "VFrameFormat" BO_ 817 14;
BA_ "OriginFrame" BO_ 818 "fuel,ev";
BA_ "GenMsgILSupport" BO_ 818 1;
BA_ "GenMsgCycleTime" BO_ 818 200;
BA_ "VFrameFormat" BO_ 818 14;
BA_ "OriginFrame" BO_ 819 "fuel,ev";
BA_ "GenMsgILSupport" BO_ 819 1;
BA_ "GenMsgCycleTime" BO_ 819 200;
BA_ "VFrameFormat" BO_ 819 14;
BA_ "OriginFrame" BO_ 825 "fuel,ev";
BA_ "GenMsgSendType" BO_ 825 2;
BA_ "GenMsgNrOfRepetition" BO_ 825 5;
BA_ "GenMsgILSupport" BO_ 825 1;
BA_ "GenMsgCycleTimeFast" BO_ 825 50;
BA_ "VFrameFormat" BO_ 825 14;
BA_ "OriginFrame" BO_ 827 "fuel,ev";
BA_ "GenMsgSendType" BO_ 827 2;
BA_ "GenMsgNrOfRepetition" BO_ 827 5;
BA_ "GenMsgILSupport" BO_ 827 1;
BA_ "GenMsgCycleTimeFast" BO_ 827 50;
BA_ "VFrameFormat" BO_ 827 14;
BA_ "SC_Message" BO_ 833 1;
BA_ "SCP_FreshnessValueTxLength" BO_ 833 16;
BA_ "SCP_FreshnessValueLength" BO_ 833 64;
BA_ "SCP_DataId" BO_ 833 833;
BA_ "SCP_AuthInfoTxLength" BO_ 833 48;
BA_ "OriginFrame" BO_ 833 "fuel,ev";
BA_ "GenMsgILSupport" BO_ 833 1;
BA_ "GenMsgCycleTime" BO_ 833 500;
BA_ "VFrameFormat" BO_ 833 14;
BA_ "OriginFrame" BO_ 836 "fuel,ev";
BA_ "GenMsgILSupport" BO_ 836 1;
BA_ "GenMsgCycleTime" BO_ 836 500;
BA_ "VFrameFormat" BO_ 836 14;
BA_ "SC_Message" BO_ 837 1;
BA_ "SCP_FreshnessValueTxLength" BO_ 837 16;
BA_ "SCP_FreshnessValueLength" BO_ 837 64;
BA_ "SCP_DataId" BO_ 837 837;
BA_ "SCP_AuthInfoTxLength" BO_ 837 48;
BA_ "OriginFrame" BO_ 837 "fuel,ev";
BA_ "GenMsgILSupport" BO_ 837 1;
BA_ "GenMsgCycleTime" BO_ 837 50;
BA_ "VFrameFormat" BO_ 837 14;
BA_ "OriginFrame" BO_ 840 "fuel,ev";
BA_ "GenMsgILSupport" BO_ 840 1;
BA_ "GenMsgCycleTime" BO_ 840 500;
BA_ "VFrameFormat" BO_ 840 14;
BA_ "OriginFrame" BO_ 842 "fuel,ev";
BA_ "GenMsgILSupport" BO_ 842 1;
BA_ "GenMsgCycleTime" BO_ 842 500;
BA_ "VFrameFormat" BO_ 842 14;
BA_ "OriginFrame" BO_ 845 "fuel,ev";
BA_ "GenMsgILSupport" BO_ 845 1;
BA_ "GenMsgCycleTime" BO_ 845 500;
BA_ "VFrameFormat" BO_ 845 14;
BA_ "SC_Message" BO_ 849 1;
BA_ "SCP_FreshnessValueTxLength" BO_ 849 16;
BA_ "SCP_FreshnessValueLength" BO_ 849 64;
BA_ "SCP_DataId" BO_ 849 849;
BA_ "SCP_AuthInfoTxLength" BO_ 849 48;
BA_ "OriginFrame" BO_ 849 "fuel,ev";
BA_ "GenMsgNrOfRepetition" BO_ 849 5;
BA_ "GenMsgILSupport" BO_ 849 1;
BA_ "GenMsgCycleTimeFast" BO_ 849 20;
BA_ "GenMsgCycleTime" BO_ 849 500;
BA_ "VFrameFormat" BO_ 849 14;
BA_ "OriginFrame" BO_ 862 "fuel,ev";
BA_ "GenMsgILSupport" BO_ 862 1;
BA_ "GenMsgCycleTime" BO_ 862 500;
BA_ "VFrameFormat" BO_ 862 14;
BA_ "OriginFrame" BO_ 871 "fuel,ev";
BA_ "GenMsgSendType" BO_ 871 2;
BA_ "GenMsgNrOfRepetition" BO_ 871 5;
BA_ "GenMsgILSupport" BO_ 871 1;
BA_ "GenMsgCycleTimeFast" BO_ 871 60;
BA_ "VFrameFormat" BO_ 871 14;
BA_ "OriginFrame" BO_ 873 "fuel,ev";
BA_ "GenMsgSendType" BO_ 873 2;
BA_ "GenMsgNrOfRepetition" BO_ 873 5;
BA_ "GenMsgILSupport" BO_ 873 1;
BA_ "GenMsgCycleTimeFast" BO_ 873 60;
BA_ "VFrameFormat" BO_ 873 14;
BA_ "OriginFrame" BO_ 875 "fuel,ev";
BA_ "GenMsgSendType" BO_ 875 2;
BA_ "GenMsgNrOfRepetition" BO_ 875 5;
BA_ "GenMsgILSupport" BO_ 875 1;
BA_ "GenMsgCycleTimeFast" BO_ 875 50;
BA_ "VFrameFormat" BO_ 875 14;
BA_ "OriginFrame" BO_ 877 "fuel,ev";
BA_ "GenMsgSendType" BO_ 877 2;
BA_ "GenMsgNrOfRepetition" BO_ 877 5;
BA_ "GenMsgILSupport" BO_ 877 1;
BA_ "GenMsgCycleTimeFast" BO_ 877 50;
BA_ "VFrameFormat" BO_ 877 14;
BA_ "OriginFrame" BO_ 880 "fuel,ev";
BA_ "GenMsgILSupport" BO_ 880 1;
BA_ "GenMsgCycleTime" BO_ 880 1000;
BA_ "VFrameFormat" BO_ 880 14;
BA_ "OriginFrame" BO_ 881 "fuel,ev";
BA_ "GenMsgILSupport" BO_ 881 1;
BA_ "GenMsgCycleTime" BO_ 881 100;
BA_ "VFrameFormat" BO_ 881 14;
BA_ "OriginFrame" BO_ 901 "fuel,ev";
BA_ "GenMsgILSupport" BO_ 901 1;
BA_ "GenMsgCycleTime" BO_ 901 100;
BA_ "VFrameFormat" BO_ 901 14;
BA_ "SC_Message" BO_ 917 1;
BA_ "SCP_FreshnessValueTxLength" BO_ 917 16;
BA_ "SCP_FreshnessValueLength" BO_ 917 64;
BA_ "SCP_DataId" BO_ 917 917;
BA_ "SCP_AuthInfoTxLength" BO_ 917 48;
BA_ "OriginFrame" BO_ 917 "fuel,ev";
BA_ "GenMsgILSupport" BO_ 917 1;
BA_ "GenMsgCycleTime" BO_ 917 500;
BA_ "VFrameFormat" BO_ 917 14;
BA_ "OriginFrame" BO_ 943 "fuel,ev";
BA_ "GenMsgILSupport" BO_ 943 1;
BA_ "GenMsgCycleTime" BO_ 943 1000;
BA_ "VFrameFormat" BO_ 943 14;
BA_ "OriginFrame" BO_ 949 "fuel,ev";
BA_ "GenMsgILSupport" BO_ 949 1;
BA_ "GenMsgCycleTime" BO_ 949 1000;
BA_ "VFrameFormat" BO_ 949 14;
BA_ "OriginFrame" BO_ 951 "fuel,ev";
BA_ "GenMsgILSupport" BO_ 951 1;
BA_ "GenMsgCycleTime" BO_ 951 1000;
BA_ "VFrameFormat" BO_ 951 14;
BA_ "OriginFrame" BO_ 962 "fuel,ev";
BA_ "GenMsgILSupport" BO_ 962 1;
BA_ "GenMsgCycleTime" BO_ 962 1000;
BA_ "VFrameFormat" BO_ 962 14;
BA_ "OriginFrame" BO_ 993 "fuel,ev";
BA_ "GenMsgSendType" BO_ 993 2;
BA_ "GenMsgNrOfRepetition" BO_ 993 5;
BA_ "GenMsgILSupport" BO_ 993 1;
BA_ "GenMsgCycleTimeFast" BO_ 993 20;
BA_ "VFrameFormat" BO_ 993 14;
BA_ "SC_Message" BO_ 995 1;
BA_ "SCP_FreshnessValueTxLength" BO_ 995 16;
BA_ "SCP_FreshnessValueLength" BO_ 995 64;
BA_ "SCP_DataId" BO_ 995 995;
BA_ "SCP_AuthInfoTxLength" BO_ 995 48;
BA_ "OriginFrame" BO_ 995 "fuel,ev";
BA_ "GenMsgSendType" BO_ 995 2;
BA_ "GenMsgNrOfRepetition" BO_ 995 5;
BA_ "GenMsgILSupport" BO_ 995 1;
BA_ "GenMsgCycleTimeFast" BO_ 995 20;
BA_ "VFrameFormat" BO_ 995 14;
BA_ "OriginFrame" BO_ 997 "fuel,ev";
BA_ "GenMsgSendType" BO_ 997 2;
BA_ "GenMsgNrOfRepetition" BO_ 997 5;
BA_ "GenMsgILSupport" BO_ 997 1;
BA_ "GenMsgCycleTimeFast" BO_ 997 20;
BA_ "VFrameFormat" BO_ 997 14;
BA_ "SC_Message" BO_ 1001 1;
BA_ "SCP_FreshnessValueTxLength" BO_ 1001 16;
BA_ "SCP_FreshnessValueLength" BO_ 1001 64;
BA_ "SCP_DataId" BO_ 1001 1001;
BA_ "SCP_AuthInfoTxLength" BO_ 1001 48;
BA_ "OriginFrame" BO_ 1001 "fuel,ev";
BA_ "GenMsgILSupport" BO_ 1001 1;
BA_ "GenMsgCycleTime" BO_ 1001 1000;
BA_ "VFrameFormat" BO_ 1001 14;
BA_ "OriginFrame" BO_ 1045 "fuel,ev";
BA_ "GenMsgILSupport" BO_ 1045 1;
BA_ "GenMsgCycleTime" BO_ 1045 5000;
BA_ "VFrameFormat" BO_ 1045 14;
BA_ "OriginFrame" BO_ 1888 "fuel,ev";
BA_ "GenMsgSendType" BO_ 1888 2;
BA_ "DiagState" BO_ 1888 1;
BA_ "VFrameFormat" BO_ 1888 14;
BA_ "OriginFrame" BO_ 1889 "fuel,ev";
BA_ "GenMsgSendType" BO_ 1889 2;
BA_ "DiagRequest" BO_ 1889 1;
BA_ "VFrameFormat" BO_ 1889 14;
BA_ "OriginFrame" BO_ 1918 "fuel,ev";
BA_ "GenMsgSendType" BO_ 1918 2;
BA_ "DiagRequest" BO_ 1918 1;
BA_ "VFrameFormat" BO_ 1918 14;
BA_ "OriginFrame" BO_ 1843 "fuel,ev";
BA_ "GenMsgSendType" BO_ 1843 2;
BA_ "DiagRequest" BO_ 1843 1;
BA_ "VFrameFormat" BO_ 1843 14;
BA_ "OriginFrame" BO_ 1907 "fuel,ev";
BA_ "GenMsgSendType" BO_ 1907 2;
BA_ "DiagRequest" BO_ 1907 1;
BA_ "VFrameFormat" BO_ 1907 14;
BA_ "OriginFrame" BO_ 1953 "fuel,ev";
BA_ "GenMsgSendType" BO_ 1953 2;
BA_ "DiagResponse" BO_ 1953 1;
BA_ "VFrameFormat" BO_ 1953 14;
BA_ "OriginFrame" BO_ 1982 "fuel,ev";
BA_ "GenMsgSendType" BO_ 1982 2;
BA_ "DiagResponse" BO_ 1982 1;
BA_ "VFrameFormat" BO_ 1982 14;
BA_ "OriginFrame" BO_ 1844 "fuel,ev";
BA_ "GenMsgSendType" BO_ 1844 2;
BA_ "DiagResponse" BO_ 1844 1;
BA_ "VFrameFormat" BO_ 1844 14;
BA_ "OriginFrame" BO_ 1971 "fuel,ev";
BA_ "GenMsgSendType" BO_ 1971 2;
BA_ "DiagResponse" BO_ 1971 1;
BA_ "VFrameFormat" BO_ 1971 14;
BA_ "VFrameFormat" BO_ 1290 0;
BA_ "OriginFrame" BO_ 1290 "fuel,ev";
BA_ "NmAsrMessage" BO_ 1290 1;
BA_ "GenMsgSendType" BO_ 1290 2;
BA_ "VFrameFormat" BO_ 1289 0;
BA_ "OriginFrame" BO_ 1289 "fuel,ev";
BA_ "NmAsrMessage" BO_ 1289 1;
BA_ "GenMsgSendType" BO_ 1289 2;
BA_ "VFrameFormat" BO_ 1334 0;
BA_ "OriginFrame" BO_ 1334 "fuel,ev";
BA_ "NmAsrMessage" BO_ 1334 1;
BA_ "GenMsgSendType" BO_ 1334 2;
BA_ "VFrameFormat" BO_ 1281 0;
BA_ "OriginFrame" BO_ 1281 "fuel,ev";
BA_ "NmAsrMessage" BO_ 1281 1;
BA_ "GenMsgSendType" BO_ 1281 2;
BA_ "OriginFrame" BO_ 1122 "fuel,ev";
BA_ "GenMsgSendType" BO_ 1122 2;
BA_ "GenMsgILSupport" BO_ 1122 1;
BA_ "VFrameFormat" BO_ 1122 14;
BA_ "SC_Message" BO_ 1121 1;
BA_ "SCP_FreshnessValueTxLength" BO_ 1121 40;
BA_ "SCP_FreshnessValueLength" BO_ 1121 40;
BA_ "SCP_DataId" BO_ 1121 1121;
BA_ "SCP_AuthInfoTxLength" BO_ 1121 88;
BA_ "OriginFrame" BO_ 1121 "fuel,ev";
BA_ "VFrameFormat" BO_ 1121 14;
BA_ "OriginFrame" BO_ 53 "ev";
BA_ "GenMsgSendType" BO_ 53 2;
BA_ "GenMsgNrOfRepetition" BO_ 53 5;
BA_ "GenMsgILSupport" BO_ 53 1;
BA_ "GenMsgCycleTimeFast" BO_ 53 20;
BA_ "VFrameFormat" BO_ 53 14;
BA_ "OriginFrame" BO_ 54 "ev";
BA_ "GenMsgSendType" BO_ 54 2;
BA_ "GenMsgNrOfRepetition" BO_ 54 5;
BA_ "GenMsgILSupport" BO_ 54 1;
BA_ "GenMsgCycleTimeFast" BO_ 54 20;
BA_ "VFrameFormat" BO_ 54 14;
BA_ "OriginFrame" BO_ 70 "ev";
BA_ "GenMsgSendType" BO_ 70 2;
BA_ "GenMsgNrOfRepetition" BO_ 70 5;
BA_ "GenMsgILSupport" BO_ 70 1;
BA_ "GenMsgCycleTimeFast" BO_ 70 20;
BA_ "VFrameFormat" BO_ 70 14;
BA_ "OriginFrame" BO_ 72 "ev";
BA_ "GenMsgSendType" BO_ 72 2;
BA_ "GenMsgNrOfRepetition" BO_ 72 5;
BA_ "GenMsgILSupport" BO_ 72 1;
BA_ "GenMsgCycleTimeFast" BO_ 72 20;
BA_ "VFrameFormat" BO_ 72 14;
BA_ "OriginFrame" BO_ 96 "ev";
BA_ "GenMsgILSupport" BO_ 96 1;
BA_ "GenMsgCycleTime" BO_ 96 10;
BA_ "VFrameFormat" BO_ 96 14;
BA_ "OriginFrame" BO_ 142 "ev";
BA_ "GenMsgILSupport" BO_ 142 1;
BA_ "GenMsgCycleTime" BO_ 142 10;
BA_ "VFrameFormat" BO_ 142 14;
BA_ "OriginFrame" BO_ 172 "ev";
BA_ "GenMsgILSupport" BO_ 172 1;
BA_ "GenMsgCycleTime" BO_ 172 10;
BA_ "VFrameFormat" BO_ 172 14;
BA_ "OriginFrame" BO_ 190 "ev";
BA_ "GenMsgILSupport" BO_ 190 1;
BA_ "GenMsgCycleTime" BO_ 190 10;
BA_ "VFrameFormat" BO_ 190 14;
BA_ "OriginFrame" BO_ 249 "ev";
BA_ "GenMsgILSupport" BO_ 249 1;
BA_ "GenMsgCycleTime" BO_ 249 10;
BA_ "VFrameFormat" BO_ 249 14;
BA_ "OriginFrame" BO_ 279 "ev";
BA_ "GenMsgILSupport" BO_ 279 1;
BA_ "GenMsgCycleTime" BO_ 279 20;
BA_ "VFrameFormat" BO_ 279 14;
BA_ "OriginFrame" BO_ 282 "ev";
BA_ "GenMsgILSupport" BO_ 282 1;
BA_ "GenMsgCycleTime" BO_ 282 20;
BA_ "VFrameFormat" BO_ 282 14;
BA_ "OriginFrame" BO_ 301 "ev";
BA_ "GenMsgILSupport" BO_ 301 1;
BA_ "GenMsgCycleTime" BO_ 301 20;
BA_ "VFrameFormat" BO_ 301 14;
BA_ "OriginFrame" BO_ 330 "ev";
BA_ "GenMsgILSupport" BO_ 330 1;
BA_ "GenMsgCycleTime" BO_ 330 20;
BA_ "VFrameFormat" BO_ 330 14;
BA_ "OriginFrame" BO_ 448 "ev";
BA_ "GenMsgILSupport" BO_ 448 1;
BA_ "GenMsgCycleTime" BO_ 448 50;
BA_ "VFrameFormat" BO_ 448 14;
BA_ "Origin" SG_ 796 AudioMuteSts "fuel,ev";
BA_ "Match" SG_ 796 AudioMuteSts "AudioMuteSts";
BA_ "GenSigCycleTime" SG_ 796 AudioMuteSts 100;
BA_ "Origin" SG_ 796 OrvmPosnEnaSts "fuel,ev";
BA_ "Match" SG_ 796 OrvmPosnEnaSts "OrvmPosnEnaSts";
BA_ "GenSigCycleTime" SG_ 796 OrvmPosnEnaSts 100;
BA_ "Origin" SG_ 796 ORVMFoldSwt_HUT "fuel,ev";
BA_ "Match" SG_ 796 ORVMFoldSwt_HUT "ORVMFoldSwt_HUT";
BA_ "GenSigCycleTime" SG_ 796 ORVMFoldSwt_HUT 100;
BA_ "Origin" SG_ 796 ORVMLensAdjmt_HUT "fuel,ev";
BA_ "Match" SG_ 796 ORVMLensAdjmt_HUT "ORVMLensAdjmt_HUT";
BA_ "GenSigCycleTime" SG_ 796 ORVMLensAdjmt_HUT 100;
BA_ "Origin" SG_ 796 DrvSeatAdjmt_HUT "fuel,ev";
BA_ "Match" SG_ 796 DrvSeatAdjmt_HUT "DrvSeatAdjmt_HUT";
BA_ "GenSigCycleTime" SG_ 796 DrvSeatAdjmt_HUT 100;
BA_ "Origin" SG_ 796 DrivingModReq_VR "fuel,ev";
BA_ "Match" SG_ 796 DrivingModReq_VR "DrivingModReq_VR";
BA_ "GenSigStartValue" SG_ 796 DrivingModReq_VR 15;
BA_ "GenSigCycleTime" SG_ 796 DrivingModReq_VR 100;
BA_ "Origin" SG_ 796 DWD_WorkCmd "fuel,ev";
BA_ "Match" SG_ 796 DWD_WorkCmd "DWD_WorkCmd";
BA_ "GenSigCycleTime" SG_ 796 DWD_WorkCmd 100;
BA_ "Origin" SG_ 796 DampgDrvModeReq "fuel,ev";
BA_ "Match" SG_ 796 DampgDrvModeReq "DampgDrvModeReq";
BA_ "GenSigStartValue" SG_ 796 DampgDrvModeReq 1;
BA_ "GenSigCycleTime" SG_ 796 DampgDrvModeReq 100;
BA_ "Origin" SG_ 796 VSGSwtSet "ev";
BA_ "Match" SG_ 796 VSGSwtSet "VSGSwtSet";
BA_ "GenSigStartValue" SG_ 796 VSGSwtSet 1;
BA_ "GenSigCycleTime" SG_ 796 VSGSwtSet 100;
BA_ "TransparentInitValue" SG_ 796 HUT13_0x31C "0 1 0 0 240 0 64 0 ";
BA_ "GenSigCycleTime" SG_ 796 HUT13_0x31C 100;
BA_ "Origin" SG_ 805 HUD_SwtSts "fuel,ev";
BA_ "Match" SG_ 805 HUD_SwtSts "HUD_SwtSts";
BA_ "GenSigStartValue" SG_ 805 HUD_SwtSts 1;
BA_ "GenSigCycleTime" SG_ 805 HUD_SwtSts 200;
BA_ "Origin" SG_ 805 HUD_BrightnessLvl "fuel,ev";
BA_ "Match" SG_ 805 HUD_BrightnessLvl "HUD_BrightnessLvl";
BA_ "GenSigStartValue" SG_ 805 HUD_BrightnessLvl 4;
BA_ "GenSigCycleTime" SG_ 805 HUD_BrightnessLvl 200;
BA_ "Origin" SG_ 805 HUD_HeightLvl "fuel,ev";
BA_ "Match" SG_ 805 HUD_HeightLvl "HUD_HeightLvl";
BA_ "GenSigStartValue" SG_ 805 HUD_HeightLvl 10;
BA_ "GenSigCycleTime" SG_ 805 HUD_HeightLvl 200;
BA_ "Origin" SG_ 805 HUD_UIMod "fuel,ev";
BA_ "Match" SG_ 805 HUD_UIMod "HUD_UIMod";
BA_ "GenSigCycleTime" SG_ 805 HUD_UIMod 200;
BA_ "Origin" SG_ 805 HUD_UIModVld "fuel,ev";
BA_ "Match" SG_ 805 HUD_UIModVld "HUD_UIModVld";
BA_ "GenSigCycleTime" SG_ 805 HUD_UIModVld 200;
BA_ "Origin" SG_ 805 HUD_Manufactor "fuel,ev";
BA_ "Match" SG_ 805 HUD_Manufactor "HUD_Manufactor";
BA_ "GenSigStartValue" SG_ 805 HUD_Manufactor 7;
BA_ "GenSigCycleTime" SG_ 805 HUD_Manufactor 200;
BA_ "Origin" SG_ 805 HUD_ReslType "fuel,ev";
BA_ "Match" SG_ 805 HUD_ReslType "HUD_ReslType";
BA_ "GenSigStartValue" SG_ 805 HUD_ReslType 7;
BA_ "GenSigCycleTime" SG_ 805 HUD_ReslType 200;
BA_ "Origin" SG_ 805 HUD_UIModDefd "fuel,ev";
BA_ "Match" SG_ 805 HUD_UIModDefd "HUD_UIModDefd";
BA_ "GenSigCycleTime" SG_ 805 HUD_UIModDefd 200;
BA_ "TransparentInitValue" SG_ 805 HUD1_0x325 "0 65 40 0 0 252 0 0 ";
BA_ "GenSigCycleTime" SG_ 805 HUD1_0x325 200;
BA_ "Origin" SG_ 816 Checksum_HCM_R2 "fuel,ev";
BA_ "Match" SG_ 816 Checksum_HCM_R2 "Checksum_HCM_R2";
BA_ "GenSigCycleTime" SG_ 816 Checksum_HCM_R2 200;
BA_ "Origin" SG_ 816 RightLightShowSts "fuel,ev";
BA_ "Match" SG_ 816 RightLightShowSts "RightLightShowSts";
BA_ "GenSigCycleTime" SG_ 816 RightLightShowSts 200;
BA_ "Origin" SG_ 816 FRMusicLightShowSts "fuel,ev";
BA_ "Match" SG_ 816 FRMusicLightShowSts "FRMusicLightShowSts";
BA_ "GenSigCycleTime" SG_ 816 FRMusicLightShowSts 200;
BA_ "Origin" SG_ 816 RollingCounter_HCM_R2 "fuel,ev";
BA_ "Match" SG_ 816 RollingCounter_HCM_R2 "RollingCounter_HCM_R2";
BA_ "GenSigCycleTime" SG_ 816 RollingCounter_HCM_R2 200;
BA_ "TransparentInitValue" SG_ 816 HCM_R2_0x330 "0 0 0 0 0 0 0 0 ";
BA_ "GenSigCycleTime" SG_ 816 HCM_R2_0x330 200;
BA_ "Origin" SG_ 817 ACDualReq_VR "fuel,ev";
BA_ "Match" SG_ 817 ACDualReq_VR "ACDualReq_VR";
BA_ "GenSigSendType" SG_ 817 ACDualReq_VR 2;
BA_ "Origin" SG_ 817 ACAQSReq_VR "fuel,ev";
BA_ "Match" SG_ 817 ACAQSReq_VR "ACAQSReq_VR";
BA_ "GenSigSendType" SG_ 817 ACAQSReq_VR 2;
BA_ "Origin" SG_ 817 ACRearDefrstReq_VR "fuel,ev";
BA_ "Match" SG_ 817 ACRearDefrstReq_VR "ACRearDefrstReq_VR";
BA_ "GenSigSendType" SG_ 817 ACRearDefrstReq_VR 2;
BA_ "Origin" SG_ 817 ACPassTempReq_VR "fuel,ev";
BA_ "Match" SG_ 817 ACPassTempReq_VR "ACPassTempReq_VR";
BA_ "GenSigSendType" SG_ 817 ACPassTempReq_VR 2;
BA_ "Origin" SG_ 817 ACAIUReq_VR "fuel,ev";
BA_ "Match" SG_ 817 ACAIUReq_VR "ACAIUReq_VR";
BA_ "GenSigSendType" SG_ 817 ACAIUReq_VR 2;
BA_ "Origin" SG_ 817 ALCMStatSwt "fuel,ev";
BA_ "Match" SG_ 817 ALCMStatSwt "ALCMStatSwt";
BA_ "GenSigSendType" SG_ 817 ALCMStatSwt 2;
BA_ "Origin" SG_ 817 ALCMDynSwt "fuel,ev";
BA_ "Match" SG_ 817 ALCMDynSwt "ALCMDynSwt";
BA_ "GenSigSendType" SG_ 817 ALCMDynSwt 2;
BA_ "Origin" SG_ 817 ALCMClrSet "fuel,ev";
BA_ "Match" SG_ 817 ALCMClrSet "ALCMClrSet";
BA_ "GenSigSendType" SG_ 817 ALCMClrSet 2;
BA_ "Origin" SG_ 817 ALCMRhmSwt "fuel,ev";
BA_ "Match" SG_ 817 ALCMRhmSwt "ALCMRhmSwt";
BA_ "GenSigStartValue" SG_ 817 ALCMRhmSwt 1;
BA_ "GenSigSendType" SG_ 817 ALCMRhmSwt 2;
BA_ "Origin" SG_ 817 IPVolSet "fuel,ev";
BA_ "Match" SG_ 817 IPVolSet "IPVolSet";
BA_ "GenSigStartValue" SG_ 817 IPVolSet 15;
BA_ "GenSigSendType" SG_ 817 IPVolSet 2;
BA_ "Origin" SG_ 817 PASSwtReq_VR "fuel,ev";
BA_ "Match" SG_ 817 PASSwtReq_VR "PASSwtReq_VR";
BA_ "GenSigSendType" SG_ 817 PASSwtReq_VR 2;
BA_ "Origin" SG_ 817 HUT_BeanIDReq "fuel,ev";
BA_ "Match" SG_ 817 HUT_BeanIDReq "HUT_BeanIDReq";
BA_ "GenSigSendType" SG_ 817 HUT_BeanIDReq 2;
BA_ "Origin" SG_ 817 HUT_EgyRecvrySet "ev";
BA_ "Match" SG_ 817 HUT_EgyRecvrySet "HUT_EgyRecvrySet";
BA_ "GenSigSendType" SG_ 817 HUT_EgyRecvrySet 2;
BA_ "TransparentInitValue" SG_ 817 HUT10_0x331 "0 0 0 1 0 0 0 60 ";
BA_ "GenSigSendType" SG_ 817 HUT10_0x331 2;
BA_ "Origin" SG_ 818 RFLLightShowSts "fuel,ev";
BA_ "Match" SG_ 818 RFLLightShowSts "RFLLightShowSts";
BA_ "GenSigCycleTime" SG_ 818 RFLLightShowSts 200;
BA_ "TransparentInitValue" SG_ 818 RFCM_L1_0x332 "0 0 0 0 0 0 0 0 ";
BA_ "GenSigCycleTime" SG_ 818 RFCM_L1_0x332 200;
BA_ "Origin" SG_ 819 RFRLightShowSts "fuel,ev";
BA_ "Match" SG_ 819 RFRLightShowSts "RFRLightShowSts";
BA_ "GenSigCycleTime" SG_ 819 RFRLightShowSts 200;
BA_ "TransparentInitValue" SG_ 819 RFCM_R1_0x333 "0 0 0 0 0 0 0 0 ";
BA_ "GenSigCycleTime" SG_ 819 RFCM_R1_0x333 200;
BA_ "Origin" SG_ 825 HUT_RemtEngCtrl "fuel,ev";
BA_ "Match" SG_ 825 HUT_RemtEngCtrl "HUT_RemtEngCtrl";
BA_ "GenSigSendType" SG_ 825 HUT_RemtEngCtrl 2;
BA_ "Origin" SG_ 825 ACDrvSetTempReq_ETC_VR "fuel,ev";
BA_ "Match" SG_ 825 ACDrvSetTempReq_ETC_VR "ACDrvSetTempReq_ETC_VR";
BA_ "GenSigSendType" SG_ 825 ACDrvSetTempReq_ETC_VR 2;
BA_ "Origin" SG_ 825 ACDrvSetTempSteplsReq_ETC_TC "fuel,ev";
BA_ "Match" SG_ 825 ACDrvSetTempSteplsReq_ETC_TC "ACDrvSetTempSteplsReq_ETC_TC";
BA_ "GenSigSendType" SG_ 825 ACDrvSetTempSteplsReq_ETC_TC 2;
BA_ "Origin" SG_ 825 HUT_ChrgnMode "ev";
BA_ "Match" SG_ 825 HUT_ChrgnMode "HUT_ChrgnMode";
BA_ "GenSigSendType" SG_ 825 HUT_ChrgnMode 2;
BA_ "Origin" SG_ 825 HUT_BattKeepTemp "ev";
BA_ "Match" SG_ 825 HUT_BattKeepTemp "HUT_BattKeepTemp";
BA_ "GenSigSendType" SG_ 825 HUT_BattKeepTemp 2;
BA_ "Origin" SG_ 825 HUT_IntelEngIdlChrgnSet "ev";
BA_ "Match" SG_ 825 HUT_IntelEngIdlChrgnSet "HUT_IntelEngIdlChrgnSet";
BA_ "GenSigSendType" SG_ 825 HUT_IntelEngIdlChrgnSet 2;
BA_ "Origin" SG_ 825 HUT_IntelBattTempMagSet "ev";
BA_ "Match" SG_ 825 HUT_IntelBattTempMagSet "HUT_IntelBattTempMagSet";
BA_ "GenSigSendType" SG_ 825 HUT_IntelBattTempMagSet 2;
BA_ "Origin" SG_ 825 HUT_BattSOCLim "ev";
BA_ "Match" SG_ 825 HUT_BattSOCLim "HUT_BattSOCLim";
BA_ "GenSigStartValue" SG_ 825 HUT_BattSOCLim 6;
BA_ "GenSigSendType" SG_ 825 HUT_BattSOCLim 2;
BA_ "TransparentInitValue" SG_ 825 HUT25_0x339 "0 0 0 0 0 0 0 192 ";
BA_ "GenSigSendType" SG_ 825 HUT25_0x339 2;
BA_ "Origin" SG_ 827 BackgroundLightLvlSet "fuel,ev";
BA_ "Match" SG_ 827 BackgroundLightLvlSet "BackgroundLightLvlSet";
BA_ "GenSigStartValue" SG_ 827 BackgroundLightLvlSet 10;
BA_ "GenSigSendType" SG_ 827 BackgroundLightLvlSet 2;
BA_ "Origin" SG_ 827 ManCmpSet "fuel,ev";
BA_ "Match" SG_ 827 ManCmpSet "ManCmpSet";
BA_ "GenSigStartValue" SG_ 827 ManCmpSet 5;
BA_ "GenSigSendType" SG_ 827 ManCmpSet 2;
BA_ "Origin" SG_ 827 DispModSet "fuel,ev";
BA_ "Match" SG_ 827 DispModSet "DispModSet";
BA_ "GenSigSendType" SG_ 827 DispModSet 2;
BA_ "Origin" SG_ 827 WPC_SwtReq "fuel,ev";
BA_ "Match" SG_ 827 WPC_SwtReq "WPC_SwtReq";
BA_ "GenSigStartValue" SG_ 827 WPC_SwtReq 1;
BA_ "GenSigSendType" SG_ 827 WPC_SwtReq 2;
BA_ "Origin" SG_ 827 AVMSwtReq "fuel,ev";
BA_ "Match" SG_ 827 AVMSwtReq "AVMSwtReq";
BA_ "GenSigSendType" SG_ 827 AVMSwtReq 2;
BA_ "Origin" SG_ 827 NaviMediaVolLvlReq "fuel,ev";
BA_ "Match" SG_ 827 NaviMediaVolLvlReq "NaviMediaVolLvlReq";
BA_ "GenSigStartValue" SG_ 827 NaviMediaVolLvlReq 3;
BA_ "GenSigSendType" SG_ 827 NaviMediaVolLvlReq 2;
BA_ "Origin" SG_ 827 AVMMediaVolLvlReq "fuel,ev";
BA_ "Match" SG_ 827 AVMMediaVolLvlReq "AVMMediaVolLvlReq";
BA_ "GenSigStartValue" SG_ 827 AVMMediaVolLvlReq 3;
BA_ "GenSigSendType" SG_ 827 AVMMediaVolLvlReq 2;
BA_ "Origin" SG_ 827 FPASChanSwtReq "fuel,ev";
BA_ "Match" SG_ 827 FPASChanSwtReq "FPASChanSwtReq";
BA_ "GenSigSendType" SG_ 827 FPASChanSwtReq 2;
BA_ "Origin" SG_ 827 RPASChanSwtReq "fuel,ev";
BA_ "Match" SG_ 827 RPASChanSwtReq "RPASChanSwtReq";
BA_ "GenSigSendType" SG_ 827 RPASChanSwtReq 2;
BA_ "Origin" SG_ 827 ACRearBlwrSpdReq_VR "fuel,ev";
BA_ "Match" SG_ 827 ACRearBlwrSpdReq_VR "ACRearBlwrSpdReq_VR";
BA_ "GenSigSendType" SG_ 827 ACRearBlwrSpdReq_VR 2;
BA_ "Origin" SG_ 827 ACRearBlwrsteplsSpdReq_TC "fuel,ev";
BA_ "Match" SG_ 827 ACRearBlwrsteplsSpdReq_TC "ACRearBlwrsteplsSpdReq_TC";
BA_ "GenSigSendType" SG_ 827 ACRearBlwrsteplsSpdReq_TC 2;
BA_ "Origin" SG_ 827 PLGReq_VR "fuel,ev";
BA_ "Match" SG_ 827 PLGReq_VR "PLGReq_VR";
BA_ "GenSigSendType" SG_ 827 PLGReq_VR 2;
BA_ "Origin" SG_ 827 ACRearAirDistribModReq_VR "fuel,ev";
BA_ "Match" SG_ 827 ACRearAirDistribModReq_VR "ACRearAirDistribModReq_VR";
BA_ "GenSigSendType" SG_ 827 ACRearAirDistribModReq_VR 2;
BA_ "Origin" SG_ 827 ACZoneReq_VR "fuel,ev";
BA_ "Match" SG_ 827 ACZoneReq_VR "ACZoneReq_VR";
BA_ "GenSigSendType" SG_ 827 ACZoneReq_VR 2;
BA_ "Origin" SG_ 827 OPDSwtSts "ev";
BA_ "Match" SG_ 827 OPDSwtSts "OPDSwtSts";
BA_ "GenSigStartValue" SG_ 827 OPDSwtSts 1;
BA_ "GenSigSendType" SG_ 827 OPDSwtSts 2;
BA_ "TransparentInitValue" SG_ 827 HUT17_0x33B "0 0 64 51 165 0 16 0 ";
BA_ "GenSigSendType" SG_ 827 HUT17_0x33B 2;
BA_ "Origin" SG_ 833 FLTirePressIndSts "fuel,ev";
BA_ "Match" SG_ 833 FLTirePressIndSts "FLTirePressIndSts";
BA_ "GenSigCycleTime" SG_ 833 FLTirePressIndSts 500;
BA_ "Origin" SG_ 833 FRTirePressIndSts "fuel,ev";
BA_ "Match" SG_ 833 FRTirePressIndSts "FRTirePressIndSts";
BA_ "GenSigCycleTime" SG_ 833 FRTirePressIndSts 500;
BA_ "Origin" SG_ 833 TirePressSysFailrIndcn "fuel,ev";
BA_ "Match" SG_ 833 TirePressSysFailrIndcn "TirePressSysFailrIndcn";
BA_ "GenSigCycleTime" SG_ 833 TirePressSysFailrIndcn 500;
BA_ "Origin" SG_ 833 RLTirePressIndSts "fuel,ev";
BA_ "Match" SG_ 833 RLTirePressIndSts "RLTirePressIndSts";
BA_ "GenSigCycleTime" SG_ 833 RLTirePressIndSts 500;
BA_ "Origin" SG_ 833 RRTirePressIndSts "fuel,ev";
BA_ "Match" SG_ 833 RRTirePressIndSts "RRTirePressIndSts";
BA_ "GenSigCycleTime" SG_ 833 RRTirePressIndSts 500;
BA_ "Origin" SG_ 833 FLTireTempSts "fuel,ev";
BA_ "Match" SG_ 833 FLTireTempSts "FLTireTempSts";
BA_ "GenSigCycleTime" SG_ 833 FLTireTempSts 500;
BA_ "Origin" SG_ 833 FRTireTempSts "fuel,ev";
BA_ "Match" SG_ 833 FRTireTempSts "FRTireTempSts";
BA_ "GenSigCycleTime" SG_ 833 FRTireTempSts 500;
BA_ "Origin" SG_ 833 RLTireTempSts "fuel,ev";
BA_ "Match" SG_ 833 RLTireTempSts "RLTireTempSts";
BA_ "GenSigCycleTime" SG_ 833 RLTireTempSts 500;
BA_ "Origin" SG_ 833 RRTireTempSts "fuel,ev";
BA_ "Match" SG_ 833 RRTireTempSts "RRTireTempSts";
BA_ "GenSigCycleTime" SG_ 833 RRTireTempSts 500;
BA_ "Origin" SG_ 833 FreshnessValue_TPMS1 "fuel,ev";
BA_ "Match" SG_ 833 FreshnessValue_TPMS1 "FreshnessValue_TPMS1";
BA_ "GenSigCycleTime" SG_ 833 FreshnessValue_TPMS1 500;
BA_ "Origin" SG_ 833 MAC_Check_TPMS1 "fuel,ev";
BA_ "Match" SG_ 833 MAC_Check_TPMS1 "MAC_Check_TPMS1";
BA_ "GenSigCycleTime" SG_ 833 MAC_Check_TPMS1 500;
BA_ "Origin" SG_ 833 TPMS_AutoLoctSts "ev";
BA_ "Match" SG_ 833 TPMS_AutoLoctSts "TPMS_AutoLoctSts";
BA_ "GenSigCycleTime" SG_ 833 TPMS_AutoLoctSts 500;
BA_ "TransparentInitValue" SG_ 833 TPMS1_0x341 "0 0 0 0 0 0 0 0 0 0 0 0 0 0 0 0 ";
BA_ "GenSigCycleTime" SG_ 833 TPMS1_0x341 500;
BA_ "Origin" SG_ 836 AntiDisIdnResult "fuel,ev";
BA_ "Match" SG_ 836 AntiDisIdnResult "AntiDisIdnResult";
BA_ "GenSigStartValue" SG_ 836 AntiDisIdnResult 2;
BA_ "GenSigCycleTime" SG_ 836 AntiDisIdnResult 500;
BA_ "Origin" SG_ 836 SelfChkSts "fuel,ev";
BA_ "Match" SG_ 836 SelfChkSts "SelfChkSts";
BA_ "GenSigStartValue" SG_ 836 SelfChkSts 2;
BA_ "GenSigCycleTime" SG_ 836 SelfChkSts 500;
BA_ "Origin" SG_ 836 ActvdSts "fuel,ev";
BA_ "Match" SG_ 836 ActvdSts "ActvdSts";
BA_ "GenSigStartValue" SG_ 836 ActvdSts 2;
BA_ "GenSigCycleTime" SG_ 836 ActvdSts 500;
BA_ "TransparentInitValue" SG_ 836 ETC3_0x344 "168 0 0 0 0 0 0 0 ";
BA_ "GenSigCycleTime" SG_ 836 ETC3_0x344 500;
BA_ "Origin" SG_ 837 LasHdLmpSts "fuel,ev";
BA_ "Match" SG_ 837 LasHdLmpSts "LasHdLmpSts";
BA_ "GenSigCycleTime" SG_ 837 LasHdLmpSts 50;
BA_ "Origin" SG_ 837 AntitheftSts "fuel,ev";
BA_ "Match" SG_ 837 AntitheftSts "AntitheftSts";
BA_ "GenSigCycleTime" SG_ 837 AntitheftSts 50;
BA_ "Origin" SG_ 837 DrvDoorLockSts "fuel,ev";
BA_ "Match" SG_ 837 DrvDoorLockSts "DrvDoorLockSts";
BA_ "GenSigCycleTime" SG_ 837 DrvDoorLockSts 50;
BA_ "Origin" SG_ 837 DoorLockSts "fuel,ev";
BA_ "Match" SG_ 837 DoorLockSts "DoorLockSts";
BA_ "GenSigCycleTime" SG_ 837 DoorLockSts 50;
BA_ "Origin" SG_ 837 HiLowBeamSts "fuel,ev";
BA_ "Match" SG_ 837 HiLowBeamSts "HiLowBeamSts";
BA_ "GenSigCycleTime" SG_ 837 HiLowBeamSts 50;
BA_ "Origin" SG_ 837 FreshnessValue_BCM3 "fuel,ev";
BA_ "Match" SG_ 837 FreshnessValue_BCM3 "FreshnessValue_BCM3";
BA_ "GenSigCycleTime" SG_ 837 FreshnessValue_BCM3 50;
BA_ "Origin" SG_ 837 MAC_Check_BCM3 "fuel,ev";
BA_ "Match" SG_ 837 MAC_Check_BCM3 "MAC_Check_BCM3";
BA_ "GenSigCycleTime" SG_ 837 MAC_Check_BCM3 50;
BA_ "Origin" SG_ 837 RLDoorLockSts "ev";
BA_ "Match" SG_ 837 RLDoorLockSts "RLDoorLockSts";
BA_ "GenSigCycleTime" SG_ 837 RLDoorLockSts 50;
BA_ "Origin" SG_ 837 PassDoorLockSts "ev";
BA_ "Match" SG_ 837 PassDoorLockSts "PassDoorLockSts";
BA_ "GenSigCycleTime" SG_ 837 PassDoorLockSts 50;
BA_ "Origin" SG_ 837 RRDoorLockSts "ev";
BA_ "Match" SG_ 837 RRDoorLockSts "RRDoorLockSts";
BA_ "GenSigCycleTime" SG_ 837 RRDoorLockSts 50;
BA_ "Origin" SG_ 837 HazardLmpSwtSts "ev";
BA_ "Match" SG_ 837 HazardLmpSwtSts "HazardLmpSwtSts";
BA_ "GenSigCycleTime" SG_ 837 HazardLmpSwtSts 50;
BA_ "Origin" SG_ 837 LRPosnLmpSts "ev";
BA_ "Match" SG_ 837 LRPosnLmpSts "LRPosnLmpSts";
BA_ "GenSigCycleTime" SG_ 837 LRPosnLmpSts 50;
BA_ "Origin" SG_ 837 RRPosnLmpSts "ev";
BA_ "Match" SG_ 837 RRPosnLmpSts "RRPosnLmpSts";
BA_ "GenSigCycleTime" SG_ 837 RRPosnLmpSts 50;
BA_ "TransparentInitValue" SG_ 837 BCM3_0x345 "0 0 0 0 0 0 0 0 0 0 0 0 0 0 0 0 ";
BA_ "GenSigCycleTime" SG_ 837 BCM3_0x345 50;
BA_ "Origin" SG_ 840 PowerSet "fuel,ev";
BA_ "Match" SG_ 840 PowerSet "PowerSet";
BA_ "GenSigStartValue" SG_ 840 PowerSet 1;
BA_ "GenSigCycleTime" SG_ 840 PowerSet 500;
BA_ "Origin" SG_ 840 HUT_CallSts_Dialing "fuel,ev";
BA_ "Match" SG_ 840 HUT_CallSts_Dialing "HUT_CallSts_Dialing";
BA_ "GenSigCycleTime" SG_ 840 HUT_CallSts_Dialing 500;
BA_ "Origin" SG_ 840 HUT_CallSts_IncomingCall "fuel,ev";
BA_ "Match" SG_ 840 HUT_CallSts_IncomingCall "HUT_CallSts_IncomingCall";
BA_ "GenSigCycleTime" SG_ 840 HUT_CallSts_IncomingCall 500;
BA_ "Origin" SG_ 840 HUT_CallSts_ongoing "fuel,ev";
BA_ "Match" SG_ 840 HUT_CallSts_ongoing "HUT_CallSts_ongoing";
BA_ "GenSigCycleTime" SG_ 840 HUT_CallSts_ongoing 500;
BA_ "Origin" SG_ 840 HUT_CallTime "fuel,ev";
BA_ "Match" SG_ 840 HUT_CallTime "HUT_CallTime";
BA_ "GenSigCycleTime" SG_ 840 HUT_CallTime 500;
BA_ "TransparentInitValue" SG_ 840 HUT16_0x348 "0 0 0 0 128 0 0 0 ";
BA_ "GenSigCycleTime" SG_ 840 HUT16_0x348 500;
BA_ "Origin" SG_ 842 IP_RemainDistance "fuel,ev";
BA_ "Match" SG_ 842 IP_RemainDistance "IP_RemainDistance";
BA_ "GenSigCycleTime" SG_ 842 IP_RemainDistance 500;
BA_ "Origin" SG_ 842 IP_InstFuelConsUnit "fuel,ev";
BA_ "Match" SG_ 842 IP_InstFuelConsUnit "IP_InstFuelConsUnit";
BA_ "GenSigCycleTime" SG_ 842 IP_InstFuelConsUnit 500;
BA_ "Origin" SG_ 842 IP_EBDFailSts "fuel,ev";
BA_ "Match" SG_ 842 IP_EBDFailSts "IP_EBDFailSts";
BA_ "GenSigCycleTime" SG_ 842 IP_EBDFailSts 500;
BA_ "Origin" SG_ 842 IP_AvgFuelCons "fuel,ev";
BA_ "Match" SG_ 842 IP_AvgFuelCons "IP_AvgFuelCons";
BA_ "GenSigStartValue" SG_ 842 IP_AvgFuelCons 4095;
BA_ "GenSigCycleTime" SG_ 842 IP_AvgFuelCons 500;
BA_ "Origin" SG_ 842 IP_InstFuelCons "fuel,ev";
BA_ "Match" SG_ 842 IP_InstFuelCons "IP_InstFuelCons";
BA_ "GenSigStartValue" SG_ 842 IP_InstFuelCons 16383;
BA_ "GenSigCycleTime" SG_ 842 IP_InstFuelCons 500;
BA_ "TransparentInitValue" SG_ 842 IP3_0x34A "0 0 0 255 255 255 192 0 0 0 0 0 0 0 0 0 ";
BA_ "GenSigCycleTime" SG_ 842 IP3_0x34A 500;
BA_ "Origin" SG_ 845 ColMemPosnSetSwtFB "fuel,ev";
BA_ "Match" SG_ 845 ColMemPosnSetSwtFB "ColMemPosnSetSwtFB";
BA_ "GenSigCycleTime" SG_ 845 ColMemPosnSetSwtFB 500;
BA_ "TransparentInitValue" SG_ 845 BCM18_0x34D "0 0 0 0 0 0 0 0 ";
BA_ "GenSigCycleTime" SG_ 845 BCM18_0x34D 500;
BA_ "Origin" SG_ 849 CheckSum_ABM1 "fuel,ev";
BA_ "Match" SG_ 849 CheckSum_ABM1 "CheckSum_ABM1";
BA_ "GenSigSendType" SG_ 849 CheckSum_ABM1 2;
BA_ "GenSigCycleTime" SG_ 849 CheckSum_ABM1 500;
BA_ "Origin" SG_ 849 SecRowLSBR "fuel,ev";
BA_ "Match" SG_ 849 SecRowLSBR "SecRowLSBR";
BA_ "GenSigStartValue" SG_ 849 SecRowLSBR 1;
BA_ "GenSigSendType" SG_ 849 SecRowLSBR 2;
BA_ "GenSigCycleTime" SG_ 849 SecRowLSBR 500;
BA_ "Origin" SG_ 849 AirbFailLmpCmd "fuel,ev";
BA_ "Match" SG_ 849 AirbFailLmpCmd "AirbFailLmpCmd";
BA_ "GenSigStartValue" SG_ 849 AirbFailLmpCmd 1;
BA_ "GenSigSendType" SG_ 849 AirbFailLmpCmd 2;
BA_ "GenSigCycleTime" SG_ 849 AirbFailLmpCmd 500;
BA_ "Origin" SG_ 849 SecRowMidSBR "fuel,ev";
BA_ "Match" SG_ 849 SecRowMidSBR "SecRowMidSBR";
BA_ "GenSigStartValue" SG_ 849 SecRowMidSBR 1;
BA_ "GenSigSendType" SG_ 849 SecRowMidSBR 2;
BA_ "GenSigCycleTime" SG_ 849 SecRowMidSBR 500;
BA_ "Origin" SG_ 849 DrvSBR "fuel,ev";
BA_ "Match" SG_ 849 DrvSBR "DrvSBR";
BA_ "GenSigStartValue" SG_ 849 DrvSBR 1;
BA_ "GenSigSendType" SG_ 849 DrvSBR 2;
BA_ "GenSigCycleTime" SG_ 849 DrvSBR 500;
BA_ "Origin" SG_ 849 SecRowRSBR "fuel,ev";
BA_ "Match" SG_ 849 SecRowRSBR "SecRowRSBR";
BA_ "GenSigStartValue" SG_ 849 SecRowRSBR 1;
BA_ "GenSigSendType" SG_ 849 SecRowRSBR 2;
BA_ "GenSigCycleTime" SG_ 849 SecRowRSBR 500;
BA_ "Origin" SG_ 849 PassSBR "fuel,ev";
BA_ "Match" SG_ 849 PassSBR "PassSBR";
BA_ "GenSigStartValue" SG_ 849 PassSBR 1;
BA_ "GenSigSendType" SG_ 849 PassSBR 2;
BA_ "GenSigCycleTime" SG_ 849 PassSBR 500;
BA_ "Origin" SG_ 849 PassSBR_Visual "fuel,ev";
BA_ "Match" SG_ 849 PassSBR_Visual "PassSBR_Visual";
BA_ "GenSigStartValue" SG_ 849 PassSBR_Visual 1;
BA_ "GenSigSendType" SG_ 849 PassSBR_Visual 2;
BA_ "GenSigCycleTime" SG_ 849 PassSBR_Visual 500;
BA_ "Origin" SG_ 849 DrvSBR_Visual "fuel,ev";
BA_ "Match" SG_ 849 DrvSBR_Visual "DrvSBR_Visual";
BA_ "GenSigStartValue" SG_ 849 DrvSBR_Visual 1;
BA_ "GenSigSendType" SG_ 849 DrvSBR_Visual 2;
BA_ "GenSigCycleTime" SG_ 849 DrvSBR_Visual 500;
BA_ "Origin" SG_ 849 SecRowLSBR_Visual "fuel,ev";
BA_ "Match" SG_ 849 SecRowLSBR_Visual "SecRowLSBR_Visual";
BA_ "GenSigStartValue" SG_ 849 SecRowLSBR_Visual 1;
BA_ "GenSigSendType" SG_ 849 SecRowLSBR_Visual 2;
BA_ "GenSigCycleTime" SG_ 849 SecRowLSBR_Visual 500;
BA_ "Origin" SG_ 849 SecRowMidSBR_Visual "fuel,ev";
BA_ "Match" SG_ 849 SecRowMidSBR_Visual "SecRowMidSBR_Visual";
BA_ "GenSigStartValue" SG_ 849 SecRowMidSBR_Visual 1;
BA_ "GenSigSendType" SG_ 849 SecRowMidSBR_Visual 2;
BA_ "GenSigCycleTime" SG_ 849 SecRowMidSBR_Visual 500;
BA_ "Origin" SG_ 849 SecRowRSBR_Visual "fuel,ev";
BA_ "Match" SG_ 849 SecRowRSBR_Visual "SecRowRSBR_Visual";
BA_ "GenSigStartValue" SG_ 849 SecRowRSBR_Visual 1;
BA_ "GenSigSendType" SG_ 849 SecRowRSBR_Visual 2;
BA_ "GenSigCycleTime" SG_ 849 SecRowRSBR_Visual 500;
BA_ "Origin" SG_ 849 CrashOutputSts "fuel,ev";
BA_ "Match" SG_ 849 CrashOutputSts "CrashOutputSts";
BA_ "GenSigSendType" SG_ 849 CrashOutputSts 2;
BA_ "GenSigCycleTime" SG_ 849 CrashOutputSts 500;
BA_ "Origin" SG_ 849 RollingCounter_ABM1 "fuel,ev";
BA_ "Match" SG_ 849 RollingCounter_ABM1 "RollingCounter_ABM1";
BA_ "GenSigSendType" SG_ 849 RollingCounter_ABM1 2;
BA_ "GenSigCycleTime" SG_ 849 RollingCounter_ABM1 500;
BA_ "Origin" SG_ 849 FreshnessValue_ABM1 "fuel,ev";
BA_ "Match" SG_ 849 FreshnessValue_ABM1 "FreshnessValue_ABM1";
BA_ "GenSigSendType" SG_ 849 FreshnessValue_ABM1 2;
BA_ "GenSigCycleTime" SG_ 849 FreshnessValue_ABM1 500;
BA_ "Origin" SG_ 849 MAC_Check_ABM1 "fuel,ev";
BA_ "Match" SG_ 849 MAC_Check_ABM1 "MAC_Check_ABM1";
BA_ "GenSigSendType" SG_ 849 MAC_Check_ABM1 2;
BA_ "GenSigCycleTime" SG_ 849 MAC_Check_ABM1 500;
BA_ "TransparentInitValue" SG_ 849 ABM1_0x351 "0 126 0 85 1 0 0 0 0 0 0 0 0 0 0 0 ";
BA_ "GenSigCycleTime" SG_ 849 ABM1_0x351 500;
BA_ "Origin" SG_ 862 RoofModFb "fuel,ev";
BA_ "Match" SG_ 862 RoofModFb "RoofModFb";
BA_ "GenSigCycleTime" SG_ 862 RoofModFb 500;
BA_ "Origin" SG_ 862 AllTerrainDislFb "fuel,ev";
BA_ "Match" SG_ 862 AllTerrainDislFb "AllTerrainDislFb";
BA_ "GenSigCycleTime" SG_ 862 AllTerrainDislFb 500;
BA_ "Origin" SG_ 862 ElecSideStepSysFb "fuel,ev";
BA_ "Match" SG_ 862 ElecSideStepSysFb "ElecSideStepSysFb";
BA_ "GenSigCycleTime" SG_ 862 ElecSideStepSysFb 500;
BA_ "TransparentInitValue" SG_ 862 CP1_0x35E "0 0 0 0 0 0 0 0 ";
BA_ "GenSigCycleTime" SG_ 862 CP1_0x35E 500;
BA_ "Origin" SG_ 871 DomeLmpDlyTimSet "fuel,ev";
BA_ "Match" SG_ 871 DomeLmpDlyTimSet "DomeLmpDlyTimSet";
BA_ "GenSigStartValue" SG_ 871 DomeLmpDlyTimSet 1;
BA_ "GenSigSendType" SG_ 871 DomeLmpDlyTimSet 2;
BA_ "Origin" SG_ 871 FolwMeHomeDlyTimSet "fuel,ev";
BA_ "Match" SG_ 871 FolwMeHomeDlyTimSet "FolwMeHomeDlyTimSet";
BA_ "GenSigStartValue" SG_ 871 FolwMeHomeDlyTimSet 1;
BA_ "GenSigSendType" SG_ 871 FolwMeHomeDlyTimSet 2;
BA_ "Origin" SG_ 871 TranPMode_Req "fuel,ev";
BA_ "Match" SG_ 871 TranPMode_Req "TranPMode_Req";
BA_ "GenSigSendType" SG_ 871 TranPMode_Req 2;
BA_ "Origin" SG_ 871 RearviewFoldModSet "fuel,ev";
BA_ "Match" SG_ 871 RearviewFoldModSet "RearviewFoldModSet";
BA_ "GenSigStartValue" SG_ 871 RearviewFoldModSet 1;
BA_ "GenSigSendType" SG_ 871 RearviewFoldModSet 2;
BA_ "Origin" SG_ 871 BattSaveDelayTimeSet "fuel,ev";
BA_ "Match" SG_ 871 BattSaveDelayTimeSet "BattSaveDelayTimeSet";
BA_ "GenSigStartValue" SG_ 871 BattSaveDelayTimeSet 1;
BA_ "GenSigSendType" SG_ 871 BattSaveDelayTimeSet 2;
BA_ "Origin" SG_ 871 ACDualReq_TC "fuel,ev";
BA_ "Match" SG_ 871 ACDualReq_TC "ACDualReq_TC";
BA_ "GenSigSendType" SG_ 871 ACDualReq_TC 2;
BA_ "Origin" SG_ 871 ACAutoModReq_TC "fuel,ev";
BA_ "Match" SG_ 871 ACAutoModReq_TC "ACAutoModReq_TC";
BA_ "GenSigSendType" SG_ 871 ACAutoModReq_TC 2;
BA_ "Origin" SG_ 871 ACAirInletReq_TC "fuel,ev";
BA_ "Match" SG_ 871 ACAirInletReq_TC "ACAirInletReq_TC";
BA_ "GenSigSendType" SG_ 871 ACAirInletReq_TC 2;
BA_ "Origin" SG_ 871 ACFrntHMIDis_TC "fuel,ev";
BA_ "Match" SG_ 871 ACFrntHMIDis_TC "ACFrntHMIDis_TC";
BA_ "GenSigSendType" SG_ 871 ACFrntHMIDis_TC 2;
BA_ "Origin" SG_ 871 ACRearHMIDis_TC "fuel,ev";
BA_ "Match" SG_ 871 ACRearHMIDis_TC "ACRearHMIDis_TC";
BA_ "GenSigSendType" SG_ 871 ACRearHMIDis_TC 2;
BA_ "Origin" SG_ 871 ACAQSReq_TC "fuel,ev";
BA_ "Match" SG_ 871 ACAQSReq_TC "ACAQSReq_TC";
BA_ "GenSigSendType" SG_ 871 ACAQSReq_TC 2;
BA_ "Origin" SG_ 871 ACCmprReq_TC "fuel,ev";
BA_ "Match" SG_ 871 ACCmprReq_TC "ACCmprReq_TC";
BA_ "GenSigSendType" SG_ 871 ACCmprReq_TC 2;
BA_ "Origin" SG_ 871 ACFrntDefrstReq_TC "fuel,ev";
BA_ "Match" SG_ 871 ACFrntDefrstReq_TC "ACFrntDefrstReq_TC";
BA_ "GenSigSendType" SG_ 871 ACFrntDefrstReq_TC 2;
BA_ "Origin" SG_ 871 ACFrntBlwrSpdDecReq_TC "fuel,ev";
BA_ "Match" SG_ 871 ACFrntBlwrSpdDecReq_TC "ACFrntBlwrSpdDecReq_TC";
BA_ "GenSigSendType" SG_ 871 ACFrntBlwrSpdDecReq_TC 2;
BA_ "Origin" SG_ 871 ACRearBlwrSpdDecReq_TC "fuel,ev";
BA_ "Match" SG_ 871 ACRearBlwrSpdDecReq_TC "ACRearBlwrSpdDecReq_TC";
BA_ "GenSigSendType" SG_ 871 ACRearBlwrSpdDecReq_TC 2;
BA_ "Origin" SG_ 871 ACRearBlwrSpdIncReq_TC "fuel,ev";
BA_ "Match" SG_ 871 ACRearBlwrSpdIncReq_TC "ACRearBlwrSpdIncReq_TC";
BA_ "GenSigSendType" SG_ 871 ACRearBlwrSpdIncReq_TC 2;
BA_ "Origin" SG_ 871 DrvDrowsnsDetnSet "fuel,ev";
BA_ "Match" SG_ 871 DrvDrowsnsDetnSet "DrvDrowsnsDetnSet";
BA_ "GenSigStartValue" SG_ 871 DrvDrowsnsDetnSet 1;
BA_ "GenSigSendType" SG_ 871 DrvDrowsnsDetnSet 2;
BA_ "Origin" SG_ 871 ACFrntBlwrSpdIncReq_TC "fuel,ev";
BA_ "Match" SG_ 871 ACFrntBlwrSpdIncReq_TC "ACFrntBlwrSpdIncReq_TC";
BA_ "GenSigSendType" SG_ 871 ACFrntBlwrSpdIncReq_TC 2;
BA_ "Origin" SG_ 871 ACDrvAirDistribModReq_TC "fuel,ev";
BA_ "Match" SG_ 871 ACDrvAirDistribModReq_TC "ACDrvAirDistribModReq_TC";
BA_ "GenSigSendType" SG_ 871 ACDrvAirDistribModReq_TC 2;
BA_ "Origin" SG_ 871 ACDrvTempDecReq_TC "fuel,ev";
BA_ "Match" SG_ 871 ACDrvTempDecReq_TC "ACDrvTempDecReq_TC";
BA_ "GenSigSendType" SG_ 871 ACDrvTempDecReq_TC 2;
BA_ "Origin" SG_ 871 ChairMemPosnEna "fuel,ev";
BA_ "Match" SG_ 871 ChairMemPosnEna "ChairMemPosnEna";
BA_ "GenSigStartValue" SG_ 871 ChairMemPosnEna 1;
BA_ "GenSigSendType" SG_ 871 ChairMemPosnEna 2;
BA_ "Origin" SG_ 871 ACDrvTempIncReq_TC "fuel,ev";
BA_ "Match" SG_ 871 ACDrvTempIncReq_TC "ACDrvTempIncReq_TC";
BA_ "GenSigSendType" SG_ 871 ACDrvTempIncReq_TC 2;
BA_ "Origin" SG_ 871 ACFrntPassTempDecReq_TC "fuel,ev";
BA_ "Match" SG_ 871 ACFrntPassTempDecReq_TC "ACFrntPassTempDecReq_TC";
BA_ "GenSigSendType" SG_ 871 ACFrntPassTempDecReq_TC 2;
BA_ "Origin" SG_ 871 ACFrntPassTempIncReq_TC "fuel,ev";
BA_ "Match" SG_ 871 ACFrntPassTempIncReq_TC "ACFrntPassTempIncReq_TC";
BA_ "GenSigSendType" SG_ 871 ACFrntPassTempIncReq_TC 2;
BA_ "Origin" SG_ 871 ACAIUReq_TC "fuel,ev";
BA_ "Match" SG_ 871 ACAIUReq_TC "ACAIUReq_TC";
BA_ "GenSigSendType" SG_ 871 ACAIUReq_TC 2;
BA_ "Origin" SG_ 871 ACOffReq_TC "fuel,ev";
BA_ "Match" SG_ 871 ACOffReq_TC "ACOffReq_TC";
BA_ "GenSigSendType" SG_ 871 ACOffReq_TC 2;
BA_ "Origin" SG_ 871 ACBlwrsteplsSpdReq_TC "fuel,ev";
BA_ "Match" SG_ 871 ACBlwrsteplsSpdReq_TC "ACBlwrsteplsSpdReq_TC";
BA_ "GenSigSendType" SG_ 871 ACBlwrsteplsSpdReq_TC 2;
BA_ "Origin" SG_ 871 ACZoneReq_TC "fuel,ev";
BA_ "Match" SG_ 871 ACZoneReq_TC "ACZoneReq_TC";
BA_ "GenSigSendType" SG_ 871 ACZoneReq_TC 2;
BA_ "TransparentInitValue" SG_ 871 HUT1_0x367 "34 80 0 0 16 1 0 0 ";
BA_ "GenSigSendType" SG_ 871 HUT1_0x367 2;
BA_ "Origin" SG_ 873 RearWinHeatCmd_TC "fuel,ev";
BA_ "Match" SG_ 873 RearWinHeatCmd_TC "RearWinHeatCmd_TC";
BA_ "GenSigSendType" SG_ 873 RearWinHeatCmd_TC 2;
BA_ "Origin" SG_ 873 AMP_MediaCallSourceSet "fuel,ev";
BA_ "Match" SG_ 873 AMP_MediaCallSourceSet "AMP_MediaCallSourceSet";
BA_ "GenSigSendType" SG_ 873 AMP_MediaCallSourceSet 2;
BA_ "Origin" SG_ 873 AMP_NaviSourceSet "fuel,ev";
BA_ "Match" SG_ 873 AMP_NaviSourceSet "AMP_NaviSourceSet";
BA_ "GenSigSendType" SG_ 873 AMP_NaviSourceSet 2;
BA_ "Origin" SG_ 873 AMP_BeepSourceSet "fuel,ev";
BA_ "Match" SG_ 873 AMP_BeepSourceSet "AMP_BeepSourceSet";
BA_ "GenSigSendType" SG_ 873 AMP_BeepSourceSet 2;
BA_ "Origin" SG_ 873 AMP_LRAudioBalanceSet "fuel,ev";
BA_ "Match" SG_ 873 AMP_LRAudioBalanceSet "AMP_LRAudioBalanceSet";
BA_ "GenSigStartValue" SG_ 873 AMP_LRAudioBalanceSet 10;
BA_ "GenSigSendType" SG_ 873 AMP_LRAudioBalanceSet 2;
BA_ "Origin" SG_ 873 AMP_AudioVolVSCModReq "fuel,ev";
BA_ "Match" SG_ 873 AMP_AudioVolVSCModReq "AMP_AudioVolVSCModReq";
BA_ "GenSigStartValue" SG_ 873 AMP_AudioVolVSCModReq 2;
BA_ "GenSigSendType" SG_ 873 AMP_AudioVolVSCModReq 2;
BA_ "Origin" SG_ 873 AMP_FRAudioFaderSet "fuel,ev";
BA_ "Match" SG_ 873 AMP_FRAudioFaderSet "AMP_FRAudioFaderSet";
BA_ "GenSigStartValue" SG_ 873 AMP_FRAudioFaderSet 10;
BA_ "GenSigSendType" SG_ 873 AMP_FRAudioFaderSet 2;
BA_ "Origin" SG_ 873 AMP_LRDrvSideSet "fuel,ev";
BA_ "Match" SG_ 873 AMP_LRDrvSideSet "AMP_LRDrvSideSet";
BA_ "GenSigSendType" SG_ 873 AMP_LRDrvSideSet 2;
BA_ "Origin" SG_ 873 AMP_LowFrqAudioSet "fuel,ev";
BA_ "Match" SG_ 873 AMP_LowFrqAudioSet "AMP_LowFrqAudioSet";
BA_ "GenSigStartValue" SG_ 873 AMP_LowFrqAudioSet 10;
BA_ "GenSigSendType" SG_ 873 AMP_LowFrqAudioSet 2;
BA_ "Origin" SG_ 873 AMP_MuteSet "fuel,ev";
BA_ "Match" SG_ 873 AMP_MuteSet "AMP_MuteSet";
BA_ "GenSigStartValue" SG_ 873 AMP_MuteSet 1;
BA_ "GenSigSendType" SG_ 873 AMP_MuteSet 2;
BA_ "Origin" SG_ 873 AMP_MidFrqAudioSet "fuel,ev";
BA_ "Match" SG_ 873 AMP_MidFrqAudioSet "AMP_MidFrqAudioSet";
BA_ "GenSigStartValue" SG_ 873 AMP_MidFrqAudioSet 10;
BA_ "GenSigSendType" SG_ 873 AMP_MidFrqAudioSet 2;
BA_ "Origin" SG_ 873 AMP_HighFrqAudioSet "fuel,ev";
BA_ "Match" SG_ 873 AMP_HighFrqAudioSet "AMP_HighFrqAudioSet";
BA_ "GenSigStartValue" SG_ 873 AMP_HighFrqAudioSet 10;
BA_ "GenSigSendType" SG_ 873 AMP_HighFrqAudioSet 2;
BA_ "Origin" SG_ 873 T_box_ECallSet "fuel,ev";
BA_ "Match" SG_ 873 T_box_ECallSet "T_box_ECallSet";
BA_ "GenSigSendType" SG_ 873 T_box_ECallSet 2;
BA_ "Origin" SG_ 873 QLISurroundSet "fuel,ev";
BA_ "Match" SG_ 873 QLISurroundSet "QLISurroundSet";
BA_ "GenSigStartValue" SG_ 873 QLISurroundSet 1;
BA_ "GenSigSendType" SG_ 873 QLISurroundSet 2;
BA_ "Origin" SG_ 873 ANCSwtSet "fuel,ev";
BA_ "Match" SG_ 873 ANCSwtSet "ANCSwtSet";
BA_ "GenSigStartValue" SG_ 873 ANCSwtSet 1;
BA_ "GenSigSendType" SG_ 873 ANCSwtSet 2;
BA_ "Origin" SG_ 873 FrntWinHeatSwt "fuel,ev";
BA_ "Match" SG_ 873 FrntWinHeatSwt "FrntWinHeatSwt";
BA_ "GenSigSendType" SG_ 873 FrntWinHeatSwt 2;
BA_ "TransparentInitValue" SG_ 873 HUT2_0x369 "0 82 80 82 16 80 82 0 ";
BA_ "GenSigSendType" SG_ 873 HUT2_0x369 2;
BA_ "Origin" SG_ 875 AMP_HFMVolSet "fuel,ev";
BA_ "Match" SG_ 875 AMP_HFMVolSet "AMP_HFMVolSet";
BA_ "GenSigStartValue" SG_ 875 AMP_HFMVolSet 10;
BA_ "GenSigSendType" SG_ 875 AMP_HFMVolSet 2;
BA_ "Origin" SG_ 875 AMP_TTSVolSet_VR "fuel,ev";
BA_ "Match" SG_ 875 AMP_TTSVolSet_VR "AMP_TTSVolSet_VR";
BA_ "GenSigStartValue" SG_ 875 AMP_TTSVolSet_VR 10;
BA_ "GenSigSendType" SG_ 875 AMP_TTSVolSet_VR 2;
BA_ "Origin" SG_ 875 AMP_NaviVolSet "fuel,ev";
BA_ "Match" SG_ 875 AMP_NaviVolSet "AMP_NaviVolSet";
BA_ "GenSigStartValue" SG_ 875 AMP_NaviVolSet 10;
BA_ "GenSigSendType" SG_ 875 AMP_NaviVolSet 2;
BA_ "Origin" SG_ 875 AMP_MainVolSet "fuel,ev";
BA_ "Match" SG_ 875 AMP_MainVolSet "AMP_MainVolSet";
BA_ "GenSigStartValue" SG_ 875 AMP_MainVolSet 10;
BA_ "GenSigSendType" SG_ 875 AMP_MainVolSet 2;
BA_ "Origin" SG_ 875 AMP_GetSWInfoReq "fuel,ev";
BA_ "Match" SG_ 875 AMP_GetSWInfoReq "AMP_GetSWInfoReq";
BA_ "GenSigSendType" SG_ 875 AMP_GetSWInfoReq 2;
BA_ "Origin" SG_ 875 AMP_GetHWInfoReq "fuel,ev";
BA_ "Match" SG_ 875 AMP_GetHWInfoReq "AMP_GetHWInfoReq";
BA_ "GenSigSendType" SG_ 875 AMP_GetHWInfoReq 2;
BA_ "Origin" SG_ 875 AMP_GetTempInfoReq "fuel,ev";
BA_ "Match" SG_ 875 AMP_GetTempInfoReq "AMP_GetTempInfoReq";
BA_ "GenSigSendType" SG_ 875 AMP_GetTempInfoReq 2;
BA_ "Origin" SG_ 875 AMP_GetIntVoltInfoReq "fuel,ev";
BA_ "Match" SG_ 875 AMP_GetIntVoltInfoReq "AMP_GetIntVoltInfoReq";
BA_ "GenSigSendType" SG_ 875 AMP_GetIntVoltInfoReq 2;
BA_ "Origin" SG_ 875 AMP_GetDTCInfoReq "fuel,ev";
BA_ "Match" SG_ 875 AMP_GetDTCInfoReq "AMP_GetDTCInfoReq";
BA_ "GenSigSendType" SG_ 875 AMP_GetDTCInfoReq 2;
BA_ "Origin" SG_ 875 IESS_MdlSwtReq "fuel,ev";
BA_ "Match" SG_ 875 IESS_MdlSwtReq "IESS_MdlSwtReq";
BA_ "GenSigSendType" SG_ 875 IESS_MdlSwtReq 2;
BA_ "Origin" SG_ 875 IESS_MdlInfoReq "fuel,ev";
BA_ "Match" SG_ 875 IESS_MdlInfoReq "IESS_MdlInfoReq";
BA_ "GenSigSendType" SG_ 875 IESS_MdlInfoReq 2;
BA_ "Origin" SG_ 875 AMP_BestListegPosnReq "fuel,ev";
BA_ "Match" SG_ 875 AMP_BestListegPosnReq "AMP_BestListegPosnReq";
BA_ "GenSigSendType" SG_ 875 AMP_BestListegPosnReq 2;
BA_ "Origin" SG_ 875 AMP_Clari_FiReq "fuel,ev";
BA_ "Match" SG_ 875 AMP_Clari_FiReq "AMP_Clari_FiReq";
BA_ "GenSigStartValue" SG_ 875 AMP_Clari_FiReq 1;
BA_ "GenSigSendType" SG_ 875 AMP_Clari_FiReq 2;
BA_ "TransparentInitValue" SG_ 875 HUT3_0x36B "40 40 40 40 0 8 0 0 ";
BA_ "GenSigSendType" SG_ 875 HUT3_0x36B 2;
BA_ "Origin" SG_ 877 DrvSeatVentnLvlSet "fuel,ev";
BA_ "Match" SG_ 877 DrvSeatVentnLvlSet "DrvSeatVentnLvlSet";
BA_ "GenSigSendType" SG_ 877 DrvSeatVentnLvlSet 2;
BA_ "Origin" SG_ 877 PassSeatVentnLvlSet "fuel,ev";
BA_ "Match" SG_ 877 PassSeatVentnLvlSet "PassSeatVentnLvlSet";
BA_ "GenSigSendType" SG_ 877 PassSeatVentnLvlSet 2;
BA_ "Origin" SG_ 877 ACAutoModReq_VR "fuel,ev";
BA_ "Match" SG_ 877 ACAutoModReq_VR "ACAutoModReq_VR";
BA_ "GenSigSendType" SG_ 877 ACAutoModReq_VR 2;
BA_ "Origin" SG_ 877 ACCmprReq_VR "fuel,ev";
BA_ "Match" SG_ 877 ACCmprReq_VR "ACCmprReq_VR";
BA_ "GenSigSendType" SG_ 877 ACCmprReq_VR 2;
BA_ "Origin" SG_ 877 ACPowerReq_VR "fuel,ev";
BA_ "Match" SG_ 877 ACPowerReq_VR "ACPowerReq_VR";
BA_ "GenSigSendType" SG_ 877 ACPowerReq_VR 2;
BA_ "Origin" SG_ 877 ACBlwrSpdReq_VR "fuel,ev";
BA_ "Match" SG_ 877 ACBlwrSpdReq_VR "ACBlwrSpdReq_VR";
BA_ "GenSigSendType" SG_ 877 ACBlwrSpdReq_VR 2;
BA_ "Origin" SG_ 877 ACDrvTempReq_VR "fuel,ev";
BA_ "Match" SG_ 877 ACDrvTempReq_VR "ACDrvTempReq_VR";
BA_ "GenSigSendType" SG_ 877 ACDrvTempReq_VR 2;
BA_ "Origin" SG_ 877 ACFrntDefrostReq_VR "fuel,ev";
BA_ "Match" SG_ 877 ACFrntDefrostReq_VR "ACFrntDefrostReq_VR";
BA_ "GenSigSendType" SG_ 877 ACFrntDefrostReq_VR 2;
BA_ "Origin" SG_ 877 ACDrvAirDistribModReq_VR "fuel,ev";
BA_ "Match" SG_ 877 ACDrvAirDistribModReq_VR "ACDrvAirDistribModReq_VR";
BA_ "GenSigSendType" SG_ 877 ACDrvAirDistribModReq_VR 2;
BA_ "Origin" SG_ 877 ACAirInletReq_VR "fuel,ev";
BA_ "Match" SG_ 877 ACAirInletReq_VR "ACAirInletReq_VR";
BA_ "GenSigSendType" SG_ 877 ACAirInletReq_VR 2;
BA_ "Origin" SG_ 877 ACModReq_HUT "fuel,ev";
BA_ "Match" SG_ 877 ACModReq_HUT "ACModReq_HUT";
BA_ "GenSigStartValue" SG_ 877 ACModReq_HUT 1;
BA_ "GenSigSendType" SG_ 877 ACModReq_HUT 2;
BA_ "Origin" SG_ 877 ElecSideSteppingSysSet "fuel,ev";
BA_ "Match" SG_ 877 ElecSideSteppingSysSet "ElecSideSteppingSysSet";
BA_ "GenSigStartValue" SG_ 877 ElecSideSteppingSysSet 1;
BA_ "GenSigSendType" SG_ 877 ElecSideSteppingSysSet 2;
BA_ "Origin" SG_ 877 RoofModSet "fuel,ev";
BA_ "Match" SG_ 877 RoofModSet "RoofModSet";
BA_ "GenSigSendType" SG_ 877 RoofModSet 2;
BA_ "Origin" SG_ 877 AllTerrainDislSet "fuel,ev";
BA_ "Match" SG_ 877 AllTerrainDislSet "AllTerrainDislSet";
BA_ "GenSigSendType" SG_ 877 AllTerrainDislSet 2;
BA_ "Origin" SG_ 877 RemUpgrdSts "fuel,ev";
BA_ "Match" SG_ 877 RemUpgrdSts "RemUpgrdSts";
BA_ "GenSigSendType" SG_ 877 RemUpgrdSts 2;
BA_ "Origin" SG_ 877 ACRearAutoModReq_TC "fuel,ev";
BA_ "Match" SG_ 877 ACRearAutoModReq_TC "ACRearAutoModReq_TC";
BA_ "GenSigSendType" SG_ 877 ACRearAutoModReq_TC 2;
BA_ "Origin" SG_ 877 DrvSeatSupportLvlSet "fuel,ev";
BA_ "Match" SG_ 877 DrvSeatSupportLvlSet "DrvSeatSupportLvlSet";
BA_ "GenSigSendType" SG_ 877 DrvSeatSupportLvlSet 2;
BA_ "Origin" SG_ 877 PassSeatSupportLvlSet "fuel,ev";
BA_ "Match" SG_ 877 PassSeatSupportLvlSet "PassSeatSupportLvlSet";
BA_ "GenSigSendType" SG_ 877 PassSeatSupportLvlSet 2;
BA_ "Origin" SG_ 877 ACRearOffReq_TC "fuel,ev";
BA_ "Match" SG_ 877 ACRearOffReq_TC "ACRearOffReq_TC";
BA_ "GenSigSendType" SG_ 877 ACRearOffReq_TC 2;
BA_ "Origin" SG_ 877 ACRearAirDistribModReq_TC "fuel,ev";
BA_ "Match" SG_ 877 ACRearAirDistribModReq_TC "ACRearAirDistribModReq_TC";
BA_ "GenSigSendType" SG_ 877 ACRearAirDistribModReq_TC 2;
BA_ "Origin" SG_ 877 RLSeatVentnLvlSet "fuel,ev";
BA_ "Match" SG_ 877 RLSeatVentnLvlSet "RLSeatVentnLvlSet";
BA_ "GenSigSendType" SG_ 877 RLSeatVentnLvlSet 2;
BA_ "Origin" SG_ 877 RRSeatVentnLvlSet "fuel,ev";
BA_ "Match" SG_ 877 RRSeatVentnLvlSet "RRSeatVentnLvlSet";
BA_ "GenSigSendType" SG_ 877 RRSeatVentnLvlSet 2;
BA_ "Origin" SG_ 877 DrvSeatHeatgLvlSet "fuel,ev";
BA_ "Match" SG_ 877 DrvSeatHeatgLvlSet "DrvSeatHeatgLvlSet";
BA_ "GenSigSendType" SG_ 877 DrvSeatHeatgLvlSet 2;
BA_ "Origin" SG_ 877 PassSeatHeatgLvlSet "fuel,ev";
BA_ "Match" SG_ 877 PassSeatHeatgLvlSet "PassSeatHeatgLvlSet";
BA_ "GenSigSendType" SG_ 877 PassSeatHeatgLvlSet 2;
BA_ "TransparentInitValue" SG_ 877 HUT4_0x36D "0 0 32 0 0 0 0 64 ";
BA_ "GenSigSendType" SG_ 877 HUT4_0x36D 2;
BA_ "Origin" SG_ 880 TimeMod "fuel,ev";
BA_ "Match" SG_ 880 TimeMod "TimeMod";
BA_ "GenSigCycleTime" SG_ 880 TimeMod 1000;
BA_ "Origin" SG_ 880 TimeIndcn "fuel,ev";
BA_ "Match" SG_ 880 TimeIndcn "TimeIndcn";
BA_ "GenSigCycleTime" SG_ 880 TimeIndcn 1000;
BA_ "Origin" SG_ 880 Time_Hour "fuel,ev";
BA_ "Match" SG_ 880 Time_Hour "Time_Hour";
BA_ "GenSigStartValue" SG_ 880 Time_Hour 31;
BA_ "GenSigCycleTime" SG_ 880 Time_Hour 1000;
BA_ "Origin" SG_ 880 Time_Minutes "fuel,ev";
BA_ "Match" SG_ 880 Time_Minutes "Time_Minutes";
BA_ "GenSigStartValue" SG_ 880 Time_Minutes 63;
BA_ "GenSigCycleTime" SG_ 880 Time_Minutes 1000;
BA_ "Origin" SG_ 880 Time_Second "fuel,ev";
BA_ "Match" SG_ 880 Time_Second "Time_Second";
BA_ "GenSigStartValue" SG_ 880 Time_Second 63;
BA_ "GenSigCycleTime" SG_ 880 Time_Second 1000;
BA_ "Origin" SG_ 880 Time_Year_Left "fuel,ev";
BA_ "Match" SG_ 880 Time_Year_Left "Time_Year_Left";
BA_ "GenSigStartValue" SG_ 880 Time_Year_Left 15;
BA_ "GenSigCycleTime" SG_ 880 Time_Year_Left 1000;
BA_ "Origin" SG_ 880 Time_Year_Right "fuel,ev";
BA_ "Match" SG_ 880 Time_Year_Right "Time_Year_Right";
BA_ "GenSigStartValue" SG_ 880 Time_Year_Right 15;
BA_ "GenSigCycleTime" SG_ 880 Time_Year_Right 1000;
BA_ "Origin" SG_ 880 Time_Month "fuel,ev";
BA_ "Match" SG_ 880 Time_Month "Time_Month";
BA_ "GenSigCycleTime" SG_ 880 Time_Month 1000;
BA_ "Origin" SG_ 880 Time_Day "fuel,ev";
BA_ "Match" SG_ 880 Time_Day "Time_Day";
BA_ "GenSigCycleTime" SG_ 880 Time_Day 1000;
BA_ "Origin" SG_ 880 HUT_TgtSOCSet "ev";
BA_ "Match" SG_ 880 HUT_TgtSOCSet "HUT_TgtSOCSet";
BA_ "GenSigCycleTime" SG_ 880 HUT_TgtSOCSet 1000;
BA_ "TransparentInitValue" SG_ 880 HUT34_0x370 "0 248 252 252 255 0 0 0 ";
BA_ "GenSigCycleTime" SG_ 880 HUT34_0x370 1000;
BA_ "Origin" SG_ 881 BaroPressure "fuel,ev";
BA_ "Match" SG_ 881 BaroPressure "BaroPressure";
BA_ "GenSigCycleTime" SG_ 881 BaroPressure 100;
BA_ "Origin" SG_ 881 EngCoolantTemp "fuel,ev";
BA_ "Match" SG_ 881 EngCoolantTemp "EngCoolantTemp";
BA_ "GenSigCycleTime" SG_ 881 EngCoolantTemp 100;
BA_ "Origin" SG_ 881 GPF_Warning "fuel,ev";
BA_ "Match" SG_ 881 GPF_Warning "GPF_Warning";
BA_ "GenSigCycleTime" SG_ 881 GPF_Warning 100;
BA_ "Origin" SG_ 881 GentrWarnLmpSts "fuel";
BA_ "Match" SG_ 881 GentrWarnLmpSts "GentrWarnLmpSts";
BA_ "GenSigCycleTime" SG_ 881 GentrWarnLmpSts 100;
BA_ "Origin" SG_ 881 EngClntTempWarn "fuel,ev";
BA_ "Match" SG_ 881 EngClntTempWarn "EngClntTempWarn";
BA_ "GenSigCycleTime" SG_ 881 EngClntTempWarn 100;
BA_ "Origin" SG_ 881 EngClntTempVldty "fuel,ev";
BA_ "Match" SG_ 881 EngClntTempVldty "EngClntTempVldty";
BA_ "GenSigStartValue" SG_ 881 EngClntTempVldty 2;
BA_ "GenSigCycleTime" SG_ 881 EngClntTempVldty 100;
BA_ "Origin" SG_ 881 SS_Screen_tip "fuel";
BA_ "Match" SG_ 881 SS_Screen_tip "SS_Screen_tip";
BA_ "GenSigCycleTime" SG_ 881 SS_Screen_tip 100;
BA_ "Origin" SG_ 881 SSSSetSts "fuel";
BA_ "Match" SG_ 881 SSSSetSts "SSSSetSts";
BA_ "GenSigStartValue" SG_ 881 SSSSetSts 1;
BA_ "GenSigCycleTime" SG_ 881 SSSSetSts 100;
BA_ "Origin" SG_ 881 SS_Enable_Lamp "fuel";
BA_ "Match" SG_ 881 SS_Enable_Lamp "SS_Enable_Lamp";
BA_ "GenSigCycleTime" SG_ 881 SS_Enable_Lamp 100;
BA_ "Origin" SG_ 881 SS_Fault_Lamp "fuel";
BA_ "Match" SG_ 881 SS_Fault_Lamp "SS_Fault_Lamp";
BA_ "GenSigCycleTime" SG_ 881 SS_Fault_Lamp 100;
BA_ "Origin" SG_ 881 MaxEngTrqNorm "fuel";
BA_ "Match" SG_ 881 MaxEngTrqNorm "MaxEngTrqNorm";
BA_ "GenSigCycleTime" SG_ 881 MaxEngTrqNorm 100;
BA_ "Origin" SG_ 881 AGS_Failure "fuel";
BA_ "Match" SG_ 881 AGS_Failure "AGS_Failure";
BA_ "GenSigCycleTime" SG_ 881 AGS_Failure 100;
BA_ "TransparentInitValue" SG_ 881 ECM3_0x371 "0 0 0 0 0 16 128 0 ";
BA_ "GenSigCycleTime" SG_ 881 ECM3_0x371 100;
BA_ "Origin" SG_ 901 ACFrntDefrstSts "fuel,ev";
BA_ "Match" SG_ 901 ACFrntDefrstSts "ACFrntDefrstSts";
BA_ "GenSigCycleTime" SG_ 901 ACFrntDefrstSts 100;
BA_ "Origin" SG_ 901 ACHMIDispCmd "fuel,ev";
BA_ "Match" SG_ 901 ACHMIDispCmd "ACHMIDispCmd";
BA_ "GenSigCycleTime" SG_ 901 ACHMIDispCmd 100;
BA_ "Origin" SG_ 901 ACFrntBlwrSpd "fuel,ev";
BA_ "Match" SG_ 901 ACFrntBlwrSpd "ACFrntBlwrSpd";
BA_ "GenSigStartValue" SG_ 901 ACFrntBlwrSpd 15;
BA_ "GenSigCycleTime" SG_ 901 ACFrntBlwrSpd 100;
BA_ "Origin" SG_ 901 ACOpenSts "fuel,ev";
BA_ "Match" SG_ 901 ACOpenSts "ACOpenSts";
BA_ "GenSigCycleTime" SG_ 901 ACOpenSts 100;
BA_ "Origin" SG_ 901 ACDualModEnaSts "fuel,ev";
BA_ "Match" SG_ 901 ACDualModEnaSts "ACDualModEnaSts";
BA_ "GenSigCycleTime" SG_ 901 ACDualModEnaSts 100;
BA_ "Origin" SG_ 901 ACDrvTemp_ATC "fuel,ev";
BA_ "Match" SG_ 901 ACDrvTemp_ATC "ACDrvTemp_ATC";
BA_ "GenSigStartValue" SG_ 901 ACDrvTemp_ATC 33;
BA_ "GenSigCycleTime" SG_ 901 ACDrvTemp_ATC 100;
BA_ "Origin" SG_ 901 ACAmbTemp "fuel,ev";
BA_ "Match" SG_ 901 ACAmbTemp "ACAmbTemp";
BA_ "GenSigStartValue" SG_ 901 ACAmbTemp 254;
BA_ "GenSigCycleTime" SG_ 901 ACAmbTemp 100;
BA_ "Origin" SG_ 901 ACAirInletSts "fuel,ev";
BA_ "Match" SG_ 901 ACAirInletSts "ACAirInletSts";
BA_ "GenSigStartValue" SG_ 901 ACAirInletSts 3;
BA_ "GenSigCycleTime" SG_ 901 ACAirInletSts 100;
BA_ "Origin" SG_ 901 ACFrntPasstTemp_ATC "fuel,ev";
BA_ "Match" SG_ 901 ACFrntPasstTemp_ATC "ACFrntPasstTemp_ATC";
BA_ "GenSigStartValue" SG_ 901 ACFrntPasstTemp_ATC 33;
BA_ "GenSigCycleTime" SG_ 901 ACFrntPasstTemp_ATC 100;
BA_ "Origin" SG_ 901 ACAutoModEnaSts "fuel,ev";
BA_ "Match" SG_ 901 ACAutoModEnaSts "ACAutoModEnaSts";
BA_ "GenSigCycleTime" SG_ 901 ACAutoModEnaSts 100;
BA_ "Origin" SG_ 901 ACCmprEnaSts "fuel,ev";
BA_ "Match" SG_ 901 ACCmprEnaSts "ACCmprEnaSts";
BA_ "GenSigCycleTime" SG_ 901 ACCmprEnaSts 100;
BA_ "Origin" SG_ 901 ACRearWinHeatSts "fuel,ev";
BA_ "Match" SG_ 901 ACRearWinHeatSts "ACRearWinHeatSts";
BA_ "GenSigCycleTime" SG_ 901 ACRearWinHeatSts 100;
BA_ "Origin" SG_ 901 ACAutoDefrstModEnaSts "fuel,ev";
BA_ "Match" SG_ 901 ACAutoDefrstModEnaSts "ACAutoDefrstModEnaSts";
BA_ "GenSigCycleTime" SG_ 901 ACAutoDefrstModEnaSts 100;
BA_ "TransparentInitValue" SG_ 901 AC2_0x385 "0 15 254 0 66 6 33 0 ";
BA_ "GenSigCycleTime" SG_ 901 AC2_0x385 100;
BA_ "Origin" SG_ 917 FLTirePress "fuel,ev";
BA_ "Match" SG_ 917 FLTirePress "FLTirePress";
BA_ "GenSigCycleTime" SG_ 917 FLTirePress 500;
BA_ "Origin" SG_ 917 FLTireTemp "fuel,ev";
BA_ "Match" SG_ 917 FLTireTemp "FLTireTemp";
BA_ "GenSigCycleTime" SG_ 917 FLTireTemp 500;
BA_ "Origin" SG_ 917 FRTirePress "fuel,ev";
BA_ "Match" SG_ 917 FRTirePress "FRTirePress";
BA_ "GenSigCycleTime" SG_ 917 FRTirePress 500;
BA_ "Origin" SG_ 917 FRTireTemp "fuel,ev";
BA_ "Match" SG_ 917 FRTireTemp "FRTireTemp";
BA_ "GenSigCycleTime" SG_ 917 FRTireTemp 500;
BA_ "Origin" SG_ 917 RLTirePress "fuel,ev";
BA_ "Match" SG_ 917 RLTirePress "RLTirePress";
BA_ "GenSigCycleTime" SG_ 917 RLTirePress 500;
BA_ "Origin" SG_ 917 RLTireTemp "fuel,ev";
BA_ "Match" SG_ 917 RLTireTemp "RLTireTemp";
BA_ "GenSigCycleTime" SG_ 917 RLTireTemp 500;
BA_ "Origin" SG_ 917 RRTirePress "fuel,ev";
BA_ "Match" SG_ 917 RRTirePress "RRTirePress";
BA_ "GenSigCycleTime" SG_ 917 RRTirePress 500;
BA_ "Origin" SG_ 917 RRTireTemp "fuel,ev";
BA_ "Match" SG_ 917 RRTireTemp "RRTireTemp";
BA_ "GenSigCycleTime" SG_ 917 RRTireTemp 500;
BA_ "Origin" SG_ 917 FreshnessValue_TPMS2 "fuel,ev";
BA_ "Match" SG_ 917 FreshnessValue_TPMS2 "FreshnessValue_TPMS2";
BA_ "GenSigCycleTime" SG_ 917 FreshnessValue_TPMS2 500;
BA_ "Origin" SG_ 917 MAC_Check_TPMS2 "fuel,ev";
BA_ "Match" SG_ 917 MAC_Check_TPMS2 "MAC_Check_TPMS2";
BA_ "GenSigCycleTime" SG_ 917 MAC_Check_TPMS2 500;
BA_ "TransparentInitValue" SG_ 917 TPMS2_0x395 "0 0 0 0 0 0 0 0 0 0 0 0 0 0 0 0 ";
BA_ "GenSigCycleTime" SG_ 917 TPMS2_0x395 500;
BA_ "Origin" SG_ 943 WeatherCdn "fuel,ev";
BA_ "Match" SG_ 943 WeatherCdn "WeatherCdn";
BA_ "GenSigCycleTime" SG_ 943 WeatherCdn 1000;
BA_ "Origin" SG_ 943 PitchAng "fuel,ev";
BA_ "Match" SG_ 943 PitchAng "PitchAng";
BA_ "GenSigCycleTime" SG_ 943 PitchAng 1000;
BA_ "Origin" SG_ 943 PitchAngSign "fuel,ev";
BA_ "Match" SG_ 943 PitchAngSign "PitchAngSign";
BA_ "GenSigCycleTime" SG_ 943 PitchAngSign 1000;
BA_ "TransparentInitValue" SG_ 943 HUT12_0x3AF "0 0 0 0 0 0 0 0 ";
BA_ "GenSigCycleTime" SG_ 943 HUT12_0x3AF 1000;
BA_ "Origin" SG_ 949 ECM_VIN "fuel,ev";
BA_ "Match" SG_ 949 ECM_VIN "ECM_VIN";
BA_ "GenSigCycleTime" SG_ 949 ECM_VIN 1000;
BA_ "TransparentInitValue" SG_ 949 ECM19_0x3B5 "0 0 0 0 0 0 0 0 ";
BA_ "GenSigCycleTime" SG_ 949 ECM19_0x3B5 1000;
BA_ "Origin" SG_ 951 ECM_VehDstBackup "fuel,ev";
BA_ "Match" SG_ 951 ECM_VehDstBackup "ECM_VehDstBackup";
BA_ "GenSigCycleTime" SG_ 951 ECM_VehDstBackup 1000;
BA_ "TransparentInitValue" SG_ 951 ECM20_0x3B7 "0 0 0 0 0 0 0 0 ";
BA_ "GenSigCycleTime" SG_ 951 ECM20_0x3B7 1000;
BA_ "Origin" SG_ 962 HCU_RecupPwr "fuel,ev";
BA_ "Match" SG_ 962 HCU_RecupPwr "HCU_RecupPwr";
BA_ "GenSigCycleTime" SG_ 962 HCU_RecupPwr 1000;
BA_ "Origin" SG_ 962 HCU_HiVoltInterlockSts_RM "ev";
BA_ "Match" SG_ 962 HCU_HiVoltInterlockSts_RM "HCU_HiVoltInterlockSts_RM";
BA_ "GenSigCycleTime" SG_ 962 HCU_HiVoltInterlockSts_RM 1000;
BA_ "Origin" SG_ 962 HCU_EVContnsDistance "ev";
BA_ "Match" SG_ 962 HCU_EVContnsDistance "HCU_EVContnsDistance";
BA_ "GenSigCycleTime" SG_ 962 HCU_EVContnsDistance 1000;
BA_ "Origin" SG_ 962 HCU_EVContnsDistanceVld "ev";
BA_ "Match" SG_ 962 HCU_EVContnsDistanceVld "HCU_EVContnsDistanceVld";
BA_ "GenSigCycleTime" SG_ 962 HCU_EVContnsDistanceVld 1000;
BA_ "Origin" SG_ 962 HCU_EgyUsed "ev";
BA_ "Match" SG_ 962 HCU_EgyUsed "HCU_EgyUsed";
BA_ "GenSigCycleTime" SG_ 962 HCU_EgyUsed 1000;
BA_ "TransparentInitValue" SG_ 962 HCU_HC7_0x3C2 "0 0 0 0 0 0 0 0 ";
BA_ "GenSigCycleTime" SG_ 962 HCU_HC7_0x3C2 1000;
BA_ "Origin" SG_ 993 AMP_SWVersion "fuel,ev";
BA_ "Match" SG_ 993 AMP_SWVersion "AMP_SWVersion";
BA_ "GenSigSendType" SG_ 993 AMP_SWVersion 2;
BA_ "Origin" SG_ 993 AMP_HWVersion "fuel,ev";
BA_ "Match" SG_ 993 AMP_HWVersion "AMP_HWVersion";
BA_ "GenSigSendType" SG_ 993 AMP_HWVersion 2;
BA_ "Origin" SG_ 993 AMP_Chan1DTCInfo "fuel,ev";
BA_ "Match" SG_ 993 AMP_Chan1DTCInfo "AMP_Chan1DTCInfo";
BA_ "GenSigSendType" SG_ 993 AMP_Chan1DTCInfo 2;
BA_ "Origin" SG_ 993 AMP_Chan2DTCInfo "fuel,ev";
BA_ "Match" SG_ 993 AMP_Chan2DTCInfo "AMP_Chan2DTCInfo";
BA_ "GenSigSendType" SG_ 993 AMP_Chan2DTCInfo 2;
BA_ "Origin" SG_ 993 AMP_Chan3DTCInfo "fuel,ev";
BA_ "Match" SG_ 993 AMP_Chan3DTCInfo "AMP_Chan3DTCInfo";
BA_ "GenSigSendType" SG_ 993 AMP_Chan3DTCInfo 2;
BA_ "Origin" SG_ 993 AMP_Chan4DTCInfo "fuel,ev";
BA_ "Match" SG_ 993 AMP_Chan4DTCInfo "AMP_Chan4DTCInfo";
BA_ "GenSigSendType" SG_ 993 AMP_Chan4DTCInfo 2;
BA_ "Origin" SG_ 993 AMP_Chan5DTCInfo "fuel,ev";
BA_ "Match" SG_ 993 AMP_Chan5DTCInfo "AMP_Chan5DTCInfo";
BA_ "GenSigSendType" SG_ 993 AMP_Chan5DTCInfo 2;
BA_ "Origin" SG_ 993 AMP_Chan6DTCInfo "fuel,ev";
BA_ "Match" SG_ 993 AMP_Chan6DTCInfo "AMP_Chan6DTCInfo";
BA_ "GenSigSendType" SG_ 993 AMP_Chan6DTCInfo 2;
BA_ "Origin" SG_ 993 AMP_Chan7DTCInfo "fuel,ev";
BA_ "Match" SG_ 993 AMP_Chan7DTCInfo "AMP_Chan7DTCInfo";
BA_ "GenSigSendType" SG_ 993 AMP_Chan7DTCInfo 2;
BA_ "Origin" SG_ 993 AMP_Chan8DTCInfo "fuel,ev";
BA_ "Match" SG_ 993 AMP_Chan8DTCInfo "AMP_Chan8DTCInfo";
BA_ "GenSigSendType" SG_ 993 AMP_Chan8DTCInfo 2;
BA_ "Origin" SG_ 993 AMP_TempValue "fuel,ev";
BA_ "Match" SG_ 993 AMP_TempValue "AMP_TempValue";
BA_ "GenSigSendType" SG_ 993 AMP_TempValue 2;
BA_ "Origin" SG_ 993 AMP_TempSts "fuel,ev";
BA_ "Match" SG_ 993 AMP_TempSts "AMP_TempSts";
BA_ "GenSigSendType" SG_ 993 AMP_TempSts 2;
BA_ "Origin" SG_ 993 AMP_VolValue "fuel,ev";
BA_ "Match" SG_ 993 AMP_VolValue "AMP_VolValue";
BA_ "GenSigSendType" SG_ 993 AMP_VolValue 2;
BA_ "Origin" SG_ 993 BestListegPosnResp "fuel,ev";
BA_ "Match" SG_ 993 BestListegPosnResp "BestListegPosnResp";
BA_ "GenSigSendType" SG_ 993 BestListegPosnResp 2;
BA_ "Origin" SG_ 993 Clari_FiResp "fuel,ev";
BA_ "Match" SG_ 993 Clari_FiResp "Clari_FiResp";
BA_ "GenSigStartValue" SG_ 993 Clari_FiResp 1;
BA_ "GenSigSendType" SG_ 993 Clari_FiResp 2;
BA_ "TransparentInitValue" SG_ 993 AMP1_0x3E1 "0 0 0 0 0 0 32 0 ";
BA_ "GenSigSendType" SG_ 993 AMP1_0x3E1 2;
BA_ "Origin" SG_ 995 MediaCallSourceState "fuel,ev";
BA_ "Match" SG_ 995 MediaCallSourceState "MediaCallSourceState";
BA_ "GenSigSendType" SG_ 995 MediaCallSourceState 2;
BA_ "Origin" SG_ 995 BeepSourceSts "fuel,ev";
BA_ "Match" SG_ 995 BeepSourceSts "BeepSourceSts";
BA_ "GenSigSendType" SG_ 995 BeepSourceSts 2;
BA_ "Origin" SG_ 995 BalanceSetState "fuel,ev";
BA_ "Match" SG_ 995 BalanceSetState "BalanceSetState";
BA_ "GenSigStartValue" SG_ 995 BalanceSetState 10;
BA_ "GenSigSendType" SG_ 995 BalanceSetState 2;
BA_ "Origin" SG_ 995 VSCModeState "fuel,ev";
BA_ "Match" SG_ 995 VSCModeState "VSCModeState";
BA_ "GenSigStartValue" SG_ 995 VSCModeState 2;
BA_ "GenSigSendType" SG_ 995 VSCModeState 2;
BA_ "Origin" SG_ 995 FadeSetState "fuel,ev";
BA_ "Match" SG_ 995 FadeSetState "FadeSetState";
BA_ "GenSigStartValue" SG_ 995 FadeSetState 10;
BA_ "GenSigSendType" SG_ 995 FadeSetState 2;
BA_ "Origin" SG_ 995 DriveSideSts "fuel,ev";
BA_ "Match" SG_ 995 DriveSideSts "DriveSideSts";
BA_ "GenSigSendType" SG_ 995 DriveSideSts 2;
BA_ "Origin" SG_ 995 BassSetState "fuel,ev";
BA_ "Match" SG_ 995 BassSetState "BassSetState";
BA_ "GenSigStartValue" SG_ 995 BassSetState 10;
BA_ "GenSigSendType" SG_ 995 BassSetState 2;
BA_ "Origin" SG_ 995 MuteState "fuel,ev";
BA_ "Match" SG_ 995 MuteState "MuteState";
BA_ "GenSigStartValue" SG_ 995 MuteState 1;
BA_ "GenSigSendType" SG_ 995 MuteState 2;
BA_ "Origin" SG_ 995 NaviSourceState "fuel,ev";
BA_ "Match" SG_ 995 NaviSourceState "NaviSourceState";
BA_ "GenSigSendType" SG_ 995 NaviSourceState 2;
BA_ "Origin" SG_ 995 MidrangeSetState "fuel,ev";
BA_ "Match" SG_ 995 MidrangeSetState "MidrangeSetState";
BA_ "GenSigStartValue" SG_ 995 MidrangeSetState 10;
BA_ "GenSigSendType" SG_ 995 MidrangeSetState 2;
BA_ "Origin" SG_ 995 T_box_ECallSts "fuel,ev";
BA_ "Match" SG_ 995 T_box_ECallSts "T_box_ECallSts";
BA_ "GenSigSendType" SG_ 995 T_box_ECallSts 2;
BA_ "Origin" SG_ 995 GetHUTInfoSts "fuel,ev";
BA_ "Match" SG_ 995 GetHUTInfoSts "GetHUTInfoSts";
BA_ "GenSigStartValue" SG_ 995 GetHUTInfoSts 1;
BA_ "GenSigSendType" SG_ 995 GetHUTInfoSts 2;
BA_ "Origin" SG_ 995 TrebleSetState "fuel,ev";
BA_ "Match" SG_ 995 TrebleSetState "TrebleSetState";
BA_ "GenSigStartValue" SG_ 995 TrebleSetState 10;
BA_ "GenSigSendType" SG_ 995 TrebleSetState 2;
BA_ "Origin" SG_ 995 QLISurroundSetSt "fuel,ev";
BA_ "Match" SG_ 995 QLISurroundSetSt "QLISurroundSetSt";
BA_ "GenSigStartValue" SG_ 995 QLISurroundSetSt 1;
BA_ "GenSigSendType" SG_ 995 QLISurroundSetSt 2;
BA_ "Origin" SG_ 995 AVMStResp "fuel,ev";
BA_ "Match" SG_ 995 AVMStResp "AVMStResp";
BA_ "GenSigSendType" SG_ 995 AVMStResp 2;
BA_ "Origin" SG_ 995 NaviMediaVolLvlResp "fuel,ev";
BA_ "Match" SG_ 995 NaviMediaVolLvlResp "NaviMediaVolLvlResp";
BA_ "GenSigStartValue" SG_ 995 NaviMediaVolLvlResp 3;
BA_ "GenSigSendType" SG_ 995 NaviMediaVolLvlResp 2;
BA_ "Origin" SG_ 995 AVMMediaVolLvlResp "fuel,ev";
BA_ "Match" SG_ 995 AVMMediaVolLvlResp "AVMMediaVolLvlResp";
BA_ "GenSigStartValue" SG_ 995 AVMMediaVolLvlResp 3;
BA_ "GenSigSendType" SG_ 995 AVMMediaVolLvlResp 2;
BA_ "Origin" SG_ 995 FPASChStResp "fuel,ev";
BA_ "Match" SG_ 995 FPASChStResp "FPASChStResp";
BA_ "GenSigSendType" SG_ 995 FPASChStResp 2;
BA_ "Origin" SG_ 995 RPASChStResp "fuel,ev";
BA_ "Match" SG_ 995 RPASChStResp "RPASChStResp";
BA_ "GenSigSendType" SG_ 995 RPASChStResp 2;
BA_ "Origin" SG_ 995 FreshnessValue_AMP2 "fuel,ev";
BA_ "Match" SG_ 995 FreshnessValue_AMP2 "FreshnessValue_AMP2";
BA_ "GenSigSendType" SG_ 995 FreshnessValue_AMP2 2;
BA_ "Origin" SG_ 995 MAC_Check_AMP2 "fuel,ev";
BA_ "Match" SG_ 995 MAC_Check_AMP2 "MAC_Check_AMP2";
BA_ "GenSigSendType" SG_ 995 MAC_Check_AMP2 2;
BA_ "TransparentInitValue" SG_ 995 AMP2_0x3E3 "0 82 80 82 0 82 82 51 0 0 0 0 0 0 0 0 ";
BA_ "GenSigSendType" SG_ 995 AMP2_0x3E3 2;
BA_ "Origin" SG_ 997 HFMVolSetSts "fuel,ev";
BA_ "Match" SG_ 997 HFMVolSetSts "HFMVolSetSts";
BA_ "GenSigStartValue" SG_ 997 HFMVolSetSts 10;
BA_ "GenSigSendType" SG_ 997 HFMVolSetSts 2;
BA_ "Origin" SG_ 997 VR_TTSVolSetSts "fuel,ev";
BA_ "Match" SG_ 997 VR_TTSVolSetSts "VR_TTSVolSetSts";
BA_ "GenSigStartValue" SG_ 997 VR_TTSVolSetSts 10;
BA_ "GenSigSendType" SG_ 997 VR_TTSVolSetSts 2;
BA_ "Origin" SG_ 997 NaviVolumeSetState "fuel,ev";
BA_ "Match" SG_ 997 NaviVolumeSetState "NaviVolumeSetState";
BA_ "GenSigStartValue" SG_ 997 NaviVolumeSetState 10;
BA_ "GenSigSendType" SG_ 997 NaviVolumeSetState 2;
BA_ "Origin" SG_ 997 MainVolumeSetState "fuel,ev";
BA_ "Match" SG_ 997 MainVolumeSetState "MainVolumeSetState";
BA_ "GenSigStartValue" SG_ 997 MainVolumeSetState 10;
BA_ "GenSigSendType" SG_ 997 MainVolumeSetState 2;
BA_ "Origin" SG_ 997 AMPPowerSts "fuel,ev";
BA_ "Match" SG_ 997 AMPPowerSts "AMPPowerSts";
BA_ "GenSigStartValue" SG_ 997 AMPPowerSts 1;
BA_ "GenSigSendType" SG_ 997 AMPPowerSts 2;
BA_ "Origin" SG_ 997 IPVolSetSts "fuel,ev";
BA_ "Match" SG_ 997 IPVolSetSts "IPVolSetSts";
BA_ "GenSigStartValue" SG_ 997 IPVolSetSts 15;
BA_ "GenSigSendType" SG_ 997 IPVolSetSts 2;
BA_ "TransparentInitValue" SG_ 997 AMP3_0x3E5 "40 40 40 40 60 4 0 0 ";
BA_ "GenSigSendType" SG_ 997 AMP3_0x3E5 2;
BA_ "Origin" SG_ 1001 T_BOX_SysErrSts "fuel,ev";
BA_ "Match" SG_ 1001 T_BOX_SysErrSts "T_BOX_SysErrSts";
BA_ "GenSigCycleTime" SG_ 1001 T_BOX_SysErrSts 1000;
BA_ "Origin" SG_ 1001 T_BOX_SWUpdSts "fuel,ev";
BA_ "Match" SG_ 1001 T_BOX_SWUpdSts "T_BOX_SWUpdSts";
BA_ "GenSigCycleTime" SG_ 1001 T_BOX_SWUpdSts 1000;
BA_ "Origin" SG_ 1001 FreshnessValue_T_BOX_FD3 "fuel,ev";
BA_ "Match" SG_ 1001 FreshnessValue_T_BOX_FD3 "FreshnessValue_T_BOX_FD3";
BA_ "GenSigCycleTime" SG_ 1001 FreshnessValue_T_BOX_FD3 1000;
BA_ "Origin" SG_ 1001 MAC_Check_T_BOX_FD3 "fuel,ev";
BA_ "Match" SG_ 1001 MAC_Check_T_BOX_FD3 "MAC_Check_T_BOX_FD3";
BA_ "GenSigCycleTime" SG_ 1001 MAC_Check_T_BOX_FD3 1000;
BA_ "TransparentInitValue" SG_ 1001 T_BOX_FD3_0x3E9 "0 0 0 0 0 0 0 0 0 0 0 0 0 0 0 0 ";
BA_ "GenSigCycleTime" SG_ 1001 T_BOX_FD3_0x3E9 1000;
BA_ "Origin" SG_ 1045 ADAS_Meta_MsgTyp "fuel,ev";
BA_ "Match" SG_ 1045 ADAS_Meta_MsgTyp "ADAS_Meta_MsgTyp";
BA_ "GenSigCycleTime" SG_ 1045 ADAS_Meta_MsgTyp 5000;
BA_ "Origin" SG_ 1045 ADAS_Meta_MapProvider "fuel,ev";
BA_ "Match" SG_ 1045 ADAS_Meta_MapProvider "ADAS_Meta_MapProvider";
BA_ "GenSigCycleTime" SG_ 1045 ADAS_Meta_MapProvider 5000;
BA_ "Origin" SG_ 1045 ADAS_Meta_CountryCode "fuel,ev";
BA_ "Match" SG_ 1045 ADAS_Meta_CountryCode "ADAS_Meta_CountryCode";
BA_ "GenSigCycleTime" SG_ 1045 ADAS_Meta_CountryCode 5000;
BA_ "Origin" SG_ 1045 ADAS_Meta_CycCnt "fuel,ev";
BA_ "Match" SG_ 1045 ADAS_Meta_CycCnt "ADAS_Meta_CycCnt";
BA_ "GenSigCycleTime" SG_ 1045 ADAS_Meta_CycCnt 5000;
BA_ "Origin" SG_ 1045 ADAS_Meta_ProtVer_Major "fuel,ev";
BA_ "Match" SG_ 1045 ADAS_Meta_ProtVer_Major "ADAS_Meta_ProtVer_Major";
BA_ "GenSigCycleTime" SG_ 1045 ADAS_Meta_ProtVer_Major 5000;
BA_ "Origin" SG_ 1045 ADAS_Meta_ProtVer_MinorSub "fuel,ev";
BA_ "Match" SG_ 1045 ADAS_Meta_ProtVer_MinorSub "ADAS_Meta_ProtVer_MinorSub";
BA_ "GenSigCycleTime" SG_ 1045 ADAS_Meta_ProtVer_MinorSub 5000;
BA_ "Origin" SG_ 1045 ADAS_Meta_HwVer "fuel,ev";
BA_ "Match" SG_ 1045 ADAS_Meta_HwVer "ADAS_Meta_HwVer";
BA_ "GenSigCycleTime" SG_ 1045 ADAS_Meta_HwVer 5000;
BA_ "Origin" SG_ 1045 ADAS_Meta_DrvSide "fuel,ev";
BA_ "Match" SG_ 1045 ADAS_Meta_DrvSide "ADAS_Meta_DrvSide";
BA_ "GenSigStartValue" SG_ 1045 ADAS_Meta_DrvSide 1;
BA_ "GenSigCycleTime" SG_ 1045 ADAS_Meta_DrvSide 5000;
BA_ "Origin" SG_ 1045 ADAS_Meta_RegionCode "fuel,ev";
BA_ "Match" SG_ 1045 ADAS_Meta_RegionCode "ADAS_Meta_RegionCode";
BA_ "GenSigCycleTime" SG_ 1045 ADAS_Meta_RegionCode 5000;
BA_ "Origin" SG_ 1045 ADAS_Meta_MapVerQtr "fuel,ev";
BA_ "Match" SG_ 1045 ADAS_Meta_MapVerQtr "ADAS_Meta_MapVerQtr";
BA_ "GenSigCycleTime" SG_ 1045 ADAS_Meta_MapVerQtr 5000;
BA_ "Origin" SG_ 1045 ADAS_Meta_MapVerYear "fuel,ev";
BA_ "Match" SG_ 1045 ADAS_Meta_MapVerYear "ADAS_Meta_MapVerYear";
BA_ "GenSigCycleTime" SG_ 1045 ADAS_Meta_MapVerYear 5000;
BA_ "Origin" SG_ 1045 ADAS_Meta_SpdUnits "fuel,ev";
BA_ "Match" SG_ 1045 ADAS_Meta_SpdUnits "ADAS_Meta_SpdUnits";
BA_ "GenSigCycleTime" SG_ 1045 ADAS_Meta_SpdUnits 5000;
BA_ "Origin" SG_ 1045 ADAS_Meta_ProtVer_Minor "fuel,ev";
BA_ "Match" SG_ 1045 ADAS_Meta_ProtVer_Minor "ADAS_Meta_ProtVer_Minor";
BA_ "GenSigCycleTime" SG_ 1045 ADAS_Meta_ProtVer_Minor 5000;
BA_ "TransparentInitValue" SG_ 1045 HUT19_0x415 "0 0 0 0 128 0 0 0 ";
BA_ "GenSigCycleTime" SG_ 1045 HUT19_0x415 5000;
BA_ "Origin" SG_ 1888 DiagFuncReq "fuel,ev";
BA_ "Match" SG_ 1888 DiagFuncReq "DiagFuncReq";
BA_ "Origin" SG_ 1889 GW_Phy_Req "fuel,ev";
BA_ "Match" SG_ 1889 GW_Phy_Req "GW_Phy_Req";
BA_ "Origin" SG_ 1918 T_Box_Phy_Req "fuel,ev";
BA_ "Match" SG_ 1918 T_Box_Phy_Req "T_Box_Phy_Req";
BA_ "Origin" SG_ 1843 XBOX_D_Phy_Req "fuel,ev";
BA_ "Match" SG_ 1843 XBOX_D_Phy_Req "XBOX_D_Phy_Req";
BA_ "Origin" SG_ 1907 HUT_Phy_Req "fuel,ev";
BA_ "Match" SG_ 1907 HUT_Phy_Req "HUT_Phy_Req";
BA_ "Origin" SG_ 1953 GW_Phy_Resp "fuel,ev";
BA_ "Match" SG_ 1953 GW_Phy_Resp "GW_Phy_Resp";
BA_ "Origin" SG_ 1982 T_Box_Phy_Resp "fuel,ev";
BA_ "Match" SG_ 1982 T_Box_Phy_Resp "T_Box_Phy_Resp";
BA_ "Origin" SG_ 1844 XBOX_D_Phy_Resp "fuel,ev";
BA_ "Match" SG_ 1844 XBOX_D_Phy_Resp "XBOX_D_Phy_Resp";
BA_ "Origin" SG_ 1971 HUT_Phy_Resp "fuel,ev";
BA_ "Match" SG_ 1971 HUT_Phy_Resp "HUT_Phy_Resp";
BA_ "Origin" SG_ 1290 Destination_T_Box_NM "fuel,ev";
BA_ "Match" SG_ 1290 Destination_T_Box_NM "Destination_T_Box_NM";
BA_ "Origin" SG_ 1290 OpCode_T_Box_NM "fuel,ev";
BA_ "Match" SG_ 1290 OpCode_T_Box_NM "OpCode_T_Box_NM";
BA_ "Origin" SG_ 1289 Destination_HUT_NM "fuel,ev";
BA_ "Match" SG_ 1289 Destination_HUT_NM "Destination_HUT_NM";
BA_ "Origin" SG_ 1289 OpCode_HUT_NM "fuel,ev";
BA_ "Match" SG_ 1289 OpCode_HUT_NM "OpCode_HUT_NM";
BA_ "Origin" SG_ 1334 Destination_XBOX_D_NM "fuel,ev";
BA_ "Match" SG_ 1334 Destination_XBOX_D_NM "Destination_XBOX_D_NM";
BA_ "Origin" SG_ 1334 OpCode_XBOX_D_NM "fuel,ev";
BA_ "Match" SG_ 1334 OpCode_XBOX_D_NM "OpCode_XBOX_D_NM";
BA_ "Origin" SG_ 1281 Destination_CEM_NM "fuel,ev";
BA_ "Match" SG_ 1281 Destination_CEM_NM "Destination_CEM_NM";
BA_ "Origin" SG_ 1281 OpCode_CEM_NM "fuel,ev";
BA_ "Match" SG_ 1281 OpCode_CEM_NM "OpCode_CEM_NM";
BA_ "Origin" SG_ 1122 SyncRequestMessageId "fuel,ev";
BA_ "Match" SG_ 1122 SyncRequestMessageId "SyncRequestMessageId";
BA_ "GenSigSendType" SG_ 1122 SyncRequestMessageId 2;
BA_ "Origin" SG_ 1122 SyncRequstReseverData "fuel,ev";
BA_ "Match" SG_ 1122 SyncRequstReseverData "SyncRequstReseverData";
BA_ "GenSigSendType" SG_ 1122 SyncRequstReseverData 2;
BA_ "Origin" SG_ 1121 ResetCount "fuel,ev";
BA_ "Match" SG_ 1121 ResetCount "ResetCount";
BA_ "Origin" SG_ 1121 CMACMessageInfo "fuel,ev";
BA_ "Match" SG_ 1121 CMACMessageInfo "CMACMessageInfo";
BA_ "Origin" SG_ 1121 TripCount "fuel,ev";
BA_ "Match" SG_ 1121 TripCount "TripCount";
BA_ "Origin" SG_ 53 PEPS_T_BOXAuth1 "ev";
BA_ "Match" SG_ 53 PEPS_T_BOXAuth1 "PEPS_T_BOXAuth1";
BA_ "GenSigSendType" SG_ 53 PEPS_T_BOXAuth1 2;
BA_ "Origin" SG_ 54 T_BOX_PEPSAuth1 "ev";
BA_ "Match" SG_ 54 T_BOX_PEPSAuth1 "T_BOX_PEPSAuth1";
BA_ "GenSigSendType" SG_ 54 T_BOX_PEPSAuth1 2;
BA_ "Origin" SG_ 70 PEPS_T_BOXAuth2 "ev";
BA_ "Match" SG_ 70 PEPS_T_BOXAuth2 "PEPS_T_BOXAuth2";
BA_ "GenSigSendType" SG_ 70 PEPS_T_BOXAuth2 2;
BA_ "Origin" SG_ 72 T_BOX_PEPSAuth2 "ev";
BA_ "Match" SG_ 72 T_BOX_PEPSAuth2 "T_BOX_PEPSAuth2";
BA_ "GenSigSendType" SG_ 72 T_BOX_PEPSAuth2 2;
BA_ "Origin" SG_ 96 HCU_BrkPedalSts "ev";
BA_ "Match" SG_ 96 HCU_BrkPedalSts "HCU_BrkPedalSts";
BA_ "GenSigCycleTime" SG_ 96 HCU_BrkPedalSts 10;
BA_ "Origin" SG_ 96 HCU_BrkPedalStsValid "ev";
BA_ "Match" SG_ 96 HCU_BrkPedalStsValid "HCU_BrkPedalStsValid";
BA_ "GenSigCycleTime" SG_ 96 HCU_BrkPedalStsValid 10;
BA_ "Origin" SG_ 96 HCU_AccelPedalPosn_Diag "ev";
BA_ "Match" SG_ 96 HCU_AccelPedalPosn_Diag "HCU_AccelPedalPosn_Diag";
BA_ "GenSigCycleTime" SG_ 96 HCU_AccelPedalPosn_Diag 10;
BA_ "Origin" SG_ 96 HCU_AccelPedalPosn_DiagValid "ev";
BA_ "Match" SG_ 96 HCU_AccelPedalPosn_DiagValid "HCU_AccelPedalPosn_DiagValid";
BA_ "GenSigStartValue" SG_ 96 HCU_AccelPedalPosn_DiagValid 1;
BA_ "GenSigCycleTime" SG_ 96 HCU_AccelPedalPosn_DiagValid 10;
BA_ "Origin" SG_ 96 HCU_PowertrainSts_0x60 "ev";
BA_ "Match" SG_ 96 HCU_PowertrainSts_0x60 "HCU_PowertrainSts";
BA_ "GenSigCycleTime" SG_ 96 HCU_PowertrainSts_0x60 10;
BA_ "Origin" SG_ 96 HCU_RaceLaunchSts_0x60 "ev";
BA_ "Match" SG_ 96 HCU_RaceLaunchSts_0x60 "HCU_RaceLaunchSts";
BA_ "GenSigCycleTime" SG_ 96 HCU_RaceLaunchSts_0x60 10;
BA_ "Origin" SG_ 96 HCU_RaceLaunchAvail_0x60 "ev";
BA_ "Match" SG_ 96 HCU_RaceLaunchAvail_0x60 "HCU_RaceLaunchAvail";
BA_ "GenSigCycleTime" SG_ 96 HCU_RaceLaunchAvail_0x60 10;
BA_ "Origin" SG_ 96 HCU_AccelPedalPosn "ev";
BA_ "Match" SG_ 96 HCU_AccelPedalPosn "HCU_AccelPedalPosn";
BA_ "GenSigCycleTime" SG_ 96 HCU_AccelPedalPosn 10;
BA_ "Origin" SG_ 96 HCU_AccelPedalPosnValid "ev";
BA_ "Match" SG_ 96 HCU_AccelPedalPosnValid "HCU_AccelPedalPosnValid";
BA_ "GenSigStartValue" SG_ 96 HCU_AccelPedalPosnValid 1;
BA_ "GenSigCycleTime" SG_ 96 HCU_AccelPedalPosnValid 10;
BA_ "Origin" SG_ 96 HCU_CruiseCtrlSts "ev";
BA_ "Match" SG_ 96 HCU_CruiseCtrlSts "HCU_CruiseCtrlSts";
BA_ "GenSigCycleTime" SG_ 96 HCU_CruiseCtrlSts 10;
BA_ "Origin" SG_ 96 HCU_TgtCrsVehSpd "ev";
BA_ "Match" SG_ 96 HCU_TgtCrsVehSpd "HCU_TgtCrsVehSpd";
BA_ "GenSigCycleTime" SG_ 96 HCU_TgtCrsVehSpd 10;
BA_ "Origin" SG_ 96 HCU_TgtCrsVehSpdvalid "ev";
BA_ "Match" SG_ 96 HCU_TgtCrsVehSpdvalid "HCU_TgtCrsVehSpdvalid";
BA_ "GenSigStartValue" SG_ 96 HCU_TgtCrsVehSpdvalid 1;
BA_ "GenSigCycleTime" SG_ 96 HCU_TgtCrsVehSpdvalid 10;
BA_ "TransparentInitValue" SG_ 96 HCU_FD1_0x60 "0 0 0 0 0 0 0 0 0 0 32 0 0 0 0 128 0 0 0 0 0 0 0 0 0 0 0 0 0 0 0 0 0 0 0 0 0 0 0 0 0 0 0 0 0 8 0 0 0 0 0 0 0 0 0 0 0 0 0 0 0 0 0 0 ";
BA_ "GenSigCycleTime" SG_ 96 HCU_FD1_0x60 10;
BA_ "Origin" SG_ 142 EngTrqCrankshaftLvl "ev";
BA_ "Match" SG_ 142 EngTrqCrankshaftLvl "EngTrqCrankshaftLvl";
BA_ "GenSigCycleTime" SG_ 142 EngTrqCrankshaftLvl 10;
BA_ "Origin" SG_ 142 EngTrqCrankshaftLvlValid "ev";
BA_ "Match" SG_ 142 EngTrqCrankshaftLvlValid "EngTrqCrankshaftLvlValid";
BA_ "GenSigStartValue" SG_ 142 EngTrqCrankshaftLvlValid 1;
BA_ "GenSigCycleTime" SG_ 142 EngTrqCrankshaftLvlValid 10;
BA_ "TransparentInitValue" SG_ 142 ECM_PT5_0x8E "0 0 0 0 0 0 0 32 ";
BA_ "GenSigCycleTime" SG_ 142 ECM_PT5_0x8E 10;
BA_ "Origin" SG_ 172 P2M_ActTrq "ev";
BA_ "Match" SG_ 172 P2M_ActTrq "P2M_ActTrq";
BA_ "GenSigStartValue" SG_ 172 P2M_ActTrq 16382;
BA_ "GenSigCycleTime" SG_ 172 P2M_ActTrq 10;
BA_ "TransparentInitValue" SG_ 172 P2M1_0xAC "0 0 0 0 127 252 0 0 ";
BA_ "GenSigCycleTime" SG_ 172 P2M1_0xAC 10;
BA_ "Origin" SG_ 190 P2M_ActSpd "ev";
BA_ "Match" SG_ 190 P2M_ActSpd "P2M_ActSpd";
BA_ "GenSigCycleTime" SG_ 190 P2M_ActSpd 10;
BA_ "Origin" SG_ 190 P2M_ActHvDcVolt "ev";
BA_ "Match" SG_ 190 P2M_ActHvDcVolt "P2M_ActHvDcVolt";
BA_ "GenSigStartValue" SG_ 190 P2M_ActHvDcVolt 4094;
BA_ "GenSigCycleTime" SG_ 190 P2M_ActHvDcVolt 10;
BA_ "TransparentInitValue" SG_ 190 P2M3_0xBE "0 255 224 0 0 0 0 0 ";
BA_ "GenSigCycleTime" SG_ 190 P2M3_0xBE 10;
BA_ "Origin" SG_ 249 HCU_TrqLimMax_Norm "ev";
BA_ "Match" SG_ 249 HCU_TrqLimMax_Norm "HCU_TrqLimMax_Norm";
BA_ "GenSigStartValue" SG_ 249 HCU_TrqLimMax_Norm 275;
BA_ "GenSigCycleTime" SG_ 249 HCU_TrqLimMax_Norm 10;
BA_ "TransparentInitValue" SG_ 249 HCU_HP8_0xF9 "0 0 1 19 0 0 0 0 ";
BA_ "GenSigCycleTime" SG_ 249 HCU_HP8_0xF9 10;
BA_ "Origin" SG_ 279 EngState_PHEV "ev";
BA_ "Match" SG_ 279 EngState_PHEV "EngState_PHEV";
BA_ "GenSigCycleTime" SG_ 279 EngState_PHEV 20;
BA_ "Origin" SG_ 279 CruiseCtrlSts_PHEV "ev";
BA_ "Match" SG_ 279 CruiseCtrlSts_PHEV "CruiseCtrlSts_PHEV";
BA_ "GenSigCycleTime" SG_ 279 CruiseCtrlSts_PHEV 20;
BA_ "TransparentInitValue" SG_ 279 ECM_PT7_0x117 "0 0 0 0 0 0 0 0 ";
BA_ "GenSigCycleTime" SG_ 279 ECM_PT7_0x117 20;
BA_ "Origin" SG_ 282 HCU_GearSts "ev";
BA_ "Match" SG_ 282 HCU_GearSts "HCU_GearSts";
BA_ "GenSigStartValue" SG_ 282 HCU_GearSts 14;
BA_ "GenSigCycleTime" SG_ 282 HCU_GearSts 20;
BA_ "Origin" SG_ 282 HCU_HybMod "ev";
BA_ "Match" SG_ 282 HCU_HybMod "HCU_HybMod";
BA_ "GenSigCycleTime" SG_ 282 HCU_HybMod 20;
BA_ "Origin" SG_ 282 HCU_HybFctnMod "ev";
BA_ "Match" SG_ 282 HCU_HybFctnMod "HCU_HybFctnMod";
BA_ "GenSigCycleTime" SG_ 282 HCU_HybFctnMod 20;
BA_ "TransparentInitValue" SG_ 282 HCU_HP6_0x11A "0 0 0 0 28 0 0 0 ";
BA_ "GenSigCycleTime" SG_ 282 HCU_HP6_0x11A 20;
BA_ "Origin" SG_ 301 EB_AEBIBActv "ev";
BA_ "Match" SG_ 301 EB_AEBIBActv "EB_AEBIBActv";
BA_ "GenSigCycleTime" SG_ 301 EB_AEBIBActv 20;
BA_ "Origin" SG_ 301 EB_AEBBAActv "ev";
BA_ "Match" SG_ 301 EB_AEBBAActv "EB_AEBBAActv";
BA_ "GenSigCycleTime" SG_ 301 EB_AEBBAActv 20;
BA_ "Origin" SG_ 301 EB_AEBAvailable "ev";
BA_ "Match" SG_ 301 EB_AEBAvailable "EB_AEBAvailable";
BA_ "GenSigCycleTime" SG_ 301 EB_AEBAvailable 20;
BA_ "Origin" SG_ 301 EB_TgtRcprtnTrqSts "ev";
BA_ "Match" SG_ 301 EB_TgtRcprtnTrqSts "EB_TgtRcprtnTrqSts";
BA_ "GenSigCycleTime" SG_ 301 EB_TgtRcprtnTrqSts 20;
BA_ "TransparentInitValue" SG_ 301 EBOOSTER_FD1_0x12D "0 0 0 0 0 0 0 0 0 0 0 0 0 0 0 0 0 0 0 0 0 0 0 0 0 0 0 0 0 0 0 0 0 0 0 0 0 0 0 0 0 0 0 0 0 0 0 0 0 0 0 0 0 0 0 0 0 0 0 0 0 0 0 0 ";
BA_ "GenSigCycleTime" SG_ 301 EBOOSTER_FD1_0x12D 20;
BA_ "Origin" SG_ 330 HCUImmoAuthRes "ev";
BA_ "Match" SG_ 330 HCUImmoAuthRes "HCUImmoAuthRes";
BA_ "GenSigCycleTime" SG_ 330 HCUImmoAuthRes 20;
BA_ "Origin" SG_ 330 HCU_EVLmpSts "ev";
BA_ "Match" SG_ 330 HCU_EVLmpSts "HCU_EVLmpSts";
BA_ "GenSigCycleTime" SG_ 330 HCU_EVLmpSts 20;
BA_ "Origin" SG_ 330 HCU_ECODrvHabit_Indcn "ev";
BA_ "Match" SG_ 330 HCU_ECODrvHabit_Indcn "HCU_ECODrvHabit_Indcn";
BA_ "GenSigStartValue" SG_ 330 HCU_ECODrvHabit_Indcn 100;
BA_ "GenSigCycleTime" SG_ 330 HCU_ECODrvHabit_Indcn 20;
BA_ "Origin" SG_ 330 HCU_TotDrvReqPower_0x14a "ev";
BA_ "Match" SG_ 330 HCU_TotDrvReqPower_0x14a "HCU_TotDrvReqPower";
BA_ "GenSigStartValue" SG_ 330 HCU_TotDrvReqPower_0x14a 100;
BA_ "GenSigCycleTime" SG_ 330 HCU_TotDrvReqPower_0x14a 20;
BA_ "Origin" SG_ 330 HCU_AvailPower_TM "ev";
BA_ "Match" SG_ 330 HCU_AvailPower_TM "HCU_AvailPower_TM";
BA_ "GenSigCycleTime" SG_ 330 HCU_AvailPower_TM 20;
BA_ "Origin" SG_ 330 HCU_DrvMod "ev";
BA_ "Match" SG_ 330 HCU_DrvMod "HCU_DrvMod";
BA_ "GenSigCycleTime" SG_ 330 HCU_DrvMod 20;
BA_ "TransparentInitValue" SG_ 330 HCU_PT5_0x14A "0 0 0 100 100 0 0 0 ";
BA_ "GenSigCycleTime" SG_ 330 HCU_PT5_0x14A 20;
BA_ "Origin" SG_ 448 HCU_ChrgSysLmpSts "ev";
BA_ "Match" SG_ 448 HCU_ChrgSysLmpSts "HCU_ChrgSysLmpSts";
BA_ "GenSigCycleTime" SG_ 448 HCU_ChrgSysLmpSts 50;
BA_ "Origin" SG_ 448 HCU_ChrgSysErr_1 "ev";
BA_ "Match" SG_ 448 HCU_ChrgSysErr_1 "HCU_ChrgSysErr_1";
BA_ "GenSigCycleTime" SG_ 448 HCU_ChrgSysErr_1 50;
BA_ "Origin" SG_ 448 HCU_ChrgSysErr_2 "ev";
BA_ "Match" SG_ 448 HCU_ChrgSysErr_2 "HCU_ChrgSysErr_2";
BA_ "GenSigCycleTime" SG_ 448 HCU_ChrgSysErr_2 50;
BA_ "Origin" SG_ 448 HCU_ChrgSysErr_3 "ev";
BA_ "Match" SG_ 448 HCU_ChrgSysErr_3 "HCU_ChrgSysErr_3";
BA_ "GenSigCycleTime" SG_ 448 HCU_ChrgSysErr_3 50;
BA_ "Origin" SG_ 448 HCU_ChrgSysErr_4 "ev";
BA_ "Match" SG_ 448 HCU_ChrgSysErr_4 "HCU_ChrgSysErr_4";
BA_ "GenSigCycleTime" SG_ 448 HCU_ChrgSysErr_4 50;
BA_ "Origin" SG_ 448 HCU_ChrgSysErr_5 "ev";
BA_ "Match" SG_ 448 HCU_ChrgSysErr_5 "HCU_ChrgSysErr_5";
BA_ "GenSigCycleTime" SG_ 448 HCU_ChrgSysErr_5 50;
BA_ "Origin" SG_ 448 HCU_ChrgSysErr_6 "ev";
BA_ "Match" SG_ 448 HCU_ChrgSysErr_6 "HCU_ChrgSysErr_6";
BA_ "GenSigCycleTime" SG_ 448 HCU_ChrgSysErr_6 50;
BA_ "Origin" SG_ 448 HCU_ChrgSysErr_7 "ev";
BA_ "Match" SG_ 448 HCU_ChrgSysErr_7 "HCU_ChrgSysErr_7";
BA_ "GenSigCycleTime" SG_ 448 HCU_ChrgSysErr_7 50;
BA_ "Origin" SG_ 448 HCU_ChrgSysErr_8 "ev";
BA_ "Match" SG_ 448 HCU_ChrgSysErr_8 "HCU_ChrgSysErr_8";
BA_ "GenSigCycleTime" SG_ 448 HCU_ChrgSysErr_8 50;
BA_ "Origin" SG_ 448 HCU_DrvModDisp "ev";
BA_ "Match" SG_ 448 HCU_DrvModDisp "HCU_DrvModDisp";
BA_ "GenSigCycleTime" SG_ 448 HCU_DrvModDisp 50;
BA_ "TransparentInitValue" SG_ 448 HCU_PT8_0x1C0 "0 0 0 0 0 0 0 0 ";
BA_ "GenSigCycleTime" SG_ 448 HCU_PT8_0x1C0 50;
VAL_ 796 AudioMuteSts 0 "Not used" 1 "not producing audio" 2 "producing audio" 3 "Reserved" ;
VAL_ 796 OrvmPosnEnaSts 0 "No command" 1 "Both side disable" 2 "Both side enable" 3 "Only driver enable" 4 "Only passager enable" 5 "Reserved" 7 "Reserved" ;
VAL_ 796 ORVMFoldSwt_HUT 0 "None" 1 "Fold" 2 "Unfold" 3 "Reserved" ;
VAL_ 796 ORVMLensAdjmt_HUT 0 "Mir_Swt_Idle" 1 "Mir_Swt_Drv_up" 2 "Mir_Swt_Drv_down" 3 "Mir_Swt_Drv_left" 4 "Mir_Swt_Drv_right" 5 "Mir_Swt_Pass_up" 6 "Mir_Swt_Pass_down" 7 "Mir_Swt_Pass_left" 8 "Mir_Swt_Pass_right" 9 "Reserved" 15 "Reserved" ;
VAL_ 796 DrvSeatAdjmt_HUT 0 "Seat_Swt_Idle" 1 "Seat_Swt_Slide_Fwd" 2 "Seat_Swt_Slide_Rwd" 3 "Seat_Swt_BckRst_Fwd" 4 "Seat_Swt_BckRst_Rwd" 5 "Seat_Swt_Height_F_up" 6 "Seat_Swt_Height_F_down" 7 "Seat_Swt_Height_R_up" 8 "Seat_Swt_Height_R_down" 9 "Reserved" 15 "Reserved" ;
VAL_ 796 DrivingModReq_VR 0 "Standard" 1 "Reserved" 2 "Reserved" 3 "ECO" 4 "Sport" 5 "Reserved" 8 "Reserved" 9 "AUTO" 10 "Reserved" 11 "Mud" 12 "Snow_TOD" 13 "Sand" 14 "Reserved" 15 "Initial Value" ;
VAL_ 796 DWD_WorkCmd 0 "OFF" 1 "ON" ;
VAL_ 796 DampgDrvModeReq 0 "Normal (Reserved)" 1 "Comfort(Default)" 2 "Sport" 3 "No HUT Control" ;
VAL_ 796 VSGSwtSet 0 "VSG OFF" 1 "VSG ON" ;
VAL_ 805 HUD_SwtSts 0 "OFF" 1 "ON" ;
VAL_ 805 HUD_BrightnessLvl 0 "Level 1" 1 "Level 2" 2 "Level 3" 3 "Level 4" 4 "Level 5" 5 "Level 6" 6 "Level 7" 7 "Level 8" 8 "Level 9" 9 "Reserved" 15 "Reserved" ;
VAL_ 805 HUD_HeightLvl 0 "Level 1" 1 "Level 2" 2 "Level 3" 3 "Level 4" 4 "Level 5" 5 "Level 6" 6 "Level 7" 7 "Level 8" 8 "Level 9" 9 "Level 10" 10 "Level 11" 11 "Level 12" 12 "Level 13" 13 "Level 14" 14 "Level 15" 15 "Level 16" 16 "Level 17" 17 "Level 18" 18 "Level 19" 19 "Level 20" 20 "Level 21" 21 "Reserved" 31 "Reserved" ;
VAL_ 805 HUD_UIMod 0 "Normal Mode" 1 "Dot Matrix Mode" ;
VAL_ 805 HUD_UIModVld 0 "Invalid" 1 "Valid" ;
VAL_ 805 HUD_Manufactor 0 "ADAYO" 1 "Reserved" 6 "Reserved" 7 "Not configured" ;
VAL_ 805 HUD_ReslType 0 "LVDS1" 1 "LVDS2" 2 "LVDS3" 3 "LVDS4" 4 "Reserved" 6 "Reserved" 7 "Not configured" ;
VAL_ 805 HUD_UIModDefd 0 "Normal_Mode" 1 "Check_Configure_Mode" 2 "Backgroud_Mode" 3 "Reserved" 7 "Reserved" ;
VAL_ 816 Checksum_HCM_R2 0 "Valid values" 255 "Valid values" ;
VAL_ 816 RightLightShowSts 0 "Animation OFF" 1 "Approach light Animation In Process" 2 "Approach light Animation Successful" 3 "Approach light Animation Failure" 4 "Unlock light Animation In Process" 5 "Unlock light Animation Successful" 6 "Unlock light Animation Failure" 7 "Lock light Animation In Process" 8 "Lock light Animation Successful" 9 "Lock light Animation Failure" 10 "Light show Animation In Process" 11 "Light show Animation Successful" 12 "Light show Animation Failure" 13 "Reserved" 31 "Reserved" ;
VAL_ 816 FRMusicLightShowSts 0 "OFF" 1 "In_Process" 2 "Successful" 3 "Failure" ;
VAL_ 816 RollingCounter_HCM_R2 0 "Valid value" 14 "Valid value" 15 "Invalid value" ;
VAL_ 817 ACDualReq_VR 0 "No action" 1 "Close" 2 "Open" 3 "Reserved" ;
VAL_ 817 ACAQSReq_VR 0 "No action" 1 "Close" 2 "Open" 3 "Reserved" ;
VAL_ 817 ACRearDefrstReq_VR 0 "No action" 1 "Close" 2 "Open" 3 "Reserved" ;
VAL_ 817 ACPassTempReq_VR 0 "No action" 1 "Low" 2 "Valid value(phys = 0.5 * raw + 15.5)" 32 "Valid value(phys = 0.5 * raw + 15.5)" 33 "High" 34 "Reserved" 63 "Reserved" ;
VAL_ 817 ACAIUReq_VR 0 "No action" 1 "Close" 2 "Open" 3 "Reserved" ;
VAL_ 817 ALCMStatSwt 0 "Off" 1 "On" ;
VAL_ 817 ALCMDynSwt 0 "Off" 1 "On" ;
VAL_ 817 ALCMClrSet 0 "Colour set 0-63" 63 "Colour set 0-63" ;
VAL_ 817 ALCMRhmSwt 0 "Off" 1 "On" ;
VAL_ 817 IPVolSet 0 "Reserved" 9 "Reserved" 10 "IP volume step 10-20" 20 "IP volume step 10-20" 21 "Reserved" 62 "Reserved" 63 "Invalid Value" ;
VAL_ 817 PASSwtReq_VR 0 "No action" 1 "OFF" 2 "ON" 3 "Reserved" ;
VAL_ 817 HUT_BeanIDReq 0 "No action" 1 "Request" 2 "Clear Data" 3 "Reserved" ;
VAL_ 817 HUT_EgyRecvrySet 0 "Strong" 1 "Normal" 2 "Weak" 3 "No action" ;
VAL_ 818 RFLLightShowSts 0 "Animation_OFF" 1 "Approach_light_In_Process" 2 "Approach_light_Successful" 3 "Approach_light_Failure" 4 "Unlock_light_In_Process" 5 "Unlock_light_Successful" 6 "Unlock_light_Failure" 7 "Lock_light_In_Process" 8 "Lock_light_Successful" 9 "Lock_light_Failure" 10 "Light_show_In_Process" 11 "Light_show_Successful" 12 "Light_show_Failure" 13 "MusicLight_In_Process" 14 "MusicLight_Successful" 15 "MusicLight_Failure" ;
VAL_ 819 RFRLightShowSts 0 "Animation_OFF" 1 "Approach_light_In_Process" 2 "Approach_light_Successful" 3 "Approach_light_Failure" 4 "Unlock_light_In_Process" 5 "Unlock_light_Successful" 6 "Unlock_light_Failure" 7 "Lock_light_In_Process" 8 "Lock_light_Successful" 9 "Lock_light_Failure" 10 "Light_show_In_Process" 11 "Light_show_Successful" 12 "Light_show_Failure" 13 "MusicLight_In_Process" 14 "MusicLight_Successful" 15 "MusicLight_Failure" ;
VAL_ 825 HUT_RemtEngCtrl 0 "No action" 1 "Start" 2 "Stop" 3 "Invalid" ;
VAL_ 825 ACDrvSetTempReq_ETC_VR 0 "Initial value" 1 "Level 1(Low)_17(Hi)" 17 "Level 1(Low)_17(Hi)" 18 "Reserved" 31 "Reserved" ;
VAL_ 825 ACDrvSetTempSteplsReq_ETC_TC 0 "Initial value" 1 "Level 1(Low)_17(Hi)" 17 "Level 1(Low)_17(Hi)" 18 "Reserved" 31 "Reserved" ;
VAL_ 825 HUT_ChrgnMode 0 "Immediate Charging" 1 "Delay Charging" 2 "Invalid value" 3 "No action" ;
VAL_ 825 HUT_BattKeepTemp 0 "Default" 1 "ON" 2 "OFF" 3 "Reserved" ;
VAL_ 825 HUT_IntelEngIdlChrgnSet 0 "Default" 1 "ON" 2 "OFF" 3 "Reserved" ;
VAL_ 825 HUT_IntelBattTempMagSet 0 "Default" 1 "ON" 2 "OFF" 3 "Reserved" ;
VAL_ 825 HUT_BattSOCLim 0 "100%" 1 "50%" 2 "60%" 3 "70%" 4 "80%" 5 "90%" 6 "No action" 7 "Reserved" ;
VAL_ 827 BackgroundLightLvlSet 0 "1" 1 "2" 2 "3" 3 "4" 4 "5" 5 "6" 6 "7" 7 "8" 8 "9" 9 "10" 10 "No action" 11 "Reserved" 15 "Reserved" ;
VAL_ 827 ManCmpSet 0 "0" 1 "1" 2 "2" 3 "3" 4 "4" 5 "5" 6 "6" 7 "7" 8 "8" 9 "9" 10 "10" 11 "Reserved" 15 "Reserved" ;
VAL_ 827 DispModSet 0 "Automode" 1 "Day mode" 2 "Night mode" 3 "Reserved" ;
VAL_ 827 WPC_SwtReq 0 "No action" 1 "Initial value" 2 "Close" 3 "Open" ;
VAL_ 827 AVMSwtReq 0 "OFF" 1 "ON" ;
VAL_ 827 NaviMediaVolLvlReq 0 "Level 0" 1 "Level 1" 2 "Level 2" 3 "Level 3" 4 "Level 4" 5 "Level 5" 6 "Level 6" 7 "Level 7" 8 "Level 8" 9 "Level 9" 10 "Level 10" 11 "Invalid" 15 "Invalid" ;
VAL_ 827 AVMMediaVolLvlReq 0 "Level 0" 1 "Level 1" 2 "Level 2" 3 "Level 3" 4 "Level 4" 5 "Level 5" 6 "Level 6" 7 "Level 7" 8 "Level 8" 9 "Level 9" 10 "Level 10" 11 "Invalid" 15 "Invalid" ;
VAL_ 827 FPASChanSwtReq 0 "OFF" 1 "ON" ;
VAL_ 827 RPASChanSwtReq 0 "OFF" 1 "ON" ;
VAL_ 827 ACRearBlwrSpdReq_VR 0 "No Command" 1 "Stepless Speed1_Low" 2 "Stepless Speed2" 3 "Stepless Speed3" 4 "Stepless Speed4" 5 "Stepless Speed5" 6 "Stepless Speed6" 7 "Stepless Speed7_High" 8 "Reserved" 15 "Reserved" ;
VAL_ 827 ACRearBlwrsteplsSpdReq_TC 0 "No Command" 1 "Stepless Speed1_Low" 2 "Stepless Speed2" 3 "Stepless Speed3" 4 "Stepless Speed4" 5 "Stepless Speed5" 6 "Stepless Speed6" 7 "Stepless Speed7_High" 8 "Reserved" 15 "Reserved" ;
VAL_ 827 PLGReq_VR 0 "No action" 1 "Close" 2 "Open" 3 "Reserved" ;
VAL_ 827 ACRearAirDistribModReq_VR 0 "No action" 1 "Face" 2 "Face & Foot" 3 "Foot" 4 "Reserved" 7 "Reserved" ;
VAL_ 827 ACZoneReq_VR 0 "No action" 1 "Close" 2 "Open" 3 "Reserved" ;
VAL_ 827 OPDSwtSts 0 "ON" 1 "OFF" 2 "Unselect able" 3 "No action" ;
VAL_ 833 FLTirePressIndSts 0 "Normal" 1 "Low" 2 "Reserved" 3 "High" 4 "Not available" 5 "Reserved" 7 "Reserved" ;
VAL_ 833 FRTirePressIndSts 0 "Normal" 1 "Low" 2 "Reserved" 3 "High" 4 "Not available" 5 "Reserved" 7 "Reserved" ;
VAL_ 833 TirePressSysFailrIndcn 0 "No failure" 1 "Failure" 2 "Reserved" 3 "Reserved" ;
VAL_ 833 RLTirePressIndSts 0 "Normal" 1 "Low" 2 "Reserved" 3 "High" 4 "Not available" 5 "Reserved" 7 "Reserved" ;
VAL_ 833 RRTirePressIndSts 0 "Normal" 1 "Low" 2 "Reserved" 3 "High" 4 "Not available" 5 "Reserved" 7 "Reserved" ;
VAL_ 833 FLTireTempSts 0 "Normal" 1 "High" 2 "Not available" 3 "Reserved" ;
VAL_ 833 FRTireTempSts 0 "Normal" 1 "High" 2 "Not available" 3 "Reserved" ;
VAL_ 833 RLTireTempSts 0 "Normal" 1 "High" 2 "Not available" 3 "Reserved" ;
VAL_ 833 RRTireTempSts 0 "Normal" 1 "High" 2 "Not available" 3 "Reserved" ;
VAL_ 833 TPMS_AutoLoctSts 0 "Auto-Learn or Auto-Locate not in progress  TPMS is base system" 1 "Auto-Learn in progress" 2 "Auto-Locate in progress (Auto-Learn complete)" 3 "Auto-Locate complete" 4 "Auto-Learn timeout" 5 "Auto-Locate timeout" 6 "Reserved" 15 "Reserved" ;
VAL_ 836 AntiDisIdnResult 0 "Succeed" 1 "Fail" 2 "Invalid" 3 "Reserved" ;
VAL_ 836 SelfChkSts 0 "Succeed" 1 "Fail" 2 "Invalid" 3 "Reserved" ;
VAL_ 836 ActvdSts 0 "Active" 1 "Not_active" 2 "Invalid" 3 "Reserved" ;
VAL_ 837 LasHdLmpSts 0 "Off" 1 "On" ;
VAL_ 837 AntitheftSts 0 "Disarmed" 1 "Armed" 2 "Prearmed" 3 "Alarmed" ;
VAL_ 837 DrvDoorLockSts 0 "Lock" 1 "Unlock" ;
VAL_ 837 DoorLockSts 0 "NA" 1 "All doors locked" 2 "Driver door unlocked" 3 "All doors unlocked" ;
VAL_ 837 HiLowBeamSts 0 "Off" 1 "ON" 2 "error" 3 "Reserved" ;
VAL_ 837 RLDoorLockSts 0 "Lock" 1 "Unlock" ;
VAL_ 837 PassDoorLockSts 0 "Lock" 1 "Unlock" ;
VAL_ 837 RRDoorLockSts 0 "Lock" 1 "Unlock" ;
VAL_ 837 HazardLmpSwtSts 0 "OFF" 1 "ON" ;
VAL_ 837 LRPosnLmpSts 0 "OFF" 1 "ON" ;
VAL_ 837 RRPosnLmpSts 0 "OFF" 1 "ON" ;
VAL_ 840 PowerSet 0 "OFF" 1 "ON" ;
VAL_ 840 HUT_CallSts_Dialing 0 "No" 1 "Yes" ;
VAL_ 840 HUT_CallSts_IncomingCall 0 "No" 1 "Yes" ;
VAL_ 840 HUT_CallSts_ongoing 0 "No" 1 "Yes" ;
VAL_ 840 HUT_CallTime 0 "00" 359999 "99" 360000 "invalid  do not display the call time" 16777215 "invalid  do not display the call time" ;
VAL_ 842 IP_RemainDistance 0 "0~2000" 2000 "0~2000" 2001 "Reserved" 4094 "Reserved" 4095 "Invalid" ;
VAL_ 842 IP_InstFuelConsUnit 0 "L100km" 1 "Lh" ;
VAL_ 842 IP_EBDFailSts 0 "No failure" 1 "Failure" ;
VAL_ 842 IP_AvgFuelCons 0 "Valid" 2999 "Valid" 3000 "Reserved" 4094 "Reserved" 4095 "Invalid" ;
VAL_ 842 IP_InstFuelCons 0 "Valid" 9999 "Valid" 10000 "Reserved" 16382 "Reserved" 16383 "Invalid" ;
VAL_ 845 ColMemPosnSetSwtFB 0 "No action" 1 "Set memory button 1 successfully" 2 "Set memory button 1 unsuccessfully" 3 "Set memory button 2 successfully" 4 "Set memory button 2 unsuccessfully" 5 "Set memory button 3 successfully" 6 "Set memory button 3 unsuccessfully" 7 "Reserved" ;
VAL_ 849 CheckSum_ABM1 0 "Valid values" 255 "Valid values" ;
VAL_ 849 SecRowLSBR 0 "No reminder" 1 "Reminder" ;
VAL_ 849 AirbFailLmpCmd 0 "Lamp off" 1 "Lamp on" ;
VAL_ 849 SecRowMidSBR 0 "No reminder" 1 "Reminder" ;
VAL_ 849 DrvSBR 0 "No reminder" 1 "Reminder" ;
VAL_ 849 SecRowRSBR 0 "No reminder" 1 "Reminder" ;
VAL_ 849 PassSBR 0 "No reminder" 1 "Reminder" ;
VAL_ 849 PassSBR_Visual 0 "Lamp off" 1 "Lamp on" 2 "Reserved" 3 "Lamp  blink & sound remind" ;
VAL_ 849 DrvSBR_Visual 0 "Lamp off" 1 "Lamp on" 2 "Reserved" 3 "Lamp  blink & sound remind" ;
VAL_ 849 SecRowLSBR_Visual 0 "Lamp off" 1 "Lamp on" 2 "Reserved" 3 "Lamp  blink & sound remind" ;
VAL_ 849 SecRowMidSBR_Visual 0 "Lamp off" 1 "Lamp on" 2 "Reserved" 3 "Lamp  blink & sound remind" ;
VAL_ 849 SecRowRSBR_Visual 0 "Lamp off" 1 "Lamp on" 2 "Reserved" 3 "Lamp  blink & sound remind" ;
VAL_ 849 CrashOutputSts 0 "No crash" 1 "Reserved" 2 "Front First level" 3 "rear crash(Reserved)" 4 "Reserved" 7 "Reserved" 8 "Right hand side" 9 "Reserved" 15 "Reserved" 16 "Left hand side" 17 "Rollover(Reserved)" 18 "Static Roll(Reserved)" 19 "Reserved" 255 "Reserved" ;
VAL_ 849 RollingCounter_ABM1 0 "Valid value" 14 "Valid value" 15 "Invalid value" ;
VAL_ 862 RoofModFb 0 "OFF" 1 "ON" ;
VAL_ 862 AllTerrainDislFb 0 "OFF" 1 "ON" ;
VAL_ 862 ElecSideStepSysFb 0 "OFF" 1 "ON" ;
VAL_ 871 DomeLmpDlyTimSet 0 "3seconds" 1 "10seconds" 2 "20seconds" 3 "30seconds" 4 "Reserved" 7 "Reserved" ;
VAL_ 871 FolwMeHomeDlyTimSet 0 "0seconds" 1 "30seconds" 2 "60seconds" 3 "90seconds" 4 "Reserved" 7 "Reserved" ;
VAL_ 871 TranPMode_Req 0 "Transport Mode OFF" 1 "Transport Mode ON" ;
VAL_ 871 RearviewFoldModSet 0 "Automatical" 1 "Manual" ;
VAL_ 871 BattSaveDelayTimeSet 0 "2minutes" 1 "5minutes" 2 "8minutes" 3 "Reserved" ;
VAL_ 871 ACDualReq_TC 0 "No action" 1 "Pressed" 2 "Reserved" 3 "Reserved" ;
VAL_ 871 ACAutoModReq_TC 0 "No action" 1 "Pressed" 2 "Reserved" 3 "Reserved" ;
VAL_ 871 ACAirInletReq_TC 0 "No action" 1 "Pressed" 2 "OneButtonCloseWindows" 3 "Reserved" ;
VAL_ 871 ACFrntHMIDis_TC 0 "No action" 1 "Pressed" ;
VAL_ 871 ACRearHMIDis_TC 0 "No action" 1 "Pressed" ;
VAL_ 871 ACAQSReq_TC 0 "No action" 1 "Pressed" 2 "Reserved" 3 "Reserved" ;
VAL_ 871 ACCmprReq_TC 0 "No action" 1 "Pressed" 2 "Reserved" 3 "Reserved" ;
VAL_ 871 ACFrntDefrstReq_TC 0 "No action" 1 "Pressed" 2 "Reserved" 3 "Reserved" ;
VAL_ 871 ACFrntBlwrSpdDecReq_TC 0 "No action" 1 "Pressed" 2 "Reserved" 3 "Reserved" ;
VAL_ 871 ACRearBlwrSpdDecReq_TC 0 "No action" 1 "Pressed" ;
VAL_ 871 ACRearBlwrSpdIncReq_TC 0 "No action" 1 "Pressed" ;
VAL_ 871 DrvDrowsnsDetnSet 0 "OFF" 1 "ON" ;
VAL_ 871 ACFrntBlwrSpdIncReq_TC 0 "No action" 1 "Pressed" 2 "Reserved" 3 "Reserved" ;
VAL_ 871 ACDrvAirDistribModReq_TC 0 "No action" 1 "Face" 2 "Face & Foot" 3 "Foot" 4 "Foot & Defrost" 5 "Reserved" 7 "Reserved" ;
VAL_ 871 ACDrvTempDecReq_TC 0 "No action" 1 "Pressed" 2 "Reserved" 3 "Reserved" ;
VAL_ 871 ChairMemPosnEna 0 "Disable" 1 "Enable" ;
VAL_ 871 ACDrvTempIncReq_TC 0 "No action" 1 "Pressed" 2 "Reserved" 3 "Reserved" ;
VAL_ 871 ACFrntPassTempDecReq_TC 0 "No action" 1 "Pressed" 2 "Reserved" 3 "Reserved" ;
VAL_ 871 ACFrntPassTempIncReq_TC 0 "No action" 1 "Pressed" 2 "Reserved" 3 "Reserved" ;
VAL_ 871 ACAIUReq_TC 0 "No action" 1 "Pressed" ;
VAL_ 871 ACOffReq_TC 0 "No action" 1 "Pressed" 2 "Reserved" 3 "Reserved" ;
VAL_ 871 ACBlwrsteplsSpdReq_TC 0 "No Command" 1 "Stepless Speed1_Low" 2 "Stepless Speed2" 3 "Stepless Speed3" 4 "Stepless Speed4" 5 "Stepless Speed5" 6 "Stepless Speed6" 7 "Stepless Speed7_High" 8 "Reserved" 15 "Reserved" ;
VAL_ 871 ACZoneReq_TC 0 "No action" 1 "Pressed" ;
VAL_ 873 RearWinHeatCmd_TC 0 "No action" 1 "Pressed" 2 "Reserved" 3 "Reserved" ;
VAL_ 873 AMP_MediaCallSourceSet 0 "Media Source on" 1 "Call Source on" 2 "Reserved" 15 "Reserved" ;
VAL_ 873 AMP_NaviSourceSet 0 "None" 1 "Navi on" 2 "VR & TTS on" 3 "Reserved" 7 "Reserved" ;
VAL_ 873 AMP_BeepSourceSet 0 "None" 1 "Beep on" 2 "IP on" 3 "IP turn light on" 4 "Radar alarm on" 5 "Reserved" 7 "Reserved" ;
VAL_ 873 AMP_LRAudioBalanceSet 0 "Lch+10-Lch+1" 9 "Lch+10-Lch+1" 10 "Center" 11 "Rch+1-Rch+10" 20 "Rch+1-Rch+10" 21 "Reserved" 31 "Reserved" ;
VAL_ 873 AMP_AudioVolVSCModReq 0 "OFF" 1 "Low" 2 "Middle" 3 "High" ;
VAL_ 873 AMP_FRAudioFaderSet 0 "Rear+10-Rear+1" 9 "Rear+10-Rear+1" 10 "Center" 11 "Front+1-Front+10" 20 "Front+1-Front+10" 21 "Reserved" 31 "Reserved" ;
VAL_ 873 AMP_LRDrvSideSet 0 "Left" 1 "Right" ;
VAL_ 873 AMP_LowFrqAudioSet 0 "-10" 1 "-9" 2 "-8" 3 "-7" 4 "-6" 5 "-5" 6 "-4" 7 "-3" 8 "-2" 9 "-1" 10 "0" 11 "1" 12 "2" 13 "3" 14 "4" 15 "5" 16 "6" 17 "7" 18 "8" 19 "9" 20 "10" 21 "Reserved" 31 "Reserved" ;
VAL_ 873 AMP_MuteSet 0 "Unmute" 1 "Mute" ;
VAL_ 873 AMP_MidFrqAudioSet 0 "-10" 1 "-9" 2 "-8" 3 "-7" 4 "-6" 5 "-5" 6 "-4" 7 "-3" 8 "-2" 9 "-1" 10 "0" 11 "1" 12 "2" 13 "3" 14 "4" 15 "5" 16 "6" 17 "7" 18 "8" 19 "9" 20 "10" 21 "Reserved" 31 "Reserved" ;
VAL_ 873 AMP_HighFrqAudioSet 0 "-10" 1 "-9" 2 "-8" 3 "-7" 4 "-6" 5 "-5" 6 "-4" 7 "-3" 8 "-2" 9 "-1" 10 "0" 11 "1" 12 "2" 13 "3" 14 "4" 15 "5" 16 "6" 17 "7" 18 "8" 19 "9" 20 "10" 21 "Reserved" 31 "Reserved" ;
VAL_ 873 T_box_ECallSet 0 "OFF" 1 "ON" ;
VAL_ 873 QLISurroundSet 0 "Stereo" 1 "QLI Surround" ;
VAL_ 873 ANCSwtSet 0 "OFF" 1 "ON" ;
VAL_ 873 FrntWinHeatSwt 0 "No action" 1 "Pressed" ;
VAL_ 875 AMP_HFMVolSet 0 "HFM volume step 0-39" 39 "HFM volume step 0-39" 40 "Reserved" 62 "Reserved" 63 "Invalid Value" ;
VAL_ 875 AMP_TTSVolSet_VR 0 "VR_TTS volume step 0-39" 39 "VR_TTS volume step 0-39" 40 "Reserved" 62 "Reserved" 63 "Invalid Value" ;
VAL_ 875 AMP_NaviVolSet 0 "Navi volume step 0-39" 39 "Navi volume step 0-39" 40 "Reserved" 62 "Reserved" 63 "Invalid Value" ;
VAL_ 875 AMP_MainVolSet 0 "Main volume step 0-39" 39 "Main volume step 0-39" 40 "Reserved" 62 "Reserved" 63 "Invalid Value" ;
VAL_ 875 AMP_GetSWInfoReq 0 "No action" 1 "Get information" ;
VAL_ 875 AMP_GetHWInfoReq 0 "No action" 1 "Get information" ;
VAL_ 875 AMP_GetTempInfoReq 0 "No action" 1 "Get information" ;
VAL_ 875 AMP_GetIntVoltInfoReq 0 "No action" 1 "Get information" ;
VAL_ 875 AMP_GetDTCInfoReq 0 "No action" 1 "Get information" ;
VAL_ 875 IESS_MdlSwtReq 0 "OFF" 1 "Model 1" 2 "Model 2" 3 "Model 3" ;
VAL_ 875 IESS_MdlInfoReq 0 "No action" 1 "Get information" ;
VAL_ 875 AMP_BestListegPosnReq 0 "All Seat" 1 "Front Seat" 2 "Rear Seat" 3 "Driver Seat" 4 "Boss Seat" 5 "Children sleep Seat" 6 "reserved" 7 "reserved" ;
VAL_ 875 AMP_Clari_FiReq 0 "OFF" 1 "ON" ;
VAL_ 877 DrvSeatVentnLvlSet 0 "OFF" 1 "Level 1_Low" 2 "Level 2_Middle" 3 "Level 3_High" ;
VAL_ 877 PassSeatVentnLvlSet 0 "OFF" 1 "Level 1_Low" 2 "Level 2_Middle" 3 "Level 3_High" ;
VAL_ 877 ACAutoModReq_VR 0 "No action" 1 "Not active_reserved" 2 "Active" 3 "Reserved" ;
VAL_ 877 ACCmprReq_VR 0 "No action" 1 "Not active" 2 "Active" 3 "Reserved" ;
VAL_ 877 ACPowerReq_VR 0 "No action" 1 "Power off" 2 "Power on" 3 "Reserved" ;
VAL_ 877 ACBlwrSpdReq_VR 0 "No Command" 1 "Stepless Speed1_Low" 2 "Stepless Speed2" 3 "Stepless Speed3" 4 "Stepless Speed4" 5 "Stepless Speed5" 6 "Stepless Speed6" 7 "Stepless Speed7_High" 8 "Reserved" 15 "Reserved" ;
VAL_ 877 ACDrvTempReq_VR 0 "No action" 1 "Low" 2 "valid value(phys=0.5 * raw + 15.5)" 32 "valid value(phys=0.5 * raw + 15.5)" 33 "High" 34 "Reserved" 63 "Reserved" ;
VAL_ 877 ACFrntDefrostReq_VR 0 "No action" 1 "Not active" 2 "Active" 3 "Reserved" ;
VAL_ 877 ACDrvAirDistribModReq_VR 0 "No action" 1 "Face" 2 "Face & Foot" 3 "Foot" 4 "Foot & Defrost" 5 "Reserved" 7 "Reserved" ;
VAL_ 877 ACAirInletReq_VR 0 "no action" 1 "Fresh" 2 "Recirculation" 3 "Reserved" ;
VAL_ 877 ACModReq_HUT 0 "no action" 1 "comfort" 2 "economy" 3 "reserved" ;
VAL_ 877 ElecSideSteppingSysSet 0 "OFF" 1 "ON" ;
VAL_ 877 RoofModSet 0 "OFF" 1 "ON" ;
VAL_ 877 AllTerrainDislSet 0 "OFF" 1 "ON" ;
VAL_ 877 RemUpgrdSts 0 "NO action" 1 "End the Remote upgrade mode" ;
VAL_ 877 ACRearAutoModReq_TC 0 "No action" 1 "Pressed" ;
VAL_ 877 DrvSeatSupportLvlSet 0 "OFF" 1 "Level 1" 2 "Level 2" 3 "Level 3" 4 "Level 4" 5 "Level 5" 6 "Level adjust fail" 7 "Reserved" ;
VAL_ 877 PassSeatSupportLvlSet 0 "OFF" 1 "Level 1" 2 "Level 2" 3 "Level 3" 4 "Level 4" 5 "Level 5" 6 "Level adjust fail" 7 "Reserved" ;
VAL_ 877 ACRearOffReq_TC 0 "No action" 1 "Pressed" ;
VAL_ 877 ACRearAirDistribModReq_TC 0 "No action" 1 "Face" 2 "Face & Foot" 3 "Foot" 4 "Reserved" 7 "Reserved" ;
VAL_ 877 RLSeatVentnLvlSet 0 "OFF" 1 "Level 1_Low" 2 "Level 2_Middle" 3 "Level 3_High" ;
VAL_ 877 RRSeatVentnLvlSet 0 "OFF" 1 "Level 1_Low" 2 "Level 2_Middle" 3 "Level 3_High" ;
VAL_ 877 DrvSeatHeatgLvlSet 0 "OFF" 1 "Level 1_Low" 2 "Level 2_Middle" 3 "Level 3_High" ;
VAL_ 877 PassSeatHeatgLvlSet 0 "OFF" 1 "Level 1_Low" 2 "Level 2_Middle" 3 "Level 3_High" ;
VAL_ 880 TimeMod 0 "24" 1 "12" ;
VAL_ 880 TimeIndcn 0 "am" 1 "pm" ;
VAL_ 880 Time_Hour 0 "Valid hour" 23 "Valid hour" 24 "Reserved" 30 "Reserved" 31 "Invalid" ;
VAL_ 880 Time_Minutes 0 "Valid minute" 59 "Valid minute" 60 "Reserved" 62 "Reserved" 63 "Invalid" ;
VAL_ 880 Time_Second 0 "Valid second" 59 "Valid second" 60 "Reserved" 62 "Reserved" 63 "Invalid" ;
VAL_ 880 Time_Year_Left 0 "Valid year" 9 "Valid year" 10 "Reserved" 14 "Reserved" 15 "Invalid" ;
VAL_ 880 Time_Year_Right 0 "Valid year" 9 "Valid year" 10 "Reserved" 14 "Reserved" 15 "Invalid" ;
VAL_ 880 Time_Month 0 "Invalid" 1 "Valid month" 12 "Valid month" 13 "Reserved" 15 "Reserved" ;
VAL_ 880 Time_Day 0 "Invalid" 1 "Valid day" 31 "Valid day" ;
VAL_ 880 HUT_TgtSOCSet 0 "Valid value" 50 "Valid value" 51 "Invalid" 52 "Extremely comfortable" 53 "Outdoor camping" 54 "Reserve" 63 "Reserve" ;
VAL_ 881 BaroPressure 0 "Valid values" 254 "Valid values" 255 "Invalid value" ;
VAL_ 881 EngCoolantTemp 0 "Valid values" 255 "Valid values" ;
VAL_ 881 GPF_Warning 0 "No Warning" 1 "GPF is regenerating" 2 "GPF need to regenerate" 3 "Reserved" ;
VAL_ 881 GentrWarnLmpSts 0 "Off" 1 "On" ;
VAL_ 881 EngClntTempWarn 0 "No" 1 "Yes" ;
VAL_ 881 EngClntTempVldty 0 "Invalid" 1 "Valid" 2 "Init value" 3 "Reserved" ;
VAL_ 881 SS_Screen_tip 0 "no screen tip" 1 "screen tip" ;
VAL_ 881 SSSSetSts 0 "Off" 1 "On" ;
VAL_ 881 SS_Enable_Lamp 0 "Lamp off" 1 "Lamp on" ;
VAL_ 881 SS_Fault_Lamp 0 "Lamp off" 1 "Lamp on" ;
VAL_ 881 MaxEngTrqNorm 0 "Valid values" 130 "Valid values" 131 "Rserved" 255 "Rserved" ;
VAL_ 881 AGS_Failure 0 "No Failure" 1 "Failure" ;
VAL_ 901 ACFrntDefrstSts 0 "Off" 1 "On" ;
VAL_ 901 ACHMIDispCmd 0 "No Display" 1 "No DisplayÃ¯Â¼ÂˆAC status changed in Auto modeÃ¯Â¼Â‰" 2 "Display" 3 "Reserved" ;
VAL_ 901 ACFrntBlwrSpd 0 "Off" 1 "Level 1Ã¯Â¼ÂˆLowÃ¯Â¼Â‰-7Ã¯Â¼ÂˆHiÃ¯Â¼Â‰" 7 "Level 1Ã¯Â¼ÂˆLowÃ¯Â¼Â‰-7Ã¯Â¼ÂˆHiÃ¯Â¼Â‰" 8 "Reserved" 13 "Reserved" 14 "Auto blower level" 15 "Initial value" ;
VAL_ 901 ACOpenSts 0 "Off" 1 "On" ;
VAL_ 901 ACDualModEnaSts 0 "Disable" 1 "Enable" ;
VAL_ 901 ACDrvTemp_ATC 0 "Low" 1 "Valid value" 31 "Valid value" 32 "High" 33 "Initial value" 34 "Reserved" 63 "Reserved" ;
VAL_ 901 ACAmbTemp 0 "Valid value" 253 "Valid value" 254 "Initial value" 255 "Invalid Value" ;
VAL_ 901 ACAirInletSts 0 "Recirculation" 1 "Fresh" 2 "Auto" 3 "Initial value" ;
VAL_ 901 ACFrntPasstTemp_ATC 0 "Low" 1 "Valid value" 31 "Valid value" 32 "High" 33 "Initial value" 34 "Reserved" 63 "Reserved" ;
VAL_ 901 ACAutoModEnaSts 0 "Disable" 1 "Enable" ;
VAL_ 901 ACCmprEnaSts 0 "Disable" 1 "Enable" ;
VAL_ 901 ACRearWinHeatSts 0 "Off" 1 "On" ;
VAL_ 901 ACAutoDefrstModEnaSts 0 "Disable" 1 "Enable" ;
VAL_ 917 FLTirePress 0 "Valid Value" 254 "Valid Value" 255 "Invalid Value" ;
VAL_ 917 FLTireTemp 0 "Valid Value" 254 "Valid Value" 255 "Invalid Value" ;
VAL_ 917 FRTirePress 0 "Valid Value" 254 "Valid Value" 255 "Invalid Value" ;
VAL_ 917 FRTireTemp 0 "Valid Value" 254 "Valid Value" 255 "Invalid Value" ;
VAL_ 917 RLTirePress 0 "Valid Value" 254 "Valid Value" 255 "Invalid Value" ;
VAL_ 917 RLTireTemp 0 "Valid Value" 254 "Valid Value" 255 "Invalid Value" ;
VAL_ 917 RRTirePress 0 "Valid Value" 254 "Valid Value" 255 "Invalid Value" ;
VAL_ 917 RRTireTemp 0 "Valid Value" 254 "Valid Value" 255 "Invalid Value" ;
VAL_ 943 WeatherCdn 0 "None Display" 1 "icon 100 SunnyClear" 2 "icon 101 Cloudy" 3 "icon 102 Few Clouds" 4 "icon 103 Partly Cloudy" 5 "icon 104 Overcast" 6 "icon 200 Windy" 7 "icon 201 Calm" 8 "icon 202 Light Breeze" 9 "icon 203 ModerateGentle Breeze" 10 "icon 204 Fresh Breeze" 11 "icon 205 Strong Breeze" 12 "icon 206 High Wind, Near Gale" 13 "icon 207 Gale" 14 "icon 208 Strong Gale" 15 "icon 209 Storm" 16 "icon 210 Violent Storm" 17 "icon 211 Hurricane" 18 "icon 212 Tornado" 19 "icon 213 Tropical Storm" 20 "icon 300 Shower Rain" 21 "icon 301 Heavy Shower Rain" 22 "icon 302 Thundershower" 23 "icon 303 Heavy Thunderstorm" 24 "icon 304 Thundershower with hail" 25 "icon 305 Light Rain" 26 "icon 306 Moderate Rain" 27 "icon 307 Heavy Rain" 28 "icon 308 Extreme Rain" 29 "icon 309 Drizzle Rain" 31 "icon 310 Storm" 32 "icon 311 Heavy Storm" 33 "icon 312 Severe Storm" 34 "icon 313 Freezing Rain" 35 "icon 314 Light to moderate rain" 36 "icon 315 Moderate to heavy rain" 37 "icon 316 Heavy rain to storm" 38 "icon 317 Storm to heavy storm" 39 "icon 318 Heavy to severe storm" 40 "icon 399 Rain" 41 "icon 400 Light Snow" 42 "icon 401 Moderate Snow" 43 "icon 402 Heavy Snow" 44 "icon 403 Snowstorm" 45 "icon 404 Sleet" 46 "icon 405 Rain And Snow" 47 "icon 406 Shower Snow" 48 "icon 407 Snow Flurry" 49 "icon 408 Light to moderate snow" 50 "icon 409 Moderate to heavy snow" 51 "icon 410 Heavy snow to snowstorm" 52 "icon 499 Snow" 53 "icon 500 Mist" 54 "icon 501 Foggy" 55 "icon 502 Haze" 56 "icon 503 Sand" 57 "icon 504 Dust" 58 "icon 507 Duststorm" 59 "icon 508 Sandstorm" 60 "icon 509 Dense fog" 61 "icon 510 Strong fog" 62 "icon 511 Moderate haze" 63 "icon 512 Heavy haze" 64 "icon 513 Severe haze" 65 "icon 514 Heavy fog" 66 "icon 515 Extra heavy fog" 67 "icon 900 Hot" 68 "icon 901 Cold" 69 "icon 999 Unknown" 70 "Reserved" 127 "Reserved" ;
VAL_ 943 PitchAng 0 "Valid Value" 90 "Valid Value" 91 "Reserved" 127 "Reserved" ;
VAL_ 943 PitchAngSign 0 "Uphill(Positive)" 1 "Downhil(Negative)" ;
VAL_ 951 ECM_VehDstBackup 0 "0-9999999-km" 9999999 "0-9999999-km" 10000000 "Reserved" 16777214 "Reserved" 16777215 "Invalid" ;
VAL_ 962 HCU_RecupPwr 0 "Valid value" 1023 "Valid value" ;
VAL_ 962 HCU_HiVoltInterlockSts_RM 0 "Normal" 1 "Warning" ;
VAL_ 962 HCU_EVContnsDistance 0 "Vaild value" 254 "Vaild value" 255 "Invalid" ;
VAL_ 962 HCU_EVContnsDistanceVld 0 "Invalid" 1 "Valid" ;
VAL_ 962 HCU_EgyUsed 0 "Valid value" 1023 "Valid value" ;
VAL_ 993 AMP_Chan1DTCInfo 0 "No error in this channel" 1 "Short to groundshort to ACC open load error" ;
VAL_ 993 AMP_Chan2DTCInfo 0 "No error in this channel" 1 "Short to groundshort to ACC open load error" ;
VAL_ 993 AMP_Chan3DTCInfo 0 "No error in this channel" 1 "Short to groundshort to ACC open load error" ;
VAL_ 993 AMP_Chan4DTCInfo 0 "No error in this channel" 1 "Short to groundshort to ACC open load error" ;
VAL_ 993 AMP_Chan5DTCInfo 0 "No error in this channel" 1 "Short to groundshort to ACC open load error" ;
VAL_ 993 AMP_Chan6DTCInfo 0 "No error in this channel" 1 "Short to groundshort to ACC open load error" ;
VAL_ 993 AMP_Chan7DTCInfo 0 "No error in this channel" 1 "Short to groundshort to ACC open load error" ;
VAL_ 993 AMP_Chan8DTCInfo 0 "No error in this channel" 1 "Short to groundshort to ACC open load error" ;
VAL_ 993 AMP_TempValue 0 "Amplifier internal temperature value" 254 "Amplifier internal temperature value" 255 "Invalid value" ;
VAL_ 993 AMP_TempSts 0 "Temperature normal" 1 "Temperature value lower than working temperature" 2 "Temperature value higher than working temperature" 3 "Invalid temperature value" ;
VAL_ 993 AMP_VolValue 0 "Amplifier internal voltage value" 254 "Amplifier internal voltage value" 255 "Invalid value" ;
VAL_ 993 BestListegPosnResp 0 "All Seat" 1 "Front Seat" 2 "Rear Seat" 3 "Driver Seat" 4 "Boss Seat" 5 "Children sleep Seat" 6 "reserved" 7 "reserved" ;
VAL_ 993 Clari_FiResp 0 "OFF" 1 "ON" ;
VAL_ 995 MediaCallSourceState 0 "Media Source on" 1 "Call Source on" 2 "Reserved-CH I CH IIÃ©Â€ÂšÃ©ÂÂ“" 15 "Reserved-CH I CH IIÃ©Â€ÂšÃ©ÂÂ“" ;
VAL_ 995 BeepSourceSts 0 "None" 1 "Beep on" 2 "IP on" 3 "IP turn light on" 4 "Radar alarm on" 5 "Reserved CH III" 7 "Reserved CH III" ;
VAL_ 995 BalanceSetState 0 "Lch+10 - Lch+1" 9 "Lch+10 - Lch+1" 10 "Center" 11 "Rch+1 - Rch+10" 20 "Rch+1 - Rch+10" 21 "Reserved" 31 "Reserved" ;
VAL_ 995 VSCModeState 0 "OFF" 1 "LOW" 2 "MID" 3 "HI" ;
VAL_ 995 FadeSetState 0 "Rear+10 - Rear+1" 9 "Rear+10 - Rear+1" 10 "Center" 11 "Front+1 - Front+10" 20 "Front+1 - Front+10" 21 "Reserved" 31 "Reserved" ;
VAL_ 995 DriveSideSts 0 "LHD" 1 "RHD" ;
VAL_ 995 BassSetState 0 "-10 - -1" 9 "-10 - -1" 10 "0" 11 "+1 - +10" 20 "+1 - +10" 21 "Reserved" 31 "Reserved" ;
VAL_ 995 MuteState 0 "Unmute" 1 "Mute" ;
VAL_ 995 NaviSourceState 0 "None" 1 "Navi on" 2 "VRTTS on" 3 "Reserved-CH IV" 7 "Reserved-CH IV" ;
VAL_ 995 MidrangeSetState 0 "-10" 1 "-9" 2 "-8" 3 "-7" 4 "-6" 5 "-5" 6 "-4" 7 "-3" 8 "-2" 9 "-1" 10 "0" 11 "1" 12 "2" 13 "3" 14 "4" 15 "5" 16 "6" 17 "7" 18 "8" 19 "9" 20 "10" 21 "Reserved" 31 "Reserved" ;
VAL_ 995 T_box_ECallSts 0 "OFF" 1 "ON" ;
VAL_ 995 GetHUTInfoSts 0 "No action" 1 "Action" ;
VAL_ 995 TrebleSetState 0 "-10" 1 "-9" 2 "-8" 3 "-7" 4 "-6" 5 "-5" 6 "-4" 7 "-3" 8 "-2" 9 "-1" 10 "0" 11 "1" 12 "2" 13 "3" 14 "4" 15 "5" 16 "6" 17 "7" 18 "8" 19 "9" 20 "10" 21 "Reserved" 31 "Reserved" ;
VAL_ 995 QLISurroundSetSt 0 "Stereo" 1 "Surround" ;
VAL_ 995 AVMStResp 0 "OFF" 1 "ON" ;
VAL_ 995 NaviMediaVolLvlResp 0 "Main audio attenuation Level 0" 1 "Main audio attenuation Level 1" 2 "Main audio attenuation Level 2" 3 "Main audio attenuation Level 3" 4 "Main audio attenuation Level 4" 5 "Main audio attenuation Level 5" 6 "Main audio attenuation Level 6" 7 "Main audio attenuation Level 7" 8 "Main audio attenuation Level 8" 9 "Main audio attenuation Level 9" 10 "Main audio attenuation Level 10" 11 "Invalid" 15 "Invalid" ;
VAL_ 995 AVMMediaVolLvlResp 0 "Main audio attenuation Level 0" 1 "Main audio attenuation Level 1" 2 "Main audio attenuation Level 2" 3 "Main audio attenuation Level 3" 4 "Main audio attenuation Level 4" 5 "Main audio attenuation Level 5" 6 "Main audio attenuation Level 6" 7 "Main audio attenuation Level 7" 8 "Main audio attenuation Level 8" 9 "Main audio attenuation Level 9" 10 "Main audio attenuation Level 10" 11 "Invalid" 15 "Invalid" ;
VAL_ 995 FPASChStResp 0 "OFF" 1 "ON" ;
VAL_ 995 RPASChStResp 0 "OFF" 1 "ON" ;
VAL_ 997 HFMVolSetSts 0 "HFMRTTbox-I&B Call volume step 0-39" 39 "HFMRTTbox-I&B Call volume step 0-39" 40 "Reserved" 62 "Reserved" 63 "Invalid Value" ;
VAL_ 997 VR_TTSVolSetSts 0 "VRTTS volume step 0-39" 39 "VRTTS volume step 0-39" 40 "Reserved" 62 "Reserved" 63 "Invalid Value" ;
VAL_ 997 NaviVolumeSetState 0 "Navi volume step 0-39" 39 "Navi volume step 0-39" 40 "Reserved" 62 "Reserved" 63 "Invalid Value" ;
VAL_ 997 MainVolumeSetState 0 "Main volume step 0-39" 39 "Main volume step 0-39" 40 "Reserved" 62 "Reserved" 63 "Invalid Value" ;
VAL_ 997 AMPPowerSts 0 "OFF" 1 "ON" ;
VAL_ 997 IPVolSetSts 0 "Reserved" 9 "Reserved" 10 "IP volume step 10-20" 20 "IP volume step 10-20" 21 "Reserved" 62 "Reserved" 63 "Invalid Value" ;
VAL_ 1001 T_BOX_SysErrSts 0 "No error" 1 "Error" 2 "Standby Battery Error" 3 "Reserved" 31 "Reserved" ;
VAL_ 1001 T_BOX_SWUpdSts 0 "Idle" 1 "NAD start update" 2 "NAD update inprogress" 3 "NAD update done" 4 "NAD update failed" 5 "MCU start update" 6 "MCU update done" 7 "Reserved" ;
VAL_ 1045 ADAS_Meta_MsgTyp 0 "System Specific" 1 "Position" 2 "Segment" 3 "Stub" 4 "Profile Short" 5 "Profile Long" 6 "Meta-data" 7 "Reserved" ;
VAL_ 1045 ADAS_Meta_MapProvider 0 "Unknown" 1 "Nokia HERE (NAVTEQ)" 2 "TomTom (Tele Atlas)" 3 "Zenrin" 4 "IPC" 5 "NavInfo" 6 "Other" 7 "NA" ;
VAL_ 1045 ADAS_Meta_CountryCode 0 "Unknown" 1 "Valid values" 1023 "Valid values" ;
VAL_ 1045 ADAS_Meta_CycCnt 0 "Valid values" 3 "Valid values" ;
VAL_ 1045 ADAS_Meta_ProtVer_Major 0 "Valid values" 3 "Valid values" ;
VAL_ 1045 ADAS_Meta_ProtVer_MinorSub 0 "Valid values" 7 "Valid values" ;
VAL_ 1045 ADAS_Meta_HwVer 0 "Unknown" 1 "Valid values" 511 "Valid values" ;
VAL_ 1045 ADAS_Meta_DrvSide 0 "Drvg Side Left" 1 "Drvg Side Right" ;
VAL_ 1045 ADAS_Meta_RegionCode 0 "Unknow" 1 "Valid values" 32766 "Valid values" 32767 "Invalid" ;
VAL_ 1045 ADAS_Meta_MapVerQtr 0 "Valid values" 3 "Valid values" ;
VAL_ 1045 ADAS_Meta_MapVerYear 0 "Valid values" 62 "Valid values" 63 "invalid" ;
VAL_ 1045 ADAS_Meta_SpdUnits 0 "KMH" 1 "MPH" ;
VAL_ 1045 ADAS_Meta_ProtVer_Minor 0 "Valid values" 15 "Valid values" ;
VAL_ 53 PEPS_T_BOXAuth1 -2147483648 "Valid Value" 0 "Valid Value" ;
VAL_ 96 HCU_BrkPedalSts 0 "not pressed" 1 "pressed" 2 "reserved" 3 "error" ;
VAL_ 96 HCU_BrkPedalStsValid 0 "Invalid value" 1 "Valid value" ;
VAL_ 96 HCU_AccelPedalPosn_Diag 0 "Vaild value" 255 "Vaild value" ;
VAL_ 96 HCU_AccelPedalPosn_DiagValid 0 "Invaild" 1 "Vaild" ;
VAL_ 96 HCU_PowertrainSts_0x60 0 "Sleep" 1 "Initialize Mode" 2 "power up" 3 "power down" 4 "Home" 5 "run" 6 "Charging" 7 "Cellphone AC" 8 "Limphome" 9 "Emergency Mode" 10 "V2L" 11 "Prepare Sleep" 12 "ready" 13 "LV Charging" 14 "LT Charging" 15 "IL heating" 16 "Thermal run away" 17 "End of line" 18 "BattTempKeep" 19 "Reserved" 31 "Reserved" ;
VAL_ 96 HCU_RaceLaunchSts_0x60 0 "Not active" 1 "Active" 2 "Timeout protection" 3 "Reserved" 7 "Reserved" ;
VAL_ 96 HCU_RaceLaunchAvail_0x60 0 "Race Launch is available" 1 "Race Launch is not available due to ESP is not OFF" 2 "Race Launch is not available due to temporary hybrid system limitations" 3 "Reserved" ;
VAL_ 96 HCU_AccelPedalPosn 0 "Vaild value" 255 "Vaild value" ;
VAL_ 96 HCU_AccelPedalPosnValid 0 "Invalid value" 1 "Valid value" ;
VAL_ 96 HCU_CruiseCtrlSts 0 "OFF" 1 "Stand by" 2 "Cruise" 3 "Acceleration" 4 "Deceleration" 5 "Tip up" 6 "Tip dwon" 7 "Resume from above vehicle speed" 8 "Resume from below vehicle speed" 9 "Error" 10 "Reserved" 15 "Reserved" ;
VAL_ 96 HCU_TgtCrsVehSpd 0 "Valid values" 255 "Valid values" ;
VAL_ 96 HCU_TgtCrsVehSpdvalid 0 "Invalid values" 1 "Valid values" ;
VAL_ 142 EngTrqCrankshaftLvl 0 "Valid values" 4095 "Valid values" ;
VAL_ 142 EngTrqCrankshaftLvlValid 0 "Invalid value" 1 "Valid value" ;
VAL_ 172 P2M_ActTrq 0 "Valid value" 16381 "Valid value" 16382 "Init" 16383 "Invalid" ;
VAL_ 190 P2M_ActSpd 0 "Valid value" 12286 "Valid value" 12287 "Invalid" 65535 "Invalid" ;
VAL_ 190 P2M_ActHvDcVolt 0 "Valid value" 4093 "Valid value" 4094 "Init" 4095 "Invalid" ;
VAL_ 249 HCU_TrqLimMax_Norm 0 "Valid values" 400 "Valid values" 401 "Reserved" 511 "Reserved" ;
VAL_ 279 EngState_PHEV 0 "Stand by" 1 "Ready" 2 "Cranking" 3 "Running" 4 "Stopping" 5 "Finish" 6 "Autostopping" 7 "Reserved" ;
VAL_ 279 CruiseCtrlSts_PHEV 0 "OFF" 1 "Stand by" 2 "Cruise" 3 "Acceleration" 4 "Deceleration" 5 "Tip up" 6 "Tip dwon" 7 "Resume from above vehicle speed" 8 "Resume from below vehicle speed" 9 "Error" 10 "Reserved" 15 "Reserved" ;
VAL_ 282 HCU_GearSts 0 "Select lever in position 'P'" 1 "Reserved" 2 "Reserved" 3 "Reserved" 4 "Reserved" 5 "Select lever in position 'D'" 6 "Select lever in position 'N'" 7 "Select lever in position 'R'" 8 "Reserved" 13 "Reserved" 14 "Intermediate position" 15 "Invalid" ;
VAL_ 282 HCU_HybMod 0 "HEV" 1 "EV" 2 "SAVE" 3 "Reserve" ;
VAL_ 282 HCU_HybFctnMod 0 "OFF" 1 "SAVE" 2 "SPORT+" 3 "Reserve" ;
VAL_ 301 EB_AEBIBActv 0 "Not active" 1 "Active" ;
VAL_ 301 EB_AEBBAActv 0 "Not active" 1 "Active" ;
VAL_ 301 EB_AEBAvailable 0 "Unusable" 1 "Usable" ;
VAL_ 301 EB_TgtRcprtnTrqSts 0 "Not Initialized" 1 "Normal" 2 "Faulty" 3 "Reserved" ;
VAL_ 330 HCUImmoAuthRes 0 "Idle" 1 "Passed" 2 "Failed" 3 "Invalid" ;
VAL_ 330 HCU_EVLmpSts 0 "Not active" 1 "Active" ;
VAL_ 330 HCU_ECODrvHabit_Indcn 0 "Valid values" 200 "Valid values" 201 "Reversed" 255 "Reversed" ;
VAL_ 330 HCU_TotDrvReqPower_0x14a 0 "Valid values-Power percentage ValueÃ¯Â¼Âˆ-100-0-100Ã¯Â¼Â‰" 200 "Valid values-Power percentage ValueÃ¯Â¼Âˆ-100-0-100Ã¯Â¼Â‰" 201 "invalid values" 255 "invalid values" ;
VAL_ 330 HCU_AvailPower_TM 0 "Valid values" 200 "Valid values" 201 "invalid value" 255 "invalid value" ;
VAL_ 330 HCU_DrvMod 0 "Normal Mode started" 1 "EV Mode started" 2 "Save Mode started" 3 "SPORT Mode started" 4 "AWD Normal Mode started" 5 "Snow Mode started" 6 "Muddy Mode started" 7 "Sand Mode started" 8 "ECO" 9 "Sport plus mode stared" 10 "AUTO Mode started" 11 "Individual" 12 "Reserved" 15 "Reserved" ;
VAL_ 448 HCU_ChrgSysLmpSts 0 "OFF" 1 "Green Light ON" 2 "Red Light ON" 3 "Yellow Light with slanting line" 4 "Red Light with slanting line" 5 "Reserved" 7 "Reserved" ;
VAL_ 448 HCU_ChrgSysErr_1 0 "Not indicate" 1 "Indicate" ;
VAL_ 448 HCU_ChrgSysErr_2 0 "Not indicate" 1 "Indicate" ;
VAL_ 448 HCU_ChrgSysErr_3 0 "Not indicate" 1 "Indicate" ;
VAL_ 448 HCU_ChrgSysErr_4 0 "Not indicate" 1 "Indicate" ;
VAL_ 448 HCU_ChrgSysErr_5 0 "Not indicate" 1 "Indicate" ;
VAL_ 448 HCU_ChrgSysErr_6 0 "Not indicate" 1 "Indicate" ;
VAL_ 448 HCU_ChrgSysErr_7 0 "Not indicate" 1 "Indicate" ;
VAL_ 448 HCU_ChrgSysErr_8 0 "Not indicate" 1 "Indicate" ;
VAL_ 448 HCU_DrvModDisp 0 "AutoNormal Mode started" 1 "EV Mode started" 2 "Save Mode started" 3 "SPORT Mode started" 4 "AWD Normal Mode started" 5 "Snow Mode started" 6 "Muddy Mode started" 7 "Sand Mode started" 8 "ECO" 9 "SPORT Plus Mode started" 10 "Reserved" 15 "Reserved" ;
SIG_GROUP_ 816 HCM_R2 1 : Checksum_HCM_R2 RightLightShowSts FRMusicLightShowSts RollingCounter_HCM_R2;
SIG_GROUP_ 849 ABM1 1 : CheckSum_ABM1 SecRowLSBR AirbFailLmpCmd SecRowMidSBR DrvSBR SecRowRSBR PassSBR CrashOutputSts SecRowMidSBR_Visual SecRowLSBR_Visual PassSBR_Visual DrvSBR_Visual SecRowRSBR_Visual RollingCounter_ABM1;
