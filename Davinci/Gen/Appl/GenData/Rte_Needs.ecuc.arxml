AUTOSAR XML (schema 4-0-3)
package /DaVinci_Project
  module config Com
    ComConfig
      72 x ComSignal, all with ComSignalType=UINT8_N:
        ABS1_0x231_oABS1_oB30_for_SC_CAN_V3_2_12e0e9e4_Rx: ComNotification=Rte_COMCbk_ABS1_0x231_oABS1_oB30_for_SC_CAN_V3_2_12e0e9e4_Rx, ComTimeoutNotification=Rte_COMCbkRxTOut_ABS1_0x231_oABS1_oB30_for_SC_CAN_V3_2_12e0e9e4_Rx, ComTimeout=0.2
        ABS2_0x246_oABS2_oB30_for_SC_CAN_V3_2_b0714d10_Rx: ComNotification=Rte_COMCbk_ABS2_0x246_oABS2_oB30_for_SC_CAN_V3_2_b0714d10_Rx, ComTimeoutNotification=Rte_COMCbkRxTOut_ABS2_0x246_oABS2_oB30_for_SC_CAN_V3_2_b0714d10_Rx, ComTimeout=0.2
        AC1_0x29D_oAC1_oB30_for_SC_CAN_V3_2_22980340_Rx: ComNotification=Rte_COMCbk_AC1_0x29D_oAC1_oB30_for_SC_CAN_V3_2_22980340_Rx, ComTimeoutNotification=Rte_COMCbkRxTOut_AC1_0x29D_oAC1_oB30_for_SC_CAN_V3_2_22980340_Rx, ComTimeout=1
        AC2_0x385_oAC2_oB30_for_SC_CAN_V3_2_0cf77687_Rx: ComNotification=Rte_COMCbk_AC2_0x385_oAC2_oB30_for_SC_CAN_V3_2_0cf77687_Rx, ComTimeoutNotification=Rte_COMCbkRxTOut_AC2_0x385_oAC2_oB30_for_SC_CAN_V3_2_0cf77687_Rx, ComTimeout=1
        ACC_FD2_0x2AB_oACC_FD2_oB30_for_SC_CAN_V3_2_33ba28b9_Rx: ComNotification=Rte_COMCbk_ACC_FD2_0x2AB_oACC_FD2_oB30_for_SC_CAN_V3_2_33ba28b9_Rx, ComTimeoutNotification=Rte_COMCbkRxTOut_ACC_FD2_0x2AB_oACC_FD2_oB30_for_SC_CAN_V3_2_33ba28b9_Rx, ComTimeout=1
        ACC_FD3_0x2B4_oACC_FD3_oB30_for_SC_CAN_V3_2_adc7888c_Rx: ComNotification=Rte_COMCbk_ACC_FD3_0x2B4_oACC_FD3_oB30_for_SC_CAN_V3_2_adc7888c_Rx, ComTimeoutNotification=Rte_COMCbkRxTOut_ACC_FD3_0x2B4_oACC_FD3_oB30_for_SC_CAN_V3_2_adc7888c_Rx, ComTimeout=1
        AEB_FD2_0x227_oAEB_FD2_oB30_for_SC_CAN_V3_2_b89db7a8_Rx: ComNotification=Rte_COMCbk_AEB_FD2_0x227_oAEB_FD2_oB30_for_SC_CAN_V3_2_b89db7a8_Rx, ComTimeoutNotification=Rte_COMCbkRxTOut_AEB_FD2_0x227_oAEB_FD2_oB30_for_SC_CAN_V3_2_b89db7a8_Rx, ComTimeout=0.5
        AMP2_0x3E3_oAMP2_oB30_for_SC_CAN_V3_2_fcde4f66_Rx: ComNotification=Rte_COMCbk_AMP2_0x3E3_oAMP2_oB30_for_SC_CAN_V3_2_fcde4f66_Rx
        AMP3_0x3E5_oAMP3_oB30_for_SC_CAN_V3_2_cac874de_Rx: ComNotification=Rte_COMCbk_AMP3_0x3E5_oAMP3_oB30_for_SC_CAN_V3_2_cac874de_Rx
        BCM12_0x238_oBCM12_oB30_for_SC_CAN_V3_2_ced434a5_Rx: ComNotification=Rte_COMCbk_BCM12_0x238_oBCM12_oB30_for_SC_CAN_V3_2_ced434a5_Rx, ComTimeoutNotification=Rte_COMCbkRxTOut_BCM12_0x238_oBCM12_oB30_for_SC_CAN_V3_2_ced434a5_Rx, ComTimeout=0.5
        BCM1_0x319_oBCM1_oB30_for_SC_CAN_V3_2_3b9040e0_Rx: ComNotification=Rte_COMCbk_BCM1_0x319_oBCM1_oB30_for_SC_CAN_V3_2_3b9040e0_Rx, ComTimeoutNotification=Rte_COMCbkRxTOut_BCM1_0x319_oBCM1_oB30_for_SC_CAN_V3_2_3b9040e0_Rx, ComTimeout=0.5
        BCM3_0x345_oBCM3_oB30_for_SC_CAN_V3_2_63d58c65_Rx: ComNotification=Rte_COMCbk_BCM3_0x345_oBCM3_oB30_for_SC_CAN_V3_2_63d58c65_Rx, ComTimeoutNotification=Rte_COMCbkRxTOut_BCM3_0x345_oBCM3_oB30_for_SC_CAN_V3_2_63d58c65_Rx, ComTimeout=0.5
        BCM8_0x29F_oBCM8_oB30_for_SC_CAN_V3_2_959fd4c6_Rx: ComNotification=Rte_COMCbk_BCM8_0x29F_oBCM8_oB30_for_SC_CAN_V3_2_959fd4c6_Rx, ComTimeoutNotification=Rte_COMCbkRxTOut_BCM8_0x29F_oBCM8_oB30_for_SC_CAN_V3_2_959fd4c6_Rx, ComTimeout=1
        BMS4_0xF1_oBMS4_oB30_for_SC_CAN_V3_2_ad291777_Rx: ComNotification=Rte_COMCbk_BMS4_0xF1_oBMS4_oB30_for_SC_CAN_V3_2_ad291777_Rx, ComTimeoutNotification=Rte_COMCbkRxTOut_BMS4_0xF1_oBMS4_oB30_for_SC_CAN_V3_2_ad291777_Rx, ComTimeout=0.1
        CSA1_0x165_oCSA1_oB30_for_SC_CAN_V3_2_432419b3_Rx: ComNotification=Rte_COMCbk_CSA1_0x165_oCSA1_oB30_for_SC_CAN_V3_2_432419b3_Rx, ComTimeoutNotification=Rte_COMCbkRxTOut_CSA1_0x165_oCSA1_oB30_for_SC_CAN_V3_2_432419b3_Rx, ComTimeout=0.2
        CSA2_0xA1_oCSA2_oB30_for_SC_CAN_V3_2_7f0f027f_Rx: ComNotification=Rte_COMCbk_CSA2_0xA1_oCSA2_oB30_for_SC_CAN_V3_2_7f0f027f_Rx, ComTimeoutNotification=Rte_COMCbkRxTOut_CSA2_0xA1_oCSA2_oB30_for_SC_CAN_V3_2_7f0f027f_Rx, ComTimeout=0.1
        CSA3_0x244_oCSA3_oB30_for_SC_CAN_V3_2_a76b1812_Rx: ComNotification=Rte_COMCbk_CSA3_0x244_oCSA3_oB30_for_SC_CAN_V3_2_a76b1812_Rx, ComTimeoutNotification=Rte_COMCbkRxTOut_CSA3_0x244_oCSA3_oB30_for_SC_CAN_V3_2_a76b1812_Rx, ComTimeout=0.5
        DCT3_0xA6_oDCT3_oB30_for_SC_CAN_V3_2_f1cd20ee_Rx: ComNotification=Rte_COMCbk_DCT3_0xA6_oDCT3_oB30_for_SC_CAN_V3_2_f1cd20ee_Rx, ComTimeoutNotification=Rte_COMCbkRxTOut_DCT3_0xA6_oDCT3_oB30_for_SC_CAN_V3_2_f1cd20ee_Rx, ComTimeout=0.1
        DCT5_0x221_oDCT5_oB30_for_SC_CAN_V3_2_6e7f38ea_Rx: ComNotification=Rte_COMCbk_DCT5_0x221_oDCT5_oB30_for_SC_CAN_V3_2_6e7f38ea_Rx, ComTimeoutNotification=Rte_COMCbkRxTOut_DCT5_0x221_oDCT5_oB30_for_SC_CAN_V3_2_6e7f38ea_Rx, ComTimeout=0.2
        DDCM1_0x2CA_oDDCM1_oB30_for_SC_CAN_V3_2_0a1045c1_Rx: ComNotification=Rte_COMCbk_DDCM1_0x2CA_oDDCM1_oB30_for_SC_CAN_V3_2_0a1045c1_Rx, ComTimeoutNotification=Rte_COMCbkRxTOut_DDCM1_0x2CA_oDDCM1_oB30_for_SC_CAN_V3_2_0a1045c1_Rx, ComTimeout=1
        DSM1_0x2C1_oDSM1_oB30_for_SC_CAN_V3_2_abfa59d6_Rx: ComNotification=Rte_COMCbk_DSM1_0x2C1_oDSM1_oB30_for_SC_CAN_V3_2_abfa59d6_Rx, ComTimeoutNotification=Rte_COMCbkRxTOut_DSM1_0x2C1_oDSM1_oB30_for_SC_CAN_V3_2_abfa59d6_Rx, ComTimeout=1
        ECM11_0x2D3_oECM11_oB30_for_SC_CAN_V3_2_a1715d7d_Rx: ComNotification=Rte_COMCbk_ECM11_0x2D3_oECM11_oB30_for_SC_CAN_V3_2_a1715d7d_Rx, ComTimeoutNotification=Rte_COMCbkRxTOut_ECM11_0x2D3_oECM11_oB30_for_SC_CAN_V3_2_a1715d7d_Rx, ComTimeout=1
        ECM1_0x111_oECM1_oB30_for_SC_CAN_V3_2_b49cfb6f_Rx: ComNotification=Rte_COMCbk_ECM1_0x111_oECM1_oB30_for_SC_CAN_V3_2_b49cfb6f_Rx, ComTimeoutNotification=Rte_COMCbkRxTOut_ECM1_0x111_oECM1_oB30_for_SC_CAN_V3_2_b49cfb6f_Rx, ComTimeout=0.1
        ECM2_0x271_oECM2_oB30_for_SC_CAN_V3_2_35a250f4_Rx: ComNotification=Rte_COMCbk_ECM2_0x271_oECM2_oB30_for_SC_CAN_V3_2_35a250f4_Rx, ComTimeoutNotification=Rte_COMCbkRxTOut_ECM2_0x271_oECM2_oB30_for_SC_CAN_V3_2_35a250f4_Rx, ComTimeout=0.2
        ECM3_0x371_oECM3_oB30_for_SC_CAN_V3_2_3a68860a_Rx: ComNotification=Rte_COMCbk_ECM3_0x371_oECM3_oB30_for_SC_CAN_V3_2_3a68860a_Rx, ComTimeoutNotification=Rte_COMCbkRxTOut_ECM3_0x371_oECM3_oB30_for_SC_CAN_V3_2_3a68860a_Rx, ComTimeout=1
        EEM1_0x2A8_oEEM1_oB30_for_SC_CAN_V3_2_a343c1b7_Rx: ComNotification=Rte_COMCbk_EEM1_0x2A8_oEEM1_oB30_for_SC_CAN_V3_2_a343c1b7_Rx, ComTimeoutNotification=Rte_COMCbkRxTOut_EEM1_0x2A8_oEEM1_oB30_for_SC_CAN_V3_2_a343c1b7_Rx, ComTimeout=1
        EPB1_0x16B_oEPB1_oB30_for_SC_CAN_V3_2_19631844_Rx: ComNotification=Rte_COMCbk_EPB1_0x16B_oEPB1_oB30_for_SC_CAN_V3_2_19631844_Rx, ComTimeoutNotification=Rte_COMCbkRxTOut_EPB1_0x16B_oEPB1_oB30_for_SC_CAN_V3_2_19631844_Rx, ComTimeout=0.2
        EPS_FD1_0x147_oEPS_FD1_oB30_for_SC_CAN_V3_2_fd5fd087_Rx: ComNotification=Rte_COMCbk_EPS_FD1_0x147_oEPS_FD1_oB30_for_SC_CAN_V3_2_fd5fd087_Rx, ComTimeoutNotification=Rte_COMCbkRxTOut_EPS_FD1_0x147_oEPS_FD1_oB30_for_SC_CAN_V3_2_fd5fd087_Rx, ComTimeout=0.2
        ESP11_0xC8_oESP11_oB30_for_SC_CAN_V3_2_b2794d17_Rx: ComNotification=Rte_COMCbk_ESP11_0xC8_oESP11_oB30_for_SC_CAN_V3_2_b2794d17_Rx, ComTimeoutNotification=Rte_COMCbkRxTOut_ESP11_0xC8_oESP11_oB30_for_SC_CAN_V3_2_b2794d17_Rx, ComTimeout=0.1
        ESP8_0x170_oESP8_oB30_for_SC_CAN_V3_2_97b77884_Rx: ComNotification=Rte_COMCbk_ESP8_0x170_oESP8_oB30_for_SC_CAN_V3_2_97b77884_Rx, ComTimeoutNotification=Rte_COMCbkRxTOut_ESP8_0x170_oESP8_oB30_for_SC_CAN_V3_2_97b77884_Rx, ComTimeout=0.2
        ESP_FD2_0x137_oESP_FD2_oB30_for_SC_CAN_V3_2_bc62acd8_Rx: ComNotification=Rte_COMCbk_ESP_FD2_0x137_oESP_FD2_oB30_for_SC_CAN_V3_2_bc62acd8_Rx, ComTimeoutNotification=Rte_COMCbkRxTOut_ESP_FD2_0x137_oESP_FD2_oB30_for_SC_CAN_V3_2_bc62acd8_Rx, ComTimeout=0.2
        GW_FD1_0x2BB_oGW_FD1_oB30_for_SC_CAN_V3_2_004ea45d_Rx: ComNotification=Rte_COMCbk_GW_FD1_0x2BB_oGW_FD1_oB30_for_SC_CAN_V3_2_004ea45d_Rx, ComTimeoutNotification=Rte_COMCbkRxTOut_GW_FD1_0x2BB_oGW_FD1_oB30_for_SC_CAN_V3_2_004ea45d_Rx, ComTimeout=1
        HAP_FD1_0x15B_oHAP_FD1_oB30_for_SC_CAN_V3_2_93124709_Rx: ComNotification=Rte_COMCbk_HAP_FD1_0x15B_oHAP_FD1_oB30_for_SC_CAN_V3_2_93124709_Rx, ComTimeoutNotification=Rte_COMCbkRxTOut_HAP_FD1_0x15B_oHAP_FD1_oB30_for_SC_CAN_V3_2_93124709_Rx, ComTimeout=0.2
        HAP_FD2_0x274_oHAP_FD2_oB30_for_SC_CAN_V3_2_5363b27c_Rx: ComNotification=Rte_COMCbk_HAP_FD2_0x274_oHAP_FD2_oB30_for_SC_CAN_V3_2_5363b27c_Rx, ComTimeoutNotification=Rte_COMCbkRxTOut_HAP_FD2_0x274_oHAP_FD2_oB30_for_SC_CAN_V3_2_5363b27c_Rx, ComTimeout=0.5
        HAP_FD3_0x298_oHAP_FD3_oB30_for_SC_CAN_V3_2_22400704_Rx: ComNotification=Rte_COMCbk_HAP_FD3_0x298_oHAP_FD3_oB30_for_SC_CAN_V3_2_22400704_Rx, ComTimeoutNotification=Rte_COMCbkRxTOut_HAP_FD3_0x298_oHAP_FD3_oB30_for_SC_CAN_V3_2_22400704_Rx, ComTimeout=1
        HCU_HC7_0x3C2_oHCU_HC7_oB30_for_SC_CAN_V3_2_d59a401d_Rx: ComNotification=Rte_COMCbk_HCU_HC7_0x3C2_oHCU_HC7_oB30_for_SC_CAN_V3_2_d59a401d_Rx, ComTimeoutNotification=Rte_COMCbkRxTOut_HCU_HC7_0x3C2_oHCU_HC7_oB30_for_SC_CAN_V3_2_d59a401d_Rx, ComTimeout=10
        HCU_PT4_0x2FA_oHCU_PT4_oB30_for_SC_CAN_V3_2_a6c96633_Rx: ComNotification=Rte_COMCbk_HCU_PT4_0x2FA_oHCU_PT4_oB30_for_SC_CAN_V3_2_a6c96633_Rx, ComTimeoutNotification=Rte_COMCbkRxTOut_HCU_PT4_0x2FA_oHCU_PT4_oB30_for_SC_CAN_V3_2_a6c96633_Rx, ComTimeout=1
        HCU_PT7_0x248_oHCU_PT7_oB30_for_SC_CAN_V3_2_30a9f673_Rx: ComNotification=Rte_COMCbk_HCU_PT7_0x248_oHCU_PT7_oB30_for_SC_CAN_V3_2_30a9f673_Rx, ComTimeoutNotification=Rte_COMCbkRxTOut_HCU_PT7_0x248_oHCU_PT7_oB30_for_SC_CAN_V3_2_30a9f673_Rx, ComTimeout=0.5
        HUD1_0x325_oHUD1_oB30_for_SC_CAN_V3_2_567ca009_Rx: ComNotification=Rte_COMCbk_HUD1_0x325_oHUD1_oB30_for_SC_CAN_V3_2_567ca009_Rx, ComTimeoutNotification=Rte_COMCbkRxTOut_HUD1_0x325_oHUD1_oB30_for_SC_CAN_V3_2_567ca009_Rx, ComTimeout=2
        HUT10_0x331_oHUT10_oB30_for_SC_CAN_V3_2_acd87eba_Tx
        HUT13_0x31C_oHUT13_oB30_for_SC_CAN_V3_2_86243622_Tx
        HUT15_0x1EE_oHUT15_oB30_for_SC_CAN_V3_2_ccda2985_Tx
        HUT16_0x348_oHUT16_oB30_for_SC_CAN_V3_2_6a07ebf7_Tx
        HUT17_0x33B_oHUT17_oB30_for_SC_CAN_V3_2_49d9e9b4_Tx
        HUT19_0x415_oHUT19_oB30_for_SC_CAN_V3_2_0070b441_Tx
        HUT1_0x367_oHUT1_oB30_for_SC_CAN_V3_2_4cf1fae5_Tx
        HUT20_0x2DE_oHUT20_oB30_for_SC_CAN_V3_2_fd1a0297_Tx
        HUT21_0x2DD_oHUT21_oB30_for_SC_CAN_V3_2_46aba8bb_Tx
        HUT22_0x2DA_oHUT22_oB30_for_SC_CAN_V3_2_c0698017_Tx
        HUT23_0x2D8_oHUT23_oB30_for_SC_CAN_V3_2_f39d4000_Tx
        HUT25_0x339_oHUT25_oB30_for_SC_CAN_V3_2_1c8c4a71_Tx
        HUT2_0x369_oHUT2_oB30_for_SC_CAN_V3_2_101c4259_Tx
        HUT30_0x1E9_oHUT30_oB30_for_SC_CAN_V3_2_037aee47_Tx
        HUT32_0x26F_oHUT32_oB30_for_SC_CAN_V3_2_cd38c3b4_Tx
        HUT33_0x1ED_oHUT33_oB30_for_SC_CAN_V3_2_0dfdacd0_Tx
        HUT34_0x370_oHUT34_oB30_for_SC_CAN_V3_2_f661979e_Tx
        HUT35_0x1E5_oHUT35_oB30_for_SC_CAN_V3_2_f645fa9e_Tx
        HUT39_0x1EB_oHUT39_oB30_for_SC_CAN_V3_2_85871b1d_Tx
        HUT3_0x36B_oHUT3_oB30_for_SC_CAN_V3_2_6c58ad50_Tx
        HUT4_0x36D_oHUT4_oB30_for_SC_CAN_V3_2_f3b22adc_Tx
        HUT6_0x4A_oHUT6_oB30_for_SC_CAN_V3_2_d227f5be_Tx
        HUT_FD1_0x2C3_oHUT_FD1_oB30_for_SC_CAN_V3_2_c297c003_Tx
        IFC_FD2_0x23D_oIFC_FD2_oB30_for_SC_CAN_V3_2_6083e7b7_Rx: ComNotification=Rte_COMCbk_IFC_FD2_0x23D_oIFC_FD2_oB30_for_SC_CAN_V3_2_6083e7b7_Rx, ComTimeoutNotification=Rte_COMCbkRxTOut_IFC_FD2_0x23D_oIFC_FD2_oB30_for_SC_CAN_V3_2_6083e7b7_Rx, ComTimeout=0.5
        IFC_FD3_0x2CF_oIFC_FD3_oB30_for_SC_CAN_V3_2_b81a4d55_Rx: ComNotification=Rte_COMCbk_IFC_FD3_0x2CF_oIFC_FD3_oB30_for_SC_CAN_V3_2_b81a4d55_Rx, ComTimeoutNotification=Rte_COMCbkRxTOut_IFC_FD3_0x2CF_oIFC_FD3_oB30_for_SC_CAN_V3_2_b81a4d55_Rx, ComTimeout=1
        PDCM1_0x2CD_oPDCM1_oB30_for_SC_CAN_V3_2_6c5cb461_Rx: ComNotification=Rte_COMCbk_PDCM1_0x2CD_oPDCM1_oB30_for_SC_CAN_V3_2_6c5cb461_Rx, ComTimeoutNotification=Rte_COMCbkRxTOut_PDCM1_0x2CD_oPDCM1_oB30_for_SC_CAN_V3_2_6c5cb461_Rx, ComTimeout=1
        PEPS2_0x295_oPEPS2_oB30_for_SC_CAN_V3_2_d1207061_Rx: ComNotification=Rte_COMCbk_PEPS2_0x295_oPEPS2_oB30_for_SC_CAN_V3_2_d1207061_Rx, ComTimeoutNotification=Rte_COMCbkRxTOut_PEPS2_0x295_oPEPS2_oB30_for_SC_CAN_V3_2_d1207061_Rx, ComTimeout=0.5
        PEPS4_0x302_oPEPS4_oB30_for_SC_CAN_V3_2_97914cf7_Rx: ComNotification=Rte_COMCbk_PEPS4_0x302_oPEPS4_oB30_for_SC_CAN_V3_2_97914cf7_Rx, ComTimeoutNotification=Rte_COMCbkRxTOut_PEPS4_0x302_oPEPS4_oB30_for_SC_CAN_V3_2_97914cf7_Rx, ComTimeout=2
        RSDS_FD1_0x16F_oRSDS_FD1_oB30_for_SC_CAN_V3_2_0c3e88fc_Rx: ComNotification=Rte_COMCbk_RSDS_FD1_0x16F_oRSDS_FD1_oB30_for_SC_CAN_V3_2_0c3e88fc_Rx, ComTimeoutNotification=Rte_COMCbkRxTOut_RSDS_FD1_0x16F_oRSDS_FD1_oB30_for_SC_CAN_V3_2_0c3e88fc_Rx, ComTimeout=0.2
        RSDS_FD2_0x30A_oRSDS_FD2_oB30_for_SC_CAN_V3_2_3f10f708_Rx: ComNotification=Rte_COMCbk_RSDS_FD2_0x30A_oRSDS_FD2_oB30_for_SC_CAN_V3_2_3f10f708_Rx, ComTimeoutNotification=Rte_COMCbkRxTOut_RSDS_FD2_0x30A_oRSDS_FD2_oB30_for_SC_CAN_V3_2_3f10f708_Rx, ComTimeout=2
        TPMS1_0x341_oTPMS1_oB30_for_SC_CAN_V3_2_7481a0ed_Rx: ComNotification=Rte_COMCbk_TPMS1_0x341_oTPMS1_oB30_for_SC_CAN_V3_2_7481a0ed_Rx, ComTimeoutNotification=Rte_COMCbkRxTOut_TPMS1_0x341_oTPMS1_oB30_for_SC_CAN_V3_2_7481a0ed_Rx, ComTimeout=5
        TPMS2_0x395_oTPMS2_oB30_for_SC_CAN_V3_2_64d1204c_Rx: ComNotification=Rte_COMCbk_TPMS2_0x395_oTPMS2_oB30_for_SC_CAN_V3_2_64d1204c_Rx, ComTimeoutNotification=Rte_COMCbkRxTOut_TPMS2_0x395_oTPMS2_oB30_for_SC_CAN_V3_2_64d1204c_Rx, ComTimeout=5
        WPC1_0x2BA_oWPC1_oB30_for_SC_CAN_V3_2_0ada7fde_Rx: ComNotification=Rte_COMCbk_WPC1_0x2BA_oWPC1_oB30_for_SC_CAN_V3_2_0ada7fde_Rx, ComTimeoutNotification=Rte_COMCbkRxTOut_WPC1_0x2BA_oWPC1_oB30_for_SC_CAN_V3_2_0ada7fde_Rx, ComTimeout=1
  module config Rte
    37 x RteBswModuleInstance:
      Adc
      BswM
        BswM_MainFunctionTimingEvent0 (RteBswEventToTaskMapping): RteBswUsedOsEventRef=Rte_Ev_Cyclic2_Default_BSW_0_10ms, RteBswUsedOsAlarmRef=Os/Rte_Al_TE2_Default_BSW_0_10ms
      Can
        5 x RteBswEventToTaskMapping, all with RteBswUsedOsEventRef=Rte_Ev_Cyclic2_BSW_COMM_0_5ms, RteBswUsedOsAlarmRef=Os/Rte_Al_TE2_BSW_COMM_0_5ms:
          Can_MainFunction_BusOffTimingEvent0
          Can_MainFunction_ModeTimingEvent0
          Can_MainFunction_ReadTimingEvent0
          Can_MainFunction_WakeupTimingEvent0
          Can_MainFunction_WriteTimingEvent0
      CanIf
      CanNm
        CanNm_MainFunctionTimingEvent0 (RteBswEventToTaskMapping): RteBswUsedOsEventRef=Rte_Ev_Cyclic2_BSW_COMM_0_5ms, RteBswUsedOsAlarmRef=Os/Rte_Al_TE2_BSW_COMM_0_5ms
      CanSM
        CanSM_MainFunctionTimingEvent0 (RteBswEventToTaskMapping): RteBswUsedOsEventRef=Rte_Ev_Cyclic2_BSW_COMM_0_5ms, RteBswUsedOsAlarmRef=Os/Rte_Al_TE2_BSW_COMM_0_5ms
      CanTp
        CanTp_MainFunctionTimingEvent0 (RteBswEventToTaskMapping): RteBswUsedOsEventRef=Rte_Ev_Cyclic2_BSW_COMM_0_5ms, RteBswUsedOsAlarmRef=Os/Rte_Al_TE2_BSW_COMM_0_5ms
      CanTrcv_0
        CanTrcv_30_Tja1040_MainFunctionTimingEvent0 (RteBswEventToTaskMapping): RteBswUsedOsEventRef=Rte_Ev_Cyclic2_BSW_COMM_0_10ms, RteBswUsedOsAlarmRef=Os/Rte_Al_TE2_BSW_COMM_0_10ms
      Com
        Com_MainFunctionRxTimingEvent0 (RteBswEventToTaskMapping): RteBswUsedOsEventRef=Rte_Ev_Cyclic2_BSW_COMM_0_5ms, RteBswUsedOsAlarmRef=Os/Rte_Al_TE2_BSW_COMM_0_5ms
        Com_MainFunctionTxTimingEvent0 (RteBswEventToTaskMapping): RteBswUsedOsEventRef=Rte_Ev_Cyclic2_BSW_COMM_0_5ms, RteBswUsedOsAlarmRef=Os/Rte_Al_TE2_BSW_COMM_0_5ms
      ComM
        ComM_MainFunction_0TimingEvent0 (RteBswEventToTaskMapping): RteBswUsedOsEventRef=Rte_Ev_Cyclic2_BSW_COMM_0_5ms, RteBswUsedOsAlarmRef=Os/Rte_Al_TE2_BSW_COMM_0_5ms
      CorTst
        CorTst_MainFunctionTimingEvent0 (RteBswEventToTaskMapping): RteBswUsedOsEventRef=Rte_Ev_Cyclic2_Default_BSW_0_5ms, RteBswUsedOsAlarmRef=Os/Rte_Al_TE2_Default_BSW_0_5ms
      Crypto
        Crypto_30_vHsm_MainFunctionTimingEvent0 (RteBswEventToTaskMapping): RteBswUsedOsEventRef=Rte_Ev_Cyclic2_BSW_COMM_0_5ms, RteBswUsedOsAlarmRef=Os/Rte_Al_TE2_BSW_COMM_0_5ms
      Csm
        Csm_MainFunctionTimingEvent0 (RteBswEventToTaskMapping): RteBswUsedOsEventRef=Rte_Ev_Cyclic2_BSW_COMM_0_5ms, RteBswUsedOsAlarmRef=Os/Rte_Al_TE2_BSW_COMM_0_5ms
      Dcm
        Dcm_MainFunctionTimingEvent0 (RteBswEventToTaskMapping): RteBswUsedOsEventRef=Rte_Ev_Cyclic2_BSW_COMM_0_10ms, RteBswUsedOsAlarmRef=Os/Rte_Al_TE2_BSW_COMM_0_10ms
      Dem
        Dem_MasterMainFunctionTimingEvent0 (RteBswEventToTaskMapping): RteBswUsedOsEventRef=Rte_Ev_Cyclic2_BSW_DIAGNOSE_0_10ms, RteBswUsedOsAlarmRef=Os/Rte_Al_TE2_BSW_DIAGNOSE_0_10ms
        Dem_SatelliteMainFunctionTimingEvent0 (RteBswEventToTaskMapping): RteBswUsedOsEventRef=Rte_Ev_Cyclic2_BSW_DIAGNOSE_0_10ms, RteBswUsedOsAlarmRef=Os/Rte_Al_TE2_BSW_DIAGNOSE_0_10ms
      Det
      Dio
      EcuM
        EcuM_MainFunctionTimingEvent0 (RteBswEventToTaskMapping): RteBswUsedOsEventRef=Rte_Ev_Cyclic2_Default_BSW_0_10ms, RteBswUsedOsAlarmRef=Os/Rte_Al_TE2_Default_BSW_0_10ms
      Fee
        Fee_30_SmallSector_MainFunctionTimingEvent0 (RteBswEventToTaskMapping): RteBswUsedOsEventRef=Rte_Ev_Cyclic2_Default_BSW_1_5ms, RteBswUsedOsAlarmRef=Os/Rte_Al_TE2_Default_BSW_1_5ms
      Fls
        Fls_MainFunctionTimingEvent0 (RteBswEventToTaskMapping): RteBswUsedOsEventRef=Rte_Ev_Cyclic2_Default_BSW_1_5ms, RteBswUsedOsAlarmRef=Os/Rte_Al_TE2_Default_BSW_1_5ms
      FlsTst
        FlsTst_MainFunctionTimingEvent0 (RteBswEventToTaskMapping): RteBswUsedOsEventRef=Rte_Ev_Cyclic2_Default_BSW_0_5ms, RteBswUsedOsAlarmRef=Os/Rte_Al_TE2_Default_BSW_0_5ms
      FvM
        FvM_MainFunctionTimingEvent0 (RteBswEventToTaskMapping): RteBswUsedOsEventRef=Rte_Ev_Run_FvM_FvM_MainFunction, RteBswUsedOsAlarmRef=Os/Rte_Al_TE_FvM_FvM_MainFunction
      Gpt
      Icu
      Lin
      LinTrcv
      Mcu
      Nm
      NvM
        NvM_MainFunctionTimingEvent0 (RteBswEventToTaskMapping): RteBswUsedOsEventRef=Rte_Ev_Cyclic2_Default_BSW_1_5ms, RteBswUsedOsAlarmRef=Os/Rte_Al_TE2_Default_BSW_1_5ms
      PduR
      Port
      Pwm
      RamTst
        RamTst_MainFunctionTimingEvent0 (RteBswEventToTaskMapping)
      SecOC
        SecOC_MainFunctionRxTimingEvent0 (RteBswEventToTaskMapping): RteBswUsedOsEventRef=Rte_Ev_Cyclic2_BSW_COMM_0_2ms, RteBswUsedOsAlarmRef=Os/Rte_Al_TE2_BSW_COMM_0_2ms
        SecOC_MainFunctionTxTimingEvent0 (RteBswEventToTaskMapping): RteBswUsedOsEventRef=Rte_Ev_Cyclic2_BSW_COMM_0_2ms, RteBswUsedOsAlarmRef=Os/Rte_Al_TE2_BSW_COMM_0_2ms
      Spi
        Spi_MainFunction_HandlingTimingEvent0 (RteBswEventToTaskMapping): RteBswUsedOsEventRef=Rte_Ev_Cyclic2_Default_BSW_0_5ms, RteBswUsedOsAlarmRef=Os/Rte_Al_TE2_Default_BSW_0_5ms
      WdgM
        WdgM_MainFunctionTimingEvent0 (RteBswEventToTaskMapping): RteBswUsedOsEventRef=Rte_Ev_Cyclic2_BSW_COMM_0_10ms, RteBswUsedOsAlarmRef=Os/Rte_Al_TE2_BSW_COMM_0_10ms
      Wdg
    41 x RteSwComponentInstance:
      ADAU1978_EcuSwComposition
        TMT_ADAU1978_MainFunction (RteEventToTaskMapping): RteUsedOsEventRef=Rte_Ev_Cyclic_DRIVERS_SAFE_0_50ms, RteUsedOsAlarmRef=Os/Rte_Al_TE_DRIVERS_SAFE_0_50ms
      AMP_EcuSwComposition
        DRT_AMP_Event_MainFunction_Rc_AMP_Notify_Message_Element (RteEventToTaskMapping): RteUsedOsEventRef=Rte_Ev_Run_AMP_AMP_Event_MainFunction
        TMT_AMP_MainFunction (RteEventToTaskMapping): RteUsedOsEventRef=Rte_Ev_Cyclic_DRIVERS_SAFE_0_5ms, RteUsedOsAlarmRef=Os/Rte_Al_TE_DRIVERS_SAFE_0_5ms
        NvmBlock_AMP_NvBlockNeed_LC_Calibration2 (RteNvRamAllocation):
          RteNvmRamBlockLocationSymbol = Rte_AMP_NvBlockNeed_LC_Calibration2_MirrorBlock
          RteNvmRomBlockLocationSymbol = Rte_AMP_NvBlockNeed_LC_Calibration2_DefaultValue
          RteNvmBlockRef = AMP_NvBlockNeed_LC_Calibration2
        NvmBlock_AMP_NvBlockNeed_LC_Calibration (RteNvRamAllocation):
          RteNvmRamBlockLocationSymbol = Rte_AMP_NvBlockNeed_LC_Calibration_MirrorBlock
          RteNvmRomBlockLocationSymbol = Rte_AMP_NvBlockNeed_LC_Calibration_DefaultValue
          RteNvmBlockRef = AMP_NvBlockNeed_LC_Calibration
      BswM_EcuSwComposition
        3 x RteEventToTaskMapping:
          Timer_BswM_MainFunction: RteUsedOsEventRef=Rte_Ev_Cyclic2_Default_BSW_0_10ms, RteUsedOsAlarmRef=Os/Rte_Al_TE2_Default_BSW_0_10ms
          DataReceivedEvent_BswM_Read_PowerModeShutdownReq_Request_PowerModeShutdownReq_requestedMode: RteUsedOsEventRef=Rte_Ev_Run_BswM_BswM_Read_PowerModeShutdownReq
          DataReceivedEvent_BswM_Read_PowerModeShutdownReq_EmergencySleep_Request_PowerModeShutdownReq_EmergencySleep_requestedMode: RteUsedOsEventRef=Rte_Ev_Run_BswM_BswM_Read_PowerModeShutdownReq_EmergencySleep
      CConfig_EcuSwComposition
        TMT_CConfig_MainFunction (RteEventToTaskMapping): RteUsedOsEventRef=Rte_Ev_Run_CConfig_CConfig_MainFunction, RteUsedOsAlarmRef=Os/Rte_Al_TE_CConfig_CConfig_MainFunction
      Can_Server_EcuSwComposition
        9 x RteEventToTaskMapping:
          OIT_Runnable_CNA_SignalGroupSet_Operation: RteUsedOsEventRef=Rte_Ev_Run_Can_Server_CNA_SignalGroupSet
          OIT_ComNoAction_CNA_SignalSet_Operation: RteUsedOsEventRef=Rte_Ev_Run_Can_Server_CNA_SignalSet
          OIT_CNA_SignalSetNoTrigger_CNA_SignalSetNoTrigger_Operation: RteUsedOsEventRef=Rte_Ev_Run_Can_Server_CNA_SignalSetNoTrigger
          OIT_CNA_SignalSet_U8N_CNA_SignalSet_U8N_Operation: RteUsedOsEventRef=Rte_Ev_Run_Can_Server_CNA_SignalSet_U8N
          OIT_CanFrameCounter_Can_ABS3_Counter_CanFrameCounter_Can_ABS3_Counter: RteUsedOsEventRef=Rte_Ev_Run_Can_Server_CanFrameCounter_Can_ABS3_Counter
          OIT_CanFrameCounter_Can_ECM2_Counter_CanFrameCounter_Can_ECM2_Counter: RteUsedOsEventRef=Rte_Ev_Run_Can_Server_CanFrameCounter_Can_ECM2_Counter
          OIT_CanFrameCounter_Can_ESP_FD2_Counter_CanFrameCounter_Can_ESP_FD2_Counter: RteUsedOsEventRef=Rte_Ev_Run_Can_Server_CanFrameCounter_Can_ESP_FD2_Counter
          TMT_CanServer_MainFunction: RteUsedOsEventRef=Rte_Ev_Cyclic_SYS_0_10ms, RteUsedOsAlarmRef=Os/Rte_Al_TE_SYS_0_10ms
          TMT_CanServer_MainFunction_5ms: RteUsedOsEventRef=Rte_Ev_Cyclic_SYS_0_5ms, RteUsedOsAlarmRef=Os/Rte_Al_TE_SYS_0_5ms
        NvmBlock_Can_Server_NvBlockNeed_ActiveWUCounter (RteNvRamAllocation):
          RteNvmRamBlockLocationSymbol = Rte_Can_Server_NvBlockNeed_ActiveWUCounter_MirrorBlock
          RteNvmRomBlockLocationSymbol = Rte_Can_Server_NvBlockNeed_ActiveWUCounter_DefaultValue
          RteNvmBlockRef = Can_ServerNvBlockNeed_ActiveWUCounter
        NvmBlock_Can_Server_NvBlockNeed_AbnormalWakeupSleepRecords (RteNvRamAllocation):
          RteNvmRamBlockLocationSymbol = Rte_Can_Server_NvBlockNeed_AbnormalWakeupSleepRecords_MirrorBlock
          RteNvmRomBlockLocationSymbol = Rte_Can_Server_NvBlockNeed_AbnormalWakeupSleepRecords_DefaultValue
          RteNvmBlockRef = Can_ServerNvBlockNeed_AbnormalWakeupSleepRecords
      ComEx_EcuSwComposition
        3 x RteEventToTaskMapping:
          OIT_ComEx_GetRxE2EStatus_ComEx_GetRxE2EStatus: RteUsedOsEventRef=Rte_Ev_Run_ComEx_ComEx_GetRxE2EStatus
          TMT_ComEx_MainFunction: RteUsedOsEventRef=Rte_Ev_Cyclic_DRIVERS_SAFE_0_5ms, RteUsedOsAlarmRef=Os/Rte_Al_TE_DRIVERS_SAFE_0_5ms
          OIT_ComEx_SendSignal_ComEx_SendSignal: RteUsedOsEventRef=Rte_Ev_Run_ComEx_ComEx_SendSignal
      ComM_EcuSwComposition
        Timer_ComM_MainFunction_0 (RteEventToTaskMapping): RteUsedOsEventRef=Rte_Ev_Cyclic2_BSW_COMM_0_5ms, RteUsedOsAlarmRef=Os/Rte_Al_TE2_BSW_COMM_0_5ms
      SWC_CAN_EcuSwComposition
        TMT_Common_GateWay_10msMainFunction (RteEventToTaskMapping):
          RteUsedOsEventRef = Rte_Ev_Run_Common_GateWay_Common_GateWay_10msMainFunction
          RteUsedOsAlarmRef = Os/Rte_Al_TE_Common_GateWay_Common_GateWay_10msMainFunction
        TMT_SWC_CAN_MainFunction (RteEventToTaskMapping):
          RteUsedOsEventRef = Rte_Ev_Run_Common_GateWay_Common_GateWay_5msMainFunction
          RteUsedOsAlarmRef = Os/Rte_Al_TE_Common_GateWay_Common_GateWay_5msMainFunction
        NvmBlock_Common_GateWay_NvBlockNeed_001 (RteNvRamAllocation):
          RteNvmRamBlockLocationSymbol = Rte_Common_GateWay_NvBlockNeed_Block_IPC_CAN_Data_MirrorBlock
          RteNvmRomBlockLocationSymbol = Rte_Common_GateWay_NvBlockNeed_Block_IPC_CAN_Data_DefaultValue
          RteNvmBlockRef = Common_GateWayNvBlockNeed_Block_IPC_CAN_Data
        NvmBlock_Common_GateWay_NvBlockNeed (RteNvRamAllocation):
          RteNvmRamBlockLocationSymbol = Rte_Common_GateWay_NvBlockNeed_Block_IPC_Config_Data_MirrorBlock
          RteNvmRomBlockLocationSymbol = Rte_Common_GateWay_NvBlockNeed_Block_IPC_Config_Data_DefaultValue
          RteNvmBlockRef = Common_GateWayNvBlockNeed_Block_IPC_Config_Data
      ODO_EcuSwComposition
        11 x RteEventToTaskMapping:
          TMT_TC_MainFunction: RteUsedOsEventRef=Rte_Ev_Run_Common_Normal_Common_Normal_100msMainFunction, RteUsedOsAlarmRef=Os/Rte_Al_TE_Common_Normal_Common_Normal_100msMainFunction
          TMT_Common_Normal_100msMainFunction_: RteUsedOsEventRef=Rte_Ev_Run_Common_Normal_Common_Normal_100msMainFunction_, RteUsedOsAlarmRef=Os/Rte_Al_TE_Common_Normal_Common_Normal_100msMainFunction_
          TMT_Common_Normal_MainFunction: RteUsedOsEventRef=Rte_Ev_Run_Common_Normal_Common_Normal_10msMainFunction, RteUsedOsAlarmRef=Os/Rte_Al_TE_Common_Normal_Common_Normal_10msMainFunction
          TMT_Common_Normal_10msMainFunction_: RteUsedOsEventRef=Rte_Ev_Run_Common_Normal_Common_Normal_10msMainFunction_, RteUsedOsAlarmRef=Os/Rte_Al_TE_Common_Normal_Common_Normal_10msMainFunction_
          TMT_ODO_MainFunction: RteUsedOsEventRef=Rte_Ev_Run_Common_Normal_Common_Normal_20msMainFunction, RteUsedOsAlarmRef=Os/Rte_Al_TE_Common_Normal_Common_Normal_20msMainFunction
          TMT_Common_Normal_20msMainFunction_: RteUsedOsEventRef=Rte_Ev_Run_Common_Normal_Common_Normal_20msMainFunction_, RteUsedOsAlarmRef=Os/Rte_Al_TE_Common_Normal_Common_Normal_20msMainFunction_
          TMT_Speedo_MainFunction: RteUsedOsEventRef=Rte_Ev_Run_Common_Normal_Common_Normal_20msMainFunction_A, RteUsedOsAlarmRef=Os/Rte_Al_TE_Common_Normal_Common_Normal_20msMainFunction_A
          TMT_Common_Normal_50msMainFunction_: RteUsedOsEventRef=Rte_Ev_Run_Common_Normal_Common_Normal_20msMainFunction_B, RteUsedOsAlarmRef=Os/Rte_Al_TE_Common_Normal_Common_Normal_20msMainFunction_B
          TMT_Tacho_MainFunction: RteUsedOsEventRef=Rte_Ev_Run_Common_Normal_Common_Normal_5msMainFunction, RteUsedOsAlarmRef=Os/Rte_Al_TE_Common_Normal_Common_Normal_5msMainFunction
          OIT_EOL_ReadDID0xFDD8_EOL_GetReadHardInputForCluster_EOL_ReadDID0xFDD8_EOL_GetReadHardInputForCluster: RteUsedOsEventRef=Rte_Ev_Run_Common_Normal_EOL_ReadDID0xFDD8_EOL_GetReadHardInputForCluster
          OIT_tiCS_Fuel_Api_ParamentGetCsPort_Operation_tiCS_Fuel_Api_ParamentGetCsPort_Operation: RteUsedOsEventRef=Rte_Ev_Run_Common_Normal_Fuel_Api_ParamentGetCsPort_Operation
        8 x RteNvRamAllocation:
          NvmBlock_ODO_NvBlockNeed_Block_MaintainOdo: RteNvmRamBlockLocationSymbol=Rte_Common_Normal_NvBlockNeed_Block_MaintainOdo_MirrorBlock, RteNvmRomBlockLocationSymbol=Rte_Common_Normal_NvBlockNeed_Block_MaintainOdo_DefaultValue, RteNvmBlockRef=Common_NormalNvBlockNeed_Block_MaintainOdo
          NvmBlock_ODO_NvBlockNeed_Block_ODO_{1..5}: RteNvmRamBlockLocationSymbol=Rte_Common_Normal_NvBlockNeed_Block_ODO_{1..5}_MirrorBlock, RteNvmRomBlockLocationSymbol=Rte_Common_Normal_NvBlockNeed_Block_ODO_{1..5}_DefaultValue, RteNvmBlockRef=Common_NormalNvBlockNeed_Block_ODO_{1..5}
          NvmBlock_ODO_NvBlockNeed_Block_Trip: RteNvmRamBlockLocationSymbol=Rte_Common_Normal_NvBlockNeed_Block_Trip_MirrorBlock, RteNvmRomBlockLocationSymbol=Rte_Common_Normal_NvBlockNeed_Block_Trip_DefaultValue, RteNvmBlockRef=Common_NormalNvBlockNeed_Block_Trip
          NvmBlock_Common_Normal_NvBlockNeed_Menu: RteNvmRamBlockLocationSymbol=Rte_Common_Normal_NvBlockNeed_Menu_MirrorBlock, RteNvmRomBlockLocationSymbol=Rte_Common_Normal_NvBlockNeed_MENU_Data_DefaultValue, RteNvmBlockRef=Common_NormalNvBlockNeed_Menu
      Gear_EcuSwComposition
        TMT_TT_MainFunction (RteEventToTaskMapping):
          RteUsedOsEventRef = Rte_Ev_Run_Common_Safety_Common_Safety_10msMainFunction
          RteUsedOsAlarmRef = Os/Rte_Al_TE_Common_Safety_Common_Safety_10msMainFunction
        TMT_Gear_MainFunction (RteEventToTaskMapping):
          RteUsedOsEventRef = Rte_Ev_Run_Common_Safety_Common_Safety_50msMainFunction
          RteUsedOsAlarmRef = Os/Rte_Al_TE_Common_Safety_Common_Safety_50msMainFunction
      Csm_EcuSwComposition
        Timer_Csm_MainFunction (RteEventToTaskMapping): RteUsedOsEventRef=Rte_Ev_Cyclic2_BSW_COMM_0_5ms, RteUsedOsAlarmRef=Os/Rte_Al_TE2_BSW_COMM_0_5ms
      DCM_Server_EcuSwComposition
        TMT_Runnable (RteEventToTaskMapping): RteUsedOsEventRef=Rte_Ev_Run_DCM_Server_DCM_Server_MainFunction, RteUsedOsAlarmRef=Os/Rte_Al_TE_DCM_Server_DCM_Server_MainFunction
        NvmBlock_DCM_Server_NvBlockNeedSecAttemptCount (RteNvRamAllocation):
          RteNvmRamBlockLocationSymbol = Rte_DCM_Server_NvBlockNeedSecAttemptCount_MirrorBlock
          RteNvmRomBlockLocationSymbol = Rte_DCM_Server_NvBlockNeedSecAttemptCount_DefaultValue
          RteNvmBlockRef = DCM_ServerNvBlockNeedSecAttemptCount
        NvmBlock_DCM_Server_NvBlockNeed_EOLUnlockCnt (RteNvRamAllocation):
          RteNvmRamBlockLocationSymbol = Rte_DCM_Server_NvBlockNeed_EOLUnlockCnt_MirrorBlock
          RteNvmRomBlockLocationSymbol = Rte_DCM_Server_NvBlockNeed_EOLUnlockCnt_DefaultValue
          RteNvmBlockRef = DCM_ServerNvBlockNeed_EOLUnlockCnt
      Dcm_EcuSwComposition
        Timer_Dcm_MainFunction (RteEventToTaskMapping): RteUsedOsEventRef=Rte_Ev_Cyclic2_BSW_COMM_0_10ms, RteUsedOsAlarmRef=Os/Rte_Al_TE2_BSW_COMM_0_10ms
      DemMaster_0_EcuSwComposition
        Timer_Dem_MasterMainFunction (RteEventToTaskMapping): RteUsedOsEventRef=Rte_Ev_Cyclic2_BSW_DIAGNOSE_0_10ms, RteUsedOsAlarmRef=Os/Rte_Al_TE2_BSW_DIAGNOSE_0_10ms
      DemSatellite_0_EcuSwComposition
        201 x RteEventToTaskMapping:
          Timer_Dem_SatelliteMainFunction: RteUsedOsEventRef=Rte_Ev_Cyclic2_BSW_DIAGNOSE_0_10ms, RteUsedOsAlarmRef=Os/Rte_Al_TE2_BSW_DIAGNOSE_0_10ms
          OpEventSetEventStatus_SetEventStatus_Event_A2B_open_Circuit_Open: RteUsedOsEventRef=Rte_Ev_Run_DemSatellite_0_SetEventStatus
          OpEventSetEventStatus_SetEventStatus_Event_A2B_short_to_battery_Circuit_Short_To_Battery: RteUsedOsEventRef=Rte_Ev_Run_DemSatellite_0_SetEventStatus
          OpEventSetEventStatus_SetEventStatus_Event_A2B_short_to_ground_Circuit_Short_To_Ground: RteUsedOsEventRef=Rte_Ev_Run_DemSatellite_0_SetEventStatus
          OpEventSetEventStatus_SetEventStatus_Event_AVM_CamerOpenCircuit: RteUsedOsEventRef=Rte_Ev_Run_DemSatellite_0_SetEventStatus
          OpEventSetEventStatus_SetEventStatus_Event_AVM_CamerShortToBattery: RteUsedOsEventRef=Rte_Ev_Run_DemSatellite_0_SetEventStatus
          OpEventSetEventStatus_SetEventStatus_Event_AVM_CamerShortToGround: RteUsedOsEventRef=Rte_Ev_Run_DemSatellite_0_SetEventStatus
          OpEventSetEventStatus_SetEventStatus_Event_AbnormalWakeupSleep: RteUsedOsEventRef=Rte_Ev_Run_DemSatellite_0_SetEventStatus
          OpEventSetEventStatus_SetEventStatus_Event_ControlModuleCANBus_off_Bus_off: RteUsedOsEventRef=Rte_Ev_Run_DemSatellite_0_SetEventStatus
          OpEventSetEventStatus_SetEventStatus_Event_Ethernet_CRC_Errors_Value_of_Signal_Protection_Calculation_Incorrect: RteUsedOsEventRef=Rte_Ev_Run_DemSatellite_0_SetEventStatus
          OpEventSetEventStatus_SetEventStatus_Event_Ethernet_signal_lines_short_circuit_Circuit_Short_To_Battery: RteUsedOsEventRef=Rte_Ev_Run_DemSatellite_0_SetEventStatus
          OpEventSetEventStatus_SetEventStatus_Event_FactoryModeNotClosed: RteUsedOsEventRef=Rte_Ev_Run_DemSatellite_0_SetEventStatus
          OpEventSetEventStatus_SetEventStatus_Event_Fuel_sensor1_short_to_BAT_Circuit_Short_To_Battery: RteUsedOsEventRef=Rte_Ev_Run_DemSatellite_0_SetEventStatus
          OpEventSetEventStatus_SetEventStatus_Event_Fuel_sensor1_short_to_GND_Circuit_Short_To_Ground: RteUsedOsEventRef=Rte_Ev_Run_DemSatellite_0_SetEventStatus
          OpEventSetEventStatus_SetEventStatus_Event_Fuel_sensor2_short_to_BAT_Circuit_Short_To_Battery: RteUsedOsEventRef=Rte_Ev_Run_DemSatellite_0_SetEventStatus
          OpEventSetEventStatus_SetEventStatus_Event_Fuel_sensor2_short_to_GND_Circuit_Short_To_Ground: RteUsedOsEventRef=Rte_Ev_Run_DemSatellite_0_SetEventStatus
          OpEventSetEventStatus_SetEventStatus_Event_GPS_AntennaOpen: RteUsedOsEventRef=Rte_Ev_Run_DemSatellite_0_SetEventStatus
          OpEventSetEventStatus_SetEventStatus_Event_GPS_AntennaShortToBattery: RteUsedOsEventRef=Rte_Ev_Run_DemSatellite_0_SetEventStatus
          OpEventSetEventStatus_SetEventStatus_Event_GPS_AntennaShortToGround: RteUsedOsEventRef=Rte_Ev_Run_DemSatellite_0_SetEventStatus
          OpEventSetEventStatus_SetEventStatus_Event_GPS_OverCurrent: RteUsedOsEventRef=Rte_Ev_Run_DemSatellite_0_SetEventStatus
          OpEventSetEventStatus_SetEventStatus_Event_HVAC_Display_BacklightModuleError: RteUsedOsEventRef=Rte_Ev_Run_DemSatellite_0_SetEventStatus
          OpEventSetEventStatus_SetEventStatus_Event_HVAC_Display_ForceInductionFailure: RteUsedOsEventRef=Rte_Ev_Run_DemSatellite_0_SetEventStatus
          OpEventSetEventStatus_SetEventStatus_Event_HVAC_Display_LowVoltage: RteUsedOsEventRef=Rte_Ev_Run_DemSatellite_0_SetEventStatus
          OpEventSetEventStatus_SetEventStatus_Event_HVAC_Display_NotReceiveBacklightValue: RteUsedOsEventRef=Rte_Ev_Run_DemSatellite_0_SetEventStatus
          OpEventSetEventStatus_SetEventStatus_Event_HVAC_Display_OverVoltage: RteUsedOsEventRef=Rte_Ev_Run_DemSatellite_0_SetEventStatus
          OpEventSetEventStatus_SetEventStatus_Event_HVAC_Display_TFT_Failure: RteUsedOsEventRef=Rte_Ev_Run_DemSatellite_0_SetEventStatus
          OpEventSetEventStatus_SetEventStatus_Event_HVAC_Display_TouchPanelFailure: RteUsedOsEventRef=Rte_Ev_Run_DemSatellite_0_SetEventStatus
          OpEventSetEventStatus_SetEventStatus_Event_HVAC_Display_VibratorFailure: RteUsedOsEventRef=Rte_Ev_Run_DemSatellite_0_SetEventStatus
          OpEventSetEventStatus_SetEventStatus_Event_HVAC_Display_VideoSignalConnectFailure: RteUsedOsEventRef=Rte_Ev_Run_DemSatellite_0_SetEventStatus
          OpEventSetEventStatus_SetEventStatus_Event_INVALID_SHORTNAME_GW_Ethernet_signal_lines_open_circuit_Circuit_Open: RteUsedOsEventRef=Rte_Ev_Run_DemSatellite_0_SetEventStatus
          OpEventSetEventStatus_SetEventStatus_Event_INVALID_SHORTNAME_GW_Ethernet_unexpected_Link_Loss_Bus_Signal_Message_Failure: RteUsedOsEventRef=Rte_Ev_Run_DemSatellite_0_SetEventStatus
          OpEventSetEventStatus_SetEventStatus_Event_INVALID_SHORTNAME_GW_Insufficient_SQI_Signal_Below_Allowable_Range: RteUsedOsEventRef=Rte_Ev_Run_DemSatellite_0_SetEventStatus
          OpEventSetEventStatus_SetEventStatus_Event_INVALID_SHORTNAME_HUT_Display_Low_voltage_Circuit_Voltage_Below_Threshold: RteUsedOsEventRef=Rte_Ev_Run_DemSatellite_0_SetEventStatus
          OpEventSetEventStatus_SetEventStatus_Event_INVALID_SHORTNAME_HUT_Display_Over_voltage_Circuit_Voltage_Above_Threshold: RteUsedOsEventRef=Rte_Ev_Run_DemSatellite_0_SetEventStatus
          OpEventSetEventStatus_SetEventStatus_Event_INVALID_SHORTNAME_HUT_Display_TFT_failure_Internal_Electronic_Failure: RteUsedOsEventRef=Rte_Ev_Run_DemSatellite_0_SetEventStatus
          OpEventSetEventStatus_SetEventStatus_Event_INVALID_SHORTNAME_HUT_Display_Touch_Panel_failure_Internal_Electronic_Failure: RteUsedOsEventRef=Rte_Ev_Run_DemSatellite_0_SetEventStatus
          OpEventSetEventStatus_SetEventStatus_Event_INVALID_SHORTNAME_HUT_Display_backlight_module_status_Internal_Electronic_Failure: RteUsedOsEventRef=Rte_Ev_Run_DemSatellite_0_SetEventStatus
          OpEventSetEventStatus_SetEventStatus_Event_INVALID_SHORTNAME_HUT_Display_not_received_backlight_value_Bus_Signal_Message_Failure: RteUsedOsEventRef=Rte_Ev_Run_DemSatellite_0_SetEventStatus
          OpEventSetEventStatus_SetEventStatus_Event_INVALID_SHORTNAME_HUT_Display_video_signal_connect_failure_Internal_Electron_1c4ba08c: RteUsedOsEventRef=Rte_Ev_Run_DemSatellite_0_SetEventStatus
          OpEventSetEventStatus_SetEventStatus_Event_INVALID_SHORTNAME_Over_Temperature_Over_Temperature: RteUsedOsEventRef=Rte_Ev_Run_DemSatellite_0_SetEventStatus
          OpEventSetEventStatus_SetEventStatus_Event_IP_Display_ASIC_failure_Internal_Electronic_Failure: RteUsedOsEventRef=Rte_Ev_Run_DemSatellite_0_SetEventStatus
          OpEventSetEventStatus_SetEventStatus_Event_IP_Display_ICD_Dimming_module_status_Internal_Electronic_Failure: RteUsedOsEventRef=Rte_Ev_Run_DemSatellite_0_SetEventStatus
          OpEventSetEventStatus_SetEventStatus_Event_IP_Display_ICD_Low_voltage_Circuit_Voltage_Below_Threshold: RteUsedOsEventRef=Rte_Ev_Run_DemSatellite_0_SetEventStatus
          OpEventSetEventStatus_SetEventStatus_Event_IP_Display_ICD_Over_voltage_Circuit_Voltage_Above_Threshold: RteUsedOsEventRef=Rte_Ev_Run_DemSatellite_0_SetEventStatus
          OpEventSetEventStatus_SetEventStatus_Event_IP_Display_ICD_screen_IC_failure_Internal_Electronic_Failure: RteUsedOsEventRef=Rte_Ev_Run_DemSatellite_0_SetEventStatus
          OpEventSetEventStatus_SetEventStatus_Event_IP_Display_IIC_communication_failure_Bus_Signal_Message_Failure: RteUsedOsEventRef=Rte_Ev_Run_DemSatellite_0_SetEventStatus
          OpEventSetEventStatus_SetEventStatus_Event_IP_Display_PRNDM_Telltale_failure_Internal_Electronic_Failure: RteUsedOsEventRef=Rte_Ev_Run_DemSatellite_0_SetEventStatus
          OpEventSetEventStatus_SetEventStatus_Event_Internal_DMS_CameraCircuitOpen: RteUsedOsEventRef=Rte_Ev_Run_DemSatellite_0_SetEventStatus
          OpEventSetEventStatus_SetEventStatus_Event_Internal_DMS_CameraShortToBattery: RteUsedOsEventRef=Rte_Ev_Run_DemSatellite_0_SetEventStatus
          OpEventSetEventStatus_SetEventStatus_Event_Internal_DMS_CameraShortToGround: RteUsedOsEventRef=Rte_Ev_Run_DemSatellite_0_SetEventStatus
          OpEventSetEventStatus_SetEventStatus_Event_Internal_DVR_CameraCircuitOpen: RteUsedOsEventRef=Rte_Ev_Run_DemSatellite_0_SetEventStatus
          OpEventSetEventStatus_SetEventStatus_Event_Internal_DVR_CameraShortToBattery: RteUsedOsEventRef=Rte_Ev_Run_DemSatellite_0_SetEventStatus
          OpEventSetEventStatus_SetEventStatus_Event_Internal_DVR_CameraShortToGround: RteUsedOsEventRef=Rte_Ev_Run_DemSatellite_0_SetEventStatus
          OpEventSetEventStatus_SetEventStatus_Event_Internal_OMS_CameraCircuitOpen: RteUsedOsEventRef=Rte_Ev_Run_DemSatellite_0_SetEventStatus
          OpEventSetEventStatus_SetEventStatus_Event_Internal_OMS_CameraShortToBattery: RteUsedOsEventRef=Rte_Ev_Run_DemSatellite_0_SetEventStatus
          OpEventSetEventStatus_SetEventStatus_Event_Internal_OMS_CameraShortToGround: RteUsedOsEventRef=Rte_Ev_Run_DemSatellite_0_SetEventStatus
          OpEventSetEventStatus_SetEventStatus_Event_LostComWithAVMFrontCamera: RteUsedOsEventRef=Rte_Ev_Run_DemSatellite_0_SetEventStatus
          OpEventSetEventStatus_SetEventStatus_Event_LostComWithAVMLeftCamera: RteUsedOsEventRef=Rte_Ev_Run_DemSatellite_0_SetEventStatus
          OpEventSetEventStatus_SetEventStatus_Event_LostComWithAVMRearCamera: RteUsedOsEventRef=Rte_Ev_Run_DemSatellite_0_SetEventStatus
          OpEventSetEventStatus_SetEventStatus_Event_LostComWithAVMRightCamera: RteUsedOsEventRef=Rte_Ev_Run_DemSatellite_0_SetEventStatus
          OpEventSetEventStatus_SetEventStatus_Event_Lost_Communication_With_Depth_Of_Water_Detection_Module: RteUsedOsEventRef=Rte_Ev_Run_DemSatellite_0_SetEventStatus
          OpEventSetEventStatus_SetEventStatus_Event_Lost_TCP_communication_Missing_Message: RteUsedOsEventRef=Rte_Ev_Run_DemSatellite_0_SetEventStatus
          OpEventSetEventStatus_SetEventStatus_Event_Lost_communication_with_AVM_Missing_Message: RteUsedOsEventRef=Rte_Ev_Run_DemSatellite_0_SetEventStatus
          OpEventSetEventStatus_SetEventStatus_Event_Lost_communication_with_ConsoleDisplay: RteUsedOsEventRef=Rte_Ev_Run_DemSatellite_0_SetEventStatus
          OpEventSetEventStatus_SetEventStatus_Event_Lost_communication_with_DMS: RteUsedOsEventRef=Rte_Ev_Run_DemSatellite_0_SetEventStatus
          OpEventSetEventStatus_SetEventStatus_Event_Lost_communication_with_DVR: RteUsedOsEventRef=Rte_Ev_Run_DemSatellite_0_SetEventStatus
          OpEventSetEventStatus_SetEventStatus_Event_Lost_communication_with_IP_Display_Front_Missing_Message: RteUsedOsEventRef=Rte_Ev_Run_DemSatellite_0_SetEventStatus
          OpEventSetEventStatus_SetEventStatus_Event_Lost_communication_with_IVI_Display_Front_Missing_Message: RteUsedOsEventRef=Rte_Ev_Run_DemSatellite_0_SetEventStatus
          OpEventSetEventStatus_SetEventStatus_Event_Lost_communication_with_InCarCamera: RteUsedOsEventRef=Rte_Ev_Run_DemSatellite_0_SetEventStatus
          OpEventSetEventStatus_SetEventStatus_Event_Lost_communication_with_PassengerDisplay: RteUsedOsEventRef=Rte_Ev_Run_DemSatellite_0_SetEventStatus
          OpEventSetEventStatus_SetEventStatus_Event_Lost_communication_with_RVC_Missing_Message: RteUsedOsEventRef=Rte_Ev_Run_DemSatellite_0_SetEventStatus
          OpEventSetEventStatus_SetEventStatus_Event_Lost_communication_with_SVC_Missing_Message: RteUsedOsEventRef=Rte_Ev_Run_DemSatellite_0_SetEventStatus
          OpEventSetEventStatus_SetEventStatus_Event_Lost_communication_with_W_HUD_Missing_Message: RteUsedOsEventRef=Rte_Ev_Run_DemSatellite_0_SetEventStatus
          OpEventSetEventStatus_SetEventStatus_Event_Mic_1_open_Circuit_Open: RteUsedOsEventRef=Rte_Ev_Run_DemSatellite_0_SetEventStatus
          OpEventSetEventStatus_SetEventStatus_Event_Mic_1_short_to_BAT_Circuit_Short_To_Battery: RteUsedOsEventRef=Rte_Ev_Run_DemSatellite_0_SetEventStatus
          OpEventSetEventStatus_SetEventStatus_Event_Mic_1_short_to_GND_Circuit_Short_To_Ground: RteUsedOsEventRef=Rte_Ev_Run_DemSatellite_0_SetEventStatus
          OpEventSetEventStatus_SetEventStatus_Event_Mic_2_open_Circuit_Open: RteUsedOsEventRef=Rte_Ev_Run_DemSatellite_0_SetEventStatus
          OpEventSetEventStatus_SetEventStatus_Event_Mic_2_short_to_BAT_Circuit_Short_To_Battery: RteUsedOsEventRef=Rte_Ev_Run_DemSatellite_0_SetEventStatus
          OpEventSetEventStatus_SetEventStatus_Event_Mic_2_short_to_GND_Circuit_Short_To_Ground: RteUsedOsEventRef=Rte_Ev_Run_DemSatellite_0_SetEventStatus
          OpEventSetEventStatus_SetEventStatus_Event_MissingBattery_Management_System: RteUsedOsEventRef=Rte_Ev_Run_DemSatellite_0_SetEventStatus
          OpEventSetEventStatus_SetEventStatus_Event_Missing_AC_Air_Condition_Rear_Front_Control_panel_Missing_Message: RteUsedOsEventRef=Rte_Ev_Run_DemSatellite_0_SetEventStatus
          OpEventSetEventStatus_SetEventStatus_Event_Missing_Airbag_Module_Missing_Message: RteUsedOsEventRef=Rte_Ev_Run_DemSatellite_0_SetEventStatus
          OpEventSetEventStatus_SetEventStatus_Event_Missing_Around_View_Monitoring_system_Highly_Automatic_Parking_Integration_P_d74a9aa2: RteUsedOsEventRef=Rte_Ev_Run_DemSatellite_0_SetEventStatus
          OpEventSetEventStatus_SetEventStatus_Event_Missing_Combination_Switch_Assembly_Missing_Message: RteUsedOsEventRef=Rte_Ev_Run_DemSatellite_0_SetEventStatus
          OpEventSetEventStatus_SetEventStatus_Event_Missing_Controler_Headlamp_Missing_Message: RteUsedOsEventRef=Rte_Ev_Run_DemSatellite_0_SetEventStatus
          OpEventSetEventStatus_SetEventStatus_Event_Missing_Controller_Pedal_Missing_Message: RteUsedOsEventRef=Rte_Ev_Run_DemSatellite_0_SetEventStatus
          OpEventSetEventStatus_SetEventStatus_Event_Missing_Driver_Door_Control_Module_Missing_Message: RteUsedOsEventRef=Rte_Ev_Run_DemSatellite_0_SetEventStatus
          OpEventSetEventStatus_SetEventStatus_Event_Missing_Driver_Seat_Memory_module: RteUsedOsEventRef=Rte_Ev_Run_DemSatellite_0_SetEventStatus
          OpEventSetEventStatus_SetEventStatus_Event_Missing_Elec_Region_Control_System_Body_Missing_Message: RteUsedOsEventRef=Rte_Ev_Run_DemSatellite_0_SetEventStatus
          OpEventSetEventStatus_SetEventStatus_Event_Missing_Electric_Park_Brake_controller: RteUsedOsEventRef=Rte_Ev_Run_DemSatellite_0_SetEventStatus
          OpEventSetEventStatus_SetEventStatus_Event_Missing_Electric_Power_Steering_system_Missing_Message: RteUsedOsEventRef=Rte_Ev_Run_DemSatellite_0_SetEventStatus
          OpEventSetEventStatus_SetEventStatus_Event_Missing_Electrical_Stable_Program_Antilock_Brake_System_Missing_Message: RteUsedOsEventRef=Rte_Ev_Run_DemSatellite_0_SetEventStatus
          OpEventSetEventStatus_SetEventStatus_Event_Missing_Electronic_Gerodisc_Missing_Message: RteUsedOsEventRef=Rte_Ev_Run_DemSatellite_0_SetEventStatus
          OpEventSetEventStatus_SetEventStatus_Event_Missing_Engine_Control_Module_Missing_Message: RteUsedOsEventRef=Rte_Ev_Run_DemSatellite_0_SetEventStatus
          OpEventSetEventStatus_SetEventStatus_Event_Missing_Front_Power_Box_Missing_Message: RteUsedOsEventRef=Rte_Ev_Run_DemSatellite_0_SetEventStatus
          OpEventSetEventStatus_SetEventStatus_Event_Missing_Gateway_Missing_Message: RteUsedOsEventRef=Rte_Ev_Run_DemSatellite_0_SetEventStatus
          OpEventSetEventStatus_SetEventStatus_Event_Missing_Head_Up_Display_Augmented_Reality_Head_Up_Display_Missing_Message: RteUsedOsEventRef=Rte_Ev_Run_DemSatellite_0_SetEventStatus
          OpEventSetEventStatus_SetEventStatus_Event_Missing_Hybrid_Vehicle_Control_Unit_Vehicle_control_unit_HCCAN: RteUsedOsEventRef=Rte_Ev_Run_DemSatellite_0_SetEventStatus
          OpEventSetEventStatus_SetEventStatus_Event_Missing_Hybrid_Vehicle_Control_Unit_Vehicle_control_unit_PTCAN: RteUsedOsEventRef=Rte_Ev_Run_DemSatellite_0_SetEventStatus
          OpEventSetEventStatus_SetEventStatus_Event_Missing_Ibooster: RteUsedOsEventRef=Rte_Ev_Run_DemSatellite_0_SetEventStatus
          OpEventSetEventStatus_SetEventStatus_Event_Missing_Intelligent_Driving_Controller_Level2: RteUsedOsEventRef=Rte_Ev_Run_DemSatellite_0_SetEventStatus
          OpEventSetEventStatus_SetEventStatus_Event_Missing_Nextrac_Torque_On_Demand_Missing_Message: RteUsedOsEventRef=Rte_Ev_Run_DemSatellite_0_SetEventStatus
          OpEventSetEventStatus_SetEventStatus_Event_Missing_Onboard_charger: RteUsedOsEventRef=Rte_Ev_Run_DemSatellite_0_SetEventStatus
          OpEventSetEventStatus_SetEventStatus_Event_Missing_Power_Lift_Gate_module: RteUsedOsEventRef=Rte_Ev_Run_DemSatellite_0_SetEventStatus
          OpEventSetEventStatus_SetEventStatus_Event_Missing_PrePretensioner_Mechatronic_Integrated: RteUsedOsEventRef=Rte_Ev_Run_DemSatellite_0_SetEventStatus
          OpEventSetEventStatus_SetEventStatus_Event_Missing_Rear_Heat_Vent_Seat_Module: RteUsedOsEventRef=Rte_Ev_Run_DemSatellite_0_SetEventStatus
          OpEventSetEventStatus_SetEventStatus_Event_Missing_Rear_Power_Box_Missing_Message: RteUsedOsEventRef=Rte_Ev_Run_DemSatellite_0_SetEventStatus
          OpEventSetEventStatus_SetEventStatus_Event_Missing_Right_Headlamp_Control_Module: RteUsedOsEventRef=Rte_Ev_Run_DemSatellite_0_SetEventStatus
          OpEventSetEventStatus_SetEventStatus_Event_Missing_Screen_touch_button_switch_controller_Missing_Message: RteUsedOsEventRef=Rte_Ev_Run_DemSatellite_0_SetEventStatus
          OpEventSetEventStatus_SetEventStatus_Event_Missing_Seat_Control_Module: RteUsedOsEventRef=Rte_Ev_Run_DemSatellite_0_SetEventStatus
          OpEventSetEventStatus_SetEventStatus_Event_Missing_Transmission_Control_Until_PTCAN_Missing_Message: RteUsedOsEventRef=Rte_Ev_Run_DemSatellite_0_SetEventStatus
          OpEventSetEventStatus_SetEventStatus_Event_Missing_Wireless_Power_Charger_Missing_Message: RteUsedOsEventRef=Rte_Ev_Run_DemSatellite_0_SetEventStatus
          OpEventSetEventStatus_SetEventStatus_Event_Over_voltage_Circuit_Voltage_Above_Threshold: RteUsedOsEventRef=Rte_Ev_Run_DemSatellite_0_SetEventStatus
          OpEventSetEventStatus_SetEventStatus_Event_RVC_CamerShortToBattery: RteUsedOsEventRef=Rte_Ev_Run_DemSatellite_0_SetEventStatus
          OpEventSetEventStatus_SetEventStatus_Event_RVC_CameraOpenCircuit: RteUsedOsEventRef=Rte_Ev_Run_DemSatellite_0_SetEventStatus
          OpEventSetEventStatus_SetEventStatus_Event_RVC_CameraShortToGround: RteUsedOsEventRef=Rte_Ev_Run_DemSatellite_0_SetEventStatus
          OpEventSetEventStatus_SetEventStatus_Event_Read_CPScreen_IDFailed: RteUsedOsEventRef=Rte_Ev_Run_DemSatellite_0_SetEventStatus
          OpEventSetEventStatus_SetEventStatus_Event_Read_ClusterScreenIDFailed: RteUsedOsEventRef=Rte_Ev_Run_DemSatellite_0_SetEventStatus
          OpEventSetEventStatus_SetEventStatus_Event_Read_CoDriverScreenIDFailed: RteUsedOsEventRef=Rte_Ev_Run_DemSatellite_0_SetEventStatus
          OpEventSetEventStatus_SetEventStatus_Event_Read_HUDScreen_IDFailed: RteUsedOsEventRef=Rte_Ev_Run_DemSatellite_0_SetEventStatus
          OpEventSetEventStatus_SetEventStatus_Event_Read_IVIScreen_IDFailed: RteUsedOsEventRef=Rte_Ev_Run_DemSatellite_0_SetEventStatus
          OpEventSetEventStatus_SetEventStatus_Event_SVC_CameraOpen: RteUsedOsEventRef=Rte_Ev_Run_DemSatellite_0_SetEventStatus
          OpEventSetEventStatus_SetEventStatus_Event_SVC_CameraShortToBattery: RteUsedOsEventRef=Rte_Ev_Run_DemSatellite_0_SetEventStatus
          OpEventSetEventStatus_SetEventStatus_Event_SVC_CameraShortToGround: RteUsedOsEventRef=Rte_Ev_Run_DemSatellite_0_SetEventStatus
          OpEventSetEventStatus_SetEventStatus_Event_ScreenCPDriverErr: RteUsedOsEventRef=Rte_Ev_Run_DemSatellite_0_SetEventStatus
          OpEventSetEventStatus_SetEventStatus_Event_ScreenClusterDriverErr: RteUsedOsEventRef=Rte_Ev_Run_DemSatellite_0_SetEventStatus
          OpEventSetEventStatus_SetEventStatus_Event_ScreenCoDriverErr: RteUsedOsEventRef=Rte_Ev_Run_DemSatellite_0_SetEventStatus
          OpEventSetEventStatus_SetEventStatus_Event_ScreenHUDDriverErr: RteUsedOsEventRef=Rte_Ev_Run_DemSatellite_0_SetEventStatus
          OpEventSetEventStatus_SetEventStatus_Event_ScreenIVIDriverErr: RteUsedOsEventRef=Rte_Ev_Run_DemSatellite_0_SetEventStatus
          OpEventSetEventStatus_SetEventStatus_Event_SecOC_FV_synchronization_authentication_message_failed_ISO_SAE_Reserved: RteUsedOsEventRef=Rte_Ev_Run_DemSatellite_0_SetEventStatus
          OpEventSetEventStatus_SetEventStatus_Event_SecOC_GWSecOcFailure: RteUsedOsEventRef=Rte_Ev_Run_DemSatellite_0_SetEventStatus
          OpEventSetEventStatus_SetEventStatus_Event_SecOC_Security_PDU_Verification_Failed_from_ESP: RteUsedOsEventRef=Rte_Ev_Run_DemSatellite_0_SetEventStatus
          OpEventSetEventStatus_SetEventStatus_Event_SecOC_Security_PDU_Verification_Failed_from_IDC_L2: RteUsedOsEventRef=Rte_Ev_Run_DemSatellite_0_SetEventStatus
          OpEventSetEventStatus_SetEventStatus_Event_SecOC_Security_PDU_Verification_Failed_from_IDC_L3: RteUsedOsEventRef=Rte_Ev_Run_DemSatellite_0_SetEventStatus
          OpEventSetEventStatus_SetEventStatus_Event_SecOC_Security_PDU_Verification_Failed_from_IFC: RteUsedOsEventRef=Rte_Ev_Run_DemSatellite_0_SetEventStatus
          OpEventSetEventStatus_SetEventStatus_Event_SecOC_Security_PDU_Verification_Failed_from_TCU: RteUsedOsEventRef=Rte_Ev_Run_DemSatellite_0_SetEventStatus
          OpEventSetEventStatus_SetEventStatus_Event_SecOC_TBoxSecOcFailure: RteUsedOsEventRef=Rte_Ev_Run_DemSatellite_0_SetEventStatus
          OpEventSetEventStatus_SetEventStatus_Event_SecOC_key_storage_exception_Calibration_Parameter_Memory_Failure: RteUsedOsEventRef=Rte_Ev_Run_DemSatellite_0_SetEventStatus
          OpEventSetEventStatus_SetEventStatus_Event_Speaker_AVAS_CircuitOpen: RteUsedOsEventRef=Rte_Ev_Run_DemSatellite_0_SetEventStatus
          OpEventSetEventStatus_SetEventStatus_Event_Speaker_AVAS_ResistanceOutOfRange: RteUsedOsEventRef=Rte_Ev_Run_DemSatellite_0_SetEventStatus
          OpEventSetEventStatus_SetEventStatus_Event_Speaker_AVAS_ShortAcross: RteUsedOsEventRef=Rte_Ev_Run_DemSatellite_0_SetEventStatus
          OpEventSetEventStatus_SetEventStatus_Event_Speaker_AVAS_ShortToBattery: RteUsedOsEventRef=Rte_Ev_Run_DemSatellite_0_SetEventStatus
          OpEventSetEventStatus_SetEventStatus_Event_Speaker_AVAS_ShortToGround: RteUsedOsEventRef=Rte_Ev_Run_DemSatellite_0_SetEventStatus
          OpEventSetEventStatus_SetEventStatus_Event_Speaker_AVAS_WaveformLackFidelity: RteUsedOsEventRef=Rte_Ev_Run_DemSatellite_0_SetEventStatus
          OpEventSetEventStatus_SetEventStatus_Event_Speaker_Center_open_Circuit_Open: RteUsedOsEventRef=Rte_Ev_Run_DemSatellite_0_SetEventStatus
          OpEventSetEventStatus_SetEventStatus_Event_Speaker_Center_output_waveform_lack_fidelity_Signal_Shape_Waveform_Failure: RteUsedOsEventRef=Rte_Ev_Run_DemSatellite_0_SetEventStatus
          OpEventSetEventStatus_SetEventStatus_Event_Speaker_Center_resistance_out_of_range_Circuit_Resistance_Out_of_Range: RteUsedOsEventRef=Rte_Ev_Run_DemSatellite_0_SetEventStatus
          OpEventSetEventStatus_SetEventStatus_Event_Speaker_Center_short_across_General_Electrical_Failure: RteUsedOsEventRef=Rte_Ev_Run_DemSatellite_0_SetEventStatus
          OpEventSetEventStatus_SetEventStatus_Event_Speaker_Center_short_to_battery_Circuit_Short_To_Battery: RteUsedOsEventRef=Rte_Ev_Run_DemSatellite_0_SetEventStatus
          OpEventSetEventStatus_SetEventStatus_Event_Speaker_Center_short_to_ground_Circuit_Short_To_Ground: RteUsedOsEventRef=Rte_Ev_Run_DemSatellite_0_SetEventStatus
          OpEventSetEventStatus_SetEventStatus_Event_Speaker_FL_open_Circuit_Open: RteUsedOsEventRef=Rte_Ev_Run_DemSatellite_0_SetEventStatus
          OpEventSetEventStatus_SetEventStatus_Event_Speaker_FL_output_waveform_lack_fidelity_Signal_Shape_Waveform_Failure: RteUsedOsEventRef=Rte_Ev_Run_DemSatellite_0_SetEventStatus
          OpEventSetEventStatus_SetEventStatus_Event_Speaker_FL_resistance_out_of_range_Circuit_Resistance_Out_of_Range: RteUsedOsEventRef=Rte_Ev_Run_DemSatellite_0_SetEventStatus
          OpEventSetEventStatus_SetEventStatus_Event_Speaker_FL_short_across_General_Electrical_Failure: RteUsedOsEventRef=Rte_Ev_Run_DemSatellite_0_SetEventStatus
          OpEventSetEventStatus_SetEventStatus_Event_Speaker_FL_short_to_battery_Circuit_Short_To_Battery: RteUsedOsEventRef=Rte_Ev_Run_DemSatellite_0_SetEventStatus
          OpEventSetEventStatus_SetEventStatus_Event_Speaker_FL_short_to_ground_Circuit_Short_To_Ground: RteUsedOsEventRef=Rte_Ev_Run_DemSatellite_0_SetEventStatus
          OpEventSetEventStatus_SetEventStatus_Event_Speaker_FR_open_Circuit_Open: RteUsedOsEventRef=Rte_Ev_Run_DemSatellite_0_SetEventStatus
          OpEventSetEventStatus_SetEventStatus_Event_Speaker_FR_output_waveform_lack_fidelity_Signal_Shape_Waveform_Failure: RteUsedOsEventRef=Rte_Ev_Run_DemSatellite_0_SetEventStatus
          OpEventSetEventStatus_SetEventStatus_Event_Speaker_FR_resistance_out_of_range_Circuit_Resistance_Out_of_Range: RteUsedOsEventRef=Rte_Ev_Run_DemSatellite_0_SetEventStatus
          OpEventSetEventStatus_SetEventStatus_Event_Speaker_FR_short_across_General_Electrical_Failure: RteUsedOsEventRef=Rte_Ev_Run_DemSatellite_0_SetEventStatus
          OpEventSetEventStatus_SetEventStatus_Event_Speaker_FR_short_to_battery_Circuit_Short_To_Battery: RteUsedOsEventRef=Rte_Ev_Run_DemSatellite_0_SetEventStatus
          OpEventSetEventStatus_SetEventStatus_Event_Speaker_FR_short_to_ground_Circuit_Short_To_Ground: RteUsedOsEventRef=Rte_Ev_Run_DemSatellite_0_SetEventStatus
          OpEventSetEventStatus_SetEventStatus_Event_Speaker_RL_open_Circuit_Open: RteUsedOsEventRef=Rte_Ev_Run_DemSatellite_0_SetEventStatus
          OpEventSetEventStatus_SetEventStatus_Event_Speaker_RL_output_waveform_lack_fidelity_Signal_Shape_Waveform_Failure: RteUsedOsEventRef=Rte_Ev_Run_DemSatellite_0_SetEventStatus
          OpEventSetEventStatus_SetEventStatus_Event_Speaker_RL_resistance_out_of_range_Circuit_Resistance_Out_of_Range: RteUsedOsEventRef=Rte_Ev_Run_DemSatellite_0_SetEventStatus
          OpEventSetEventStatus_SetEventStatus_Event_Speaker_RL_short_across_General_Electrical_Failure: RteUsedOsEventRef=Rte_Ev_Run_DemSatellite_0_SetEventStatus
          OpEventSetEventStatus_SetEventStatus_Event_Speaker_RL_short_to_battery_Circuit_Short_To_Battery: RteUsedOsEventRef=Rte_Ev_Run_DemSatellite_0_SetEventStatus
          OpEventSetEventStatus_SetEventStatus_Event_Speaker_RL_short_to_ground_Circuit_Short_To_Ground: RteUsedOsEventRef=Rte_Ev_Run_DemSatellite_0_SetEventStatus
          OpEventSetEventStatus_SetEventStatus_Event_Speaker_RR_open_Circuit_Open: RteUsedOsEventRef=Rte_Ev_Run_DemSatellite_0_SetEventStatus
          OpEventSetEventStatus_SetEventStatus_Event_Speaker_RR_output_waveform_lack_fidelity_Signal_Shape_Waveform_Failure: RteUsedOsEventRef=Rte_Ev_Run_DemSatellite_0_SetEventStatus
          OpEventSetEventStatus_SetEventStatus_Event_Speaker_RR_resistance_out_of_range_Circuit_Resistance_Out_of_Range: RteUsedOsEventRef=Rte_Ev_Run_DemSatellite_0_SetEventStatus
          OpEventSetEventStatus_SetEventStatus_Event_Speaker_RR_short_across_General_Electrical_Failure: RteUsedOsEventRef=Rte_Ev_Run_DemSatellite_0_SetEventStatus
          OpEventSetEventStatus_SetEventStatus_Event_Speaker_RR_short_to_battery_Circuit_Short_To_Battery: RteUsedOsEventRef=Rte_Ev_Run_DemSatellite_0_SetEventStatus
          OpEventSetEventStatus_SetEventStatus_Event_Speaker_RR_short_to_ground_Circuit_Short_To_Ground: RteUsedOsEventRef=Rte_Ev_Run_DemSatellite_0_SetEventStatus
          OpEventSetEventStatus_SetEventStatus_Event_Speaker_Woofer_open_Circuit_Open: RteUsedOsEventRef=Rte_Ev_Run_DemSatellite_0_SetEventStatus
          OpEventSetEventStatus_SetEventStatus_Event_Speaker_Woofer_output_waveform_lack_fidelity_Signal_Shape_Waveform_Failure: RteUsedOsEventRef=Rte_Ev_Run_DemSatellite_0_SetEventStatus
          OpEventSetEventStatus_SetEventStatus_Event_Speaker_Woofer_resistance_out_of_range_Circuit_Resistance_Out_of_Range: RteUsedOsEventRef=Rte_Ev_Run_DemSatellite_0_SetEventStatus
          OpEventSetEventStatus_SetEventStatus_Event_Speaker_Woofer_short_across_General_Electrical_Failure: RteUsedOsEventRef=Rte_Ev_Run_DemSatellite_0_SetEventStatus
          OpEventSetEventStatus_SetEventStatus_Event_Speaker_Woofer_short_to_battery_Circuit_Short_To_Battery: RteUsedOsEventRef=Rte_Ev_Run_DemSatellite_0_SetEventStatus
          OpEventSetEventStatus_SetEventStatus_Event_Speaker_Woofer_short_to_ground_Circuit_Short_To_Ground: RteUsedOsEventRef=Rte_Ev_Run_DemSatellite_0_SetEventStatus
          OpEventSetEventStatus_SetEventStatus_Event_Synchronization_counter_data_NVM_erasure_failed_Calibration_Parameter_Memory_Failure: RteUsedOsEventRef=Rte_Ev_Run_DemSatellite_0_SetEventStatus
          OpEventSetEventStatus_SetEventStatus_Event_TUNER_FM1_open_Circuit_Open: RteUsedOsEventRef=Rte_Ev_Run_DemSatellite_0_SetEventStatus
          OpEventSetEventStatus_SetEventStatus_Event_TUNER_FM1_over_current_detection_Circuit_Current_Above_Threshold: RteUsedOsEventRef=Rte_Ev_Run_DemSatellite_0_SetEventStatus
          OpEventSetEventStatus_SetEventStatus_Event_TUNER_FM1_short_to_battary_Circuit_Short_To_Battery: RteUsedOsEventRef=Rte_Ev_Run_DemSatellite_0_SetEventStatus
          OpEventSetEventStatus_SetEventStatus_Event_TUNER_FM1_short_to_groud_Circuit_Short_To_Ground: RteUsedOsEventRef=Rte_Ev_Run_DemSatellite_0_SetEventStatus
          OpEventSetEventStatus_SetEventStatus_Event_TUNER_FM2_open_Circuit_Open: RteUsedOsEventRef=Rte_Ev_Run_DemSatellite_0_SetEventStatus
          OpEventSetEventStatus_SetEventStatus_Event_TUNER_FM2_over_current_detection_Circuit_Current_Above_Threshold: RteUsedOsEventRef=Rte_Ev_Run_DemSatellite_0_SetEventStatus
          OpEventSetEventStatus_SetEventStatus_Event_TUNER_FM2_short_to_battary_Circuit_Short_To_Battery: RteUsedOsEventRef=Rte_Ev_Run_DemSatellite_0_SetEventStatus
          OpEventSetEventStatus_SetEventStatus_Event_TUNER_FM2_short_to_groud_Circuit_Short_To_Ground: RteUsedOsEventRef=Rte_Ev_Run_DemSatellite_0_SetEventStatus
          OpEventSetEventStatus_SetEventStatus_Event_Temperature_SensorError: RteUsedOsEventRef=Rte_Ev_Run_DemSatellite_0_SetEventStatus
          OpEventSetEventStatus_SetEventStatus_Event_Under_voltage_Circuit_Voltage_Below_Threshold: RteUsedOsEventRef=Rte_Ev_Run_DemSatellite_0_SetEventStatus
          OpEventSetEventStatus_SetEventStatus_Event_missing_Adaptive_Cruise_Control_system_Radar_Control_Module: RteUsedOsEventRef=Rte_Ev_Run_DemSatellite_0_SetEventStatus
          OpEventSetEventStatus_SetEventStatus_Event_missing_Driver_Monitoring_System_Missing_Message: RteUsedOsEventRef=Rte_Ev_Run_DemSatellite_0_SetEventStatus
          OpEventSetEventStatus_SetEventStatus_Event_missing_Intelligent_Forward_View_Camera_Lane_Detection_Warning_system_Intell_0ff374a9: RteUsedOsEventRef=Rte_Ev_Run_DemSatellite_0_SetEventStatus
          OpEventSetEventStatus_SetEventStatus_Event_missing_Parking_Assistance_System_Missing_Message: RteUsedOsEventRef=Rte_Ev_Run_DemSatellite_0_SetEventStatus
          OpEventSetEventStatus_SetEventStatus_Event_missing_Passenger_Door_Control_Module_Missing_Message: RteUsedOsEventRef=Rte_Ev_Run_DemSatellite_0_SetEventStatus
          OpEventSetEventStatus_SetEventStatus_Event_missing_Right_Corner_Radar: RteUsedOsEventRef=Rte_Ev_Run_DemSatellite_0_SetEventStatus
          OpEventSetEventStatus_SetEventStatus_Event_missing_Right_Rear_Side_Detection_System_Missing_Message: RteUsedOsEventRef=Rte_Ev_Run_DemSatellite_0_SetEventStatus
          OpEventSetEventStatus_SetEventStatus_Event_missing_Telematics_control_Box_Missing_Message: RteUsedOsEventRef=Rte_Ev_Run_DemSatellite_0_SetEventStatus
          OpEventSetEventStatus_SetEventStatus_Event_missing_Trailer_Missing_Message: RteUsedOsEventRef=Rte_Ev_Run_DemSatellite_0_SetEventStatus
          OpEventSetEventStatus_SetEventStatus_Event_missing_Tyre_Pressure_Monitoring_Systems_Missing_Message: RteUsedOsEventRef=Rte_Ev_Run_DemSatellite_0_SetEventStatus
      Det_EcuSwComposition
      DidDataProcess_EcuSwComposition
        5 x RteEventToTaskMapping:
          TMT_DidDataProcess_MainFunction: RteUsedOsEventRef=Rte_Ev_Cyclic_SWC_LOW_0_10ms, RteUsedOsAlarmRef=Os/Rte_Al_TE_SWC_LOW_0_10ms
          OIT_ppCS_E2ESwitchStatusRead_Operation_ppCS_E2ESwitchStatusRead_Operation: RteUsedOsEventRef=Rte_Ev_Run_DidDataProcess_E2ESwitchStatusRead
          OIT_ppCS_E2ESwitchStatusWrite_Operation_ppCS_E2ESwitchStatusWrite_Operation: RteUsedOsEventRef=Rte_Ev_Run_DidDataProcess_E2ESwitchStatusWrite
          OIT_ppCS_SecOcSwitchStatusRead_Operation_ppCS_SecOcSwitchStatusRead_Operation: RteUsedOsEventRef=Rte_Ev_Run_DidDataProcess_SecOcSwitchStatusRead
          OIT_ppCS_SecOcSwitchStatusWrite_Operation_ppCS_SecOcSwitchStatusWrite_Operation: RteUsedOsEventRef=Rte_Ev_Run_DidDataProcess_SecOcSwitchStatusWrite
        9 x RteNvRamAllocation:
          NvmBlock_DidDataProcess_NvBlockNeed_ClusterDisplayHMIAdjustmentOffset: RteNvmRamBlockLocationSymbol=Rte_DidDataProcess_NvBlockNeed_ClusterDisplayHMIAdjustmentOffset_MirrorBlock, RteNvmRomBlockLocationSymbol=Rte_DidDataProcess_NvBlockNeed_ClusterDisplayHMIAdjustmentOffset_DefaultValue, RteNvmBlockRef=DidDataProcessNvBlockNeed_ClusterDisplayHMIAdjustmentOffset
          NvmBlock_DidDataProcess_NvBlockNeed_001: RteNvmRamBlockLocationSymbol=Rte_DidDataProcess_NvBlockNeed_ClusterInternalConfiguration_MirrorBlock, RteNvmRomBlockLocationSymbol=Rte_DidDataProcess_NvBlockNeed_ClusterInternalConfiguration_DefaultValue, RteNvmBlockRef=DidDataProcessNvBlockNeed_ClusterInternalConfiguration
          NvmBlock_DidDataProcess_NvBlockNeed_E2ESwitch: RteNvmRamBlockLocationSymbol=Rte_DidDataProcess_NvBlockNeed_E2ESwitch_MirrorBlock, RteNvmRomBlockLocationSymbol=Rte_DidDataProcess_NvBlockNeed_E2ESwitch_DefaultValue, RteNvmBlockRef=DidDataProcessNvBlockNeed_E2ESwitch
          NvmBlock_DidDataProcess_NvBlockNeed_ECUlevelNetworkConfigurationData: RteNvmRamBlockLocationSymbol=Rte_DidDataProcess_NvBlockNeed_ECUlevelNetworkConfigurationData_MirrorBlock, RteNvmRomBlockLocationSymbol=Rte_DidDataProcess_NvBlockNeed_ECUlevelNetworkConfigurationData_DefaultValue, RteNvmBlockRef=DidDataProcessNvBlockNeed_ECUlevelNetworkConfigurationData
          NvmBlock_DidDataProcess_NvBlockNeed_FactoryMode: RteNvmRamBlockLocationSymbol=Rte_DidDataProcess_NvBlockNeed_FactoryMode_MirrorBlock, RteNvmRomBlockLocationSymbol=Rte_DidDataProcess_NvBlockNeed_FactoryMode_DefaultValue, RteNvmBlockRef=DidDataProcessNvBlockNeed_FactoryMode
          NvmBlock_DidDataProcess_NvBlockNeed_SecOcSwitch: RteNvmRamBlockLocationSymbol=Rte_DidDataProcess_NvBlockNeed_SecOcSwitch_MirrorBlock, RteNvmRomBlockLocationSymbol=Rte_DidDataProcess_NvBlockNeed_SecOcSwitch_DefaultValue, RteNvmBlockRef=DidDataProcessNvBlockNeed_SecOcSwitch
          NvmBlock_DidDataProcess_NvBlockNeed: RteNvmRamBlockLocationSymbol=Rte_DidDataProcess_NvBlockNeed_VIN_MirrorBlock, RteNvmRomBlockLocationSymbol=Rte_DidDataProcess_NvBlockNeed_VIN_DefaultValue, RteNvmBlockRef=DidDataProcessNvBlockNeed_VIN
          NvmBlock_DidDataProcess_NvBlockNeed_VehicleMode: RteNvmRamBlockLocationSymbol=Rte_DidDataProcess_NvBlockNeed_VehicleMode_MirrorBlock, RteNvmRomBlockLocationSymbol=Rte_DidDataProcess_NvBlockNeed_VehicleMode_DefaultValue, RteNvmBlockRef=DidDataProcessNvBlockNeed_VehicleMode
          NvmBlock_DidDataProcess_NvBlockNeed_VehicleSoftwareVersion: RteNvmRamBlockLocationSymbol=Rte_DidDataProcess_NvBlockNeed_VehicleSoftwareVersion_MirrorBlock, RteNvmRomBlockLocationSymbol=Rte_DidDataProcess_NvBlockNeed_VehicleSoftwareVersion_DefaultValue, RteNvmBlockRef=DidDataProcessNvBlockNeed_VehicleSoftwareVersion
      EOL_EcuSwComposition
        TMT_EOL_MainFunction (RteEventToTaskMapping): RteUsedOsEventRef=Rte_Ev_Run_EOL_EOL_MainFunction, RteUsedOsAlarmRef=Os/Rte_Al_TE_EOL_EOL_MainFunction
        12 x RteNvRamAllocation:
          NvmBlock_EOL_NvBlockNeed_0xF187: RteNvmRamBlockLocationSymbol=Rte_EOL_NvBlockNeed_0xF187_MirrorBlock, RteNvmRomBlockLocationSymbol=Rte_EOL_NvBlockNeed_0xF187_DefaultValue, RteNvmBlockRef=EOL_NvBlockNeed_0xF187
          NvmBlock_EOL_NvBlockNeed_0xF18C: RteNvmRamBlockLocationSymbol=Rte_EOL_NvBlockNeed_0xF18C_MirrorBlock, RteNvmRomBlockLocationSymbol=Rte_EOL_NvBlockNeed_0xF18C_DefaultValue, RteNvmBlockRef=EOL_NvBlockNeed_0xF18C
          NvmBlock_EOL_NvBlockNeed_0xF193: RteNvmRamBlockLocationSymbol=Rte_EOL_NvBlockNeed_0xF193_MirrorBlock, RteNvmRomBlockLocationSymbol=Rte_EOL_NvBlockNeed_0xF193_DefaultValue, RteNvmBlockRef=EOL_NvBlockNeed_0xF193
          NvmBlock_EOL_NvBlockNeed_0xF195: RteNvmRamBlockLocationSymbol=Rte_EOL_NvBlockNeed_0xF195_MirrorBlock, RteNvmRomBlockLocationSymbol=Rte_EOL_NvBlockNeed_0xF195_DefaultValue, RteNvmBlockRef=EOL_NvBlockNeed_0xF195
          NvmBlock_EOL_NvBlockNeed_0xFD00: RteNvmRamBlockLocationSymbol=Rte_EOL_NvBlockNeed_0xFD00_MirrorBlock, RteNvmRomBlockLocationSymbol=Rte_EOL_NvBlockNeed_0xFD00_DefaultValue, RteNvmBlockRef=EOL_NvBlockNeed_0xFD00
          NvmBlock_EOL_NvBlockNeed_0xFD19: RteNvmRamBlockLocationSymbol=Rte_EOL_NvBlockNeed_0xFD19_MirrorBlock, RteNvmRomBlockLocationSymbol=Rte_EOL_NvBlockNeed_0xFD19_DefaultValue, RteNvmBlockRef=EOL_NvBlockNeed_0xFD19
          NvmBlock_EOL_NvBlockNeed_0xFE{20..25}: RteNvmRamBlockLocationSymbol=Rte_EOL_NvBlockNeed_0xFE{20..25}_MirrorBlock, RteNvmRomBlockLocationSymbol=Rte_EOL_NvBlockNeed_0xFE{20..25}_DefaultValue, RteNvmBlockRef=EOL_NvBlockNeed_0xFE{20..25}
      EcuM_EcuSwComposition
        Timer_EcuM_MainFunction (RteEventToTaskMapping): RteUsedOsEventRef=Rte_Ev_Cyclic2_Default_BSW_0_10ms, RteUsedOsAlarmRef=Os/Rte_Al_TE2_Default_BSW_0_10ms
      GNSS_EcuSwComposition
        TMT_GNSS_MainFunction (RteEventToTaskMapping): RteUsedOsEventRef=Rte_Ev_Cyclic_DRIVERS_SAFE_0_5ms, RteUsedOsAlarmRef=Os/Rte_Al_TE_DRIVERS_SAFE_0_5ms
      Gyro_EcuSwComposition
        TMT_Gyro_MainFunction (RteEventToTaskMapping): RteUsedOsEventRef=Rte_Ev_Run_Gyro_Gyro_MainFunction, RteUsedOsAlarmRef=Os/Rte_Al_TE_Gyro_Gyro_MainFunction
      HSM_EcuSwComposition
        4 x RteEventToTaskMapping:
          OIT_Runnable_1_HsmKeyM_GetAes128Key: RteUsedOsEventRef=Rte_Ev_Run_HSM_HsmGetAes128Key
          OIT_Runnable_HsmKeyM_SetAes128Key: RteUsedOsEventRef=Rte_Ev_Run_HSM_HsmSetAes128Key
          OIT_HsmTrngGenerate_Hsm_Port_TrngGenerate: RteUsedOsEventRef=Rte_Ev_Run_HSM_HsmTrngGenerate
          TMT_Hsm_MainFunction: RteUsedOsEventRef=Rte_Ev_Run_HSM_Hsm_MainFunction, RteUsedOsAlarmRef=Os/Rte_Al_TE_HSM_Hsm_MainFunction
      IIC_EcuSwComposition
        4 x RteEventToTaskMapping:
          DRT_IIC0_MainFunction_Rc_IIC0_Notify_Message_Message: RteUsedOsEventRef=Rte_Ev_Run_IIC_IIC0_MainFunction
          TMT_IIC0_MainFunction: RteUsedOsEventRef=Rte_Ev_Cyclic_DRIVERS_SAFE_0_5ms, RteUsedOsAlarmRef=Os/Rte_Al_TE_DRIVERS_SAFE_0_5ms
          DRT_IIC1_MainFunction_Rc_IIC1_Notify_Message_Message: RteUsedOsEventRef=Rte_Ev_Run_IIC_IIC1_MainFunction
          TMT_IIC1_MainFunction: RteUsedOsEventRef=Rte_Ev_Cyclic_DRIVERS_SAFE_0_5ms, RteUsedOsAlarmRef=Os/Rte_Al_TE_DRIVERS_SAFE_0_5ms
      IPC_EcuSwComposition
        3 x RteEventToTaskMapping:
          OIT_IPC_DataSend_If_Operation_IPC_DataSend_If_Operation: RteUsedOsEventRef=Rte_Ev_Run_IPC_IPC_DataSend_If_Operation
          TMT_IPC_MainFunction: RteUsedOsEventRef=Rte_Ev_Run_IPC_IPC_MainFunction, RteUsedOsAlarmRef=Os/Rte_Al_TE_IPC_IPC_MainFunction
          TMT_IPC_STB_MainFunction: RteUsedOsEventRef=Rte_Ev_Run_IPC_IPC_STB_MainFunction, RteUsedOsAlarmRef=Os/Rte_Al_TE_IPC_IPC_STB_MainFunction
      IoHwAb_EcuSwComposition
        3 x RteEventToTaskMapping:
          OIT_IoHwAb_Interface_GetPin_IoHwAb_Interface_GetPin: RteUsedOsEventRef=Rte_Ev_Run_IoHwAb_IoHwAb_GetPin
          OIT_IoHwAb_Interface_GetVoltage_IoHwAb_Interface_GetVoltage: RteUsedOsEventRef=Rte_Ev_Run_IoHwAb_IoHwAb_GetVoltage
          TMT_IoHwAb_MainFunction: RteUsedOsEventRef=Rte_Ev_Cyclic_SYS_0_5ms, RteUsedOsAlarmRef=Os/Rte_Al_TE_SYS_0_5ms
      KeyReturn_EcuSwComposition
        TMT_KeyReturn_MainFunction (RteEventToTaskMapping): RteUsedOsEventRef=Rte_Ev_Cyclic_SYS_0_10ms, RteUsedOsAlarmRef=Os/Rte_Al_TE_SYS_0_10ms
      Log_EcuSwComposition
        TMT_Log_MainFunction (RteEventToTaskMapping): RteUsedOsEventRef=Rte_Ev_Cyclic_DRIVERS_SAFE_0_50ms, RteUsedOsAlarmRef=Os/Rte_Al_TE_DRIVERS_SAFE_0_50ms
      Misc_EcuSwComposition
        5 x RteEventToTaskMapping:
          TMT_Misc_MainFunction: RteUsedOsEventRef=Rte_Ev_Cyclic_SYS_0_5ms, RteUsedOsAlarmRef=Os/Rte_Al_TE_SYS_0_5ms
          TMT_Misc_MainFunction_100ms: RteUsedOsEventRef=Rte_Ev_Cyclic_SYS_0_100ms, RteUsedOsAlarmRef=Os/Rte_Al_TE_SYS_0_100ms
          TMT_Misc_MainFunction_500ms: RteUsedOsEventRef=Rte_Ev_Run_Misc_Misc_MainFunction_500ms, RteUsedOsAlarmRef=Os/Rte_Al_TE_Misc_Misc_MainFunction_500ms
          TMT_Misc_MainFunction_50ms: RteUsedOsEventRef=Rte_Ev_Cyclic_SYS_0_50ms, RteUsedOsAlarmRef=Os/Rte_Al_TE_SYS_0_50ms
          TMT_NVM_Read_Speedup_Runnable: RteUsedOsEventRef=Rte_Ev_Run_Misc_NVM_Read_Speedup_Runnable, RteUsedOsAlarmRef=Os/Rte_Al_TE_Misc_NVM_Read_Speedup_Runnable
        NvmBlock_Misc_NvBlockNeed_ResetInfomation (RteNvRamAllocation):
          RteNvmRamBlockLocationSymbol = Rte_Misc_NvBlockNeed_ResetInfomation_MirrorBlock
          RteNvmRomBlockLocationSymbol = Rte_Misc_NvBlockNeed_ResetInfomation_DefaultValue
          RteNvmBlockRef = MiscNvBlockNeed_ResetInfomation
      NvM_EcuSwComposition
        42 x RteEventToTaskMapping:
          Timer_NvM_MainFunction: RteUsedOsEventRef=Rte_Ev_Cyclic2_Default_BSW_1_5ms, RteUsedOsAlarmRef=Os/Rte_Al_TE2_Default_BSW_1_5ms
          OpEventWriteBlock_WriteBlock_PS_AMP_NvBlockNeed_LC_Calibration: RteUsedOsEventRef=Rte_Ev_Run_NvM_WriteBlock
          OpEventWriteBlock_WriteBlock_PS_AMP_NvBlockNeed_LC_Calibration2: RteUsedOsEventRef=Rte_Ev_Run_NvM_WriteBlock
          OpEventWriteBlock_WriteBlock_PS_Can_ServerNvBlockNeed_AbnormalWakeupSleepRecords: RteUsedOsEventRef=Rte_Ev_Run_NvM_WriteBlock
          OpEventWriteBlock_WriteBlock_PS_Can_ServerNvBlockNeed_ActiveWUCounter: RteUsedOsEventRef=Rte_Ev_Run_NvM_WriteBlock
          OpEventWriteBlock_WriteBlock_PS_Common_GateWayNvBlockNeed_Block_IPC_CAN_Data: RteUsedOsEventRef=Rte_Ev_Run_NvM_WriteBlock
          OpEventWriteBlock_WriteBlock_PS_Common_GateWayNvBlockNeed_Block_IPC_Config_Data: RteUsedOsEventRef=Rte_Ev_Run_NvM_WriteBlock
          OpEventWriteBlock_WriteBlock_PS_Common_NormalNvBlockNeed_Block_MaintainOdo: RteUsedOsEventRef=Rte_Ev_Run_NvM_WriteBlock
          OpEventWriteBlock_WriteBlock_PS_Common_NormalNvBlockNeed_Block_ODO_{1..5}: RteUsedOsEventRef=Rte_Ev_Run_NvM_WriteBlock
          OpEventWriteBlock_WriteBlock_PS_Common_NormalNvBlockNeed_Block_Trip: RteUsedOsEventRef=Rte_Ev_Run_NvM_WriteBlock
          OpEventWriteBlock_WriteBlock_PS_Common_NormalNvBlockNeed_Menu: RteUsedOsEventRef=Rte_Ev_Run_NvM_WriteBlock
          OpEventWriteBlock_WriteBlock_PS_DCM_ServerNvBlockNeedSecAttemptCount: RteUsedOsEventRef=Rte_Ev_Run_NvM_WriteBlock
          OpEventWriteBlock_WriteBlock_PS_DCM_ServerNvBlockNeed_EOLUnlockCnt: RteUsedOsEventRef=Rte_Ev_Run_NvM_WriteBlock
          OpEventWriteBlock_WriteBlock_PS_DidDataProcessNvBlockNeed_ClusterDisplayHMIAdjustmentOffset: RteUsedOsEventRef=Rte_Ev_Run_NvM_WriteBlock
          OpEventWriteBlock_WriteBlock_PS_DidDataProcessNvBlockNeed_ClusterInternalConfiguration: RteUsedOsEventRef=Rte_Ev_Run_NvM_WriteBlock
          OpEventWriteBlock_WriteBlock_PS_DidDataProcessNvBlockNeed_E2ESwitch: RteUsedOsEventRef=Rte_Ev_Run_NvM_WriteBlock
          OpEventWriteBlock_WriteBlock_PS_DidDataProcessNvBlockNeed_ECUlevelNetworkConfigurationData: RteUsedOsEventRef=Rte_Ev_Run_NvM_WriteBlock
          OpEventWriteBlock_WriteBlock_PS_DidDataProcessNvBlockNeed_FactoryMode: RteUsedOsEventRef=Rte_Ev_Run_NvM_WriteBlock
          OpEventWriteBlock_WriteBlock_PS_DidDataProcessNvBlockNeed_SecOcSwitch: RteUsedOsEventRef=Rte_Ev_Run_NvM_WriteBlock
          OpEventWriteBlock_WriteBlock_PS_DidDataProcessNvBlockNeed_VIN: RteUsedOsEventRef=Rte_Ev_Run_NvM_WriteBlock
          OpEventWriteBlock_WriteBlock_PS_DidDataProcessNvBlockNeed_VehicleMode: RteUsedOsEventRef=Rte_Ev_Run_NvM_WriteBlock
          OpEventWriteBlock_WriteBlock_PS_DidDataProcessNvBlockNeed_VehicleSoftwareVersion: RteUsedOsEventRef=Rte_Ev_Run_NvM_WriteBlock
          OpEventWriteBlock_WriteBlock_PS_EOL_NvBlockNeed_0xF187: RteUsedOsEventRef=Rte_Ev_Run_NvM_WriteBlock
          OpEventWriteBlock_WriteBlock_PS_EOL_NvBlockNeed_0xF18C: RteUsedOsEventRef=Rte_Ev_Run_NvM_WriteBlock
          OpEventWriteBlock_WriteBlock_PS_EOL_NvBlockNeed_0xF193: RteUsedOsEventRef=Rte_Ev_Run_NvM_WriteBlock
          OpEventWriteBlock_WriteBlock_PS_EOL_NvBlockNeed_0xF195: RteUsedOsEventRef=Rte_Ev_Run_NvM_WriteBlock
          OpEventWriteBlock_WriteBlock_PS_EOL_NvBlockNeed_0xFD00: RteUsedOsEventRef=Rte_Ev_Run_NvM_WriteBlock
          OpEventWriteBlock_WriteBlock_PS_EOL_NvBlockNeed_0xFD19: RteUsedOsEventRef=Rte_Ev_Run_NvM_WriteBlock
          OpEventWriteBlock_WriteBlock_PS_EOL_NvBlockNeed_0xFE{20..25}: RteUsedOsEventRef=Rte_Ev_Run_NvM_WriteBlock
          OpEventWriteBlock_WriteBlock_PS_MiscNvBlockNeed_ResetInfomation: RteUsedOsEventRef=Rte_Ev_Run_NvM_WriteBlock
          OpEventWriteBlock_WriteBlock_PS_NvBlockNeed_UpgradeResetFlag: RteUsedOsEventRef=Rte_Ev_Run_NvM_WriteBlock
          OpEventWriteBlock_WriteBlock_PS_NvMBlockDescriptor_Fvm_TripCount: RteUsedOsEventRef=Rte_Ev_Run_NvM_WriteBlock
          OpEventWriteBlock_WriteBlock_PS_SOCManagerNvBlockNeed_HealthSwitch: RteUsedOsEventRef=Rte_Ev_Run_NvM_WriteBlock
      Os_OsCore0_swc_EcuSwComposition
        OpEventGetCounterValue_GetCounterValue_OsService_SystemTimer (RteEventToTaskMapping): RteUsedOsEventRef=Rte_Ev_Run_Os_OsCore0_swc_GetCounterValue
        OpEventGetElapsedValue_GetElapsedValue_OsService_SystemTimer (RteEventToTaskMapping): RteUsedOsEventRef=Rte_Ev_Run_Os_OsCore0_swc_GetElapsedValue
      SystemState_EcuSwComposition
        TMT_SystemState_MainFunction (RteEventToTaskMapping): RteUsedOsEventRef=Rte_Ev_Cyclic_SYS_0_5ms, RteUsedOsAlarmRef=Os/Rte_Al_TE_SYS_0_5ms
      RTC_EcuSwComposition
        4 x RteEventToTaskMapping:
          OIT_GetUTCTimeInMillis_Sv_RTC_GetUTCTimeInMillis: RteUsedOsEventRef=Rte_Ev_Run_RTC_GetUTCTimeInMillis
          TMT_RTC_CycleTask: RteUsedOsEventRef=Rte_Ev_Cyclic_DRIVERS_SAFE_0_100ms, RteUsedOsAlarmRef=Os/Rte_Al_TE_DRIVERS_SAFE_0_100ms
          TMT_RTC_MainFunction: RteUsedOsEventRef=Rte_Ev_Cyclic_DRIVERS_SAFE_0_100ms, RteUsedOsAlarmRef=Os/Rte_Al_TE_DRIVERS_SAFE_0_100ms
          OIT_UTC2PerpetualCalendar_Sv_RTC_UTC2PerpetualCalendar: RteUsedOsEventRef=Rte_Ev_Run_RTC_UTC2PerpetualCalendar
      SOCManager_EcuSwComposition
        TMT_SOCManager_ManFunction (RteEventToTaskMapping): RteUsedOsEventRef=Rte_Ev_Cyclic_SYS_0_100ms, RteUsedOsAlarmRef=Os/Rte_Al_TE_SYS_0_100ms
        NvmBlock_SOCManager_NvBlockNeed_HealthSwitch (RteNvRamAllocation):
          RteNvmRamBlockLocationSymbol = Rte_SOCManager_NvBlockNeed_HealthSwitch_MirrorBlock
          RteNvmRomBlockLocationSymbol = Rte_SOCManager_NvBlockNeed_HealthSwitch_DefaultValue
          RteNvmBlockRef = SOCManagerNvBlockNeed_HealthSwitch
      SecOC_EcuSwComposition
        Timer_SecOC_MainFunctionRx (RteEventToTaskMapping): RteUsedOsEventRef=Rte_Ev_Cyclic2_BSW_COMM_0_2ms, RteUsedOsAlarmRef=Os/Rte_Al_TE2_BSW_COMM_0_2ms
        Timer_SecOC_MainFunctionTx (RteEventToTaskMapping): RteUsedOsEventRef=Rte_Ev_Cyclic2_BSW_COMM_0_2ms, RteUsedOsAlarmRef=Os/Rte_Al_TE2_BSW_COMM_0_2ms
      SecOc_Server_EcuSwComposition
        TMT_SecOc_Server_MainFunction (RteEventToTaskMapping): RteUsedOsEventRef=Rte_Ev_Run_SecOc_Server_SecOc_Server_MainFunction, RteUsedOsAlarmRef=Os/Rte_Al_TE_SecOc_Server_SecOc_Server_MainFunction
      SocDtcProcess_EcuSwComposition
        OIT_PpCS_AppClearDTCInfo_AppClearDTCInfo_PpCS_AppClearDTCInfo_AppClearDTCInfo (RteEventToTaskMapping): RteUsedOsEventRef=Rte_Ev_Run_SocDtcProcess_PpCS_AppClearDTCInfo_AppClearDTCInfo
        TMT_SocDtcProcess_MainFunction (RteEventToTaskMapping): RteUsedOsEventRef=Rte_Ev_Cyclic_SWC_LOW_0_10ms, RteUsedOsAlarmRef=Os/Rte_Al_TE_SWC_LOW_0_10ms
      SysSafety_EcuSwComposition
        TMT_SysSafety_MainFunction (RteEventToTaskMapping): RteUsedOsEventRef=Rte_Ev_Cyclic_DRIVERS_SAFE_0_5ms, RteUsedOsAlarmRef=Os/Rte_Al_TE_DRIVERS_SAFE_0_5ms
      TM_EcuSwComposition
        TMT_TM_MainFunction (RteEventToTaskMapping): RteUsedOsEventRef=Rte_Ev_Cyclic_SYS_0_100ms, RteUsedOsAlarmRef=Os/Rte_Al_TE_SYS_0_100ms
      Upgrade_EcuSwComposition
        TMT_Upgrade_MainFunction (RteEventToTaskMapping): RteUsedOsEventRef=Rte_Ev_Cyclic_SYS_0_10ms, RteUsedOsAlarmRef=Os/Rte_Al_TE_SYS_0_10ms
        NvmBlock_Upgrade_NvBlockNeed_UpgradeResetFlag (RteNvRamAllocation):
          RteNvmRamBlockLocationSymbol = Rte_Upgrade_NvBlockNeed_UpgradeResetFlag_MirrorBlock
          RteNvmRomBlockLocationSymbol = Rte_Upgrade_NvBlockNeed_UpgradeResetFlag_DefaultValue
          RteNvmBlockRef = NvBlockNeed_UpgradeResetFlag
      Vconfig_EcuSwComposition
        3 x RteEventToTaskMapping:
          OIT_VConfig_GetKindConfig_Operation_VConfig_GetKindConfig_VConfig_GetKindConfig_Operation_VConfig_GetKindConfig: RteUsedOsEventRef=Rte_Ev_Run_Vconfig_VConfig_GetKindConfig_Operation_VConfig_GetKindConfig
          OIT_VConfig_GetUpdateTick_OperationVConfig_GetUpdateTick_VConfig_GetUpdateTick_OperationVConfig_GetUpdateTick: RteUsedOsEventRef=Rte_Ev_Run_Vconfig_VConfig_GetUpdateTick_OperationVConfig_GetUpdateTick
          TMT_Vconfig_MainFunction: RteUsedOsEventRef=Rte_Ev_Cyclic_SYS_0_50ms, RteUsedOsAlarmRef=Os/Rte_Al_TE_SYS_0_50ms
      WdgM_SystemApplication_OsCore0_EcuSwComposition
        Timer_WdgM_MainFunction (RteEventToTaskMapping): RteUsedOsEventRef=Rte_Ev_Cyclic2_BSW_COMM_0_10ms, RteUsedOsAlarmRef=Os/Rte_Al_TE2_BSW_COMM_0_10ms
    RteOsInteraction
      39 x RteUsedOsActivation, all with RteExpectedActivationOffset=0:
        Rte_Al_TE2_BSW_COMM_0_10ms: RteActivationOsAlarmRef=Os/Rte_Al_TE2_BSW_COMM_0_10ms, RteActivationOsTaskRef=BSW_COMM
        Rte_Al_TE2_BSW_COMM_0_2ms: RteActivationOsAlarmRef=Os/Rte_Al_TE2_BSW_COMM_0_2ms, RteActivationOsTaskRef=BSW_COMM
        Rte_Al_TE2_BSW_COMM_0_5ms: RteActivationOsAlarmRef=Os/Rte_Al_TE2_BSW_COMM_0_5ms, RteActivationOsTaskRef=BSW_COMM
        Rte_Al_TE_CConfig_CConfig_MainFunction: RteActivationOsAlarmRef=Os/Rte_Al_TE_CConfig_CConfig_MainFunction, RteActivationOsTaskRef=BSW_COMM
        Rte_Al_TE_FvM_FvM_MainFunction: RteActivationOsAlarmRef=Os/Rte_Al_TE_FvM_FvM_MainFunction, RteActivationOsTaskRef=BSW_COMM
        Rte_Al_TE_SecOc_Server_SecOc_Server_MainFunction: RteActivationOsAlarmRef=Os/Rte_Al_TE_SecOc_Server_SecOc_Server_MainFunction, RteActivationOsTaskRef=BSW_COMM
        Rte_Al_TE2_BSW_DIAGNOSE_0_10ms: RteActivationOsAlarmRef=Os/Rte_Al_TE2_BSW_DIAGNOSE_0_10ms, RteActivationOsTaskRef=BSW_DIAGNOSE
        Rte_Al_TE_DRIVERS_SAFE_0_100ms: RteActivationOsAlarmRef=Os/Rte_Al_TE_DRIVERS_SAFE_0_100ms, RteActivationOsTaskRef=DRIVERS_SAFE
        Rte_Al_TE_DRIVERS_SAFE_0_50ms: RteActivationOsAlarmRef=Os/Rte_Al_TE_DRIVERS_SAFE_0_50ms, RteActivationOsTaskRef=DRIVERS_SAFE
        Rte_Al_TE_DRIVERS_SAFE_0_5ms: RteActivationOsAlarmRef=Os/Rte_Al_TE_DRIVERS_SAFE_0_5ms, RteActivationOsTaskRef=DRIVERS_SAFE
        Rte_Al_TE_Gyro_Gyro_MainFunction: RteActivationOsAlarmRef=Os/Rte_Al_TE_Gyro_Gyro_MainFunction, RteActivationOsTaskRef=DRIVERS_SAFE
        Rte_Al_TE2_Default_BSW_0_10ms: RteActivationOsAlarmRef=Os/Rte_Al_TE2_Default_BSW_0_10ms, RteActivationOsTaskRef=Default_BSW
        Rte_Al_TE2_Default_BSW_0_5ms: RteActivationOsAlarmRef=Os/Rte_Al_TE2_Default_BSW_0_5ms, RteActivationOsTaskRef=Default_BSW
        Rte_Al_TE2_Default_BSW_1_5ms: RteActivationOsAlarmRef=Os/Rte_Al_TE2_Default_BSW_1_5ms, RteActivationOsTaskRef=Default_BSW
        Rte_Al_TE_DCM_Server_DCM_Server_MainFunction: RteActivationOsAlarmRef=Os/Rte_Al_TE_DCM_Server_DCM_Server_MainFunction, RteActivationOsTaskRef=Default_BSW
        Rte_Al_TE_HSM_Hsm_MainFunction: RteActivationOsAlarmRef=Os/Rte_Al_TE_HSM_Hsm_MainFunction, RteActivationOsTaskRef=Default_BSW
        Rte_Al_TE_Misc_NVM_Read_Speedup_Runnable: RteActivationOsAlarmRef=Os/Rte_Al_TE_Misc_NVM_Read_Speedup_Runnable, RteActivationOsTaskRef=Default_BSW
        Rte_Al_TE_Common_Normal_Common_Normal_100msMainFunction: RteActivationOsAlarmRef=Os/Rte_Al_TE_Common_Normal_Common_Normal_100msMainFunction, RteActivationOsTaskRef=FUEL_TC_ODO
        Rte_Al_TE_Common_Normal_Common_Normal_100msMainFunction_: RteActivationOsAlarmRef=Os/Rte_Al_TE_Common_Normal_Common_Normal_100msMainFunction_, RteActivationOsTaskRef=FUEL_TC_ODO
        Rte_Al_TE_Common_Normal_Common_Normal_10msMainFunction: RteActivationOsAlarmRef=Os/Rte_Al_TE_Common_Normal_Common_Normal_10msMainFunction, RteActivationOsTaskRef=FUEL_TC_ODO
        Rte_Al_TE_Common_Normal_Common_Normal_10msMainFunction_: RteActivationOsAlarmRef=Os/Rte_Al_TE_Common_Normal_Common_Normal_10msMainFunction_, RteActivationOsTaskRef=FUEL_TC_ODO
        Rte_Al_TE_Common_Normal_Common_Normal_20msMainFunction: RteActivationOsAlarmRef=Os/Rte_Al_TE_Common_Normal_Common_Normal_20msMainFunction, RteActivationOsTaskRef=FUEL_TC_ODO
        Rte_Al_TE_Common_Normal_Common_Normal_20msMainFunction_: RteActivationOsAlarmRef=Os/Rte_Al_TE_Common_Normal_Common_Normal_20msMainFunction_, RteActivationOsTaskRef=FUEL_TC_ODO
        Rte_Al_TE_Common_Normal_Common_Normal_20msMainFunction_A: RteActivationOsAlarmRef=Os/Rte_Al_TE_Common_Normal_Common_Normal_20msMainFunction_A, RteActivationOsTaskRef=FUEL_TC_ODO
        Rte_Al_TE_Common_Normal_Common_Normal_20msMainFunction_B: RteActivationOsAlarmRef=Os/Rte_Al_TE_Common_Normal_Common_Normal_20msMainFunction_B, RteActivationOsTaskRef=FUEL_TC_ODO
        Rte_Al_TE_Common_Normal_Common_Normal_5msMainFunction: RteActivationOsAlarmRef=Os/Rte_Al_TE_Common_Normal_Common_Normal_5msMainFunction, RteActivationOsTaskRef=FUEL_TC_ODO
        Rte_Al_TE_Common_GateWay_Common_GateWay_10msMainFunction: RteActivationOsAlarmRef=Os/Rte_Al_TE_Common_GateWay_Common_GateWay_10msMainFunction, RteActivationOsTaskRef=GateWay
        Rte_Al_TE_Common_GateWay_Common_GateWay_5msMainFunction: RteActivationOsAlarmRef=Os/Rte_Al_TE_Common_GateWay_Common_GateWay_5msMainFunction, RteActivationOsTaskRef=GateWay
        Rte_Al_TE_IPC_IPC_MainFunction: RteActivationOsAlarmRef=Os/Rte_Al_TE_IPC_IPC_MainFunction, RteActivationOsTaskRef=IPC
        Rte_Al_TE_IPC_IPC_STB_MainFunction: RteActivationOsAlarmRef=Os/Rte_Al_TE_IPC_IPC_STB_MainFunction, RteActivationOsTaskRef=IPC
        Rte_Al_TE_EOL_EOL_MainFunction: RteActivationOsAlarmRef=Os/Rte_Al_TE_EOL_EOL_MainFunction, RteActivationOsTaskRef=SWC_LOW
        Rte_Al_TE_SWC_LOW_0_10ms: RteActivationOsAlarmRef=Os/Rte_Al_TE_SWC_LOW_0_10ms, RteActivationOsTaskRef=SWC_LOW
        Rte_Al_TE_Misc_Misc_MainFunction_500ms: RteActivationOsAlarmRef=Os/Rte_Al_TE_Misc_Misc_MainFunction_500ms, RteActivationOsTaskRef=SYS
        Rte_Al_TE_SYS_0_100ms: RteActivationOsAlarmRef=Os/Rte_Al_TE_SYS_0_100ms, RteActivationOsTaskRef=SYS
        Rte_Al_TE_SYS_0_10ms: RteActivationOsAlarmRef=Os/Rte_Al_TE_SYS_0_10ms, RteActivationOsTaskRef=SYS
        Rte_Al_TE_SYS_0_50ms: RteActivationOsAlarmRef=Os/Rte_Al_TE_SYS_0_50ms, RteActivationOsTaskRef=SYS
        Rte_Al_TE_SYS_0_5ms: RteActivationOsAlarmRef=Os/Rte_Al_TE_SYS_0_5ms, RteActivationOsTaskRef=SYS
        Rte_Al_TE_Common_Safety_Common_Safety_10msMainFunction: RteActivationOsAlarmRef=Os/Rte_Al_TE_Common_Safety_Common_Safety_10msMainFunction, RteActivationOsTaskRef=TT_GEAR
        Rte_Al_TE_Common_Safety_Common_Safety_50msMainFunction: RteActivationOsAlarmRef=Os/Rte_Al_TE_Common_Safety_Common_Safety_50msMainFunction, RteActivationOsTaskRef=TT_GEAR
  module config NvM
    40 x NvMBlockDescriptor:
      AMP_NvBlockNeed_LC_Calibration2: NvMNvBlockLength=20, NvMRamBlockDataAddress=Rte_AMP_NvBlockNeed_LC_Calibration2_MirrorBlock, NvMRomBlockDataAddress=Rte_AMP_NvBlockNeed_LC_Calibration2_DefaultValue
      AMP_NvBlockNeed_LC_Calibration: NvMNvBlockLength=20, NvMRamBlockDataAddress=Rte_AMP_NvBlockNeed_LC_Calibration_MirrorBlock, NvMRomBlockDataAddress=Rte_AMP_NvBlockNeed_LC_Calibration_DefaultValue
      Can_ServerNvBlockNeed_ActiveWUCounter: NvMNvBlockLength=1, NvMRamBlockDataAddress=Rte_Can_Server_NvBlockNeed_ActiveWUCounter_MirrorBlock, NvMRomBlockDataAddress=Rte_Can_Server_NvBlockNeed_ActiveWUCounter_DefaultValue
      Can_ServerNvBlockNeed_AbnormalWakeupSleepRecords: NvMNvBlockLength=80, NvMRamBlockDataAddress=Rte_Can_Server_NvBlockNeed_AbnormalWakeupSleepRecords_MirrorBlock, NvMRomBlockDataAddress=Rte_Can_Server_NvBlockNeed_AbnormalWakeupSleepRecords_DefaultValue
      Common_GateWayNvBlockNeed_Block_IPC_CAN_Data: NvMNvBlockLength=120, NvMRamBlockDataAddress=Rte_Common_GateWay_NvBlockNeed_Block_IPC_CAN_Data_MirrorBlock, NvMRomBlockDataAddress=Rte_Common_GateWay_NvBlockNeed_Block_IPC_CAN_Data_DefaultValue
      Common_GateWayNvBlockNeed_Block_IPC_Config_Data: NvMNvBlockLength=60, NvMRamBlockDataAddress=Rte_Common_GateWay_NvBlockNeed_Block_IPC_Config_Data_MirrorBlock, NvMRomBlockDataAddress=Rte_Common_GateWay_NvBlockNeed_Block_IPC_Config_Data_DefaultValue
      Common_NormalNvBlockNeed_Block_MaintainOdo: NvMNvBlockLength=80, NvMRamBlockDataAddress=Rte_Common_Normal_NvBlockNeed_Block_MaintainOdo_MirrorBlock, NvMRomBlockDataAddress=Rte_Common_Normal_NvBlockNeed_Block_MaintainOdo_DefaultValue
      Common_NormalNvBlockNeed_Block_ODO_{1..5}: NvMNvBlockLength=16, NvMRamBlockDataAddress=Rte_Common_Normal_NvBlockNeed_Block_ODO_{1..5}_MirrorBlock, NvMRomBlockDataAddress=Rte_Common_Normal_NvBlockNeed_Block_ODO_{1..5}_DefaultValue
      Common_NormalNvBlockNeed_Block_Trip: NvMNvBlockLength=20, NvMRamBlockDataAddress=Rte_Common_Normal_NvBlockNeed_Block_Trip_MirrorBlock, NvMRomBlockDataAddress=Rte_Common_Normal_NvBlockNeed_Block_Trip_DefaultValue
      Common_NormalNvBlockNeed_Menu: NvMNvBlockLength=20, NvMRamBlockDataAddress=Rte_Common_Normal_NvBlockNeed_Menu_MirrorBlock, NvMRomBlockDataAddress=Rte_Common_Normal_NvBlockNeed_MENU_Data_DefaultValue
      DCM_ServerNvBlockNeedSecAttemptCount: NvMNvBlockLength=1, NvMRamBlockDataAddress=Rte_DCM_Server_NvBlockNeedSecAttemptCount_MirrorBlock, NvMRomBlockDataAddress=Rte_DCM_Server_NvBlockNeedSecAttemptCount_DefaultValue
      DCM_ServerNvBlockNeed_EOLUnlockCnt: NvMNvBlockLength=1, NvMRamBlockDataAddress=Rte_DCM_Server_NvBlockNeed_EOLUnlockCnt_MirrorBlock, NvMRomBlockDataAddress=Rte_DCM_Server_NvBlockNeed_EOLUnlockCnt_DefaultValue
      DidDataProcessNvBlockNeed_ClusterDisplayHMIAdjustmentOffset: NvMNvBlockLength=8, NvMRamBlockDataAddress=Rte_DidDataProcess_NvBlockNeed_ClusterDisplayHMIAdjustmentOffset_MirrorBlock, NvMRomBlockDataAddress=Rte_DidDataProcess_NvBlockNeed_ClusterDisplayHMIAdjustmentOffset_DefaultValue
      DidDataProcessNvBlockNeed_ClusterInternalConfiguration: NvMNvBlockLength=300, NvMRamBlockDataAddress=Rte_DidDataProcess_NvBlockNeed_ClusterInternalConfiguration_MirrorBlock, NvMRomBlockDataAddress=Rte_DidDataProcess_NvBlockNeed_ClusterInternalConfiguration_DefaultValue
      DidDataProcessNvBlockNeed_E2ESwitch: NvMNvBlockLength=1, NvMRamBlockDataAddress=Rte_DidDataProcess_NvBlockNeed_E2ESwitch_MirrorBlock, NvMRomBlockDataAddress=Rte_DidDataProcess_NvBlockNeed_E2ESwitch_DefaultValue
      DidDataProcessNvBlockNeed_ECUlevelNetworkConfigurationData: NvMNvBlockLength=200, NvMRamBlockDataAddress=Rte_DidDataProcess_NvBlockNeed_ECUlevelNetworkConfigurationData_MirrorBlock, NvMRomBlockDataAddress=Rte_DidDataProcess_NvBlockNeed_ECUlevelNetworkConfigurationData_DefaultValue
      DidDataProcessNvBlockNeed_FactoryMode: NvMNvBlockLength=1, NvMRamBlockDataAddress=Rte_DidDataProcess_NvBlockNeed_FactoryMode_MirrorBlock, NvMRomBlockDataAddress=Rte_DidDataProcess_NvBlockNeed_FactoryMode_DefaultValue
      DidDataProcessNvBlockNeed_SecOcSwitch: NvMNvBlockLength=1, NvMRamBlockDataAddress=Rte_DidDataProcess_NvBlockNeed_SecOcSwitch_MirrorBlock, NvMRomBlockDataAddress=Rte_DidDataProcess_NvBlockNeed_SecOcSwitch_DefaultValue
      DidDataProcessNvBlockNeed_VIN: NvMNvBlockLength=17, NvMRamBlockDataAddress=Rte_DidDataProcess_NvBlockNeed_VIN_MirrorBlock, NvMRomBlockDataAddress=Rte_DidDataProcess_NvBlockNeed_VIN_DefaultValue
      DidDataProcessNvBlockNeed_VehicleMode: NvMNvBlockLength=20, NvMRamBlockDataAddress=Rte_DidDataProcess_NvBlockNeed_VehicleMode_MirrorBlock, NvMRomBlockDataAddress=Rte_DidDataProcess_NvBlockNeed_VehicleMode_DefaultValue
      DidDataProcessNvBlockNeed_VehicleSoftwareVersion: NvMNvBlockLength=30, NvMRamBlockDataAddress=Rte_DidDataProcess_NvBlockNeed_VehicleSoftwareVersion_MirrorBlock, NvMRomBlockDataAddress=Rte_DidDataProcess_NvBlockNeed_VehicleSoftwareVersion_DefaultValue
      EOL_NvBlockNeed_0xF187: NvMNvBlockLength=13, NvMRamBlockDataAddress=Rte_EOL_NvBlockNeed_0xF187_MirrorBlock, NvMRomBlockDataAddress=Rte_EOL_NvBlockNeed_0xF187_DefaultValue
      EOL_NvBlockNeed_0xF18C: NvMNvBlockLength=20, NvMRamBlockDataAddress=Rte_EOL_NvBlockNeed_0xF18C_MirrorBlock, NvMRomBlockDataAddress=Rte_EOL_NvBlockNeed_0xF18C_DefaultValue
      EOL_NvBlockNeed_0xF193: NvMNvBlockLength=15, NvMRamBlockDataAddress=Rte_EOL_NvBlockNeed_0xF193_MirrorBlock, NvMRomBlockDataAddress=Rte_EOL_NvBlockNeed_0xF193_DefaultValue
      EOL_NvBlockNeed_0xF195: NvMNvBlockLength=17, NvMRamBlockDataAddress=Rte_EOL_NvBlockNeed_0xF195_MirrorBlock, NvMRomBlockDataAddress=Rte_EOL_NvBlockNeed_0xF195_DefaultValue
      EOL_NvBlockNeed_0xFD00: NvMNvBlockLength=4, NvMRamBlockDataAddress=Rte_EOL_NvBlockNeed_0xFD00_MirrorBlock, NvMRomBlockDataAddress=Rte_EOL_NvBlockNeed_0xFD00_DefaultValue
      EOL_NvBlockNeed_0xFD19: NvMNvBlockLength=1, NvMRamBlockDataAddress=Rte_EOL_NvBlockNeed_0xFD19_MirrorBlock, NvMRomBlockDataAddress=Rte_EOL_NvBlockNeed_0xFD19_DefaultValue
      EOL_NvBlockNeed_0xFE{20..22}: NvMNvBlockLength=1, NvMRamBlockDataAddress=Rte_EOL_NvBlockNeed_0xFE{20..22}_MirrorBlock, NvMRomBlockDataAddress=Rte_EOL_NvBlockNeed_0xFE{20..22}_DefaultValue
      EOL_NvBlockNeed_0xFE23: NvMNvBlockLength=2, NvMRamBlockDataAddress=Rte_EOL_NvBlockNeed_0xFE23_MirrorBlock, NvMRomBlockDataAddress=Rte_EOL_NvBlockNeed_0xFE23_DefaultValue
      EOL_NvBlockNeed_0xFE24: NvMNvBlockLength=1, NvMRamBlockDataAddress=Rte_EOL_NvBlockNeed_0xFE24_MirrorBlock, NvMRomBlockDataAddress=Rte_EOL_NvBlockNeed_0xFE24_DefaultValue
      EOL_NvBlockNeed_0xFE25: NvMNvBlockLength=2, NvMRamBlockDataAddress=Rte_EOL_NvBlockNeed_0xFE25_MirrorBlock, NvMRomBlockDataAddress=Rte_EOL_NvBlockNeed_0xFE25_DefaultValue
      MiscNvBlockNeed_ResetInfomation: NvMNvBlockLength=63, NvMRamBlockDataAddress=Rte_Misc_NvBlockNeed_ResetInfomation_MirrorBlock, NvMRomBlockDataAddress=Rte_Misc_NvBlockNeed_ResetInfomation_DefaultValue
      SOCManagerNvBlockNeed_HealthSwitch: NvMNvBlockLength=1, NvMRamBlockDataAddress=Rte_SOCManager_NvBlockNeed_HealthSwitch_MirrorBlock, NvMRomBlockDataAddress=Rte_SOCManager_NvBlockNeed_HealthSwitch_DefaultValue
      NvBlockNeed_UpgradeResetFlag: NvMNvBlockLength=4, NvMRamBlockDataAddress=Rte_Upgrade_NvBlockNeed_UpgradeResetFlag_MirrorBlock, NvMRomBlockDataAddress=Rte_Upgrade_NvBlockNeed_UpgradeResetFlag_DefaultValue
  module config Os
    BSW_COMM (OsTask):
      OsTaskActivation = 1
      OsTaskPriority = 8
      OsTaskSchedule = FULL
      OsTaskEventRef = Rte_Ev_Cyclic2_BSW_COMM_0_10ms
      OsTaskEventRef = Rte_Ev_Cyclic2_BSW_COMM_0_2ms
      OsTaskEventRef = Rte_Ev_Cyclic2_BSW_COMM_0_5ms
      OsTaskEventRef = Rte_Ev_Run_CConfig_CConfig_MainFunction
      OsTaskEventRef = Rte_Ev_Run_Can_Server_CNA_SignalGroupSet
      OsTaskEventRef = Rte_Ev_Run_Can_Server_CNA_SignalSet
      OsTaskEventRef = Rte_Ev_Run_Can_Server_CNA_SignalSetNoTrigger
      OsTaskEventRef = Rte_Ev_Run_Can_Server_CNA_SignalSet_U8N
      OsTaskEventRef = Rte_Ev_Run_FvM_FvM_MainFunction
      OsTaskEventRef = Rte_Ev_Run_SecOc_Server_SecOc_Server_MainFunction
      OsTaskEventRef = Rte_Ev_WP_BSW_COMM
      OsTaskAccessingApplication = OsApplication_NonTrust_OsCore0
    6 x OsAlarm, all with OsAlarmCounterRef=SystemTimer:
      Rte_Al_TE2_BSW_COMM_0_10ms
        OsAlarmAction
          OsAlarmSetEvent: OsAlarmSetEventRef=Rte_Ev_Cyclic2_BSW_COMM_0_10ms, OsAlarmSetEventTaskRef=BSW_COMM
      Rte_Al_TE2_BSW_COMM_0_2ms
        OsAlarmAction
          OsAlarmSetEvent: OsAlarmSetEventRef=Rte_Ev_Cyclic2_BSW_COMM_0_2ms, OsAlarmSetEventTaskRef=BSW_COMM
      Rte_Al_TE2_BSW_COMM_0_5ms
        OsAlarmAction
          OsAlarmSetEvent: OsAlarmSetEventRef=Rte_Ev_Cyclic2_BSW_COMM_0_5ms, OsAlarmSetEventTaskRef=BSW_COMM
      Rte_Al_TE_CConfig_CConfig_MainFunction
        OsAlarmAction
          OsAlarmSetEvent: OsAlarmSetEventRef=Rte_Ev_Run_CConfig_CConfig_MainFunction, OsAlarmSetEventTaskRef=BSW_COMM
      Rte_Al_TE_FvM_FvM_MainFunction
        OsAlarmAction
          OsAlarmSetEvent: OsAlarmSetEventRef=Rte_Ev_Run_FvM_FvM_MainFunction, OsAlarmSetEventTaskRef=BSW_COMM
      Rte_Al_TE_SecOc_Server_SecOc_Server_MainFunction
        OsAlarmAction
          OsAlarmSetEvent: OsAlarmSetEventRef=Rte_Ev_Run_SecOc_Server_SecOc_Server_MainFunction, OsAlarmSetEventTaskRef=BSW_COMM
    BSW_DIAGNOSE (OsTask):
      OsTaskActivation = 1
      OsTaskPriority = 4
      OsTaskSchedule = FULL
      OsTaskEventRef = Rte_Ev_Cyclic2_BSW_DIAGNOSE_0_10ms
      OsTaskEventRef = Rte_Ev_Run_DemSatellite_0_SetEventStatus
      OsTaskEventRef = Rte_Ev_WP_BSW_DIAGNOSE
      OsTaskAccessingApplication = OsApplication_NonTrust_OsCore0
    Rte_Al_TE2_BSW_DIAGNOSE_0_10ms (OsAlarm): OsAlarmCounterRef=SystemTimer
      OsAlarmAction
        OsAlarmSetEvent: OsAlarmSetEventRef=Rte_Ev_Cyclic2_BSW_DIAGNOSE_0_10ms, OsAlarmSetEventTaskRef=BSW_DIAGNOSE
    DRIVERS_SAFE (OsTask):
      OsTaskActivation = 1
      OsTaskPriority = 6
      OsTaskSchedule = FULL
      OsTaskEventRef = Rte_Ev_Cyclic_DRIVERS_SAFE_0_100ms
      OsTaskEventRef = Rte_Ev_Cyclic_DRIVERS_SAFE_0_50ms
      OsTaskEventRef = Rte_Ev_Cyclic_DRIVERS_SAFE_0_5ms
      OsTaskEventRef = Rte_Ev_Run_AMP_AMP_Event_MainFunction
      OsTaskEventRef = Rte_Ev_Run_ComEx_ComEx_GetRxE2EStatus
      OsTaskEventRef = Rte_Ev_Run_ComEx_ComEx_SendSignal
      OsTaskEventRef = Rte_Ev_Run_Gyro_Gyro_MainFunction
      OsTaskEventRef = Rte_Ev_Run_IIC_IIC0_MainFunction
      OsTaskEventRef = Rte_Ev_Run_IIC_IIC1_MainFunction
      OsTaskEventRef = Rte_Ev_Run_RTC_GetUTCTimeInMillis
      OsTaskEventRef = Rte_Ev_Run_RTC_UTC2PerpetualCalendar
      OsTaskEventRef = Rte_Ev_WP_DRIVERS_SAFE
      OsTaskAccessingApplication = OsApplication_NonTrust_OsCore0
    4 x OsAlarm, all with OsAlarmCounterRef=SystemTimer:
      Rte_Al_TE_DRIVERS_SAFE_0_100ms
        OsAlarmAction
          OsAlarmSetEvent: OsAlarmSetEventRef=Rte_Ev_Cyclic_DRIVERS_SAFE_0_100ms, OsAlarmSetEventTaskRef=DRIVERS_SAFE
      Rte_Al_TE_DRIVERS_SAFE_0_50ms
        OsAlarmAction
          OsAlarmSetEvent: OsAlarmSetEventRef=Rte_Ev_Cyclic_DRIVERS_SAFE_0_50ms, OsAlarmSetEventTaskRef=DRIVERS_SAFE
      Rte_Al_TE_DRIVERS_SAFE_0_5ms
        OsAlarmAction
          OsAlarmSetEvent: OsAlarmSetEventRef=Rte_Ev_Cyclic_DRIVERS_SAFE_0_5ms, OsAlarmSetEventTaskRef=DRIVERS_SAFE
      Rte_Al_TE_Gyro_Gyro_MainFunction
        OsAlarmAction
          OsAlarmSetEvent: OsAlarmSetEventRef=Rte_Ev_Run_Gyro_Gyro_MainFunction, OsAlarmSetEventTaskRef=DRIVERS_SAFE
    Default_BSW (OsTask):
      OsTaskActivation = 1
      OsTaskPriority = 7
      OsTaskSchedule = FULL
      OsTaskEventRef = Rte_Ev_Cyclic2_Default_BSW_0_10ms
      OsTaskEventRef = Rte_Ev_Cyclic2_Default_BSW_0_5ms
      OsTaskEventRef = Rte_Ev_Cyclic2_Default_BSW_1_5ms
      OsTaskEventRef = Rte_Ev_Run_BswM_BswM_Read_PowerModeShutdownReq
      OsTaskEventRef = Rte_Ev_Run_BswM_BswM_Read_PowerModeShutdownReq_EmergencySleep
      OsTaskEventRef = Rte_Ev_Run_DCM_Server_DCM_Server_MainFunction
      OsTaskEventRef = Rte_Ev_Run_HSM_HsmGetAes128Key
      OsTaskEventRef = Rte_Ev_Run_HSM_HsmSetAes128Key
      OsTaskEventRef = Rte_Ev_Run_HSM_HsmTrngGenerate
      OsTaskEventRef = Rte_Ev_Run_HSM_Hsm_MainFunction
      OsTaskEventRef = Rte_Ev_Run_Misc_NVM_Read_Speedup_Runnable
      OsTaskEventRef = Rte_Ev_Run_NvM_WriteBlock
      OsTaskEventRef = Rte_Ev_Run_Os_OsCore0_swc_GetCounterValue
      OsTaskEventRef = Rte_Ev_Run_Os_OsCore0_swc_GetElapsedValue
      OsTaskEventRef = Rte_Ev_WP_Default_BSW
      OsTaskAccessingApplication = OsApplication_NonTrust_OsCore0
    6 x OsAlarm, all with OsAlarmCounterRef=SystemTimer:
      Rte_Al_TE2_Default_BSW_0_10ms
        OsAlarmAction
          OsAlarmSetEvent: OsAlarmSetEventRef=Rte_Ev_Cyclic2_Default_BSW_0_10ms, OsAlarmSetEventTaskRef=Default_BSW
      Rte_Al_TE2_Default_BSW_0_5ms
        OsAlarmAction
          OsAlarmSetEvent: OsAlarmSetEventRef=Rte_Ev_Cyclic2_Default_BSW_0_5ms, OsAlarmSetEventTaskRef=Default_BSW
      Rte_Al_TE2_Default_BSW_1_5ms
        OsAlarmAction
          OsAlarmSetEvent: OsAlarmSetEventRef=Rte_Ev_Cyclic2_Default_BSW_1_5ms, OsAlarmSetEventTaskRef=Default_BSW
      Rte_Al_TE_DCM_Server_DCM_Server_MainFunction
        OsAlarmAction
          OsAlarmSetEvent: OsAlarmSetEventRef=Rte_Ev_Run_DCM_Server_DCM_Server_MainFunction, OsAlarmSetEventTaskRef=Default_BSW
      Rte_Al_TE_HSM_Hsm_MainFunction
        OsAlarmAction
          OsAlarmSetEvent: OsAlarmSetEventRef=Rte_Ev_Run_HSM_Hsm_MainFunction, OsAlarmSetEventTaskRef=Default_BSW
      Rte_Al_TE_Misc_NVM_Read_Speedup_Runnable
        OsAlarmAction
          OsAlarmSetEvent: OsAlarmSetEventRef=Rte_Ev_Run_Misc_NVM_Read_Speedup_Runnable, OsAlarmSetEventTaskRef=Default_BSW
    FUEL_TC_ODO (OsTask):
      OsTaskActivation = 1
      OsTaskPriority = 5
      OsTaskSchedule = FULL
      OsTaskEventRef = Rte_Ev_Run_Common_Normal_Common_Normal_100msMainFunction
      OsTaskEventRef = Rte_Ev_Run_Common_Normal_Common_Normal_100msMainFunction_
      OsTaskEventRef = Rte_Ev_Run_Common_Normal_Common_Normal_10msMainFunction
      OsTaskEventRef = Rte_Ev_Run_Common_Normal_Common_Normal_10msMainFunction_
      OsTaskEventRef = Rte_Ev_Run_Common_Normal_Common_Normal_20msMainFunction
      OsTaskEventRef = Rte_Ev_Run_Common_Normal_Common_Normal_20msMainFunction_
      OsTaskEventRef = Rte_Ev_Run_Common_Normal_Common_Normal_20msMainFunction_A
      OsTaskEventRef = Rte_Ev_Run_Common_Normal_Common_Normal_20msMainFunction_B
      OsTaskEventRef = Rte_Ev_Run_Common_Normal_Common_Normal_5msMainFunction
      OsTaskEventRef = Rte_Ev_Run_Common_Normal_EOL_ReadDID0xFDD8_EOL_GetReadHardInputForCluster
      OsTaskEventRef = Rte_Ev_Run_Common_Normal_Fuel_Api_ParamentGetCsPort_Operation
      OsTaskEventRef = Rte_Ev_WP_FUEL_TC_ODO
      OsTaskAccessingApplication = OsApplication_Trust_OsCore0
    9 x OsAlarm, all with OsAlarmCounterRef=SystemTimer, OsAlarmAccessingApplication=OsApplication_Trust_OsCore0:
      Rte_Al_TE_Common_Normal_Common_Normal_100msMainFunction
        OsAlarmAction
          OsAlarmSetEvent: OsAlarmSetEventRef=Rte_Ev_Run_Common_Normal_Common_Normal_100msMainFunction, OsAlarmSetEventTaskRef=FUEL_TC_ODO
      Rte_Al_TE_Common_Normal_Common_Normal_100msMainFunction_
        OsAlarmAction
          OsAlarmSetEvent: OsAlarmSetEventRef=Rte_Ev_Run_Common_Normal_Common_Normal_100msMainFunction_, OsAlarmSetEventTaskRef=FUEL_TC_ODO
      Rte_Al_TE_Common_Normal_Common_Normal_10msMainFunction
        OsAlarmAction
          OsAlarmSetEvent: OsAlarmSetEventRef=Rte_Ev_Run_Common_Normal_Common_Normal_10msMainFunction, OsAlarmSetEventTaskRef=FUEL_TC_ODO
      Rte_Al_TE_Common_Normal_Common_Normal_10msMainFunction_
        OsAlarmAction
          OsAlarmSetEvent: OsAlarmSetEventRef=Rte_Ev_Run_Common_Normal_Common_Normal_10msMainFunction_, OsAlarmSetEventTaskRef=FUEL_TC_ODO
      Rte_Al_TE_Common_Normal_Common_Normal_20msMainFunction
        OsAlarmAction
          OsAlarmSetEvent: OsAlarmSetEventRef=Rte_Ev_Run_Common_Normal_Common_Normal_20msMainFunction, OsAlarmSetEventTaskRef=FUEL_TC_ODO
      Rte_Al_TE_Common_Normal_Common_Normal_20msMainFunction_
        OsAlarmAction
          OsAlarmSetEvent: OsAlarmSetEventRef=Rte_Ev_Run_Common_Normal_Common_Normal_20msMainFunction_, OsAlarmSetEventTaskRef=FUEL_TC_ODO
      Rte_Al_TE_Common_Normal_Common_Normal_20msMainFunction_A
        OsAlarmAction
          OsAlarmSetEvent: OsAlarmSetEventRef=Rte_Ev_Run_Common_Normal_Common_Normal_20msMainFunction_A, OsAlarmSetEventTaskRef=FUEL_TC_ODO
      Rte_Al_TE_Common_Normal_Common_Normal_20msMainFunction_B
        OsAlarmAction
          OsAlarmSetEvent: OsAlarmSetEventRef=Rte_Ev_Run_Common_Normal_Common_Normal_20msMainFunction_B, OsAlarmSetEventTaskRef=FUEL_TC_ODO
      Rte_Al_TE_Common_Normal_Common_Normal_5msMainFunction
        OsAlarmAction
          OsAlarmSetEvent: OsAlarmSetEventRef=Rte_Ev_Run_Common_Normal_Common_Normal_5msMainFunction, OsAlarmSetEventTaskRef=FUEL_TC_ODO
    GateWay (OsTask):
      OsTaskActivation = 1
      OsTaskPriority = 5
      OsTaskSchedule = FULL
      OsTaskEventRef = Rte_Ev_Run_Common_GateWay_Common_GateWay_10msMainFunction
      OsTaskEventRef = Rte_Ev_Run_Common_GateWay_Common_GateWay_5msMainFunction
      OsTaskEventRef = Rte_Ev_WP_GateWay
      OsTaskAccessingApplication = OsApplication_Trust_OsCore0
    Rte_Al_TE_Common_GateWay_Common_GateWay_10msMainFunction (OsAlarm): OsAlarmCounterRef=SystemTimer, OsAlarmAccessingApplication=OsApplication_Trust_OsCore0
      OsAlarmAction
        OsAlarmSetEvent: OsAlarmSetEventRef=Rte_Ev_Run_Common_GateWay_Common_GateWay_10msMainFunction, OsAlarmSetEventTaskRef=GateWay
    Rte_Al_TE_Common_GateWay_Common_GateWay_5msMainFunction (OsAlarm): OsAlarmCounterRef=SystemTimer, OsAlarmAccessingApplication=OsApplication_Trust_OsCore0
      OsAlarmAction
        OsAlarmSetEvent: OsAlarmSetEventRef=Rte_Ev_Run_Common_GateWay_Common_GateWay_5msMainFunction, OsAlarmSetEventTaskRef=GateWay
    IPC (OsTask):
      OsTaskActivation = 1
      OsTaskPriority = 6
      OsTaskSchedule = FULL
      OsTaskEventRef = Rte_Ev_Run_IPC_IPC_DataSend_If_Operation
      OsTaskEventRef = Rte_Ev_Run_IPC_IPC_MainFunction
      OsTaskEventRef = Rte_Ev_Run_IPC_IPC_STB_MainFunction
      OsTaskAccessingApplication = OsApplication_NonTrust_OsCore0
    Rte_Al_TE_IPC_IPC_MainFunction (OsAlarm): OsAlarmCounterRef=SystemTimer
      OsAlarmAction
        OsAlarmSetEvent: OsAlarmSetEventRef=Rte_Ev_Run_IPC_IPC_MainFunction, OsAlarmSetEventTaskRef=IPC
    Rte_Al_TE_IPC_IPC_STB_MainFunction (OsAlarm): OsAlarmCounterRef=SystemTimer
      OsAlarmAction
        OsAlarmSetEvent: OsAlarmSetEventRef=Rte_Ev_Run_IPC_IPC_STB_MainFunction, OsAlarmSetEventTaskRef=IPC
    SWC_LOW (OsTask):
      OsTaskActivation = 1
      OsTaskPriority = 3
      OsTaskSchedule = FULL
      OsTaskEventRef = Rte_Ev_Cyclic_SWC_LOW_0_10ms
      OsTaskEventRef = Rte_Ev_Run_DidDataProcess_E2ESwitchStatusRead
      OsTaskEventRef = Rte_Ev_Run_DidDataProcess_E2ESwitchStatusWrite
      OsTaskEventRef = Rte_Ev_Run_DidDataProcess_SecOcSwitchStatusRead
      OsTaskEventRef = Rte_Ev_Run_DidDataProcess_SecOcSwitchStatusWrite
      OsTaskEventRef = Rte_Ev_Run_EOL_EOL_MainFunction
      OsTaskEventRef = Rte_Ev_Run_SocDtcProcess_PpCS_AppClearDTCInfo_AppClearDTCInfo
      OsTaskEventRef = Rte_Ev_WP_SWC_LOW
      OsTaskAccessingApplication = OsApplication_NonTrust_OsCore0
    Rte_Al_TE_EOL_EOL_MainFunction (OsAlarm): OsAlarmCounterRef=SystemTimer
      OsAlarmAction
        OsAlarmSetEvent: OsAlarmSetEventRef=Rte_Ev_Run_EOL_EOL_MainFunction, OsAlarmSetEventTaskRef=SWC_LOW
    Rte_Al_TE_SWC_LOW_0_10ms (OsAlarm): OsAlarmCounterRef=SystemTimer
      OsAlarmAction
        OsAlarmSetEvent: OsAlarmSetEventRef=Rte_Ev_Cyclic_SWC_LOW_0_10ms, OsAlarmSetEventTaskRef=SWC_LOW
    SYS (OsTask):
      OsTaskActivation = 1
      OsTaskPriority = 7
      OsTaskSchedule = FULL
      OsTaskEventRef = Rte_Ev_Cyclic_SYS_0_100ms
      OsTaskEventRef = Rte_Ev_Cyclic_SYS_0_10ms
      OsTaskEventRef = Rte_Ev_Cyclic_SYS_0_50ms
      OsTaskEventRef = Rte_Ev_Cyclic_SYS_0_5ms
      OsTaskEventRef = Rte_Ev_Run_Can_Server_CanFrameCounter_Can_ABS3_Counter
      OsTaskEventRef = Rte_Ev_Run_Can_Server_CanFrameCounter_Can_ECM2_Counter
      OsTaskEventRef = Rte_Ev_Run_Can_Server_CanFrameCounter_Can_ESP_FD2_Counter
      OsTaskEventRef = Rte_Ev_Run_IoHwAb_IoHwAb_GetPin
      OsTaskEventRef = Rte_Ev_Run_IoHwAb_IoHwAb_GetVoltage
      OsTaskEventRef = Rte_Ev_Run_Misc_Misc_MainFunction_500ms
      OsTaskEventRef = Rte_Ev_Run_Vconfig_VConfig_GetKindConfig_Operation_VConfig_GetKindConfig
      OsTaskEventRef = Rte_Ev_Run_Vconfig_VConfig_GetUpdateTick_OperationVConfig_GetUpdateTick
      OsTaskEventRef = Rte_Ev_WP_SYS
      OsTaskAccessingApplication = OsApplication_NonTrust_OsCore0
    5 x OsAlarm, all with OsAlarmCounterRef=SystemTimer:
      Rte_Al_TE_Misc_Misc_MainFunction_500ms
        OsAlarmAction
          OsAlarmSetEvent: OsAlarmSetEventRef=Rte_Ev_Run_Misc_Misc_MainFunction_500ms, OsAlarmSetEventTaskRef=SYS
      Rte_Al_TE_SYS_0_100ms
        OsAlarmAction
          OsAlarmSetEvent: OsAlarmSetEventRef=Rte_Ev_Cyclic_SYS_0_100ms, OsAlarmSetEventTaskRef=SYS
      Rte_Al_TE_SYS_0_10ms
        OsAlarmAction
          OsAlarmSetEvent: OsAlarmSetEventRef=Rte_Ev_Cyclic_SYS_0_10ms, OsAlarmSetEventTaskRef=SYS
      Rte_Al_TE_SYS_0_50ms
        OsAlarmAction
          OsAlarmSetEvent: OsAlarmSetEventRef=Rte_Ev_Cyclic_SYS_0_50ms, OsAlarmSetEventTaskRef=SYS
      Rte_Al_TE_SYS_0_5ms
        OsAlarmAction
          OsAlarmSetEvent: OsAlarmSetEventRef=Rte_Ev_Cyclic_SYS_0_5ms, OsAlarmSetEventTaskRef=SYS
    TT_GEAR (OsTask):
      OsTaskActivation = 1
      OsTaskPriority = 6
      OsTaskSchedule = FULL
      OsTaskEventRef = Rte_Ev_Run_Common_Safety_Common_Safety_10msMainFunction
      OsTaskEventRef = Rte_Ev_Run_Common_Safety_Common_Safety_50msMainFunction
      OsTaskEventRef = Rte_Ev_WP_TT_GEAR
      OsTaskAccessingApplication = OsApplication_NonTrust_OsCore0
    Rte_Al_TE_Common_Safety_Common_Safety_10msMainFunction (OsAlarm): OsAlarmCounterRef=SystemTimer
      OsAlarmAction
        OsAlarmSetEvent: OsAlarmSetEventRef=Rte_Ev_Run_Common_Safety_Common_Safety_10msMainFunction, OsAlarmSetEventTaskRef=TT_GEAR
    Rte_Al_TE_Common_Safety_Common_Safety_50msMainFunction (OsAlarm): OsAlarmCounterRef=SystemTimer
      OsAlarmAction
        OsAlarmSetEvent: OsAlarmSetEventRef=Rte_Ev_Run_Common_Safety_Common_Safety_50msMainFunction, OsAlarmSetEventTaskRef=TT_GEAR
    83 x OsEvent:
      Rte_Ev_Cyclic2_BSW_COMM_0_10ms
      Rte_Ev_Cyclic2_BSW_COMM_0_2ms
      Rte_Ev_Cyclic2_BSW_COMM_0_5ms
      Rte_Ev_Cyclic2_BSW_DIAGNOSE_0_10ms
      Rte_Ev_Cyclic2_Default_BSW_0_10ms
      Rte_Ev_Cyclic2_Default_BSW_0_5ms
      Rte_Ev_Cyclic2_Default_BSW_1_5ms
      Rte_Ev_Cyclic_DRIVERS_SAFE_0_100ms
      Rte_Ev_Cyclic_DRIVERS_SAFE_0_50ms
      Rte_Ev_Cyclic_DRIVERS_SAFE_0_5ms
      Rte_Ev_Cyclic_SWC_LOW_0_10ms
      Rte_Ev_Cyclic_SYS_0_100ms
      Rte_Ev_Cyclic_SYS_0_10ms
      Rte_Ev_Cyclic_SYS_0_50ms
      Rte_Ev_Cyclic_SYS_0_5ms
      Rte_Ev_Run_AMP_AMP_Event_MainFunction
      Rte_Ev_Run_BswM_BswM_Read_PowerModeShutdownReq
      Rte_Ev_Run_BswM_BswM_Read_PowerModeShutdownReq_EmergencySleep
      Rte_Ev_Run_CConfig_CConfig_MainFunction
      Rte_Ev_Run_Can_Server_CNA_SignalGroupSet
      Rte_Ev_Run_Can_Server_CNA_SignalSet
      Rte_Ev_Run_Can_Server_CNA_SignalSetNoTrigger
      Rte_Ev_Run_Can_Server_CNA_SignalSet_U8N
      Rte_Ev_Run_Can_Server_CanFrameCounter_Can_ABS3_Counter
      Rte_Ev_Run_Can_Server_CanFrameCounter_Can_ECM2_Counter
      Rte_Ev_Run_Can_Server_CanFrameCounter_Can_ESP_FD2_Counter
      Rte_Ev_Run_ComEx_ComEx_GetRxE2EStatus
      Rte_Ev_Run_ComEx_ComEx_SendSignal
      Rte_Ev_Run_Common_GateWay_Common_GateWay_10msMainFunction
      Rte_Ev_Run_Common_GateWay_Common_GateWay_5msMainFunction
      Rte_Ev_Run_Common_Normal_Common_Normal_100msMainFunction
      Rte_Ev_Run_Common_Normal_Common_Normal_100msMainFunction_
      Rte_Ev_Run_Common_Normal_Common_Normal_10msMainFunction
      Rte_Ev_Run_Common_Normal_Common_Normal_10msMainFunction_
      Rte_Ev_Run_Common_Normal_Common_Normal_20msMainFunction
      Rte_Ev_Run_Common_Normal_Common_Normal_20msMainFunction_
      Rte_Ev_Run_Common_Normal_Common_Normal_20msMainFunction_A
      Rte_Ev_Run_Common_Normal_Common_Normal_20msMainFunction_B
      Rte_Ev_Run_Common_Normal_Common_Normal_5msMainFunction
      Rte_Ev_Run_Common_Normal_EOL_ReadDID0xFDD8_EOL_GetReadHardInputForCluster
      Rte_Ev_Run_Common_Normal_Fuel_Api_ParamentGetCsPort_Operation
      Rte_Ev_Run_Common_Safety_Common_Safety_10msMainFunction
      Rte_Ev_Run_Common_Safety_Common_Safety_50msMainFunction
      Rte_Ev_Run_DCM_Server_DCM_Server_MainFunction
      Rte_Ev_Run_DemSatellite_0_SetEventStatus
      Rte_Ev_Run_DidDataProcess_E2ESwitchStatusRead
      Rte_Ev_Run_DidDataProcess_E2ESwitchStatusWrite
      Rte_Ev_Run_DidDataProcess_SecOcSwitchStatusRead
      Rte_Ev_Run_DidDataProcess_SecOcSwitchStatusWrite
      Rte_Ev_Run_EOL_EOL_MainFunction
      Rte_Ev_Run_FvM_FvM_MainFunction
      Rte_Ev_Run_Gyro_Gyro_MainFunction
      Rte_Ev_Run_HSM_HsmGetAes128Key
      Rte_Ev_Run_HSM_HsmSetAes128Key
      Rte_Ev_Run_HSM_HsmTrngGenerate
      Rte_Ev_Run_HSM_Hsm_MainFunction
      Rte_Ev_Run_IIC_IIC0_MainFunction
      Rte_Ev_Run_IIC_IIC1_MainFunction
      Rte_Ev_Run_IPC_IPC_DataSend_If_Operation
      Rte_Ev_Run_IPC_IPC_MainFunction
      Rte_Ev_Run_IPC_IPC_STB_MainFunction
      Rte_Ev_Run_IoHwAb_IoHwAb_GetPin
      Rte_Ev_Run_IoHwAb_IoHwAb_GetVoltage
      Rte_Ev_Run_Misc_Misc_MainFunction_500ms
      Rte_Ev_Run_Misc_NVM_Read_Speedup_Runnable
      Rte_Ev_Run_NvM_WriteBlock
      Rte_Ev_Run_Os_OsCore0_swc_GetCounterValue
      Rte_Ev_Run_Os_OsCore0_swc_GetElapsedValue
      Rte_Ev_Run_RTC_GetUTCTimeInMillis
      Rte_Ev_Run_RTC_UTC2PerpetualCalendar
      Rte_Ev_Run_SecOc_Server_SecOc_Server_MainFunction
      Rte_Ev_Run_SocDtcProcess_PpCS_AppClearDTCInfo_AppClearDTCInfo
      Rte_Ev_Run_Vconfig_VConfig_GetKindConfig_Operation_VConfig_GetKindConfig
      Rte_Ev_Run_Vconfig_VConfig_GetUpdateTick_OperationVConfig_GetUpdateTick
      Rte_Ev_WP_BSW_COMM: OsEventMask=2
      Rte_Ev_WP_BSW_DIAGNOSE: OsEventMask=2
      Rte_Ev_WP_DRIVERS_SAFE: OsEventMask=2
      Rte_Ev_WP_Default_BSW: OsEventMask=2
      Rte_Ev_WP_FUEL_TC_ODO: OsEventMask=2
      Rte_Ev_WP_GateWay: OsEventMask=2
      Rte_Ev_WP_SWC_LOW: OsEventMask=2
      Rte_Ev_WP_SYS: OsEventMask=2
      Rte_Ev_WP_TT_GEAR: OsEventMask=2
    OsApplication_NonTrust_OsCore0 (OsApplication):
      OsTrusted = false
      OsAppTaskRef = FUEL_TC_ODO
      OsAppAlarmRef = Os/Rte_Al_TE_Common_Normal_Common_Normal_100msMainFunction
      OsAppAlarmRef = Os/Rte_Al_TE_Common_Normal_Common_Normal_100msMainFunction_
      OsAppAlarmRef = Os/Rte_Al_TE_Common_Normal_Common_Normal_10msMainFunction
      OsAppAlarmRef = Os/Rte_Al_TE_Common_Normal_Common_Normal_10msMainFunction_
      OsAppAlarmRef = Os/Rte_Al_TE_Common_Normal_Common_Normal_20msMainFunction
      OsAppAlarmRef = Os/Rte_Al_TE_Common_Normal_Common_Normal_20msMainFunction_
      OsAppAlarmRef = Os/Rte_Al_TE_Common_Normal_Common_Normal_20msMainFunction_A
      OsAppAlarmRef = Os/Rte_Al_TE_Common_Normal_Common_Normal_20msMainFunction_B
      OsAppAlarmRef = Os/Rte_Al_TE_Common_Normal_Common_Normal_5msMainFunction
      OsAppTaskRef = GateWay
      OsAppAlarmRef = Os/Rte_Al_TE_Common_GateWay_Common_GateWay_10msMainFunction
      OsAppAlarmRef = Os/Rte_Al_TE_Common_GateWay_Common_GateWay_5msMainFunction
    OsApplication_Trust_OsCore0 (OsApplication):
      OsTrusted = true
      OsAppUseTrustedFunctionStubs = true
      OsAppCalloutStubsIncludeHeader = usrostyp.h
      OsAppTaskRef = BSW_COMM
      OsAppAlarmRef = Os/Rte_Al_TE2_BSW_COMM_0_10ms
      OsAppAlarmRef = Os/Rte_Al_TE2_BSW_COMM_0_2ms
      OsAppAlarmRef = Os/Rte_Al_TE2_BSW_COMM_0_5ms
      OsAppAlarmRef = Os/Rte_Al_TE_CConfig_CConfig_MainFunction
      OsAppAlarmRef = Os/Rte_Al_TE_FvM_FvM_MainFunction
      OsAppAlarmRef = Os/Rte_Al_TE_SecOc_Server_SecOc_Server_MainFunction
      OsAppTaskRef = BSW_DIAGNOSE
      OsAppAlarmRef = Os/Rte_Al_TE2_BSW_DIAGNOSE_0_10ms
      OsAppTaskRef = DRIVERS_SAFE
      OsAppAlarmRef = Os/Rte_Al_TE_DRIVERS_SAFE_0_100ms
      OsAppAlarmRef = Os/Rte_Al_TE_DRIVERS_SAFE_0_50ms
      OsAppAlarmRef = Os/Rte_Al_TE_DRIVERS_SAFE_0_5ms
      OsAppAlarmRef = Os/Rte_Al_TE_Gyro_Gyro_MainFunction
      OsAppTaskRef = Default_BSW
      OsAppAlarmRef = Os/Rte_Al_TE2_Default_BSW_0_10ms
      OsAppAlarmRef = Os/Rte_Al_TE2_Default_BSW_0_5ms
      OsAppAlarmRef = Os/Rte_Al_TE2_Default_BSW_1_5ms
      OsAppAlarmRef = Os/Rte_Al_TE_DCM_Server_DCM_Server_MainFunction
      OsAppAlarmRef = Os/Rte_Al_TE_HSM_Hsm_MainFunction
      OsAppAlarmRef = Os/Rte_Al_TE_Misc_NVM_Read_Speedup_Runnable
      OsAppTaskRef = IPC
      OsAppAlarmRef = Os/Rte_Al_TE_IPC_IPC_MainFunction
      OsAppAlarmRef = Os/Rte_Al_TE_IPC_IPC_STB_MainFunction
      OsAppTaskRef = SWC_LOW
      OsAppAlarmRef = Os/Rte_Al_TE_EOL_EOL_MainFunction
      OsAppAlarmRef = Os/Rte_Al_TE_SWC_LOW_0_10ms
      OsAppTaskRef = SYS
      OsAppAlarmRef = Os/Rte_Al_TE_Misc_Misc_MainFunction_500ms
      OsAppAlarmRef = Os/Rte_Al_TE_SYS_0_100ms
      OsAppAlarmRef = Os/Rte_Al_TE_SYS_0_10ms
      OsAppAlarmRef = Os/Rte_Al_TE_SYS_0_50ms
      OsAppAlarmRef = Os/Rte_Al_TE_SYS_0_5ms
      OsAppTaskRef = TT_GEAR
      OsAppAlarmRef = Os/Rte_Al_TE_Common_Safety_Common_Safety_10msMainFunction
      OsAppAlarmRef = Os/Rte_Al_TE_Common_Safety_Common_Safety_50msMainFunction
      45 x OsApplicationTrustedFunction:
        Rte_TrustedCall_Common_GateWay_CNA_SignalGroupSet_Operation: OsTrustedFunctionName=Rte_TrustedCall_Common_GateWay_CNA_SignalGroupSet_Operation, OsTrustedFunctionReturnType=Std_ReturnType
          event_signal_info (OsTrustedFunctionParam): OsTrustedFunctionParamId=1, OsTrustedFunctionParamDataType=const EventSignalInfo_Type*, OsTrustedFunctionParamDirection=IN
        Rte_TrustedCall_Common_GateWay_CNA_SignalSet_Operation: OsTrustedFunctionName=Rte_TrustedCall_Common_GateWay_CNA_SignalSet_Operation, OsTrustedFunctionReturnType=Std_ReturnType
          signalId (OsTrustedFunctionParam): OsTrustedFunctionParamId=1, OsTrustedFunctionParamDataType=uint16, OsTrustedFunctionParamDirection=IN
          value (OsTrustedFunctionParam): OsTrustedFunctionParamId=2, OsTrustedFunctionParamDataType=uint32, OsTrustedFunctionParamDirection=IN_OUT
        Rte_TrustedCall_Common_GateWay_IPC_DataSend_If_Operation: OsTrustedFunctionName=Rte_TrustedCall_Common_GateWay_IPC_DataSend_If_Operation, OsTrustedFunctionReturnType=Std_ReturnType
          3 x OsTrustedFunctionParam:
            len: OsTrustedFunctionParamId=2, OsTrustedFunctionParamDataType=uint16, OsTrustedFunctionParamDirection=IN
            p_msg: OsTrustedFunctionParamId=1, OsTrustedFunctionParamDataType=uint8, OsTrustedFunctionParamDirection=IN_OUT
            priority: OsTrustedFunctionParamId=3, OsTrustedFunctionParamDataType=uint8, OsTrustedFunctionParamDirection=IN
        Rte_TrustedCall_Common_GateWay_NvMService_AC3_Defs_NvBlockNeed_Block_IPC_CAN_Data_WriteBlock: OsTrustedFunctionName=Rte_TrustedCall_Common_GateWay_NvMService_AC3_Defs_NvBlockNeed_Block_IPC_CAN_Data_WriteBlock, OsTrustedFunctionReturnType=Std_ReturnType
          SrcPtr (OsTrustedFunctionParam): OsTrustedFunctionParamId=1, OsTrustedFunctionParamDataType=dtRef_const_VOID, OsTrustedFunctionParamDirection=IN
        Rte_TrustedCall_Common_GateWay_NvMService_AC3_Defs_NvBlockNeed_Block_IPC_Config_Data_WriteBlock: OsTrustedFunctionName=Rte_TrustedCall_Common_GateWay_NvMService_AC3_Defs_NvBlockNeed_Block_IPC_Config_Data_WriteBlock, OsTrustedFunctionReturnType=Std_ReturnType
          SrcPtr (OsTrustedFunctionParam): OsTrustedFunctionParamId=1, OsTrustedFunctionParamDataType=dtRef_const_VOID, OsTrustedFunctionParamDirection=IN
        Rte_TrustedCall_Common_GateWay_VConfig_GetKindConfig_Operation_VConfig_GetKindConfig: OsTrustedFunctionName=Rte_TrustedCall_Common_GateWay_VConfig_GetKindConfig_Operation_VConfig_GetKindConfig, OsTrustedFunctionReturnType=Std_ReturnType
          kindConfig (OsTrustedFunctionParam): OsTrustedFunctionParamId=2, OsTrustedFunctionParamDataType=uint8, OsTrustedFunctionParamDirection=OUT
          kindId (OsTrustedFunctionParam): OsTrustedFunctionParamId=1, OsTrustedFunctionParamDataType=uint16, OsTrustedFunctionParamDirection=IN
        Rte_TrustedCall_Common_GateWay_rpCS_AppClearDTCInfo_AppClearDTCInfo: OsTrustedFunctionName=Rte_TrustedCall_Common_GateWay_rpCS_AppClearDTCInfo_AppClearDTCInfo, OsTrustedFunctionReturnType=Std_ReturnType
          OpStatus (OsTrustedFunctionParam): OsTrustedFunctionParamId=1, OsTrustedFunctionParamDataType=uint8, OsTrustedFunctionParamDirection=IN
          Result (OsTrustedFunctionParam): OsTrustedFunctionParamId=2, OsTrustedFunctionParamDataType=uint8, OsTrustedFunctionParamDirection=OUT
        Rte_TrustedCall_Common_GateWay_rpCS_SWCGateWay_CNA_SignalSetNoTrigger_Operation: OsTrustedFunctionName=Rte_TrustedCall_Common_GateWay_rpCS_SWCGateWay_CNA_SignalSetNoTrigger_Operation, OsTrustedFunctionReturnType=Std_ReturnType
          signalId (OsTrustedFunctionParam): OsTrustedFunctionParamId=1, OsTrustedFunctionParamDataType=uint16, OsTrustedFunctionParamDirection=IN
          value (OsTrustedFunctionParam): OsTrustedFunctionParamId=2, OsTrustedFunctionParamDataType=uint8, OsTrustedFunctionParamDirection=IN_OUT
        Rte_TrustedCall_Common_GateWay_rpCS_SWCGateWay_CNA_SignalSet_U8N_Operation: OsTrustedFunctionName=Rte_TrustedCall_Common_GateWay_rpCS_SWCGateWay_CNA_SignalSet_U8N_Operation, OsTrustedFunctionReturnType=Std_ReturnType
          signalId (OsTrustedFunctionParam): OsTrustedFunctionParamId=1, OsTrustedFunctionParamDataType=uint16, OsTrustedFunctionParamDirection=IN
          value (OsTrustedFunctionParam): OsTrustedFunctionParamId=2, OsTrustedFunctionParamDataType=EventSignalType, OsTrustedFunctionParamDirection=IN_OUT
        Rte_TrustedCall_Common_GateWay_rpCS_SWCGateWay_ComEx_GetRxE2EStatus: OsTrustedFunctionName=Rte_TrustedCall_Common_GateWay_rpCS_SWCGateWay_ComEx_GetRxE2EStatus, OsTrustedFunctionReturnType=Std_ReturnType
          E2eStatus (OsTrustedFunctionParam): OsTrustedFunctionParamId=2, OsTrustedFunctionParamDataType=uint32, OsTrustedFunctionParamDirection=OUT
          GroupId (OsTrustedFunctionParam): OsTrustedFunctionParamId=1, OsTrustedFunctionParamDataType=ComEx_SignalGroupIdType, OsTrustedFunctionParamDirection=IN
        Rte_TrustedCall_Common_GateWay_rpCS_SWCGateWay_ComEx_SendSignal: OsTrustedFunctionName=Rte_TrustedCall_Common_GateWay_rpCS_SWCGateWay_ComEx_SendSignal, OsTrustedFunctionReturnType=Std_ReturnType
          3 x OsTrustedFunctionParam, all with OsTrustedFunctionParamDirection=IN:
            Length: OsTrustedFunctionParamId=3, OsTrustedFunctionParamDataType=uint8
            SignalDataPtr: OsTrustedFunctionParamId=2, OsTrustedFunctionParamDataType=ComEx_ConstSignalDataType
            SignalId: OsTrustedFunctionParamId=1, OsTrustedFunctionParamDataType=ComEx_SignalIdType
        Rte_TrustedCall_Common_GateWay_rpCS_SWCGateWay_E2ESwitchStatusRead_Operation: OsTrustedFunctionName=Rte_TrustedCall_Common_GateWay_rpCS_SWCGateWay_E2ESwitchStatusRead_Operation, OsTrustedFunctionReturnType=Std_ReturnType
          3 x OsTrustedFunctionParam, all with OsTrustedFunctionParamDataType=uint8:
            Data: OsTrustedFunctionParamId=2, OsTrustedFunctionParamDirection=IN_OUT
            Length: OsTrustedFunctionParamId=1, OsTrustedFunctionParamDirection=IN
            Status: OsTrustedFunctionParamId=3, OsTrustedFunctionParamDirection=OUT
        Rte_TrustedCall_Common_GateWay_rpCS_SWCGateWay_E2ESwitchStatusWrite_Operation: OsTrustedFunctionName=Rte_TrustedCall_Common_GateWay_rpCS_SWCGateWay_E2ESwitchStatusWrite_Operation, OsTrustedFunctionReturnType=Std_ReturnType
          3 x OsTrustedFunctionParam, all with OsTrustedFunctionParamDataType=uint8:
            Data: OsTrustedFunctionParamId=2, OsTrustedFunctionParamDirection=IN_OUT
            Length: OsTrustedFunctionParamId=1, OsTrustedFunctionParamDirection=IN
            Status: OsTrustedFunctionParamId=3, OsTrustedFunctionParamDirection=OUT
        Rte_TrustedCall_Common_GateWay_rpCS_SWCGateWay_SecOcSwitchStatusRead_Operation: OsTrustedFunctionName=Rte_TrustedCall_Common_GateWay_rpCS_SWCGateWay_SecOcSwitchStatusRead_Operation, OsTrustedFunctionReturnType=Std_ReturnType
          3 x OsTrustedFunctionParam, all with OsTrustedFunctionParamDataType=uint8:
            Data: OsTrustedFunctionParamId=2, OsTrustedFunctionParamDirection=IN_OUT
            Length: OsTrustedFunctionParamId=1, OsTrustedFunctionParamDirection=IN
            Status: OsTrustedFunctionParamId=3, OsTrustedFunctionParamDirection=OUT
        Rte_TrustedCall_Common_GateWay_rpCS_SWCGateWay_SecOcSwitchStatusWrite_Operation: OsTrustedFunctionName=Rte_TrustedCall_Common_GateWay_rpCS_SWCGateWay_SecOcSwitchStatusWrite_Operation, OsTrustedFunctionReturnType=Std_ReturnType
          3 x OsTrustedFunctionParam, all with OsTrustedFunctionParamDataType=uint8:
            Data: OsTrustedFunctionParamId=2, OsTrustedFunctionParamDirection=IN_OUT
            Length: OsTrustedFunctionParamId=1, OsTrustedFunctionParamDirection=IN
            Status: OsTrustedFunctionParamId=3, OsTrustedFunctionParamDirection=OUT
        Rte_TrustedCall_Common_GateWay_rpCS_SWCGateway_UTCTime_UTC2PerpetualCalendar: OsTrustedFunctionName=Rte_TrustedCall_Common_GateWay_rpCS_SWCGateway_UTCTime_UTC2PerpetualCalendar, OsTrustedFunctionReturnType=Std_ReturnType
          date (OsTrustedFunctionParam): OsTrustedFunctionParamId=2, OsTrustedFunctionParamDataType=DateTimeType_t, OsTrustedFunctionParamDirection=OUT
          utc (OsTrustedFunctionParam): OsTrustedFunctionParamId=1, OsTrustedFunctionParamDataType=sint64, OsTrustedFunctionParamDirection=IN
        Rte_TrustedCall_Common_Normal_CanFrameCounter_Can_ABS3_Counter: OsTrustedFunctionName=Rte_TrustedCall_Common_Normal_CanFrameCounter_Can_ABS3_Counter, OsTrustedFunctionReturnType=Std_ReturnType
          counter (OsTrustedFunctionParam): OsTrustedFunctionParamId=1, OsTrustedFunctionParamDataType=CanFrameCounterType, OsTrustedFunctionParamDirection=OUT
        Rte_TrustedCall_Common_Normal_CanFrameCounter_Can_ECM2_Counter: OsTrustedFunctionName=Rte_TrustedCall_Common_Normal_CanFrameCounter_Can_ECM2_Counter, OsTrustedFunctionReturnType=Std_ReturnType
          counter (OsTrustedFunctionParam): OsTrustedFunctionParamId=1, OsTrustedFunctionParamDataType=CanFrameCounterType, OsTrustedFunctionParamDirection=OUT
        Rte_TrustedCall_Common_Normal_CanFrameCounter_Can_ESP_FD2_Counter: OsTrustedFunctionName=Rte_TrustedCall_Common_Normal_CanFrameCounter_Can_ESP_FD2_Counter, OsTrustedFunctionReturnType=Std_ReturnType
          counter (OsTrustedFunctionParam): OsTrustedFunctionParamId=1, OsTrustedFunctionParamDataType=CanFrameCounterType, OsTrustedFunctionParamDirection=OUT
        Rte_TrustedCall_Common_Normal_DiagnosticMonitor_Fuel_Sensor1_ShortToBAT_SetEventStatus: OsTrustedFunctionName=Rte_TrustedCall_Common_Normal_DiagnosticMonitor_Fuel_Sensor1_ShortToBAT_SetEventStatus, OsTrustedFunctionReturnType=Std_ReturnType
          EventStatus (OsTrustedFunctionParam): OsTrustedFunctionParamId=1, OsTrustedFunctionParamDataType=Dem_EventStatusType, OsTrustedFunctionParamDirection=IN
        Rte_TrustedCall_Common_Normal_DiagnosticMonitor_Fuel_Sensor1_ShortToGND_SetEventStatus: OsTrustedFunctionName=Rte_TrustedCall_Common_Normal_DiagnosticMonitor_Fuel_Sensor1_ShortToGND_SetEventStatus, OsTrustedFunctionReturnType=Std_ReturnType
          EventStatus (OsTrustedFunctionParam): OsTrustedFunctionParamId=1, OsTrustedFunctionParamDataType=Dem_EventStatusType, OsTrustedFunctionParamDirection=IN
        Rte_TrustedCall_Common_Normal_DiagnosticMonitor_Fuel_Sensor2_ShortToBAT_SetEventStatus: OsTrustedFunctionName=Rte_TrustedCall_Common_Normal_DiagnosticMonitor_Fuel_Sensor2_ShortToBAT_SetEventStatus, OsTrustedFunctionReturnType=Std_ReturnType
          EventStatus (OsTrustedFunctionParam): OsTrustedFunctionParamId=1, OsTrustedFunctionParamDataType=Dem_EventStatusType, OsTrustedFunctionParamDirection=IN
        Rte_TrustedCall_Common_Normal_DiagnosticMonitor_Fuel_Sensor2_ShortToGND_SetEventStatus: OsTrustedFunctionName=Rte_TrustedCall_Common_Normal_DiagnosticMonitor_Fuel_Sensor2_ShortToGND_SetEventStatus, OsTrustedFunctionReturnType=Std_ReturnType
          EventStatus (OsTrustedFunctionParam): OsTrustedFunctionParamId=1, OsTrustedFunctionParamDataType=Dem_EventStatusType, OsTrustedFunctionParamDirection=IN
        Rte_TrustedCall_Common_Normal_HsmKeyM_GetAes128Key: OsTrustedFunctionName=Rte_TrustedCall_Common_Normal_HsmKeyM_GetAes128Key, OsTrustedFunctionReturnType=Std_ReturnType
          3 x OsTrustedFunctionParam:
            IV: OsTrustedFunctionParamId=1, OsTrustedFunctionParamDataType=A_17Bytes, OsTrustedFunctionParamDirection=OUT
            KEY: OsTrustedFunctionParamId=2, OsTrustedFunctionParamDataType=A_16Bytes, OsTrustedFunctionParamDirection=OUT
            key_len: OsTrustedFunctionParamId=3, OsTrustedFunctionParamDataType=uint32, OsTrustedFunctionParamDirection=IN_OUT
        Rte_TrustedCall_Common_Normal_HsmKeyM_SetAes128Key: OsTrustedFunctionName=Rte_TrustedCall_Common_Normal_HsmKeyM_SetAes128Key, OsTrustedFunctionReturnType=Std_ReturnType
          3 x OsTrustedFunctionParam, all with OsTrustedFunctionParamDirection=IN:
            IV: OsTrustedFunctionParamId=1, OsTrustedFunctionParamDataType=const A_16Bytes*
            KEY: OsTrustedFunctionParamId=2, OsTrustedFunctionParamDataType=const A_16Bytes*
            key_len: OsTrustedFunctionParamId=3, OsTrustedFunctionParamDataType=uint32
        Rte_TrustedCall_Common_Normal_Hsm_Port_TrngGenerate: OsTrustedFunctionName=Rte_TrustedCall_Common_Normal_Hsm_Port_TrngGenerate, OsTrustedFunctionReturnType=Std_ReturnType
          Trng (OsTrustedFunctionParam): OsTrustedFunctionParamId=1, OsTrustedFunctionParamDataType=A_16Bytes, OsTrustedFunctionParamDirection=OUT
          len (OsTrustedFunctionParam): OsTrustedFunctionParamId=2, OsTrustedFunctionParamDataType=uint32, OsTrustedFunctionParamDirection=IN_OUT
        Rte_TrustedCall_Common_Normal_IRTC_Service_GetUTCTimeInMillis: OsTrustedFunctionName=Rte_TrustedCall_Common_Normal_IRTC_Service_GetUTCTimeInMillis, OsTrustedFunctionReturnType=Std_ReturnType
          arg (OsTrustedFunctionParam): OsTrustedFunctionParamId=1, OsTrustedFunctionParamDataType=uint64, OsTrustedFunctionParamDirection=OUT
        Rte_TrustedCall_Common_Normal_IRTC_Service_UTC2PerpetualCalendar: OsTrustedFunctionName=Rte_TrustedCall_Common_Normal_IRTC_Service_UTC2PerpetualCalendar, OsTrustedFunctionReturnType=Std_ReturnType
          date (OsTrustedFunctionParam): OsTrustedFunctionParamId=2, OsTrustedFunctionParamDataType=DateTimeType_t, OsTrustedFunctionParamDirection=OUT
          utc (OsTrustedFunctionParam): OsTrustedFunctionParamId=1, OsTrustedFunctionParamDataType=sint64, OsTrustedFunctionParamDirection=IN
        Rte_TrustedCall_Common_Normal_IoHwAb_Interface_GetPin: OsTrustedFunctionName=Rte_TrustedCall_Common_Normal_IoHwAb_Interface_GetPin, OsTrustedFunctionReturnType=Std_ReturnType
          Id (OsTrustedFunctionParam): OsTrustedFunctionParamId=1, OsTrustedFunctionParamDataType=uint8, OsTrustedFunctionParamDirection=IN
          Pin (OsTrustedFunctionParam): OsTrustedFunctionParamId=2, OsTrustedFunctionParamDataType=boolean, OsTrustedFunctionParamDirection=OUT
        Rte_TrustedCall_Common_Normal_IoHwAb_Interface_GetVoltage: OsTrustedFunctionName=Rte_TrustedCall_Common_Normal_IoHwAb_Interface_GetVoltage, OsTrustedFunctionReturnType=Std_ReturnType
          Id (OsTrustedFunctionParam): OsTrustedFunctionParamId=1, OsTrustedFunctionParamDataType=uint8, OsTrustedFunctionParamDirection=IN
          Voltage (OsTrustedFunctionParam): OsTrustedFunctionParamId=2, OsTrustedFunctionParamDataType=uint32, OsTrustedFunctionParamDirection=OUT
        Rte_TrustedCall_Common_Normal_NvMService_AC3_SRBS_Defs_NvBlockNeed_Block_MaintainOdo_WriteBlock: OsTrustedFunctionName=Rte_TrustedCall_Common_Normal_NvMService_AC3_SRBS_Defs_NvBlockNeed_Block_MaintainOdo_WriteBlock, OsTrustedFunctionReturnType=Std_ReturnType
          SrcPtr (OsTrustedFunctionParam): OsTrustedFunctionParamId=1, OsTrustedFunctionParamDataType=dtRef_const_VOID, OsTrustedFunctionParamDirection=IN
        Rte_TrustedCall_Common_Normal_NvMService_AC3_SRBS_Defs_NvBlockNeed_Block_ODO_1_WriteBlock: OsTrustedFunctionName=Rte_TrustedCall_Common_Normal_NvMService_AC3_SRBS_Defs_NvBlockNeed_Block_ODO_1_WriteBlock, OsTrustedFunctionReturnType=Std_ReturnType
          SrcPtr (OsTrustedFunctionParam): OsTrustedFunctionParamId=1, OsTrustedFunctionParamDataType=dtRef_const_VOID, OsTrustedFunctionParamDirection=IN
        Rte_TrustedCall_Common_Normal_NvMService_AC3_SRBS_Defs_NvBlockNeed_Block_ODO_2_WriteBlock: OsTrustedFunctionName=Rte_TrustedCall_Common_Normal_NvMService_AC3_SRBS_Defs_NvBlockNeed_Block_ODO_2_WriteBlock, OsTrustedFunctionReturnType=Std_ReturnType
          SrcPtr (OsTrustedFunctionParam): OsTrustedFunctionParamId=1, OsTrustedFunctionParamDataType=dtRef_const_VOID, OsTrustedFunctionParamDirection=IN
        Rte_TrustedCall_Common_Normal_NvMService_AC3_SRBS_Defs_NvBlockNeed_Block_ODO_3_WriteBlock: OsTrustedFunctionName=Rte_TrustedCall_Common_Normal_NvMService_AC3_SRBS_Defs_NvBlockNeed_Block_ODO_3_WriteBlock, OsTrustedFunctionReturnType=Std_ReturnType
          SrcPtr (OsTrustedFunctionParam): OsTrustedFunctionParamId=1, OsTrustedFunctionParamDataType=dtRef_const_VOID, OsTrustedFunctionParamDirection=IN
        Rte_TrustedCall_Common_Normal_NvMService_AC3_SRBS_Defs_NvBlockNeed_Block_ODO_4_WriteBlock: OsTrustedFunctionName=Rte_TrustedCall_Common_Normal_NvMService_AC3_SRBS_Defs_NvBlockNeed_Block_ODO_4_WriteBlock, OsTrustedFunctionReturnType=Std_ReturnType
          SrcPtr (OsTrustedFunctionParam): OsTrustedFunctionParamId=1, OsTrustedFunctionParamDataType=dtRef_const_VOID, OsTrustedFunctionParamDirection=IN
        Rte_TrustedCall_Common_Normal_NvMService_AC3_SRBS_Defs_NvBlockNeed_Block_ODO_5_WriteBlock: OsTrustedFunctionName=Rte_TrustedCall_Common_Normal_NvMService_AC3_SRBS_Defs_NvBlockNeed_Block_ODO_5_WriteBlock, OsTrustedFunctionReturnType=Std_ReturnType
          SrcPtr (OsTrustedFunctionParam): OsTrustedFunctionParamId=1, OsTrustedFunctionParamDataType=dtRef_const_VOID, OsTrustedFunctionParamDirection=IN
        Rte_TrustedCall_Common_Normal_NvMService_AC3_SRBS_Defs_NvBlockNeed_Block_Trip_WriteBlock: OsTrustedFunctionName=Rte_TrustedCall_Common_Normal_NvMService_AC3_SRBS_Defs_NvBlockNeed_Block_Trip_WriteBlock, OsTrustedFunctionReturnType=Std_ReturnType
          SrcPtr (OsTrustedFunctionParam): OsTrustedFunctionParamId=1, OsTrustedFunctionParamDataType=dtRef_const_VOID, OsTrustedFunctionParamDirection=IN
        Rte_TrustedCall_Common_Normal_NvMService_AC3_SRBS_NvBlockNeed_Menu_WriteBlock: OsTrustedFunctionName=Rte_TrustedCall_Common_Normal_NvMService_AC3_SRBS_NvBlockNeed_Menu_WriteBlock, OsTrustedFunctionReturnType=Std_ReturnType
          SrcPtr (OsTrustedFunctionParam): OsTrustedFunctionParamId=1, OsTrustedFunctionParamDataType=dtRef_const_VOID, OsTrustedFunctionParamDirection=IN
        Rte_TrustedCall_Common_Normal_Os_Service_GetCounterValue: OsTrustedFunctionName=Rte_TrustedCall_Common_Normal_Os_Service_GetCounterValue, OsTrustedFunctionReturnType=Std_ReturnType
          Value (OsTrustedFunctionParam): OsTrustedFunctionParamId=1, OsTrustedFunctionParamDataType=TimeInMicrosecondsType, OsTrustedFunctionParamDirection=OUT
        Rte_TrustedCall_Common_Normal_Os_Service_GetElapsedValue: OsTrustedFunctionName=Rte_TrustedCall_Common_Normal_Os_Service_GetElapsedValue, OsTrustedFunctionReturnType=Std_ReturnType
          ElapsedValue (OsTrustedFunctionParam): OsTrustedFunctionParamId=2, OsTrustedFunctionParamDataType=TimeInMicrosecondsType, OsTrustedFunctionParamDirection=OUT
          Value (OsTrustedFunctionParam): OsTrustedFunctionParamId=1, OsTrustedFunctionParamDataType=TimeInMicrosecondsType, OsTrustedFunctionParamDirection=IN_OUT
        Rte_TrustedCall_Common_Normal_VConfig_GetKindConfig_Operation_VConfig_GetKindConfig: OsTrustedFunctionName=Rte_TrustedCall_Common_Normal_VConfig_GetKindConfig_Operation_VConfig_GetKindConfig, OsTrustedFunctionReturnType=Std_ReturnType
          kindConfig (OsTrustedFunctionParam): OsTrustedFunctionParamId=2, OsTrustedFunctionParamDataType=uint8, OsTrustedFunctionParamDirection=OUT
          kindId (OsTrustedFunctionParam): OsTrustedFunctionParamId=1, OsTrustedFunctionParamDataType=uint16, OsTrustedFunctionParamDirection=IN
        Rte_TrustedCall_Common_Normal_VConfig_GetUpdateTick_OperationVConfig_GetUpdateTick: OsTrustedFunctionName=Rte_TrustedCall_Common_Normal_VConfig_GetUpdateTick_OperationVConfig_GetUpdateTick, OsTrustedFunctionReturnType=Std_ReturnType
          updateTick (OsTrustedFunctionParam): OsTrustedFunctionParamId=1, OsTrustedFunctionParamDataType=TimeInMicrosecondsType, OsTrustedFunctionParamDirection=OUT
        Rte_TrustedCall_Common_Normal_rpCS_SWCNormal_ComEx_GetRxE2EStatus: OsTrustedFunctionName=Rte_TrustedCall_Common_Normal_rpCS_SWCNormal_ComEx_GetRxE2EStatus, OsTrustedFunctionReturnType=Std_ReturnType
          E2eStatus (OsTrustedFunctionParam): OsTrustedFunctionParamId=2, OsTrustedFunctionParamDataType=uint32, OsTrustedFunctionParamDirection=OUT
          GroupId (OsTrustedFunctionParam): OsTrustedFunctionParamId=1, OsTrustedFunctionParamDataType=ComEx_SignalGroupIdType, OsTrustedFunctionParamDirection=IN
        Rte_TrustedCall_Common_Normal_rpCS_SWCNormal_ComEx_SendSignal: OsTrustedFunctionName=Rte_TrustedCall_Common_Normal_rpCS_SWCNormal_ComEx_SendSignal, OsTrustedFunctionReturnType=Std_ReturnType
          3 x OsTrustedFunctionParam, all with OsTrustedFunctionParamDirection=IN:
            Length: OsTrustedFunctionParamId=3, OsTrustedFunctionParamDataType=uint8
            SignalDataPtr: OsTrustedFunctionParamId=2, OsTrustedFunctionParamDataType=ComEx_ConstSignalDataType
            SignalId: OsTrustedFunctionParamId=1, OsTrustedFunctionParamDataType=ComEx_SignalIdType
        Rte_TrustedCom_SendSignal: OsTrustedFunctionName=Rte_TrustedCom_SendSignal, OsTrustedFunctionReturnType=uint8
          SignalDataPtr (OsTrustedFunctionParam): OsTrustedFunctionParamId=2, OsTrustedFunctionParamDataType=const void*, OsTrustedFunctionParamDirection=IN
          SignalId (OsTrustedFunctionParam): OsTrustedFunctionParamId=1, OsTrustedFunctionParamDataType=Com_SignalIdType, OsTrustedFunctionParamDirection=IN
    OsIoc: OsIocIncludeHeader=usrostyp.h
      Rte_Common_Normal_Rc_Cluster_Shutdown_Status_Element (OsIocCommunication)
        OsIocDataProperties0 (OsIocDataProperties):
          OsIocDataType = uint8
          OsIocInitValue = Rte_IocInitValue_Common_Normal_Rc_Cluster_Shutdown_Status_Element
          OsIocDataPropertyIndex = 0
          OsIocDataTypeIsAtomic = true
        OsIocReceiverProperties: OsIocReceivingOsApplicationRef=OsApplication_NonTrust_OsCore0
        OsIocSenderProperties0 (OsIocSenderProperties): OsIocSenderId=0, OsIocSendingOsApplicationRef=OsApplication_NonTrust_OsCore0
        OsIocSenderProperties1 (OsIocSenderProperties): OsIocSenderId=1, OsIocSendingOsApplicationRef=OsApplication_Trust_OsCore0
      Rte_Power_Rc_Cluster_Shutdown_Status_Element (OsIocCommunication)
        OsIocDataProperties0 (OsIocDataProperties):
          OsIocDataType = uint8
          OsIocInitValue = Rte_IocInitValue_Power_Rc_Cluster_Shutdown_Status_Element
          OsIocDataPropertyIndex = 0
          OsIocDataTypeIsAtomic = true
        OsIocReceiverProperties: OsIocReceivingOsApplicationRef=OsApplication_Trust_OsCore0
        OsIocSenderProperties0 (OsIocSenderProperties): OsIocSenderId=0, OsIocSendingOsApplicationRef=OsApplication_NonTrust_OsCore0
        OsIocSenderProperties1 (OsIocSenderProperties): OsIocSenderId=1, OsIocSendingOsApplicationRef=OsApplication_Trust_OsCore0
  module config EcuC
  ecuc value collection DaVinci_Project: ecuc-values=[Com, Rte, Os, EcuC, NvM]
